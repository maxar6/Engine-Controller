ASAP2_VERSION 1 51
/begin PROJECT Project ""
/begin MODULE BaseEngin_034 ""
/begin MOD_COMMON /* MOD_COMMON Comment */ "" BYTE_ORDER MSB_FIRST ALIGNMENT_BYTE 1 ALIGNMENT_FLOAT32_IEEE 1 ALIGNMENT_FLOAT64_IEEE 1 ALIGNMENT_LONG 1 ALIGNMENT_WORD 1 /end MOD_COMMON
/begin MEASUREMENT ETC_IGainMult "Multiplier on the ETC I gain based on ETC error." FLOAT32_IEEE CompuMethod_2 1 0 -1E+17 1E+17 ECU_ADDRESS 0x40000451 /end MEASUREMENT
/begin MEASUREMENT ETC_PGainMult "Multiplier on the ETC P gain based on ETC error." FLOAT32_IEEE CompuMethod_2 1 0 -1E+17 1E+17 ECU_ADDRESS 0x40000455 /end MEASUREMENT
/begin MEASUREMENT ETC_ShutdownSetpointMode "Shutdown mode for ETC setpoint. 0=Passthrough, 1=LoAdapt, 2=SpringTest." SBYTE CompuMethod_1 1 0 -128 127 ECU_ADDRESS 0x40000463 /end MEASUREMENT
/begin MEASUREMENT ETCDamperSwtichState "" UBYTE CompuMethod_12 1 0 0 1 ECU_ADDRESS 0x4000046C /end MEASUREMENT
/begin MEASUREMENT ETCDamperTPS "" FLOAT32_IEEE CompuMethod_2 1 0 -1E+17 1E+17 ECU_ADDRESS 0x4000046D /end MEASUREMENT
/begin MEASUREMENT ETCDamperTPSThresh "" FLOAT32_IEEE CompuMethod_2 1 0 -1E+17 1E+17 ECU_ADDRESS 0x40000471 /end MEASUREMENT
/begin MEASUREMENT ETCStallAppOvrReq "" FLOAT32_IEEE CompuMethod_9 1 0 -1E+17 1E+17 ECU_ADDRESS 0x400004A6 /end MEASUREMENT
/begin MEASUREMENT ETCStallIceBreakReq "" FLOAT32_IEEE CompuMethod_9 1 0 -1E+17 1E+17 ECU_ADDRESS 0x400004AA /end MEASUREMENT
/begin MEASUREMENT ETCStallReq "" FLOAT32_IEEE CompuMethod_9 1 0 -1E+17 1E+17 ECU_ADDRESS 0x400004AE /end MEASUREMENT
/begin MEASUREMENT ETCStallStateShutdown "" UBYTE CompuMethod_10 1 0 0 1 ECU_ADDRESS 0x400004B2 /end MEASUREMENT
/begin MEASUREMENT Ethanol_Spk_Ofst "Total Spark Offset based on ECT, IAT2, engine speed and load" FLOAT32_IEEE CompuMethod_88 1 0 -1E+17 1E+17 ECU_ADDRESS 0x400004B3 /end MEASUREMENT
/begin MEASUREMENT Ethanol_SpkOfstMult "Multiplier on ECT spark offset table." FLOAT32_IEEE CompuMethod_29 1 0 -1E+17 1E+17 ECU_ADDRESS 0x400004B7 /end MEASUREMENT
/begin MEASUREMENT EthSpkMod "Spark advance as a function of ethanol %" FLOAT32_IEEE CompuMethod_70 1 0 -1E+17 1E+17 ECU_ADDRESS 0x400004BB /end MEASUREMENT
/begin MEASUREMENT EVAP "Final value after Linear Sensor Characterization" FLOAT32_IEEE CompuMethod_59 1 0 -1E+17 1E+17 ECU_ADDRESS 0x400004BF /end MEASUREMENT
/begin MEASUREMENT EVAPADC "Signal measured directly from sensor" UWORD CompuMethod_17 1 0 0 65535 ECU_ADDRESS 0x400004C3 /end MEASUREMENT
/begin MEASUREMENT EVAPIdx "Look up table to allownon-linear characterization of sensors" UWORD CompuMethod_15 1 0 0 127.998 ECU_ADDRESS 0x400004C5 /end MEASUREMENT
/begin MEASUREMENT EVAPRaw "After conversion to engineering units, before range checking" FLOAT32_IEEE CompuMethod_59 1 0 -1E+17 1E+17 ECU_ADDRESS 0x400004C7 /end MEASUREMENT
/begin MEASUREMENT FAN1_PWMDutyCycle "Actual duty cycle of actuator" FLOAT32_IEEE CompuMethod_9 1 0 -1E+17 1E+17 ECU_ADDRESS 0x400004CB /end MEASUREMENT
/begin MEASUREMENT FAN2_PWMDutyCycle "Actual duty cycle of actuator" FLOAT32_IEEE CompuMethod_9 1 0 -1E+17 1E+17 ECU_ADDRESS 0x400004D3 /end MEASUREMENT
/begin MEASUREMENT FaultActionReason._.CutThrottle "Displays a rolling marquee of the reasons for fault action: FaultActionReason." UBYTE CompuMethod_103 1 0 0 255 ECU_ADDRESS 0x400004DB /end MEASUREMENT
/begin MEASUREMENT FaultActionReason._.DFCODisable "Displays a rolling marquee of the reasons for fault action: FaultActionReason." UBYTE CompuMethod_103 1 0 0 255 ECU_ADDRESS 0x400004DC /end MEASUREMENT
/begin MEASUREMENT FaultActionReason._.DelayedEngineShutdown "Displays a rolling marquee of the reasons for fault action: FaultActionReason." UBYTE CompuMethod_103 1 0 0 255 ECU_ADDRESS 0x400004DD /end MEASUREMENT
/begin MEASUREMENT FaultActionReason._.DisableAC "Displays a rolling marquee of the reasons for fault action: FaultActionReason." UBYTE CompuMethod_103 1 0 0 255 ECU_ADDRESS 0x400004DE /end MEASUREMENT
/begin MEASUREMENT FaultActionReason._.DisableFanRun "Displays a rolling marquee of the reasons for fault action: FaultActionReason." UBYTE CompuMethod_103 1 0 0 255 ECU_ADDRESS 0x400004DF /end MEASUREMENT
/begin MEASUREMENT FaultActionReason._.DisableFanStall "Displays a rolling marquee of the reasons for fault action: FaultActionReason." UBYTE CompuMethod_103 1 0 0 255 ECU_ADDRESS 0x400004E0 /end MEASUREMENT
/begin MEASUREMENT FaultActionReason._.DisableO2Ctrl "Displays a rolling marquee of the reasons for fault action: FaultActionReason." UBYTE CompuMethod_103 1 0 0 255 ECU_ADDRESS 0x400004E1 /end MEASUREMENT
/begin MEASUREMENT FaultActionReason._.DisableVEAdapt "Displays a rolling marquee of the reasons for fault action: FaultActionReason." UBYTE CompuMethod_103 1 0 0 255 ECU_ADDRESS 0x400004E2 /end MEASUREMENT
/begin MEASUREMENT FaultActionReason._.DisableWastegate "Displays a rolling marquee of the reasons for fault action: FaultActionReason." UBYTE CompuMethod_103 1 0 0 255 ECU_ADDRESS 0x400004E3 /end MEASUREMENT
/begin MEASUREMENT FaultActionReason._.EngineProtectLED "Displays a rolling marquee of the reasons for fault action: FaultActionReason." UBYTE CompuMethod_103 1 0 0 255 ECU_ADDRESS 0x400004E4 /end MEASUREMENT
/begin MEASUREMENT FaultActionReason._.EngineShutdown "Displays a rolling marquee of the reasons for fault action: FaultActionReason." UBYTE CompuMethod_103 1 0 0 255 ECU_ADDRESS 0x400004E5 /end MEASUREMENT
/begin MEASUREMENT FaultActionReason._.HardRevLimit "Displays a rolling marquee of the reasons for fault action: FaultActionReason." UBYTE CompuMethod_103 1 0 0 255 ECU_ADDRESS 0x400004E6 /end MEASUREMENT
/begin MEASUREMENT FaultActionReason._.MIL_LED "Displays a rolling marquee of the reasons for fault action: FaultActionReason." UBYTE CompuMethod_103 1 0 0 255 ECU_ADDRESS 0x400004E7 /end MEASUREMENT
/begin MEASUREMENT FaultActionReason._.MediumRevLimit "Displays a rolling marquee of the reasons for fault action: FaultActionReason." UBYTE CompuMethod_103 1 0 0 255 ECU_ADDRESS 0x400004E8 /end MEASUREMENT
/begin MEASUREMENT FaultActionReason._.SoftRevLimit "Displays a rolling marquee of the reasons for fault action: FaultActionReason." UBYTE CompuMethod_103 1 0 0 255 ECU_ADDRESS 0x400004E9 /end MEASUREMENT
/begin MEASUREMENT Fuel_Economy_Filtered "" FLOAT32_IEEE CompuMethod_2 1 0 -1E+17 1E+17 ECU_ADDRESS 0x400004F9 MATRIX_DIM 8 1 1 /end MEASUREMENT
/begin MEASUREMENT Fuel_Economy_Inst "" FLOAT32_IEEE CompuMethod_2 1 0 -1E+17 1E+17 ECU_ADDRESS 0x40000519 MATRIX_DIM 8 1 1 /end MEASUREMENT
/begin MEASUREMENT Fuel_Lvl "Final value after Linear Sensor Characterization" FLOAT32_IEEE CompuMethod_9 1 0 -1E+17 1E+17 ECU_ADDRESS 0x40000539 /end MEASUREMENT
/begin MEASUREMENT Fuel_LvlADC "Signal measured directly from sensor" UWORD CompuMethod_17 1 0 0 65535 ECU_ADDRESS 0x4000053D /end MEASUREMENT
/begin MEASUREMENT Fuel_LvlIdx "Look up table to allownon-linear characterization of sensors" UWORD CompuMethod_15 1 0 0 127.998 ECU_ADDRESS 0x4000053F /end MEASUREMENT
/begin MEASUREMENT Fuel_LvlRaw "After conversion to engineering units, before range checking" FLOAT32_IEEE CompuMethod_9 1 0 -1E+17 1E+17 ECU_ADDRESS 0x40000541 /end MEASUREMENT
/begin MEASUREMENT FuelDeltaPress "Fuel Delta Pressure - across the fuel injector" FLOAT32_IEEE CompuMethod_16 1 0 -1E+17 1E+17 ECU_ADDRESS 0x40000556 /end MEASUREMENT
/begin MEASUREMENT FuelDeltaPressure "Fuel pressure across injector (rail - manifold)" FLOAT32_IEEE CompuMethod_16 1 0 -1E+17 1E+17 ECU_ADDRESS 0x4000055A /end MEASUREMENT
/begin MEASUREMENT FuelLevel_FiltConst "FuelLevel_FiltConst" FLOAT32_IEEE CompuMethod_19 1 0 -1E+17 1E+17 ECU_ADDRESS 0x4000056A /end MEASUREMENT
/begin MEASUREMENT FuelLevel_FiltConstColIdx "FuelLevel_FiltConst" UWORD CompuMethod_15 1 0 0 127.998 ECU_ADDRESS 0x4000056E /end MEASUREMENT
/begin MEASUREMENT FuelLevel_FiltConstColIn "FuelLevel_FiltConst" FLOAT32_IEEE CompuMethod_111 1 0 -1E+17 1E+17 ECU_ADDRESS 0x40000570 /end MEASUREMENT
/begin MEASUREMENT FuelLevel_FiltConstRowIdx "FuelLevel_FiltConst" UWORD CompuMethod_15 1 0 0 127.998 ECU_ADDRESS 0x40000574 /end MEASUREMENT
/begin MEASUREMENT FuelLevel_FiltConstRowIn "FuelLevel_FiltConst" FLOAT32_IEEE CompuMethod_19 1 0 -1E+17 1E+17 ECU_ADDRESS 0x40000576 /end MEASUREMENT
/begin MEASUREMENT FuelLevel_RefuelEvent "" UBYTE CompuMethod_12 1 0 0 1 ECU_ADDRESS 0x4000057A /end MEASUREMENT
/begin MEASUREMENT FuelLvl_Fin "" FLOAT32_IEEE CompuMethod_2 1 0 -1E+17 1E+17 ECU_ADDRESS 0x4000057B /end MEASUREMENT
/begin MEASUREMENT FuelLvl_NVM_Prb "" FLOAT32_IEEE CompuMethod_2 1 0 -1E+17 1E+17 ECU_ADDRESS 0x4000057F /end MEASUREMENT
/begin MEASUREMENT FUELP "Display output in engineering units" UBYTE CompuMethod_6 1 0 0 1 ECU_ADDRESS 0x40000583 /end MEASUREMENT
/begin MEASUREMENT FuelPres "Final value after Linear Sensor Characterization" FLOAT32_IEEE CompuMethod_13 1 0 -1E+17 1E+17 ECU_ADDRESS 0x40000584 /end MEASUREMENT
/begin MEASUREMENT FuelPresADC "Singal measured directly from sensor" UWORD CompuMethod_17 1 0 0 65535 ECU_ADDRESS 0x40000588 /end MEASUREMENT
/begin MEASUREMENT FuelPresRaw "After conversion to engineering units, before range checking" FLOAT32_IEEE CompuMethod_13 1 0 -1E+17 1E+17 ECU_ADDRESS 0x4000058A /end MEASUREMENT
/begin MEASUREMENT FuelSens "Final value after Linear Sensor Characterization" FLOAT32_IEEE CompuMethod_9 1 0 -1E+17 1E+17 ECU_ADDRESS 0x40000592 /end MEASUREMENT
/begin MEASUREMENT FuelSensADC "Singal measured directly from sensor" ULONG CompuMethod_113 1 0 0 4294970000 ECU_ADDRESS 0x40000596 /end MEASUREMENT
/begin MEASUREMENT FuelSensRaw "After conversion to engineering units, before range checking" FLOAT32_IEEE CompuMethod_9 1 0 -1E+17 1E+17 ECU_ADDRESS 0x4000059A /end MEASUREMENT
/begin MEASUREMENT GearEstimated "" FLOAT32_IEEE CompuMethod_2 1 0 -1E+17 1E+17 ECU_ADDRESS 0x4000059E /end MEASUREMENT
/begin MEASUREMENT GPS_Altitude_Prb "" FLOAT32_IEEE CompuMethod_2 1 0 -1E+17 1E+17 ECU_ADDRESS 0x400005A6 /end MEASUREMENT
/begin MEASUREMENT GPS_Course_Prb "" FLOAT32_IEEE CompuMethod_2 1 0 -1E+17 1E+17 ECU_ADDRESS 0x400005AA /end MEASUREMENT
/begin MEASUREMENT GPS_DayUTC_Prb "" UBYTE CompuMethod_1 1 0 0 255 ECU_ADDRESS 0x400005AE /end MEASUREMENT
/begin MEASUREMENT GPS_HoursUTC_Prb "" UBYTE CompuMethod_1 1 0 0 255 ECU_ADDRESS 0x400005AF /end MEASUREMENT
/begin MEASUREMENT GPS_Latitude_Prb "" FLOAT32_IEEE CompuMethod_2 1 0 -1E+17 1E+17 ECU_ADDRESS 0x400005B0 /end MEASUREMENT
/begin MEASUREMENT GPS_Longitude_Prb "" FLOAT32_IEEE CompuMethod_2 1 0 -1E+17 1E+17 ECU_ADDRESS 0x400005B4 /end MEASUREMENT
/begin MEASUREMENT GPS_MinutesUTC_Prb "" UBYTE CompuMethod_1 1 0 0 255 ECU_ADDRESS 0x400005B8 /end MEASUREMENT
/begin MEASUREMENT GPS_MonthUTC_Prb "" UBYTE CompuMethod_1 1 0 0 255 ECU_ADDRESS 0x400005B9 /end MEASUREMENT
/begin MEASUREMENT GPS_SatelliteCount_Prb "" UBYTE CompuMethod_1 1 0 0 255 ECU_ADDRESS 0x400005BA /end MEASUREMENT
/begin MEASUREMENT GPS_SecondsUTC_Prb "" UBYTE CompuMethod_1 1 0 0 255 ECU_ADDRESS 0x400005BB /end MEASUREMENT
/begin MEASUREMENT GPS_Speed_Prb "" FLOAT32_IEEE CompuMethod_2 1 0 -1E+17 1E+17 ECU_ADDRESS 0x400005BC /end MEASUREMENT
/begin MEASUREMENT GPS_Valid_Prb "" UBYTE CompuMethod_12 1 0 0 1 ECU_ADDRESS 0x400005C0 /end MEASUREMENT
/begin MEASUREMENT GPS_YearUTC_Prb "" UBYTE CompuMethod_1 1 0 0 255 ECU_ADDRESS 0x400005C1 /end MEASUREMENT
/begin MEASUREMENT IAC_PDutyCycle "Actual duty cycle of actuator" FLOAT32_IEEE CompuMethod_9 1 0 -1E+17 1E+17 ECU_ADDRESS 0x400005C2 /end MEASUREMENT
/begin MEASUREMENT IAC_SDutyCycle "Actual duty cycle of actuator" FLOAT32_IEEE CompuMethod_9 1 0 -1E+17 1E+17 ECU_ADDRESS 0x400005C6 /end MEASUREMENT
/begin MEASUREMENT IAT "Final value after Linear Sensor Characterization" FLOAT32_IEEE CompuMethod_59 1 0 -1E+17 1E+17 ECU_ADDRESS 0x400005CA /end MEASUREMENT
/begin MEASUREMENT IAT_KeyUp "" FLOAT32_IEEE CompuMethod_59 1 0 -1E+17 1E+17 ECU_ADDRESS 0x400005CE /end MEASUREMENT
/begin MEASUREMENT IAT_KeyUp09Idx "Index of IAT captured at key-up." UWORD CompuMethod_15 1 0 0 127.998 ECU_ADDRESS 0x400005D2 /end MEASUREMENT
/begin MEASUREMENT IAT_KeyUp09In "Index of IAT captured at key-up." FLOAT32_IEEE CompuMethod_60 1 0 -1E+17 1E+17 ECU_ADDRESS 0x400005D4 /end MEASUREMENT
/begin MEASUREMENT IAT05Idx "Index of IAT" UWORD CompuMethod_15 1 0 0 127.998 ECU_ADDRESS 0x400005E0 /end MEASUREMENT
/begin MEASUREMENT IAT05In "Index of IAT" FLOAT32_IEEE CompuMethod_60 1 0 -1E+17 1E+17 ECU_ADDRESS 0x400005E2 /end MEASUREMENT
/begin MEASUREMENT IAT07Idx "Index of IAT" UWORD CompuMethod_15 1 0 0 127.998 ECU_ADDRESS 0x400005E6 /end MEASUREMENT
/begin MEASUREMENT IAT07In "Index of IAT" FLOAT32_IEEE CompuMethod_60 1 0 -1E+17 1E+17 ECU_ADDRESS 0x400005E8 /end MEASUREMENT
/begin MEASUREMENT IAT17Idx "Index of IAT" UWORD CompuMethod_15 1 0 0 127.998 ECU_ADDRESS 0x400005EC /end MEASUREMENT
/begin MEASUREMENT IAT17In "Index of IAT" FLOAT32_IEEE CompuMethod_60 1 0 -1E+17 1E+17 ECU_ADDRESS 0x400005EE /end MEASUREMENT
/begin MEASUREMENT IATADC "Signal measured directly from sensor" UWORD CompuMethod_17 1 0 0 65535 ECU_ADDRESS 0x400005F2 /end MEASUREMENT
/begin MEASUREMENT IATIdx "Look up table to allownon-linear characterization of sensors" UWORD CompuMethod_15 1 0 0 127.998 ECU_ADDRESS 0x400005FC /end MEASUREMENT
/begin MEASUREMENT IATRaw "After conversion to engineering units, before range checking" FLOAT32_IEEE CompuMethod_59 1 0 -1E+17 1E+17 ECU_ADDRESS 0x400005FE /end MEASUREMENT
/begin MEASUREMENT InjDC "" FLOAT32_IEEE CompuMethod_2 1 0 -1E+17 1E+17 ECU_ADDRESS 0x40000609 MATRIX_DIM 8 1 1 /end MEASUREMENT
/begin MEASUREMENT InjDeltaPress09Idx "" UWORD CompuMethod_15 1 0 0 127.998 ECU_ADDRESS 0x40000629 /end MEASUREMENT
/begin MEASUREMENT InjDeltaPress09In "" FLOAT32_IEEE CompuMethod_2 1 0 -1E+17 1E+17 ECU_ADDRESS 0x4000062B /end MEASUREMENT
/begin MEASUREMENT InjdPComp "Injector characterization compenastion based on dP across injector." FLOAT32_IEEE CompuMethod_120 1 0 -1E+17 1E+17 ECU_ADDRESS 0x4000062F /end MEASUREMENT
/begin MEASUREMENT InjEPW "" FLOAT32_IEEE CompuMethod_2 1 0 -1E+17 1E+17 ECU_ADDRESS 0x4000063B /end MEASUREMENT
/begin MEASUREMENT InjMPW "" FLOAT32_IEEE CompuMethod_2 1 0 -1E+17 1E+17 ECU_ADDRESS 0x4000063F MATRIX_DIM 8 1 1 /end MEASUREMENT
/begin MEASUREMENT InjTurnOff "Injector turn off time" FLOAT32_IEEE CompuMethod_68 1 0 -1E+17 1E+17 ECU_ADDRESS 0x40000667 /end MEASUREMENT
/begin MEASUREMENT InjTurnOn "Injector turn on time." FLOAT32_IEEE CompuMethod_68 1 0 -1E+17 1E+17 ECU_ADDRESS 0x4000066B /end MEASUREMENT
/begin MEASUREMENT ISR_ADCCPU "Percentage of CPU spent in eSCI interrupt servicing" UWORD CompuMethod_123 1 0 0 100 ECU_ADDRESS 0x40000675 /end MEASUREMENT
/begin MEASUREMENT ISR_CANCPU "Percentage of CPU spent in CAN interrupt servicing" UWORD CompuMethod_123 1 0 0 100 ECU_ADDRESS 0x40000677 /end MEASUREMENT
/begin MEASUREMENT ISR_DecrementorCPU "Percentage of CPU spent in the Decrementor interrupt" UWORD CompuMethod_123 1 0 0 100 ECU_ADDRESS 0x40000679 /end MEASUREMENT
/begin MEASUREMENT ISR_DMACPU "Percentage of CPU spent in DMA interrupt servicing" UWORD CompuMethod_123 1 0 0 100 ECU_ADDRESS 0x4000067B /end MEASUREMENT
/begin MEASUREMENT ISR_EMIOSCPU "Percentage of CPU spent in eMIOS interrupt servicing" UWORD CompuMethod_123 1 0 0 100 ECU_ADDRESS 0x4000067D /end MEASUREMENT
/begin MEASUREMENT ISR_SCICPU "Percentage of CPU spent in eSCI interrupt servicing" UWORD CompuMethod_123 1 0 0 100 ECU_ADDRESS 0x4000067F /end MEASUREMENT
/begin MEASUREMENT ISR_TPUCPU "Percentage of CPU spent in eTPU interrupts" UWORD CompuMethod_123 1 0 0 100 ECU_ADDRESS 0x40000681 /end MEASUREMENT
/begin MEASUREMENT LeanSwPtDelta "If actual O2 reaches this point, switch the target to the RichTargetDelta" FLOAT32_IEEE CompuMethod_41 1 0 -1E+17 1E+17 ECU_ADDRESS 0x40000685 /end MEASUREMENT
/begin MEASUREMENT LeanTargetDelta "Target on the lean side for perturbation." FLOAT32_IEEE CompuMethod_41 1 0 -1E+17 1E+17 ECU_ADDRESS 0x40000689 /end MEASUREMENT
/begin MEASUREMENT LiquidO2Control_DTerm_BankA "Closed-loop O2 control D-Term, for bank" FLOAT32_IEEE CompuMethod_29 1 0 -1E+17 1E+17 ECU_ADDRESS 0x4000068D /end MEASUREMENT
/begin MEASUREMENT LiquidO2Control_DTerm_BankB "Closed-loop O2 control D-Term, for bank" FLOAT32_IEEE CompuMethod_29 1 0 -1E+17 1E+17 ECU_ADDRESS 0x40000691 /end MEASUREMENT
/begin MEASUREMENT LiquidO2Control_ErrorTerm_BankA "Closed-loop O2 control error-term, for bank" FLOAT32_IEEE CompuMethod_29 1 0 -1E+17 1E+17 ECU_ADDRESS 0x40000695 /end MEASUREMENT
/begin MEASUREMENT LiquidO2Control_ErrorTerm_BankB "Closed-loop O2 control error-term, for bank" FLOAT32_IEEE CompuMethod_29 1 0 -1E+17 1E+17 ECU_ADDRESS 0x40000699 /end MEASUREMENT
/begin MEASUREMENT LiquidO2Control_ITerm_BankA "Closed-loop O2 control I-Term" FLOAT32_IEEE CompuMethod_29 1 0 -1E+17 1E+17 ECU_ADDRESS 0x4000069D /end MEASUREMENT
/begin MEASUREMENT LiquidO2Control_ITerm_BankB "Closed-loop O2 control I-Term" FLOAT32_IEEE CompuMethod_29 1 0 -1E+17 1E+17 ECU_ADDRESS 0x400006A1 /end MEASUREMENT
/begin MEASUREMENT LiquidO2Control_PTerm_BankA "Closed-loop O2 control P-Term" FLOAT32_IEEE CompuMethod_29 1 0 -1E+17 1E+17 ECU_ADDRESS 0x400006A5 /end MEASUREMENT
/begin MEASUREMENT LiquidO2Control_PTerm_BankB "Closed-loop O2 control P-Term" FLOAT32_IEEE CompuMethod_29 1 0 -1E+17 1E+17 ECU_ADDRESS 0x400006A9 /end MEASUREMENT
/begin MEASUREMENT MAF "Final value after Linear Sensor Characterization" FLOAT32_IEEE CompuMethod_27 1 0 -1E+17 1E+17 ECU_ADDRESS 0x400006AD /end MEASUREMENT
/begin MEASUREMENT MAFADC "Signal measured directly from sensor" FLOAT32_IEEE CompuMethod_96 1 0 -1E+17 1E+17 ECU_ADDRESS 0x400006B7 /end MEASUREMENT
/begin MEASUREMENT MAFIdx "Look up table to allownon-linear characterization of sensors" UWORD CompuMethod_15 1 0 0 127.998 ECU_ADDRESS 0x400006BF /end MEASUREMENT
/begin MEASUREMENT MAFPort05Idx "Index of MAF" UWORD CompuMethod_15 1 0 0 127.998 ECU_ADDRESS 0x400006C1 /end MEASUREMENT
/begin MEASUREMENT MAFPort05In "Index of MAF" FLOAT32_IEEE CompuMethod_27 1 0 -1E+17 1E+17 ECU_ADDRESS 0x400006C3 /end MEASUREMENT
/begin MEASUREMENT MAFRaw "After conversion to engineering units, before range checking" FLOAT32_IEEE CompuMethod_27 1 0 -1E+17 1E+17 ECU_ADDRESS 0x400006C7 /end MEASUREMENT
/begin MEASUREMENT MAP "Final value after Linear Sensor Characterization" FLOAT32_IEEE CompuMethod_16 1 0 -1E+17 1E+17 ECU_ADDRESS 0x400006CF /end MEASUREMENT
/begin MEASUREMENT MAP05Idx "Index of MAP" UWORD CompuMethod_15 1 0 0 127.998 ECU_ADDRESS 0x400006D3 /end MEASUREMENT
/begin MEASUREMENT MAP05In "Index of MAP" FLOAT32_IEEE CompuMethod_16 1 0 -1E+17 1E+17 ECU_ADDRESS 0x400006D5 /end MEASUREMENT
/begin MEASUREMENT MAP09Idx "Index of MAP" UWORD CompuMethod_15 1 0 0 127.998 ECU_ADDRESS 0x400006D9 /end MEASUREMENT
/begin MEASUREMENT MAP09In "Index of MAP" FLOAT32_IEEE CompuMethod_16 1 0 -1E+17 1E+17 ECU_ADDRESS 0x400006DB /end MEASUREMENT
/begin MEASUREMENT MAP17Idx "Index of MAP" UWORD CompuMethod_15 1 0 0 127.998 ECU_ADDRESS 0x400006DF /end MEASUREMENT
/begin MEASUREMENT MAP17In "Index of MAP" FLOAT32_IEEE CompuMethod_16 1 0 -1E+17 1E+17 ECU_ADDRESS 0x400006E1 /end MEASUREMENT
/begin MEASUREMENT MAPADC "Singal measured directly from sensor" FLOAT32_IEEE CompuMethod_21 1 0 -1E+17 1E+17 ECU_ADDRESS 0x400006E5 /end MEASUREMENT
/begin MEASUREMENT MAPRaw "After conversion to engineering units, before range checking" FLOAT32_IEEE CompuMethod_16 1 0 -1E+17 1E+17 ECU_ADDRESS 0x400006E9 /end MEASUREMENT
/begin MEASUREMENT MAPTime "Final value after Linear Sensor Characterization" FLOAT32_IEEE CompuMethod_16 1 0 -1E+17 1E+17 ECU_ADDRESS 0x400006ED /end MEASUREMENT
/begin MEASUREMENT MAPTimeADC "Singal measured directly from sensor" UWORD CompuMethod_17 1 0 0 65535 ECU_ADDRESS 0x400006F1 /end MEASUREMENT
/begin MEASUREMENT MAPTimeRaw "After conversion to engineering units, before range checking" FLOAT32_IEEE CompuMethod_16 1 0 -1E+17 1E+17 ECU_ADDRESS 0x400006F3 /end MEASUREMENT
/begin MEASUREMENT MaxAllowableMPW "" FLOAT32_IEEE CompuMethod_2 1 0 -1E+17 1E+17 ECU_ADDRESS 0x40000747 /end MEASUREMENT
/begin MEASUREMENT MaxGovDGainErrorMult "" FLOAT32_IEEE CompuMethod_29 1 0 -1E+17 1E+17 ECU_ADDRESS 0x4000074F /end MEASUREMENT
/begin MEASUREMENT MaxGovDTerm "" FLOAT32_IEEE CompuMethod_2 1 0 -1E+17 1E+17 ECU_ADDRESS 0x40000753 /end MEASUREMENT
/begin MEASUREMENT MaxGovError "" FLOAT32_IEEE CompuMethod_2 1 0 -1E+17 1E+17 ECU_ADDRESS 0x40000757 /end MEASUREMENT
/begin MEASUREMENT MaxGovETCMode "" UBYTE CompuMethod_127 1 0 0 1 ECU_ADDRESS 0x4000075B /end MEASUREMENT
/begin MEASUREMENT MaxGovHold "" SBYTE CompuMethod_128 1 0 -128 127 ECU_ADDRESS 0x4000075C /end MEASUREMENT
/begin MEASUREMENT MaxGovIC "" FLOAT32_IEEE CompuMethod_2 1 0 -1E+17 1E+17 ECU_ADDRESS 0x4000075D /end MEASUREMENT
/begin MEASUREMENT MaxGovIGainErrorMult "" FLOAT32_IEEE CompuMethod_29 1 0 -1E+17 1E+17 ECU_ADDRESS 0x40000761 /end MEASUREMENT
/begin MEASUREMENT MaxGovITerm "" FLOAT32_IEEE CompuMethod_2 1 0 -1E+17 1E+17 ECU_ADDRESS 0x40000765 /end MEASUREMENT
/begin MEASUREMENT MaxGovOutput "" FLOAT32_IEEE CompuMethod_2 1 0 -1E+17 1E+17 ECU_ADDRESS 0x40000769 /end MEASUREMENT
/begin MEASUREMENT MaxGovPGainErrorMult "" FLOAT32_IEEE CompuMethod_29 1 0 -1E+17 1E+17 ECU_ADDRESS 0x4000076D /end MEASUREMENT
/begin MEASUREMENT MaxGovPreloadITerm "Preload for Max Gov PID ITerm based on engine acceleration rate upon entry into max gov." FLOAT32_IEEE CompuMethod_9 1 0 -1E+17 1E+17 ECU_ADDRESS 0x40000771 /end MEASUREMENT
/begin MEASUREMENT MaxGovPTerm "" FLOAT32_IEEE CompuMethod_2 1 0 -1E+17 1E+17 ECU_ADDRESS 0x40000775 /end MEASUREMENT
/begin MEASUREMENT MaxGovReset "" SBYTE CompuMethod_129 1 0 -128 127 ECU_ADDRESS 0x40000779 /end MEASUREMENT
/begin MEASUREMENT MaxGovRPMSetpoint "RPMSetpoint of Max Gov controller." FLOAT32_IEEE CompuMethod_72 1 0 -1E+17 1E+17 ECU_ADDRESS 0x4000077A /end MEASUREMENT
/begin MEASUREMENT MaxGovSpeedErrorIdx "" UWORD CompuMethod_15 1 0 0 127.998 ECU_ADDRESS 0x4000077E /end MEASUREMENT
/begin MEASUREMENT MaxGovSpeedErrorIn "" FLOAT32_IEEE CompuMethod_72 1 0 -1E+17 1E+17 ECU_ADDRESS 0x40000780 /end MEASUREMENT
/begin MEASUREMENT MaxGovState "" UBYTE CompuMethod_10 1 0 0 1 ECU_ADDRESS 0x40000784 /end MEASUREMENT
/begin MEASUREMENT MaxSparkLimit "Maximum allowable spark advance." FLOAT32_IEEE CompuMethod_70 1 0 -1E+17 1E+17 ECU_ADDRESS 0x40000785 /end MEASUREMENT
/begin MEASUREMENT MinGovClntRPMSetPt "RPM setpoint based on ECT." SWORD CompuMethod_22 1 0 -32768 32767 ECU_ADDRESS 0x4000078D /end MEASUREMENT
/begin MEASUREMENT MinGovRPMSetPt "" FLOAT32_IEEE CompuMethod_2 1 0 -1E+17 1E+17 ECU_ADDRESS 0x40000790 /end MEASUREMENT
/begin MEASUREMENT MinOilPressure_Fault "Minimum oil pressure based on RPM - engine faults and shuts down below this" FLOAT32_IEEE CompuMethod_130 1 0 -1E+17 1E+17 ECU_ADDRESS 0x40000794 /end MEASUREMENT
/begin MEASUREMENT MinOilPressure_Warn "Minimum oil pressure based on RPM - indicator light comes on below this" FLOAT32_IEEE CompuMethod_130 1 0 -1E+17 1E+17 ECU_ADDRESS 0x40000798 /end MEASUREMENT
/begin MEASUREMENT MisfireDiag_AverageStartRPM "" UWORD CompuMethod_5 1 0 0 65535 ECU_ADDRESS 0x4000079C /end MEASUREMENT
/begin MEASUREMENT MisfireDiag_AverageStartRPMDR "" UBYTE CompuMethod_12 1 0 0 1 ECU_ADDRESS 0x4000079E /end MEASUREMENT
/begin MEASUREMENT MisfireDiag_AverageStopRPM "" UWORD CompuMethod_5 1 0 0 65535 ECU_ADDRESS 0x4000079F /end MEASUREMENT
/begin MEASUREMENT MisfireDiag_AverageStopRPMDR "" UBYTE CompuMethod_12 1 0 0 1 ECU_ADDRESS 0x400007A1 /end MEASUREMENT
/begin MEASUREMENT MisfireDiag_EncoderAngle "" SWORD CompuMethod_5 1 0 -32768 32767 ECU_ADDRESS 0x400007A2 /end MEASUREMENT
/begin MEASUREMENT MotoringDetectionFlag "" UBYTE CompuMethod_12 1 0 0 1 ECU_ADDRESS 0x40000921 /end MEASUREMENT
/begin MEASUREMENT MotoringDetectionTime "" FLOAT32_IEEE CompuMethod_2 1 0 -1E+17 1E+17 ECU_ADDRESS 0x40000922 /end MEASUREMENT
/begin MEASUREMENT NonVolatileCRC "Calculated NonVolatile CRC" ULONG CompuMethod_12 1 0 0 65535 ECU_ADDRESS 0x40000926 /end MEASUREMENT
/begin MEASUREMENT NonVolatileFormatID "Unique identifier of the NonVolatile memory format.  Used to validate whether stored variables are in the correct form for the program" ULONG CompuMethod_65 1 0 0 4294970000 ECU_ADDRESS 0x4000092A /end MEASUREMENT
/begin MEASUREMENT NonVolatileStatus "Indicates how NonVolatile memory was loaded" UBYTE CompuMethod_134 1 0 0 6 ECU_ADDRESS 0x4000092E /end MEASUREMENT
/begin MEASUREMENT O2BankA_O2Delag "" FLOAT32_IEEE CompuMethod_2 1 0 -1E+17 1E+17 ECU_ADDRESS 0x40000933 /end MEASUREMENT
/begin MEASUREMENT O2BankB_O2Delag "" FLOAT32_IEEE CompuMethod_2 1 0 -1E+17 1E+17 ECU_ADDRESS 0x40000937 /end MEASUREMENT
/begin MEASUREMENT O2Diag_Bank2Bank_DiffAlwd "" FLOAT32_IEEE CompuMethod_2 1 0 -1E+17 1E+17 ECU_ADDRESS 0x4000093D /end MEASUREMENT
/begin MEASUREMENT O2FuelMult "Closed-loop O2 control fuel multiplier." FLOAT32_IEEE CompuMethod_29 1 0 -1E+17 1E+17 ECU_ADDRESS 0x40000942 MATRIX_DIM 8 1 1 /end MEASUREMENT
/begin MEASUREMENT O2LeanTime_BankA "" FLOAT32_IEEE CompuMethod_2 1 0 -1E+17 1E+17 ECU_ADDRESS 0x4000096E /end MEASUREMENT
/begin MEASUREMENT O2LeanTime_BankB "" FLOAT32_IEEE CompuMethod_2 1 0 -1E+17 1E+17 ECU_ADDRESS 0x40000972 /end MEASUREMENT
/begin MEASUREMENT O2MAFErrGainMult "O2 PID controller system gain based on MAF port." FLOAT32_IEEE CompuMethod_48 1 0 -1E+17 1E+17 ECU_ADDRESS 0x40000976 /end MEASUREMENT
/begin MEASUREMENT O2NECCTErrGainMult "O2 PID controller system gain based on NECCT." FLOAT32_IEEE CompuMethod_48 1 0 -1E+17 1E+17 ECU_ADDRESS 0x4000097A /end MEASUREMENT
/begin MEASUREMENT O2NotActiveTime_BankA "" FLOAT32_IEEE CompuMethod_2 1 0 -1E+17 1E+17 ECU_ADDRESS 0x4000097E /end MEASUREMENT
/begin MEASUREMENT O2NotActiveTime_BankB "" FLOAT32_IEEE CompuMethod_2 1 0 -1E+17 1E+17 ECU_ADDRESS 0x40000982 /end MEASUREMENT
/begin MEASUREMENT O2RichTime_BankA "" FLOAT32_IEEE CompuMethod_2 1 0 -1E+17 1E+17 ECU_ADDRESS 0x40000986 /end MEASUREMENT
/begin MEASUREMENT O2RichTime_BankB "" FLOAT32_IEEE CompuMethod_2 1 0 -1E+17 1E+17 ECU_ADDRESS 0x4000098A /end MEASUREMENT
/begin MEASUREMENT O2TargetEquivRatio_BankA "Current target equivalence ratio for closed-loop O2 control." FLOAT32_IEEE CompuMethod_139 1 0 -1E+17 1E+17 ECU_ADDRESS 0x40000993 /end MEASUREMENT
/begin MEASUREMENT O2TargetEquivRatio_BankB "Current target equivalence ratio for closed-loop O2 control." FLOAT32_IEEE CompuMethod_139 1 0 -1E+17 1E+17 ECU_ADDRESS 0x40000997 /end MEASUREMENT
/begin MEASUREMENT OilPres "Final value after Linear Sensor Characterization" FLOAT32_IEEE CompuMethod_130 1 0 -1E+17 1E+17 ECU_ADDRESS 0x4000099C /end MEASUREMENT
/begin MEASUREMENT OilPresADC "Singal measured directly from sensor" UWORD CompuMethod_17 1 0 0 65535 ECU_ADDRESS 0x400009A0 /end MEASUREMENT
/begin MEASUREMENT OilPresRaw "After conversion to engineering units, before range checking" FLOAT32_IEEE CompuMethod_130 1 0 -1E+17 1E+17 ECU_ADDRESS 0x400009A2 /end MEASUREMENT
/begin MEASUREMENT OXY05Idx "Index of fuel oxygenation content" UWORD CompuMethod_15 1 0 0 127.998 ECU_ADDRESS 0x400009A6 /end MEASUREMENT
/begin MEASUREMENT OXY05In "Index of fuel oxygenation content" FLOAT32_IEEE CompuMethod_9 1 0 -1E+17 1E+17 ECU_ADDRESS 0x400009A8 /end MEASUREMENT
/begin MEASUREMENT OXYTransFuelMult "Transient fuel multiplier based on OXY.  Only engaged during transient fueling" FLOAT32_IEEE CompuMethod_2 1 0 -1E+17 1E+17 ECU_ADDRESS 0x400009AC /end MEASUREMENT
/begin MEASUREMENT PHI1_FiltFin "" FLOAT32_IEEE CompuMethod_2 1 0 -1E+17 1E+17 ECU_ADDRESS 0x400009E0 /end MEASUREMENT
/begin MEASUREMENT PHI2_FiltFin "" FLOAT32_IEEE CompuMethod_2 1 0 -1E+17 1E+17 ECU_ADDRESS 0x400009E4 /end MEASUREMENT
/begin MEASUREMENT PowerUpStatus "This indicates the power-up state of the system." UBYTE CompuMethod_143 1 0 0 1 ECU_ADDRESS 0x400009E8 /end MEASUREMENT
/begin MEASUREMENT RevLimiterState "" UBYTE CompuMethod_146 1 0 0 255 ECU_ADDRESS 0x400009ED /end MEASUREMENT
/begin MEASUREMENT RichSwPtDelta "If actual O2 reaches this point, switch the target to the LeanTargetDelta" FLOAT32_IEEE CompuMethod_41 1 0 -1E+17 1E+17 ECU_ADDRESS 0x400009EE /end MEASUREMENT
/begin MEASUREMENT RichTargetDelta "Target on the rich side for perturbation." FLOAT32_IEEE CompuMethod_41 1 0 -1E+17 1E+17 ECU_ADDRESS 0x400009F2 /end MEASUREMENT
/begin MEASUREMENT RPM05Idx "Index of RPM" UWORD CompuMethod_15 1 0 0 127.998 ECU_ADDRESS 0x400009FA /end MEASUREMENT
/begin MEASUREMENT RPM05In "Index of RPM" FLOAT32_IEEE CompuMethod_72 1 0 -1E+17 1E+17 ECU_ADDRESS 0x400009FC /end MEASUREMENT
/begin MEASUREMENT RPM09Idx "Index of RPM" UWORD CompuMethod_15 1 0 0 127.998 ECU_ADDRESS 0x40000A00 /end MEASUREMENT
/begin MEASUREMENT RPM09In "Index of RPM" FLOAT32_IEEE CompuMethod_72 1 0 -1E+17 1E+17 ECU_ADDRESS 0x40000A02 /end MEASUREMENT
/begin MEASUREMENT RPM17Idx "Index of RPM" UWORD CompuMethod_15 1 0 0 127.998 ECU_ADDRESS 0x40000A06 /end MEASUREMENT
/begin MEASUREMENT RPM17In "Index of RPM" FLOAT32_IEEE CompuMethod_72 1 0 -1E+17 1E+17 ECU_ADDRESS 0x40000A08 /end MEASUREMENT
/begin MEASUREMENT RPMFalling "Indicates whether the RPM is falling" UBYTE CompuMethod_148 1 0 0 1 ECU_ADDRESS 0x40000A13 /end MEASUREMENT
/begin MEASUREMENT RPMFilt_Final "" FLOAT32_IEEE CompuMethod_2 1 0 -1E+17 1E+17 ECU_ADDRESS 0x40000A14 /end MEASUREMENT
/begin MEASUREMENT RPMFilt_PostLowPass "" FLOAT32_IEEE CompuMethod_2 1 0 -1E+17 1E+17 ECU_ADDRESS 0x40000A18 /end MEASUREMENT
/begin MEASUREMENT Scramble "Display output in engineering units" UBYTE CompuMethod_23 1 0 0 1 ECU_ADDRESS 0x40000A20 /end MEASUREMENT
/begin MEASUREMENT Scramble_Raw "Display output in engineering units" FLOAT32_IEEE CompuMethod_21 1 0 -1E+17 1E+17 ECU_ADDRESS 0x40000A21 /end MEASUREMENT
/begin MEASUREMENT SensVolt "Final value after Linear Sensor Characterization" FLOAT32_IEEE CompuMethod_152 1 0 -1E+17 1E+17 ECU_ADDRESS 0x40000A25 /end MEASUREMENT
/begin MEASUREMENT SensVoltADC "Singal measured directly from sensor" UWORD CompuMethod_17 1 0 0 65535 ECU_ADDRESS 0x40000A29 /end MEASUREMENT
/begin MEASUREMENT SensVoltRaw "After conversion to engineering units, before range checking" FLOAT32_IEEE CompuMethod_152 1 0 -1E+17 1E+17 ECU_ADDRESS 0x40000A2B /end MEASUREMENT
/begin MEASUREMENT SpkMinGovDGainErrorMult "" FLOAT32_IEEE CompuMethod_29 1 0 -1E+17 1E+17 ECU_ADDRESS 0x40000A4A /end MEASUREMENT
/begin MEASUREMENT SpkMinGovDTerm "PID Derivative Term" FLOAT32_IEEE CompuMethod_88 1 0 -1E+17 1E+17 ECU_ADDRESS 0x40000A4E /end MEASUREMENT
/begin MEASUREMENT SpkMinGovError "PID Error Term" FLOAT32_IEEE CompuMethod_88 1 0 -1E+17 1E+17 ECU_ADDRESS 0x40000A52 /end MEASUREMENT
/begin MEASUREMENT SpkMinGovPGainErrorMult "" FLOAT32_IEEE CompuMethod_29 1 0 -1E+17 1E+17 ECU_ADDRESS 0x40000A5A /end MEASUREMENT
/begin MEASUREMENT SpkMinGovPTerm "PID Proportional Term" FLOAT32_IEEE CompuMethod_88 1 0 -1E+17 1E+17 ECU_ADDRESS 0x40000A5E /end MEASUREMENT
/begin MEASUREMENT SpkMinGovSpeedErrorIdx "" UWORD CompuMethod_15 1 0 0 127.998 ECU_ADDRESS 0x40000A62 /end MEASUREMENT
/begin MEASUREMENT SpkMinGovSpeedErrorIn "" FLOAT32_IEEE CompuMethod_2 1 0 -1E+17 1E+17 ECU_ADDRESS 0x40000A64 /end MEASUREMENT
/begin MEASUREMENT SSEng "" UBYTE CompuMethod_12 1 0 0 1 ECU_ADDRESS 0x40000A6C /end MEASUREMENT
/begin MEASUREMENT SSEngOpr "Steady-State Engine Operation" UBYTE CompuMethod_157 1 0 0 1 ECU_ADDRESS 0x40000A6D /end MEASUREMENT
/begin MEASUREMENT SSLoadDirection "" UBYTE CompuMethod_100 1 0 0 1 ECU_ADDRESS 0x40000A6E /end MEASUREMENT
/begin MEASUREMENT SSLoadFilterConst "" FLOAT32_IEEE CompuMethod_2 1 0 -1E+17 1E+17 ECU_ADDRESS 0x40000A6F /end MEASUREMENT
/begin MEASUREMENT SSLoadFiltered "" FLOAT32_IEEE CompuMethod_2 1 0 -1E+17 1E+17 ECU_ADDRESS 0x40000A73 /end MEASUREMENT
/begin MEASUREMENT SSRPMDirection "" UBYTE CompuMethod_100 1 0 0 1 ECU_ADDRESS 0x40000A77 /end MEASUREMENT
/begin MEASUREMENT SSRPMFilterConst "" FLOAT32_IEEE CompuMethod_2 1 0 -1E+17 1E+17 ECU_ADDRESS 0x40000A78 /end MEASUREMENT
/begin MEASUREMENT SSRPMFiltered "" FLOAT32_IEEE CompuMethod_2 1 0 -1E+17 1E+17 ECU_ADDRESS 0x40000A7C /end MEASUREMENT
/begin MEASUREMENT SysVolt "Final value after Linear Sensor Characterization" FLOAT32_IEEE CompuMethod_152 1 0 -1E+17 1E+17 ECU_ADDRESS 0x40000A80 /end MEASUREMENT
/begin MEASUREMENT SysVolt09Idx "Index of system voltage" UWORD CompuMethod_15 1 0 0 127.998 ECU_ADDRESS 0x40000A84 /end MEASUREMENT
/begin MEASUREMENT SysVolt09In "Index of system voltage" FLOAT32_IEEE CompuMethod_152 1 0 -1E+17 1E+17 ECU_ADDRESS 0x40000A86 /end MEASUREMENT
/begin MEASUREMENT SysVoltADC "Singal measured directly from sensor" UWORD CompuMethod_17 1 0 0 65535 ECU_ADDRESS 0x40000A8A /end MEASUREMENT
/begin MEASUREMENT SysVoltRaw "After conversion to engineering units, before range checking" FLOAT32_IEEE CompuMethod_152 1 0 -1E+17 1E+17 ECU_ADDRESS 0x40000A8C /end MEASUREMENT
/begin MEASUREMENT TimeSinceKeyOn "" FLOAT32_IEEE CompuMethod_2 1 0 -1E+17 1E+17 ECU_ADDRESS 0x40000A92 /end MEASUREMENT
/begin MEASUREMENT TimeSinceRun "" FLOAT32_IEEE CompuMethod_2 1 0 -1E+17 1E+17 ECU_ADDRESS 0x40000A96 /end MEASUREMENT
/begin MEASUREMENT TimeSinceStall "Indicates time since entering Stall State - saturates and disables at 2000 seconds" FLOAT32_IEEE CompuMethod_45 1 0 -1E+17 1E+17 ECU_ADDRESS 0x40000AA0 /end MEASUREMENT
/begin MEASUREMENT TotalFPC "Total fuel per cylinder after application of transient algorithm" FLOAT32_IEEE CompuMethod_161 1 0 -1E+17 1E+17 ECU_ADDRESS 0x40000AA8 MATRIX_DIM 8 1 1 /end MEASUREMENT
/begin MEASUREMENT TotalSparkAdv "" FLOAT32_IEEE CompuMethod_2 1 0 -1E+17 1E+17 ECU_ADDRESS 0x40000AC8 /end MEASUREMENT
/begin MEASUREMENT TPS09Idx "Index of TPS" UWORD CompuMethod_15 1 0 0 127.998 ECU_ADDRESS 0x40000ACC /end MEASUREMENT
/begin MEASUREMENT TPS09In "Index of TPS" FLOAT32_IEEE CompuMethod_9 1 0 -1E+17 1E+17 ECU_ADDRESS 0x40000ACE /end MEASUREMENT
/begin MEASUREMENT TPS1Adapt_Hi "" FLOAT32_IEEE CompuMethod_2 1 0 -1E+17 1E+17 ECU_ADDRESS 0x40000AD2 /end MEASUREMENT
/begin MEASUREMENT TPS1Adapt_Low "" FLOAT32_IEEE CompuMethod_2 1 0 -1E+17 1E+17 ECU_ADDRESS 0x40000AD6 /end MEASUREMENT
/begin MEASUREMENT TPS1ADC "" FLOAT32_IEEE CompuMethod_2 1 0 -1E+17 1E+17 ECU_ADDRESS 0x40000ADA /end MEASUREMENT
/begin MEASUREMENT TPS1Percent "" FLOAT32_IEEE CompuMethod_2 1 0 -1E+17 1E+17 ECU_ADDRESS 0x40000ADE /end MEASUREMENT
/begin MEASUREMENT TPS1PercentRaw "" FLOAT32_IEEE CompuMethod_2 1 0 -1E+17 1E+17 ECU_ADDRESS 0x40000AE2 /end MEASUREMENT
/begin MEASUREMENT TPS2Adapt_Hi "" FLOAT32_IEEE CompuMethod_2 1 0 -1E+17 1E+17 ECU_ADDRESS 0x40000AE6 /end MEASUREMENT
/begin MEASUREMENT TPS2Adapt_Low "" FLOAT32_IEEE CompuMethod_2 1 0 -1E+17 1E+17 ECU_ADDRESS 0x40000AEA /end MEASUREMENT
/begin MEASUREMENT TPS2ADC "" FLOAT32_IEEE CompuMethod_2 1 0 -1E+17 1E+17 ECU_ADDRESS 0x40000AEE /end MEASUREMENT
/begin MEASUREMENT TPS2Percent "" FLOAT32_IEEE CompuMethod_2 1 0 -1E+17 1E+17 ECU_ADDRESS 0x40000AF2 /end MEASUREMENT
/begin MEASUREMENT TPS2PercentRaw "" FLOAT32_IEEE CompuMethod_2 1 0 -1E+17 1E+17 ECU_ADDRESS 0x40000AF6 /end MEASUREMENT
/begin MEASUREMENT TPSFinal "" FLOAT32_IEEE CompuMethod_9 1 0 -1E+17 1E+17 ECU_ADDRESS 0x40000AFA /end MEASUREMENT
/begin MEASUREMENT TPSRequestLookupAirOfst "" FLOAT32_IEEE CompuMethod_2 1 0 -1E+17 1E+17 ECU_ADDRESS 0x40000AFE /end MEASUREMENT
/begin MEASUREMENT VE_AdaptErrorIdxArrIdx "Multiplier on error for adaptation, should always be positive" UWORD CompuMethod_15 1 0 0 127.998 ECU_ADDRESS 0x40000B0A /end MEASUREMENT
/begin MEASUREMENT VE_AdaptErrorIdxArrIn "Multiplier on error for adaptation, should always be positive" FLOAT32_IEEE CompuMethod_2 1 0 -1E+17 1E+17 ECU_ADDRESS 0x40000B0C /end MEASUREMENT
/begin MEASUREMENT VEAdaptGainTbl "Multiplier on error for adaptation, should always be positive" FLOAT32_IEEE CompuMethod_2 1 0 -1E+17 1E+17 ECU_ADDRESS 0x40000B14 /end MEASUREMENT
/begin MEASUREMENT VSPD "Final value after Linear Sensor Characterization" FLOAT32_IEEE CompuMethod_165 1 0 -1E+17 1E+17 ECU_ADDRESS 0x40000B3B /end MEASUREMENT
/begin MEASUREMENT VSPD_ChangeReject_Enabled "" UBYTE CompuMethod_12 1 0 0 1 ECU_ADDRESS 0x40000B3F /end MEASUREMENT
/begin MEASUREMENT VSPD_DigFinal "" FLOAT32_IEEE CompuMethod_2 1 0 -1E+17 1E+17 ECU_ADDRESS 0x40000B40 /end MEASUREMENT
/begin MEASUREMENT VSPD_FinalFinal "" FLOAT32_IEEE CompuMethod_2 1 0 -1E+17 1E+17 ECU_ADDRESS 0x40000B44 /end MEASUREMENT
/begin MEASUREMENT VSPD_RateReject_Enabled "" UBYTE CompuMethod_12 1 0 0 1 ECU_ADDRESS 0x40000B48 /end MEASUREMENT
/begin MEASUREMENT VSPD07Idx "Index of VSPD" UWORD CompuMethod_15 1 0 0 127.998 ECU_ADDRESS 0x40000B49 /end MEASUREMENT
/begin MEASUREMENT VSPD07In "Index of VSPD" FLOAT32_IEEE CompuMethod_165 1 0 -1E+17 1E+17 ECU_ADDRESS 0x40000B4B /end MEASUREMENT
/begin MEASUREMENT VSPD09Idx "Index of VSPD" UWORD CompuMethod_15 1 0 0 127.998 ECU_ADDRESS 0x40000B4F /end MEASUREMENT
/begin MEASUREMENT VSPD09In "Index of VSPD" FLOAT32_IEEE CompuMethod_165 1 0 -1E+17 1E+17 ECU_ADDRESS 0x40000B51 /end MEASUREMENT
/begin MEASUREMENT VSPD17Idx "Index of VSPD" UWORD CompuMethod_15 1 0 0 127.998 ECU_ADDRESS 0x40000B55 /end MEASUREMENT
/begin MEASUREMENT VSPD17In "Index of VSPD" FLOAT32_IEEE CompuMethod_165 1 0 -1E+17 1E+17 ECU_ADDRESS 0x40000B57 /end MEASUREMENT
/begin MEASUREMENT VSPDADC "Signal measured directly from sensor" FLOAT32_IEEE CompuMethod_96 1 0 -1E+17 1E+17 ECU_ADDRESS 0x40000B5B /end MEASUREMENT
/begin MEASUREMENT VSPDIdx "Look up table to allownon-linear characterization of sensors" UWORD CompuMethod_15 1 0 0 127.998 ECU_ADDRESS 0x40000B5F /end MEASUREMENT
/begin MEASUREMENT VSPDRaw "After conversion to engineering units, before range checking" FLOAT32_IEEE CompuMethod_165 1 0 -1E+17 1E+17 ECU_ADDRESS 0x40000B61 /end MEASUREMENT
/begin MEASUREMENT Warmup_Time_Holdoff "Time before warmup fuel multiplier active" FLOAT32_IEEE CompuMethod_168 1 0 -1E+17 1E+17 ECU_ADDRESS 0x40000B65 /end MEASUREMENT
/begin MEASUREMENT WarmUpO2AdaptEnabled "Indicates whether FuelFlowComp map adapting is enabled due to WarmUp" UBYTE CompuMethod_46 1 0 0 1 ECU_ADDRESS 0x40000B6D /end MEASUREMENT
/begin MEASUREMENT WASTEGATEDutyCycle "Actual duty cycle of actuator" FLOAT32_IEEE CompuMethod_9 1 0 -1E+17 1E+17 ECU_ADDRESS 0x40000B72 /end MEASUREMENT
/begin CHARACTERISTIC ETC_IceBreakEnblTm "" VALUE 0x80001F03 RecordLayout_4 0 CompuMethod_19 0 10 /end CHARACTERISTIC
/begin CHARACTERISTIC ETC_IceBreakHoldTm "" VALUE 0x80001F07 RecordLayout_4 0 CompuMethod_19 0 10 /end CHARACTERISTIC
/begin CHARACTERISTIC ETC_IceBreakPos "" VALUE 0x80001F0B RecordLayout_4 0 CompuMethod_9 0 100 /end CHARACTERISTIC
/begin CHARACTERISTIC ETC_IGainMultTbl "Multiplier on the ETC I gain based on ETC error." CURVE 0x80001F0F RecordLayout_4 0 CompuMethod_2 -1E+17 1E+17
 /begin AXIS_DESCR COM_AXIS ETC_ErrorIn CompuMethod_2 10 -1E+17 1E+17 AXIS_PTS_REF ETC_ErrorIdxArr /end AXIS_DESCR
/end CHARACTERISTIC
/begin CHARACTERISTIC ETC_LoAdaptRateLimit "Dictates the rate at which the ETC setpoint is decreased during shutdown to perform a low TPS adapt." VALUE 0x80001F37 RecordLayout_4 0 CompuMethod_98 -1E+17 1E+17 /end CHARACTERISTIC
/begin CHARACTERISTIC ETC_new "Override result of linear sensor characterization, in engineering units" VALUE 0x80001F3B RecordLayout_4 0 CompuMethod_2 -1E+17 1E+17 /end CHARACTERISTIC
/begin CHARACTERISTIC ETC_ovr "" VALUE 0x80001F47 RecordLayout_2 0 CompuMethod_7 0 1 /end CHARACTERISTIC
/begin CHARACTERISTIC ETC_PGainMultTbl "Multiplier on the ETC P gain based on ETC error." CURVE 0x80001F48 RecordLayout_4 0 CompuMethod_2 -1E+17 1E+17
 /begin AXIS_DESCR COM_AXIS ETC_ErrorIn CompuMethod_2 10 -1E+17 1E+17 AXIS_PTS_REF ETC_ErrorIdxArr /end AXIS_DESCR
/end CHARACTERISTIC
/begin CHARACTERISTIC ETC_StallAppOvrThesh "" VALUE 0x80001FD0 RecordLayout_4 0 CompuMethod_9 0 100 /end CHARACTERISTIC
/begin CHARACTERISTIC ETC_StallAppOvrTm "" VALUE 0x80001FD4 RecordLayout_4 0 CompuMethod_19 0 10 /end CHARACTERISTIC
/begin CHARACTERISTIC ETC_StickingThresh "Defines error limit between TPS_Request and TPS where ETC sticking fault will be set." VALUE 0x80001FD8 RecordLayout_4 0 CompuMethod_9 -1E+17 1E+17 /end CHARACTERISTIC
/begin CHARACTERISTIC ETCDamperSwitchHyst "Hysterisis around the ThrPosDamperSwitchThresh." VALUE 0x80002000 RecordLayout_4 0 CompuMethod_98 -1E+17 1E+17 /end CHARACTERISTIC
/begin CHARACTERISTIC ETCDamperSwitchThresh "When filtered derivative of TPS is greater than this threshold, Damper_Up gain will be used." VALUE 0x80002004 RecordLayout_4 0 CompuMethod_98 -1E+17 1E+17 /end CHARACTERISTIC
/begin CHARACTERISTIC ETCDamperTPSFilt "Filter time constant" VALUE 0x80002008 RecordLayout_4 0 CompuMethod_19 -1E+17 1E+17 /end CHARACTERISTIC
/begin CHARACTERISTIC ETCIGain "PID Integral Gain" VALUE 0x8000206C RecordLayout_4 0 CompuMethod_29 -1E+17 1E+17 /end CHARACTERISTIC
/begin CHARACTERISTIC ETCLwrLim "Lower Limit Value" VALUE 0x80002078 RecordLayout_4 0 CompuMethod_9 -1E+17 1E+17 /end CHARACTERISTIC
/begin CHARACTERISTIC ETCPGain "PID Proportional Gain" VALUE 0x8000207C RecordLayout_4 0 CompuMethod_29 -1E+17 1E+17 /end CHARACTERISTIC
/begin CHARACTERISTIC ETCReq_new "Override the electronic throttle position" VALUE 0x80002084 RecordLayout_4 0 CompuMethod_9 0 100 /end CHARACTERISTIC
/begin CHARACTERISTIC ETCReq_ovr "" VALUE 0x80002088 RecordLayout_2 0 CompuMethod_7 0 1 /end CHARACTERISTIC
/begin CHARACTERISTIC ETCShutdownTimerThresh "Time limit in Stall State after which ETC will shutdown." VALUE 0x8000255D RecordLayout_4 0 CompuMethod_45 -1E+17 1E+17 /end CHARACTERISTIC
/begin CHARACTERISTIC ETCTuneAmp "" VALUE 0x80002561 RecordLayout_4 0 CompuMethod_2 -1E+17 1E+17 /end CHARACTERISTIC
/begin CHARACTERISTIC ETCTuneEnable "" VALUE 0x80002565 RecordLayout_2 0 CompuMethod_10 0 1 /end CHARACTERISTIC
/begin CHARACTERISTIC ETCTuneFreq "" VALUE 0x80002566 RecordLayout_4 0 CompuMethod_96 0 100 /end CHARACTERISTIC
/begin CHARACTERISTIC ETCTuneOffset "" VALUE 0x8000256A RecordLayout_4 0 CompuMethod_2 -1E+17 1E+17 /end CHARACTERISTIC
/begin CHARACTERISTIC ETCUprLim "Upper Limit Value" VALUE 0x8000256E RecordLayout_4 0 CompuMethod_9 -1E+17 1E+17 /end CHARACTERISTIC
/begin CHARACTERISTIC Ethanol_SpkOfstMultMap "Multiplier on ECT spark offset table." MAP 0x80002572 RecordLayout_4 0 CompuMethod_29 -1E+17 1E+17
 /begin AXIS_DESCR COM_AXIS RPM09In CompuMethod_72 9 0 14000 AXIS_PTS_REF RPM09IdxArr /end AXIS_DESCR
 /begin AXIS_DESCR COM_AXIS MAP09In CompuMethod_16 9 0 1000 AXIS_PTS_REF MAP09IdxArr /end AXIS_DESCR
/end CHARACTERISTIC
/begin CHARACTERISTIC EthSpkModTbl "Spark advance as a function of ethanol %" CURVE 0x800026B6 RecordLayout_4 0 CompuMethod_70 -1E+17 1E+17
 /begin AXIS_DESCR COM_AXIS OXY05In CompuMethod_9 5 0 100 AXIS_PTS_REF OXY05IdxArr /end AXIS_DESCR
/end CHARACTERISTIC
/begin CHARACTERISTIC EVAP_new "Override result of linear sensor characterization, in engineering units" VALUE 0x800026CA RecordLayout_4 0 CompuMethod_59 -1E+17 1E+17 /end CHARACTERISTIC
/begin CHARACTERISTIC EVAP_ovr "" VALUE 0x800026CE RecordLayout_2 0 CompuMethod_7 0 1 /end CHARACTERISTIC
/begin CHARACTERISTIC EVAPDefault "This is the initial default value should the sensor be in fault on key-up.  Otherwise the sensors outputs the last value prior to faulting" VALUE 0x800026CF RecordLayout_4 0 CompuMethod_59 -1E+17 1E+17 /end CHARACTERISTIC
/begin CHARACTERISTIC EVAPFiltConst "Filter time constant" VALUE 0x800026D3 RecordLayout_4 0 CompuMethod_19 -1E+17 1E+17 /end CHARACTERISTIC
/begin CHARACTERISTIC EVAPMax "Maximum allowable input, indicating short or open circuit" VALUE 0x8000270B RecordLayout_4 0 CompuMethod_21 -1E+17 1E+17 /end CHARACTERISTIC
/begin CHARACTERISTIC EVAPMin "Minimum allowable input, indicating short or open circuit" VALUE 0x8000270F RecordLayout_4 0 CompuMethod_21 -1E+17 1E+17 /end CHARACTERISTIC
/begin CHARACTERISTIC EVAPTbl "Look up table to allownon-linear characterization of sensors" CURVE 0x80002713 RecordLayout_4 0 CompuMethod_59 -1E+17 1E+17
 /begin AXIS_DESCR COM_AXIS EVAPADC CompuMethod_21 13 -1E+17 1E+17 AXIS_PTS_REF EVAPIdxArr /end AXIS_DESCR
/end CHARACTERISTIC
/begin CHARACTERISTIC Fall_Rate "" VALUE 0x80002747 RecordLayout_4 0 CompuMethod_2 -1E+17 1E+17 /end CHARACTERISTIC
/begin CHARACTERISTIC FAN1_PWM_new "Override result of linear sensor characterization, in engineering units" VALUE 0x8000274C RecordLayout_4 0 CompuMethod_9 -1E+17 1E+17 /end CHARACTERISTIC
/begin CHARACTERISTIC FAN1_PWM_ovr "" VALUE 0x80002750 RecordLayout_2 0 CompuMethod_7 0 1 /end CHARACTERISTIC
/begin CHARACTERISTIC FAN1_PWMFrequency "Frequency of PWM output" VALUE 0x80002751 RecordLayout_4 0 CompuMethod_96 -1E+17 1E+17 /end CHARACTERISTIC
/begin CHARACTERISTIC FAN1_PWMGain "Scaling from engineering units to PWM duty cycle" VALUE 0x80002755 RecordLayout_4 0 CompuMethod_102 -1E+17 1E+17 /end CHARACTERISTIC
/begin CHARACTERISTIC FAN1_PWMMaxLimit "Maximum limit of PWM signal." VALUE 0x80002759 RecordLayout_4 0 CompuMethod_9 -1E+17 1E+17 /end CHARACTERISTIC
/begin CHARACTERISTIC FAN1_PWMMinLimit "Minimum limit of PWM signal." VALUE 0x8000275D RecordLayout_4 0 CompuMethod_9 -1E+17 1E+17 /end CHARACTERISTIC
/begin CHARACTERISTIC FAN1_PWMOffset "Offset from engineering units to PWM duty cycle" VALUE 0x80002761 RecordLayout_4 0 CompuMethod_9 -1E+17 1E+17 /end CHARACTERISTIC
/begin CHARACTERISTIC FAN2_PWM_new "Override result of linear sensor characterization, in engineering units" VALUE 0x80002769 RecordLayout_4 0 CompuMethod_9 -1E+17 1E+17 /end CHARACTERISTIC
/begin CHARACTERISTIC FAN2_PWM_ovr "" VALUE 0x8000276D RecordLayout_2 0 CompuMethod_7 0 1 /end CHARACTERISTIC
/begin CHARACTERISTIC FAN2_PWMFrequency "Frequency of PWM output" VALUE 0x8000276E RecordLayout_4 0 CompuMethod_96 -1E+17 1E+17 /end CHARACTERISTIC
/begin CHARACTERISTIC FAN2_PWMGain "Scaling from engineering units to PWM duty cycle" VALUE 0x80002772 RecordLayout_4 0 CompuMethod_102 -1E+17 1E+17 /end CHARACTERISTIC
/begin CHARACTERISTIC FAN2_PWMMaxLimit "Maximum limit of PWM signal." VALUE 0x80002776 RecordLayout_4 0 CompuMethod_9 -1E+17 1E+17 /end CHARACTERISTIC
/begin CHARACTERISTIC FAN2_PWMMinLimit "Minimum limit of PWM signal." VALUE 0x8000277A RecordLayout_4 0 CompuMethod_9 -1E+17 1E+17 /end CHARACTERISTIC
/begin CHARACTERISTIC FAN2_PWMOffset "Offset from engineering units to PWM duty cycle" VALUE 0x8000277E RecordLayout_4 0 CompuMethod_9 -1E+17 1E+17 /end CHARACTERISTIC
/begin CHARACTERISTIC FDR "" VALUE 0x800037FB RecordLayout_4 0 CompuMethod_2 -1E+17 1E+17 /end CHARACTERISTIC
/begin CHARACTERISTIC Filter_Type_Selection "Filter Section For Fuel Oxygenation Sensor" VALUE 0x80003801 RecordLayout_2 0 CompuMethod_109 0 255 /end CHARACTERISTIC
/begin CHARACTERISTIC FinalGain "Gain 4 For Moving Average Filter" VALUE 0x80003802 RecordLayout_4 0 CompuMethod_2 -1E+17 1E+17 /end CHARACTERISTIC
/begin CHARACTERISTIC Flex_Filt "Filter time constant" VALUE 0x80003806 RecordLayout_4 0 CompuMethod_19 -1E+17 1E+17 /end CHARACTERISTIC
/begin CHARACTERISTIC Fuel_Lvl_new "Override result of linear sensor characterization, in engineering units" VALUE 0x8000380E RecordLayout_4 0 CompuMethod_9 -1E+17 1E+17 /end CHARACTERISTIC
/begin CHARACTERISTIC Fuel_Lvl_ovr "" VALUE 0x80003812 RecordLayout_2 0 CompuMethod_7 0 1 /end CHARACTERISTIC
/begin CHARACTERISTIC Fuel_LvlDefault "This is the initial default value should the sensor be in fault on key-up.  Otherwise the sensors outputs the last value prior to faulting" VALUE 0x80003813 RecordLayout_4 0 CompuMethod_9 -1E+17 1E+17 /end CHARACTERISTIC
/begin CHARACTERISTIC Fuel_LvlFiltConst "Filter time constant" VALUE 0x80003817 RecordLayout_4 0 CompuMethod_19 -1E+17 1E+17 /end CHARACTERISTIC
/begin CHARACTERISTIC Fuel_LvlMax "Maximum allowable input, indicating short or open circuit" VALUE 0x8000382F RecordLayout_4 0 CompuMethod_21 -1E+17 1E+17 /end CHARACTERISTIC
/begin CHARACTERISTIC Fuel_LvlMin "Minimum allowable input, indicating short or open circuit" VALUE 0x80003833 RecordLayout_4 0 CompuMethod_21 -1E+17 1E+17 /end CHARACTERISTIC
/begin CHARACTERISTIC Fuel_LvlTbl "Look up table to allownon-linear characterization of sensors" CURVE 0x80003837 RecordLayout_4 0 CompuMethod_9 -1E+17 1E+17
 /begin AXIS_DESCR COM_AXIS Fuel_LvlADC CompuMethod_21 5 -1E+17 1E+17 AXIS_PTS_REF Fuel_LvlIdxArr /end AXIS_DESCR
/end CHARACTERISTIC
/begin CHARACTERISTIC FuelAdaptError_BankALwrLim "Lower Limit Value" VALUE 0x80003850 RecordLayout_4 0 CompuMethod_47 -1E+17 1E+17 /end CHARACTERISTIC
/begin CHARACTERISTIC FuelAdaptError_BankAUprLim "Upper Limit Value" VALUE 0x80003854 RecordLayout_4 0 CompuMethod_47 -1E+17 1E+17 /end CHARACTERISTIC
/begin CHARACTERISTIC FuelAdaptError_BankBLwrLim "Lower Limit Value" VALUE 0x80003858 RecordLayout_4 0 CompuMethod_47 -1E+17 1E+17 /end CHARACTERISTIC
/begin CHARACTERISTIC FuelAdaptError_BankBUprLim "Upper Limit Value" VALUE 0x8000385C RecordLayout_4 0 CompuMethod_47 -1E+17 1E+17 /end CHARACTERISTIC
/begin CHARACTERISTIC FuelEconomy_FilterC "Time constant for fuel economy filter" VALUE 0x80003888 RecordLayout_4 0 CompuMethod_110 0.001 100 /end CHARACTERISTIC
/begin CHARACTERISTIC FuelFlowCompMaxValue "Maximum value that can be adapted into the FuelFlowCompMap" VALUE 0x80003C58 RecordLayout_4 0 CompuMethod_29 0 2 /end CHARACTERISTIC
/begin CHARACTERISTIC FuelFlowCompMaxValue_BankA "Maximum value that can be adapted into the FuelFlowCompMap" VALUE 0x80003C5C RecordLayout_4 0 CompuMethod_29 0 2 /end CHARACTERISTIC
/begin CHARACTERISTIC FuelFlowCompMinValue "Minimum value that can be adapted into the FuelFlowCompMap" VALUE 0x80003C60 RecordLayout_4 0 CompuMethod_29 0 2 /end CHARACTERISTIC
/begin CHARACTERISTIC FuelFlowCompMinValue_BankA "Minimum value that can be adapted into the FuelFlowCompMap" VALUE 0x80003C64 RecordLayout_4 0 CompuMethod_29 0 2 /end CHARACTERISTIC
/begin CHARACTERISTIC FuelLevel_FiltConstMap "FuelLevel_FiltConst" MAP 0x80003C84 RecordLayout_4 0 CompuMethod_19 0 1E+17
 /begin AXIS_DESCR COM_AXIS FuelLevel_FiltConstColIn CompuMethod_111 7 0 1E+17 AXIS_PTS_REF FuelLevel_FiltConstColIdxArr /end AXIS_DESCR
 /begin AXIS_DESCR COM_AXIS FuelLevel_FiltConstRowIn CompuMethod_19 7 0 1E+17 AXIS_PTS_REF FuelLevel_FiltConstRowIdxArr /end AXIS_DESCR
/end CHARACTERISTIC
/begin CHARACTERISTIC FuelLevel_FuelEevntAlpha "Fuel event alpha" VALUE 0x80003D64 RecordLayout_4 0 CompuMethod_112 0 1E+17 /end CHARACTERISTIC
/begin CHARACTERISTIC FuelLevel_KeyUpDelay "Fuel level time from key on delay" VALUE 0x80003D68 RecordLayout_4 0 CompuMethod_19 0 1E+17 /end CHARACTERISTIC
/begin CHARACTERISTIC FuelLevl_KeyUpDiff "Fuel level key up different for refuel event" VALUE 0x80003D6C RecordLayout_4 0 CompuMethod_9 0 1E+17 /end CHARACTERISTIC
/begin CHARACTERISTIC FUELP_new "Override actuator, in engineering units" VALUE 0x80003D70 RecordLayout_2 0 CompuMethod_6 0 1 /end CHARACTERISTIC
/begin CHARACTERISTIC FUELP_ovr "" VALUE 0x80003D71 RecordLayout_2 0 CompuMethod_7 0 1 /end CHARACTERISTIC
/begin CHARACTERISTIC FUELP_Polarity "Inverts the output of the actuator relative to the desired command - 0 = High True    1 = Low True" VALUE 0x80003D72 RecordLayout_2 0 CompuMethod_6 0 1 /end CHARACTERISTIC
/begin CHARACTERISTIC FuelPres_DeltaTarget "Target fuel pressure delta across injector (rail - manifold)" VALUE 0x80003D73 RecordLayout_4 0 CompuMethod_16 -1E+17 1E+17 /end CHARACTERISTIC
/begin CHARACTERISTIC FuelPres_DeltaTolerance "Target fuel pressure delta across injector (rail - manifold)" VALUE 0x80003D77 RecordLayout_4 0 CompuMethod_16 -1E+17 1E+17 /end CHARACTERISTIC
/begin CHARACTERISTIC FuelPres_Filt "Filter time constant" VALUE 0x80003D7B RecordLayout_4 0 CompuMethod_19 -1E+17 1E+17 /end CHARACTERISTIC
/begin CHARACTERISTIC FuelPres_new "Override result of linear sensor characterization, in engineering units" VALUE 0x80003D7F RecordLayout_4 0 CompuMethod_14 -1E+17 1E+17 /end CHARACTERISTIC
/begin CHARACTERISTIC FuelPres_ovr "" VALUE 0x80003D83 RecordLayout_2 0 CompuMethod_7 0 1 /end CHARACTERISTIC
/begin CHARACTERISTIC FuelPresDfltValue "This is the initial default value should the sensor be in fault on key-up.  Otherwise the sensors outputs the last value prior to faulting" VALUE 0x80003D84 RecordLayout_4 0 CompuMethod_14 -1E+17 1E+17 /end CHARACTERISTIC
/begin CHARACTERISTIC FuelPresFilterConst "Filter time constant" VALUE 0x80003D88 RecordLayout_4 0 CompuMethod_19 -1E+17 1E+17 /end CHARACTERISTIC
/begin CHARACTERISTIC FuelPresGain "Scaling from A/D counts to engineering units" VALUE 0x80003D8C RecordLayout_4 0 CompuMethod_20 -1E+17 1E+17 /end CHARACTERISTIC
/begin CHARACTERISTIC FuelPresInputHiFltPos "Maximum allowable input, indicating short or open circuit" VALUE 0x80003D90 RecordLayout_4 0 CompuMethod_21 -1E+17 1E+17 /end CHARACTERISTIC
/begin CHARACTERISTIC FuelPresInputLoFltPos "Minimum allowable input, indicating short or open circuit" VALUE 0x80003D94 RecordLayout_4 0 CompuMethod_21 -1E+17 1E+17 /end CHARACTERISTIC
/begin CHARACTERISTIC FuelPresOfst "Offset after gain in engineering units" VALUE 0x80003D98 RecordLayout_4 0 CompuMethod_14 -1E+17 1E+17 /end CHARACTERISTIC
/begin CHARACTERISTIC FuelSens_new "Override result of linear sensor characterization, in engineering units" VALUE 0x80003DA0 RecordLayout_4 0 CompuMethod_9 -1E+17 1E+17 /end CHARACTERISTIC
/begin CHARACTERISTIC FuelSens_ovr "" VALUE 0x80003DA4 RecordLayout_2 0 CompuMethod_7 0 1 /end CHARACTERISTIC
/begin CHARACTERISTIC FuelSensDfltValue "This is the initial default value should the sensor be in fault on key-up.  Otherwise the sensors outputs the last value prior to faulting" VALUE 0x80003DA5 RecordLayout_4 0 CompuMethod_9 -1E+17 1E+17 /end CHARACTERISTIC
/begin CHARACTERISTIC FuelSensFilterConst "Filter time constant" VALUE 0x80003DA9 RecordLayout_4 0 CompuMethod_19 -1E+17 1E+17 /end CHARACTERISTIC
/begin CHARACTERISTIC FuelSensGain "Scaling from A/D counts to engineering units" VALUE 0x80003DAD RecordLayout_4 0 CompuMethod_114 -1E+17 1E+17 /end CHARACTERISTIC
/begin CHARACTERISTIC FuelSensInputHiFltPos "Maximum allowable input, indicating short or open circuit" VALUE 0x80003DB1 RecordLayout_4 0 CompuMethod_96 -1E+17 1E+17 /end CHARACTERISTIC
/begin CHARACTERISTIC FuelSensInputLoFltPos "Minimum allowable input, indicating short or open circuit" VALUE 0x80003DB5 RecordLayout_4 0 CompuMethod_96 -1E+17 1E+17 /end CHARACTERISTIC
/begin CHARACTERISTIC FuelSensOfst "Offset after gain in engineering units" VALUE 0x80003DB9 RecordLayout_4 0 CompuMethod_9 -1E+17 1E+17 /end CHARACTERISTIC
/begin CHARACTERISTIC Gain1 "Gain 1 For Moving Average Filter" VALUE 0x80003DBD RecordLayout_4 0 CompuMethod_2 -1E+17 1E+17 /end CHARACTERISTIC
/begin CHARACTERISTIC Gain2 "Gain 2 For Moving Average Filter" VALUE 0x80003DC1 RecordLayout_4 0 CompuMethod_2 -1E+17 1E+17 /end CHARACTERISTIC
/begin CHARACTERISTIC Gain3 "Gain 3 For Moving Average Filter" VALUE 0x80003DC5 RecordLayout_4 0 CompuMethod_2 -1E+17 1E+17 /end CHARACTERISTIC
/begin CHARACTERISTIC Gear1Ratio "" VALUE 0x80003DC9 RecordLayout_4 0 CompuMethod_2 -1E+17 1E+17 /end CHARACTERISTIC
/begin CHARACTERISTIC Gear2Ratio "" VALUE 0x80003DCD RecordLayout_4 0 CompuMethod_2 -1E+17 1E+17 /end CHARACTERISTIC
/begin CHARACTERISTIC Gear3Ratio "" VALUE 0x80003DD1 RecordLayout_4 0 CompuMethod_2 -1E+17 1E+17 /end CHARACTERISTIC
/begin CHARACTERISTIC Gear4Ratio "" VALUE 0x80003DD5 RecordLayout_4 0 CompuMethod_2 -1E+17 1E+17 /end CHARACTERISTIC
/begin CHARACTERISTIC Gear5Ratio "" VALUE 0x80003DD9 RecordLayout_4 0 CompuMethod_2 -1E+17 1E+17 /end CHARACTERISTIC
/begin CHARACTERISTIC Gear6Ratio "" VALUE 0x80003DDD RecordLayout_4 0 CompuMethod_2 -1E+17 1E+17 /end CHARACTERISTIC
/begin CHARACTERISTIC GearMatchHyst "" VALUE 0x80003DE1 RecordLayout_4 0 CompuMethod_2 -1E+17 1E+17 /end CHARACTERISTIC
/begin CHARACTERISTIC GPS_DateTime_Timeout "" VALUE 0x80003DE5 RecordLayout_3 0 CompuMethod_115 0 65535 /end CHARACTERISTIC
/begin CHARACTERISTIC GPS_LatLong_Timeout "" VALUE 0x80003DE7 RecordLayout_3 0 CompuMethod_115 0 65535 /end CHARACTERISTIC
/begin CHARACTERISTIC GPS_SpeedDir_Timeout "" VALUE 0x80003DE9 RecordLayout_3 0 CompuMethod_115 0 65535 /end CHARACTERISTIC
/begin CHARACTERISTIC HardCycle1Cyl1 "" VALUE 0x80003DEB RecordLayout_6 0 CompuMethod_116 -128 127 /end CHARACTERISTIC
/begin CHARACTERISTIC HardCycle1Cyl2 "" VALUE 0x80003DEC RecordLayout_6 0 CompuMethod_116 -128 127 /end CHARACTERISTIC
/begin CHARACTERISTIC HardCycle1Cyl3 "" VALUE 0x80003DED RecordLayout_6 0 CompuMethod_116 -128 127 /end CHARACTERISTIC
/begin CHARACTERISTIC HardCycle1Cyl4 "" VALUE 0x80003DEE RecordLayout_6 0 CompuMethod_116 -128 127 /end CHARACTERISTIC
/begin CHARACTERISTIC HardCycle1Cyl5 "" VALUE 0x80003DEF RecordLayout_6 0 CompuMethod_116 -128 127 /end CHARACTERISTIC
/begin CHARACTERISTIC HardCycle1Cyl6 "" VALUE 0x80003DF0 RecordLayout_6 0 CompuMethod_116 -128 127 /end CHARACTERISTIC
/begin CHARACTERISTIC HardCycle1Cyl7 "" VALUE 0x80003DF1 RecordLayout_6 0 CompuMethod_116 -128 127 /end CHARACTERISTIC
/begin CHARACTERISTIC HardCycle1Cyl8 "" VALUE 0x80003DF2 RecordLayout_6 0 CompuMethod_116 -128 127 /end CHARACTERISTIC
/begin CHARACTERISTIC HardCycle2Cyl1 "" VALUE 0x80003DF3 RecordLayout_6 0 CompuMethod_116 -128 127 /end CHARACTERISTIC
/begin CHARACTERISTIC HardCycle2Cyl2 "" VALUE 0x80003DF4 RecordLayout_6 0 CompuMethod_116 -128 127 /end CHARACTERISTIC
/begin CHARACTERISTIC HardCycle2Cyl3 "" VALUE 0x80003DF5 RecordLayout_6 0 CompuMethod_116 -128 127 /end CHARACTERISTIC
/begin CHARACTERISTIC HardCycle2Cyl4 "" VALUE 0x80003DF6 RecordLayout_6 0 CompuMethod_116 -128 127 /end CHARACTERISTIC
/begin CHARACTERISTIC HardCycle2Cyl5 "" VALUE 0x80003DF7 RecordLayout_6 0 CompuMethod_116 -128 127 /end CHARACTERISTIC
/begin CHARACTERISTIC HardCycle2Cyl6 "" VALUE 0x80003DF8 RecordLayout_6 0 CompuMethod_116 -128 127 /end CHARACTERISTIC
/begin CHARACTERISTIC HardCycle2Cyl7 "" VALUE 0x80003DF9 RecordLayout_6 0 CompuMethod_116 -128 127 /end CHARACTERISTIC
/begin CHARACTERISTIC HardCycle2Cyl8 "" VALUE 0x80003DFA RecordLayout_6 0 CompuMethod_116 -128 127 /end CHARACTERISTIC
/begin CHARACTERISTIC HardCycle3Cyl1 "" VALUE 0x80003DFB RecordLayout_6 0 CompuMethod_116 -128 127 /end CHARACTERISTIC
/begin CHARACTERISTIC HardCycle3Cyl2 "" VALUE 0x80003DFC RecordLayout_6 0 CompuMethod_116 -128 127 /end CHARACTERISTIC
/begin CHARACTERISTIC HardCycle3Cyl3 "" VALUE 0x80003DFD RecordLayout_6 0 CompuMethod_116 -128 127 /end CHARACTERISTIC
/begin CHARACTERISTIC HardCycle3Cyl4 "" VALUE 0x80003DFE RecordLayout_6 0 CompuMethod_116 -128 127 /end CHARACTERISTIC
/begin CHARACTERISTIC HardCycle3Cyl5 "" VALUE 0x80003DFF RecordLayout_6 0 CompuMethod_116 -128 127 /end CHARACTERISTIC
/begin CHARACTERISTIC HardCycle3Cyl6 "" VALUE 0x80003E00 RecordLayout_6 0 CompuMethod_116 -128 127 /end CHARACTERISTIC
/begin CHARACTERISTIC HardCycle3Cyl7 "" VALUE 0x80003E01 RecordLayout_6 0 CompuMethod_116 -128 127 /end CHARACTERISTIC
/begin CHARACTERISTIC HardCycle3Cyl8 "" VALUE 0x80003E02 RecordLayout_6 0 CompuMethod_116 -128 127 /end CHARACTERISTIC
/begin CHARACTERISTIC HardCycle4Cyl1 "" VALUE 0x80003E03 RecordLayout_6 0 CompuMethod_116 -128 127 /end CHARACTERISTIC
/begin CHARACTERISTIC HardCycle4Cyl2 "" VALUE 0x80003E04 RecordLayout_6 0 CompuMethod_116 -128 127 /end CHARACTERISTIC
/begin CHARACTERISTIC HardCycle4Cyl3 "" VALUE 0x80003E05 RecordLayout_6 0 CompuMethod_116 -128 127 /end CHARACTERISTIC
/begin CHARACTERISTIC HardCycle4Cyl4 "" VALUE 0x80003E06 RecordLayout_6 0 CompuMethod_116 -128 127 /end CHARACTERISTIC
/begin CHARACTERISTIC HardCycle4Cyl5 "" VALUE 0x80003E07 RecordLayout_6 0 CompuMethod_116 -128 127 /end CHARACTERISTIC
/begin CHARACTERISTIC HardCycle4Cyl6 "" VALUE 0x80003E08 RecordLayout_6 0 CompuMethod_116 -128 127 /end CHARACTERISTIC
/begin CHARACTERISTIC HardCycle4Cyl7 "" VALUE 0x80003E09 RecordLayout_6 0 CompuMethod_116 -128 127 /end CHARACTERISTIC
/begin CHARACTERISTIC HardCycle4Cyl8 "" VALUE 0x80003E0A RecordLayout_6 0 CompuMethod_116 -128 127 /end CHARACTERISTIC
/begin CHARACTERISTIC IAC_P_new "Override result of linear sensor characterization, in engineering units" VALUE 0x80003E13 RecordLayout_4 0 CompuMethod_9 -1E+17 1E+17 /end CHARACTERISTIC
/begin CHARACTERISTIC IAC_P_ovr "" VALUE 0x80003E17 RecordLayout_2 0 CompuMethod_7 0 1 /end CHARACTERISTIC
/begin CHARACTERISTIC IAC_PFrequency "Frequency of PWM output" VALUE 0x80003E18 RecordLayout_4 0 CompuMethod_96 -1E+17 1E+17 /end CHARACTERISTIC
/begin CHARACTERISTIC IAC_PGain "Scaling from engineering units to PWM duty cycle" VALUE 0x80003E1C RecordLayout_4 0 CompuMethod_102 -1E+17 1E+17 /end CHARACTERISTIC
/begin CHARACTERISTIC IAC_PMaxLimit "Maximum limit of PWM signal." VALUE 0x80003E20 RecordLayout_4 0 CompuMethod_9 -1E+17 1E+17 /end CHARACTERISTIC
/begin CHARACTERISTIC IAC_PMinLimit "Minimum limit of PWM signal." VALUE 0x80003E24 RecordLayout_4 0 CompuMethod_9 -1E+17 1E+17 /end CHARACTERISTIC
/begin CHARACTERISTIC IAC_POffset "Offset from engineering units to PWM duty cycle" VALUE 0x80003E28 RecordLayout_4 0 CompuMethod_9 -1E+17 1E+17 /end CHARACTERISTIC
/begin CHARACTERISTIC IAC_S_new "Override result of linear sensor characterization, in engineering units" VALUE 0x80003E2C RecordLayout_4 0 CompuMethod_9 -1E+17 1E+17 /end CHARACTERISTIC
/begin CHARACTERISTIC IAC_S_ovr "" VALUE 0x80003E30 RecordLayout_2 0 CompuMethod_7 0 1 /end CHARACTERISTIC
/begin CHARACTERISTIC IAC_SFrequency "Frequency of PWM output" VALUE 0x80003E31 RecordLayout_4 0 CompuMethod_96 -1E+17 1E+17 /end CHARACTERISTIC
/begin CHARACTERISTIC IAC_SGain "Scaling from engineering units to PWM duty cycle" VALUE 0x80003E35 RecordLayout_4 0 CompuMethod_102 -1E+17 1E+17 /end CHARACTERISTIC
/begin CHARACTERISTIC IAC_SMaxLimit "Maximum limit of PWM signal." VALUE 0x80003E39 RecordLayout_4 0 CompuMethod_9 -1E+17 1E+17 /end CHARACTERISTIC
/begin CHARACTERISTIC IAC_SMinLimit "Minimum limit of PWM signal." VALUE 0x80003E3D RecordLayout_4 0 CompuMethod_9 -1E+17 1E+17 /end CHARACTERISTIC
/begin CHARACTERISTIC IAC_SOffset "Offset from engineering units to PWM duty cycle" VALUE 0x80003E41 RecordLayout_4 0 CompuMethod_9 -1E+17 1E+17 /end CHARACTERISTIC
/begin CHARACTERISTIC IAT_KeyUp_Count "Number of samples to average at key-up to produce signal value" VALUE 0x80003E46 RecordLayout_6 0 CompuMethod_1 -128 127 /end CHARACTERISTIC
/begin CHARACTERISTIC IAT_new "Override result of linear sensor characterization, in engineering units" VALUE 0x80003E6B RecordLayout_4 0 CompuMethod_59 -1E+17 1E+17 /end CHARACTERISTIC
/begin CHARACTERISTIC IAT_ovr "" VALUE 0x80003E6F RecordLayout_2 0 CompuMethod_7 0 1 /end CHARACTERISTIC
/begin CHARACTERISTIC IATDefault "This is the initial default value should the sensor be in fault on key-up.  Otherwise the sensors outputs the last value prior to faulting" VALUE 0x8000403C RecordLayout_4 0 CompuMethod_59 -1E+17 1E+17 /end CHARACTERISTIC
/begin CHARACTERISTIC IATFiltConst "Filter time constant" VALUE 0x80004120 RecordLayout_4 0 CompuMethod_19 -1E+17 1E+17 /end CHARACTERISTIC
/begin CHARACTERISTIC IATMax "Maximum allowable input, indicating short or open circuit" VALUE 0x80004158 RecordLayout_4 0 CompuMethod_21 -1E+17 1E+17 /end CHARACTERISTIC
/begin CHARACTERISTIC IATMin "Minimum allowable input, indicating short or open circuit" VALUE 0x8000415C RecordLayout_4 0 CompuMethod_21 -1E+17 1E+17 /end CHARACTERISTIC
/begin CHARACTERISTIC IATTbl "Look up table to allownon-linear characterization of sensors" CURVE 0x80004160 RecordLayout_4 0 CompuMethod_59 -1E+17 1E+17
 /begin AXIS_DESCR COM_AXIS IATADC CompuMethod_21 13 -1E+17 1E+17 AXIS_PTS_REF IATIdxArr /end AXIS_DESCR
/end CHARACTERISTIC
/begin CHARACTERISTIC IdleEntryAirRampInFiltC "Decays TPS Setpoint from Crank TPS to Run State base value at this rate." VALUE 0x80004194 RecordLayout_4 0 CompuMethod_19 0.005 1E+17 /end CHARACTERISTIC
/begin CHARACTERISTIC InGearRPMCtrlEntryFiltC "Sets decay rate of RPM setpoint from entry RPM." VALUE 0x8000419E RecordLayout_4 0 CompuMethod_19 0.005 1E+17 /end CHARACTERISTIC
/begin CHARACTERISTIC InjdPCompTbl "Injector characterization compenastion based on dP across injector." CURVE 0x800041C6 RecordLayout_4 0 CompuMethod_120 -1E+17 1E+17
 /begin AXIS_DESCR COM_AXIS InjDeltaPress09In CompuMethod_2 9 -1E+17 1E+17 AXIS_PTS_REF InjDeltaPress09IdxArr /end AXIS_DESCR
/end CHARACTERISTIC
/begin CHARACTERISTIC InjEnable_new "" VAL_BLK 0x800041FA RecordLayout_2 0 CompuMethod_12 0 1 MATRIX_DIM 8 1 1 /end CHARACTERISTIC
/begin CHARACTERISTIC InjEnable_ovr "" VALUE 0x80004202 RecordLayout_2 0 CompuMethod_7 0 1 /end CHARACTERISTIC
/begin CHARACTERISTIC InjGain "Gain value used in the linear transformation of FPC to mechanical pulsewidth." VALUE 0x80004203 RecordLayout_4 0 CompuMethod_121 0 1E+17 /end CHARACTERISTIC
/begin CHARACTERISTIC InjOffset "Offset value used in the linear transformation of FPC to mechanical pulsewidth." VALUE 0x80004207 RecordLayout_4 0 CompuMethod_122 -1E+17 1E+17 /end CHARACTERISTIC
/begin CHARACTERISTIC InjTurnOffTbl "Injector turn off time" CURVE 0x8000420B RecordLayout_4 0 CompuMethod_68 -1E+17 1E+17
 /begin AXIS_DESCR COM_AXIS InjDeltaPress09In CompuMethod_2 9 -1E+17 1E+17 AXIS_PTS_REF InjDeltaPress09IdxArr /end AXIS_DESCR
/end CHARACTERISTIC
/begin CHARACTERISTIC InjTurnOnTbl "Injector turn on time." CURVE 0x8000422F RecordLayout_4 0 CompuMethod_68 -1E+17 1E+17
 /begin AXIS_DESCR COM_AXIS SysVolt09In CompuMethod_152 9 0 32 AXIS_PTS_REF SysVolt09IdxArr /end AXIS_DESCR
/end CHARACTERISTIC
/begin CHARACTERISTIC Lambda1_VoltHighThresh "" VALUE 0x800042BD RecordLayout_4 0 CompuMethod_2 -1E+17 1E+17 /end CHARACTERISTIC
/begin CHARACTERISTIC Lambda1_VoltLowThresh "" VALUE 0x800042C1 RecordLayout_4 0 CompuMethod_2 -1E+17 1E+17 /end CHARACTERISTIC
/begin CHARACTERISTIC Lambda2_VoltHighThresh "" VALUE 0x800042C5 RecordLayout_4 0 CompuMethod_2 -1E+17 1E+17 /end CHARACTERISTIC
/begin CHARACTERISTIC Lambda2_VoltLowThresh "" VALUE 0x800042C9 RecordLayout_4 0 CompuMethod_2 -1E+17 1E+17 /end CHARACTERISTIC
/begin CHARACTERISTIC LeanProtect_Threshold "Target fuel pressure delta across injector (rail - manifold)" VALUE 0x800042CD RecordLayout_4 0 CompuMethod_16 -1E+17 1E+17 /end CHARACTERISTIC
/begin CHARACTERISTIC LeanSwPtDeltaMap "If actual O2 reaches this point, switch the target to the RichTargetDelta" MAP 0x800042D1 RecordLayout_4 0 CompuMethod_41 -1E+17 1E+17
 /begin AXIS_DESCR COM_AXIS RPM09In CompuMethod_72 9 0 14000 AXIS_PTS_REF RPM09IdxArr /end AXIS_DESCR
 /begin AXIS_DESCR COM_AXIS MAP09In CompuMethod_16 9 0 1000 AXIS_PTS_REF MAP09IdxArr /end AXIS_DESCR
/end CHARACTERISTIC
/begin CHARACTERISTIC LeanTargetDeltaMap "Target on the lean side for perturbation." MAP 0x80004415 RecordLayout_4 0 CompuMethod_41 -1E+17 1E+17
 /begin AXIS_DESCR COM_AXIS RPM09In CompuMethod_72 9 0 14000 AXIS_PTS_REF RPM09IdxArr /end AXIS_DESCR
 /begin AXIS_DESCR COM_AXIS MAP09In CompuMethod_16 9 0 1000 AXIS_PTS_REF MAP09IdxArr /end AXIS_DESCR
/end CHARACTERISTIC
/begin CHARACTERISTIC LoadCalibrationError "Debug value for LoadCalibrationError" VALUE 0x80004559 RecordLayout_3 0 CompuMethod_57 0 65535 /end CHARACTERISTIC
/begin CHARACTERISTIC LVDiag_AltInop "" VALUE 0x8000455B RecordLayout_4 0 CompuMethod_2 -1E+17 1E+17 /end CHARACTERISTIC
/begin CHARACTERISTIC LVDiag_VoltLow "" VALUE 0x8000455F RecordLayout_4 0 CompuMethod_2 -1E+17 1E+17 /end CHARACTERISTIC
/begin CHARACTERISTIC LVDiag_VoltTooHigh "" VALUE 0x80004563 RecordLayout_4 0 CompuMethod_2 -1E+17 1E+17 /end CHARACTERISTIC
/begin CHARACTERISTIC MAF_new "Override result of linear sensor characterization, in engineering units" VALUE 0x80004567 RecordLayout_4 0 CompuMethod_27 -1E+17 1E+17 /end CHARACTERISTIC
/begin CHARACTERISTIC MAF_ovr "" VALUE 0x8000456B RecordLayout_2 0 CompuMethod_7 0 1 /end CHARACTERISTIC
/begin CHARACTERISTIC MAFDefault "This is the initial default value should the sensor be in fault on key-up.  Otherwise the sensors outputs the last value prior to faulting" VALUE 0x80004591 RecordLayout_4 0 CompuMethod_27 -1E+17 1E+17 /end CHARACTERISTIC
/begin CHARACTERISTIC MAFFiltConst "Filter time constant" VALUE 0x80004595 RecordLayout_4 0 CompuMethod_19 -1E+17 1E+17 /end CHARACTERISTIC
/begin CHARACTERISTIC MAFMax "Maximum allowable input, indicating short or open circuit" VALUE 0x800045CD RecordLayout_4 0 CompuMethod_96 -1E+17 1E+17 /end CHARACTERISTIC
/begin CHARACTERISTIC MAFMin "Minimum allowable input, indicating short or open circuit" VALUE 0x800045D1 RecordLayout_4 0 CompuMethod_96 -1E+17 1E+17 /end CHARACTERISTIC
/begin CHARACTERISTIC MAFTbl "Look up table to allownon-linear characterization of sensors" CURVE 0x800045E9 RecordLayout_4 0 CompuMethod_27 -1E+17 1E+17
 /begin AXIS_DESCR COM_AXIS MAFADC CompuMethod_96 13 -1E+17 1E+17 AXIS_PTS_REF MAFIdxArr /end AXIS_DESCR
/end CHARACTERISTIC
/begin CHARACTERISTIC MakeUp_EOI_new "" VALUE 0x8000461F RecordLayout_4 0 CompuMethod_2 -1E+17 1E+17 /end CHARACTERISTIC
/begin CHARACTERISTIC MakeUp_EOI_ovr "" VALUE 0x80004623 RecordLayout_2 0 CompuMethod_7 0 1 /end CHARACTERISTIC
/begin CHARACTERISTIC MAP_filt "Filter time constant" VALUE 0x80004768 RecordLayout_4 0 CompuMethod_19 -1E+17 1E+17 /end CHARACTERISTIC
/begin CHARACTERISTIC MAP_IR_HI "In-range MAP fault logic. Maximum value that MAP should not exceed with closed throttle and engine running" VALUE 0x8000476C RecordLayout_4 0 CompuMethod_16 0 1E+17 /end CHARACTERISTIC
/begin CHARACTERISTIC MAP_IR_LO "In-range MAP fault logic. Minimum value that MAP should not be less than with open throttle and engine running" VALUE 0x80004770 RecordLayout_4 0 CompuMethod_16 0 1E+17 /end CHARACTERISTIC
/begin CHARACTERISTIC MAP_IR_TPS_CL "In-range MAP fault logic.  Maximum throttle position, below which MAP should be less than MAP_IR_HI" VALUE 0x80004774 RecordLayout_4 0 CompuMethod_9 0 1E+17 /end CHARACTERISTIC
/begin CHARACTERISTIC MAP_IR_TPS_OP "In-range MAP fault logic.  Minimum throttle position, above which MAP should be greater than MAP_IR_LO" VALUE 0x80004778 RecordLayout_4 0 CompuMethod_9 0 1E+17 /end CHARACTERISTIC
/begin CHARACTERISTIC MAP_new "Override result of linear sensor characterization, in engineering units" VALUE 0x8000477C RecordLayout_4 0 CompuMethod_16 -1E+17 1E+17 /end CHARACTERISTIC
/begin CHARACTERISTIC MAP_ovr "" VALUE 0x80004780 RecordLayout_2 0 CompuMethod_7 0 1 /end CHARACTERISTIC
/begin CHARACTERISTIC MAP_STUCK "In-range MAP fault logic.  Minimum difference between MAP and BARO with throttle closed. If less than this, a fault exists" VALUE 0x80004781 RecordLayout_4 0 CompuMethod_16 0 1E+17 /end CHARACTERISTIC
/begin CHARACTERISTIC MAP_TPS_STUCK "In-range MAP fault logic.  Maximum throttle position, below_which MAP should be less than BARO" VALUE 0x80004785 RecordLayout_4 0 CompuMethod_9 0 1E+17 /end CHARACTERISTIC
/begin CHARACTERISTIC MAPDfltValue "This is the initial default value should the sensor be in fault on key-up.  Otherwise the sensors outputs the last value prior to faulting" VALUE 0x80004805 RecordLayout_4 0 CompuMethod_16 -1E+17 1E+17 /end CHARACTERISTIC
/begin CHARACTERISTIC MAPFilterConst "Filter time constant" VALUE 0x80004809 RecordLayout_4 0 CompuMethod_19 -1E+17 1E+17 /end CHARACTERISTIC
/begin CHARACTERISTIC MAPGain "Scaling from A/D counts to engineering units" VALUE 0x8000480D RecordLayout_4 0 CompuMethod_125 -1E+17 1E+17 /end CHARACTERISTIC
/begin CHARACTERISTIC MAPInputHiFltPos "Maximum allowable input, indicating short or open circuit" VALUE 0x80004811 RecordLayout_4 0 CompuMethod_21 -1E+17 1E+17 /end CHARACTERISTIC
/begin CHARACTERISTIC MAPInputLoFltPos "Minimum allowable input, indicating short or open circuit" VALUE 0x80004815 RecordLayout_4 0 CompuMethod_21 -1E+17 1E+17 /end CHARACTERISTIC
/begin CHARACTERISTIC MAPOfst "Offset after gain in engineering units" VALUE 0x80004819 RecordLayout_4 0 CompuMethod_16 -1E+17 1E+17 /end CHARACTERISTIC
/begin CHARACTERISTIC MAPTime_new "Override result of linear sensor characterization, in engineering units" VALUE 0x8000481D RecordLayout_4 0 CompuMethod_16 -1E+17 1E+17 /end CHARACTERISTIC
/begin CHARACTERISTIC MAPTime_ovr "" VALUE 0x80004821 RecordLayout_2 0 CompuMethod_7 0 1 /end CHARACTERISTIC
/begin CHARACTERISTIC MAPTimeDfltValue "This is the initial default value should the sensor be in fault on key-up.  Otherwise the sensors outputs the last value prior to faulting" VALUE 0x80004822 RecordLayout_4 0 CompuMethod_16 -1E+17 1E+17 /end CHARACTERISTIC
/begin CHARACTERISTIC MAPTimeFilterConst "Filter time constant" VALUE 0x80004826 RecordLayout_4 0 CompuMethod_19 -1E+17 1E+17 /end CHARACTERISTIC
/begin CHARACTERISTIC MAPTimeGain "Scaling from A/D counts to engineering units" VALUE 0x8000482A RecordLayout_4 0 CompuMethod_125 -1E+17 1E+17 /end CHARACTERISTIC
/begin CHARACTERISTIC MAPTimeInputHiFltPos "Maximum allowable input, indicating short or open circuit" VALUE 0x8000482E RecordLayout_4 0 CompuMethod_21 -1E+17 1E+17 /end CHARACTERISTIC
/begin CHARACTERISTIC MAPTimeInputLoFltPos "Minimum allowable input, indicating short or open circuit" VALUE 0x80004832 RecordLayout_4 0 CompuMethod_21 -1E+17 1E+17 /end CHARACTERISTIC
/begin CHARACTERISTIC MAPTimeOfst "Offset after gain in engineering units" VALUE 0x80004836 RecordLayout_4 0 CompuMethod_16 -1E+17 1E+17 /end CHARACTERISTIC
/begin CHARACTERISTIC MaxGovDGain "Base D-gain for the max. governor controller." VALUE 0x8000485E RecordLayout_4 0 CompuMethod_29 -1E+17 1E+17 /end CHARACTERISTIC
/begin CHARACTERISTIC MaxGovDGainErrorMultTbl "" CURVE 0x80004862 RecordLayout_4 0 CompuMethod_29 -1E+17 1E+17
 /begin AXIS_DESCR COM_AXIS MaxGovSpeedErrorIn CompuMethod_72 9 -1E+17 1E+17 AXIS_PTS_REF MaxGovSpeedErrorIdxArr /end AXIS_DESCR
/end CHARACTERISTIC
/begin CHARACTERISTIC MaxGovDisable "Max governor manual disable" VALUE 0x80004886 RecordLayout_2 0 CompuMethod_126 0 1 /end CHARACTERISTIC
/begin CHARACTERISTIC MaxGovErrorGain "Error gain for the max governor controller. This gain is applied to the RPM error term before it is used to calculate the P, I and D terms." VALUE 0x80004887 RecordLayout_4 0 CompuMethod_29 -1E+17 1E+17 /end CHARACTERISTIC
/begin CHARACTERISTIC MaxGovIGain "Base I-gain for the max. governor controller." VALUE 0x8000488B RecordLayout_4 0 CompuMethod_29 -1E+17 1E+17 /end CHARACTERISTIC
/begin CHARACTERISTIC MaxGovIGainErrorMultTbl "" CURVE 0x8000488F RecordLayout_4 0 CompuMethod_29 -1E+17 1E+17
 /begin AXIS_DESCR COM_AXIS MaxGovSpeedErrorIn CompuMethod_72 9 -1E+17 1E+17 AXIS_PTS_REF MaxGovSpeedErrorIdxArr /end AXIS_DESCR
/end CHARACTERISTIC
/begin CHARACTERISTIC MaxGovInGearLowerLim "Max Gov RPM setpoint when in gear." VALUE 0x800048B3 RecordLayout_3 0 CompuMethod_22 0 65535 /end CHARACTERISTIC
/begin CHARACTERISTIC MaxGovInGearRPMSetPt "Max Gov RPM setpoint when in gear." VALUE 0x800048B5 RecordLayout_3 0 CompuMethod_22 0 65535 /end CHARACTERISTIC
/begin CHARACTERISTIC MaxGovInGearRPMThresh "When in-gear, RPM has to pass the base RPM setpoint minus this calibration. to start the I term preload and ramp-in." VALUE 0x800048B7 RecordLayout_3 0 CompuMethod_22 0 65535 /end CHARACTERISTIC
/begin CHARACTERISTIC MaxGovInGearUpperLim "Max Gov RPM setpoint when in gear." VALUE 0x800048B9 RecordLayout_3 0 CompuMethod_22 0 65535 /end CHARACTERISTIC
/begin CHARACTERISTIC MaxGovITermLowerLimit "Lower limit on max governor I-term value." VALUE 0x800048BB RecordLayout_4 0 CompuMethod_9 -1E+17 1E+17 /end CHARACTERISTIC
/begin CHARACTERISTIC MaxGovITermUpperLimit "Upper limit on max governor I-term value." VALUE 0x800048BF RecordLayout_4 0 CompuMethod_9 -1E+17 1E+17 /end CHARACTERISTIC
/begin CHARACTERISTIC MaxGovNtrlLowerLim "Max Gov RPM setpoint when in gear." VALUE 0x800048C3 RecordLayout_3 0 CompuMethod_22 0 65535 /end CHARACTERISTIC
/begin CHARACTERISTIC MaxGovNtrlRPMSetPt "Max Gov RPM setpoint when in neutral." VALUE 0x800048C5 RecordLayout_3 0 CompuMethod_22 0 65535 /end CHARACTERISTIC
/begin CHARACTERISTIC MaxGovNtrlRPMThresh "When in neutral, RPM has to pass the base RPM setpoint minus this calibration. to start the I term preload and ramp-in." VALUE 0x800048C7 RecordLayout_3 0 CompuMethod_22 0 65535 /end CHARACTERISTIC
/begin CHARACTERISTIC MaxGovNtrlUpperLim "Max Gov RPM setpoint when in gear." VALUE 0x800048C9 RecordLayout_3 0 CompuMethod_22 0 65535 /end CHARACTERISTIC
/begin CHARACTERISTIC MaxGovPGain "Base P-gain for the max. governor controller." VALUE 0x800048CB RecordLayout_4 0 CompuMethod_29 -1E+17 1E+17 /end CHARACTERISTIC
/begin CHARACTERISTIC MaxGovPGainErrorMultTbl "" CURVE 0x800048CF RecordLayout_4 0 CompuMethod_29 -1E+17 1E+17
 /begin AXIS_DESCR COM_AXIS MaxGovSpeedErrorIn CompuMethod_72 9 -1E+17 1E+17 AXIS_PTS_REF MaxGovSpeedErrorIdxArr /end AXIS_DESCR
/end CHARACTERISTIC
/begin CHARACTERISTIC MaxGovPIDOutLowerLimit "Lower limit on max governor PID Output." VALUE 0x800048F3 RecordLayout_4 0 CompuMethod_9 -1E+17 1E+17 /end CHARACTERISTIC
/begin CHARACTERISTIC MaxGovPIDOutUpperLimit "Upper limit on max governor PID Output." VALUE 0x800048F7 RecordLayout_4 0 CompuMethod_9 -1E+17 1E+17 /end CHARACTERISTIC
/begin CHARACTERISTIC MaxGovPreloadITermTbl "Preload for Max Gov PID ITerm based on engine acceleration rate upon entry into max gov." CURVE 0x800048FB RecordLayout_4 0 CompuMethod_9 -1E+17 1E+17
 /begin AXIS_DESCR COM_AXIS RPMAccel17In CompuMethod_2 17 -1E+17 1E+17 AXIS_PTS_REF RPMAccel17IdxArr /end AXIS_DESCR
/end CHARACTERISTIC
/begin CHARACTERISTIC MaxGovRPMCtrlEntryFiltC "Filter rate at which Max Gov setup is increased to MaxGovBaseRPMSetpoint." VALUE 0x8000493F RecordLayout_4 0 CompuMethod_19 0.005 1E+17 /end CHARACTERISTIC
/begin CHARACTERISTIC MaxGovTPSHyst "Hysterisis around max gov TPS entry criteria." VALUE 0x80004967 RecordLayout_4 0 CompuMethod_9 0 1E+17 /end CHARACTERISTIC
/begin CHARACTERISTIC MaxSparkLimitOffIdle "Max. spark limit on the delivered spark advance, when not in idle control." VALUE 0x8000496B RecordLayout_4 0 CompuMethod_70 -1E+17 1E+17 /end CHARACTERISTIC
/begin CHARACTERISTIC MaxSparkLimitTbl "Maximum allowable spark advance." CURVE 0x8000496F RecordLayout_4 0 CompuMethod_70 -1E+17 1E+17
 /begin AXIS_DESCR COM_AXIS MAP09In CompuMethod_16 9 0 1000 AXIS_PTS_REF MAP09IdxArr /end AXIS_DESCR
/end CHARACTERISTIC
/begin CHARACTERISTIC Mech_PW_new "" VAL_BLK 0x80004993 RecordLayout_4 0 CompuMethod_2 -1E+17 1E+17 MATRIX_DIM 8 1 1 /end CHARACTERISTIC
/begin CHARACTERISTIC Mech_PW_ovr "" VALUE 0x800049B3 RecordLayout_2 0 CompuMethod_7 0 1 /end CHARACTERISTIC
/begin CHARACTERISTIC MediumCycle1Cyl1 "" VALUE 0x800049B4 RecordLayout_6 0 CompuMethod_116 -128 127 /end CHARACTERISTIC
/begin CHARACTERISTIC MediumCycle1Cyl2 "" VALUE 0x800049B5 RecordLayout_6 0 CompuMethod_116 -128 127 /end CHARACTERISTIC
/begin CHARACTERISTIC MediumCycle1Cyl3 "" VALUE 0x800049B6 RecordLayout_6 0 CompuMethod_116 -128 127 /end CHARACTERISTIC
/begin CHARACTERISTIC MediumCycle1Cyl4 "" VALUE 0x800049B7 RecordLayout_6 0 CompuMethod_116 -128 127 /end CHARACTERISTIC
/begin CHARACTERISTIC MediumCycle1Cyl5 "" VALUE 0x800049B8 RecordLayout_6 0 CompuMethod_116 -128 127 /end CHARACTERISTIC
/begin CHARACTERISTIC MediumCycle1Cyl6 "" VALUE 0x800049B9 RecordLayout_6 0 CompuMethod_116 -128 127 /end CHARACTERISTIC
/begin CHARACTERISTIC MediumCycle1Cyl7 "" VALUE 0x800049BA RecordLayout_6 0 CompuMethod_116 -128 127 /end CHARACTERISTIC
/begin CHARACTERISTIC MediumCycle1Cyl8 "" VALUE 0x800049BB RecordLayout_6 0 CompuMethod_116 -128 127 /end CHARACTERISTIC
/begin CHARACTERISTIC MediumCycle2Cyl1 "" VALUE 0x800049BC RecordLayout_6 0 CompuMethod_116 -128 127 /end CHARACTERISTIC
/begin CHARACTERISTIC MediumCycle2Cyl2 "" VALUE 0x800049BD RecordLayout_6 0 CompuMethod_116 -128 127 /end CHARACTERISTIC
/begin CHARACTERISTIC MediumCycle2Cyl3 "" VALUE 0x800049BE RecordLayout_6 0 CompuMethod_116 -128 127 /end CHARACTERISTIC
/begin CHARACTERISTIC MediumCycle2Cyl4 "" VALUE 0x800049BF RecordLayout_6 0 CompuMethod_116 -128 127 /end CHARACTERISTIC
/begin CHARACTERISTIC MediumCycle2Cyl5 "" VALUE 0x800049C0 RecordLayout_6 0 CompuMethod_116 -128 127 /end CHARACTERISTIC
/begin CHARACTERISTIC MediumCycle2Cyl6 "" VALUE 0x800049C1 RecordLayout_6 0 CompuMethod_116 -128 127 /end CHARACTERISTIC
/begin CHARACTERISTIC MediumCycle2Cyl7 "" VALUE 0x800049C2 RecordLayout_6 0 CompuMethod_116 -128 127 /end CHARACTERISTIC
/begin CHARACTERISTIC MediumCycle2Cyl8 "" VALUE 0x800049C3 RecordLayout_6 0 CompuMethod_116 -128 127 /end CHARACTERISTIC
/begin CHARACTERISTIC MediumCycle3Cyl1 "" VALUE 0x800049C4 RecordLayout_6 0 CompuMethod_116 -128 127 /end CHARACTERISTIC
/begin CHARACTERISTIC MediumCycle3Cyl2 "" VALUE 0x800049C5 RecordLayout_6 0 CompuMethod_116 -128 127 /end CHARACTERISTIC
/begin CHARACTERISTIC MediumCycle3Cyl3 "" VALUE 0x800049C6 RecordLayout_6 0 CompuMethod_116 -128 127 /end CHARACTERISTIC
/begin CHARACTERISTIC MediumCycle3Cyl4 "" VALUE 0x800049C7 RecordLayout_6 0 CompuMethod_116 -128 127 /end CHARACTERISTIC
/begin CHARACTERISTIC MediumCycle3Cyl5 "" VALUE 0x800049C8 RecordLayout_6 0 CompuMethod_116 -128 127 /end CHARACTERISTIC
/begin CHARACTERISTIC MediumCycle3Cyl6 "" VALUE 0x800049C9 RecordLayout_6 0 CompuMethod_116 -128 127 /end CHARACTERISTIC
/begin CHARACTERISTIC MediumCycle3Cyl7 "" VALUE 0x800049CA RecordLayout_6 0 CompuMethod_116 -128 127 /end CHARACTERISTIC
/begin CHARACTERISTIC MediumCycle3Cyl8 "" VALUE 0x800049CB RecordLayout_6 0 CompuMethod_116 -128 127 /end CHARACTERISTIC
/begin CHARACTERISTIC MediumCycle4Cyl1 "" VALUE 0x800049CC RecordLayout_6 0 CompuMethod_116 -128 127 /end CHARACTERISTIC
/begin CHARACTERISTIC MediumCycle4Cyl2 "" VALUE 0x800049CD RecordLayout_6 0 CompuMethod_116 -128 127 /end CHARACTERISTIC
/begin CHARACTERISTIC MediumCycle4Cyl3 "" VALUE 0x800049CE RecordLayout_6 0 CompuMethod_116 -128 127 /end CHARACTERISTIC
/begin CHARACTERISTIC MediumCycle4Cyl4 "" VALUE 0x800049CF RecordLayout_6 0 CompuMethod_116 -128 127 /end CHARACTERISTIC
/begin CHARACTERISTIC MediumCycle4Cyl5 "" VALUE 0x800049D0 RecordLayout_6 0 CompuMethod_116 -128 127 /end CHARACTERISTIC
/begin CHARACTERISTIC MediumCycle4Cyl6 "" VALUE 0x800049D1 RecordLayout_6 0 CompuMethod_116 -128 127 /end CHARACTERISTIC
/begin CHARACTERISTIC MediumCycle4Cyl7 "" VALUE 0x800049D2 RecordLayout_6 0 CompuMethod_116 -128 127 /end CHARACTERISTIC
/begin CHARACTERISTIC MediumCycle4Cyl8 "" VALUE 0x800049D3 RecordLayout_6 0 CompuMethod_116 -128 127 /end CHARACTERISTIC
/begin CHARACTERISTIC MinGovClntRPMSetPtTbl "RPM setpoint based on ECT." CURVE 0x800049FE RecordLayout_7 0 CompuMethod_22 -32768 32767
 /begin AXIS_DESCR COM_AXIS ECT05In CompuMethod_60 5 -40 200 AXIS_PTS_REF ECT05IdxArr /end AXIS_DESCR
/end CHARACTERISTIC
/begin CHARACTERISTIC MinOilPressure_FaultTbl "Minimum oil pressure based on RPM - engine faults and shuts down below this" CURVE 0x80004A14 RecordLayout_4 0 CompuMethod_130 -1E+17 1E+17
 /begin AXIS_DESCR COM_AXIS RPM09In CompuMethod_72 9 0 14000 AXIS_PTS_REF RPM09IdxArr /end AXIS_DESCR
/end CHARACTERISTIC
/begin CHARACTERISTIC MinOilPressure_WarnTbl "Minimum oil pressure based on RPM - indicator light comes on below this" CURVE 0x80004A38 RecordLayout_4 0 CompuMethod_130 -1E+17 1E+17
 /begin AXIS_DESCR COM_AXIS RPM09In CompuMethod_72 9 0 14000 AXIS_PTS_REF RPM09IdxArr /end AXIS_DESCR
/end CHARACTERISTIC
/begin CHARACTERISTIC MinSparkLimit "Min. spark limit on the delivered spark advance." VALUE 0x80004A5C RecordLayout_4 0 CompuMethod_70 -1E+17 1E+17 /end CHARACTERISTIC
/begin CHARACTERISTIC MisfireDiag_AngleHyst "" VALUE 0x80004A60 RecordLayout_3 0 CompuMethod_5 0 65535 /end CHARACTERISTIC
/begin CHARACTERISTIC MisfireDiag_ECTHighEnbl "" VALUE 0x80004A62 RecordLayout_7 0 CompuMethod_5 -32768 32767 /end CHARACTERISTIC
/begin CHARACTERISTIC MisfireDiag_ECTLowEnbl "" VALUE 0x80004A64 RecordLayout_7 0 CompuMethod_5 -32768 32767 /end CHARACTERISTIC
/begin CHARACTERISTIC MisfireDiag_Enbl "" VALUE 0x80004A66 RecordLayout_2 0 CompuMethod_10 0 1 /end CHARACTERISTIC
/begin CHARACTERISTIC MisfireDiag_EncoderExtrap_MPC5XX "" VALUE 0x80004A67 RecordLayout_2 0 CompuMethod_10 0 1 /end CHARACTERISTIC
/begin CHARACTERISTIC MisfireDiag_HardMisfireThreshold "" VALUE 0x80004A68 RecordLayout_4 0 CompuMethod_2 -1E+17 1E+17 /end CHARACTERISTIC
/begin CHARACTERISTIC MisfireDiag_MAPHighEnbl "" VALUE 0x80004A6C RecordLayout_7 0 CompuMethod_5 -32768 32767 /end CHARACTERISTIC
/begin CHARACTERISTIC MisfireDiag_MAPIRDiagEnable "" VALUE 0x80004A6E RecordLayout_2 0 CompuMethod_10 0 1 /end CHARACTERISTIC
/begin CHARACTERISTIC MisfireDiag_MAPLowEnbl "" VALUE 0x80004A6F RecordLayout_7 0 CompuMethod_5 -32768 32767 /end CHARACTERISTIC
/begin CHARACTERISTIC MisfireDiag_RPMHighEnbl "" VALUE 0x80004A71 RecordLayout_7 0 CompuMethod_5 -32768 32767 /end CHARACTERISTIC
/begin CHARACTERISTIC MisfireDiag_RPMLowEnbl "" VALUE 0x80004A73 RecordLayout_7 0 CompuMethod_5 -32768 32767 /end CHARACTERISTIC
/begin CHARACTERISTIC MisfireDiag_StartAngles "" VAL_BLK 0x80004A75 RecordLayout_3 0 CompuMethod_5 0 65535 MATRIX_DIM 8 1 1 /end CHARACTERISTIC
/begin CHARACTERISTIC MisfireDiag_StartRPMAvgCnt "" VALUE 0x80004A85 RecordLayout_2 0 CompuMethod_1 0 255 /end CHARACTERISTIC
/begin CHARACTERISTIC MisfireDiag_StopAngles "" VAL_BLK 0x80004A86 RecordLayout_3 0 CompuMethod_5 0 65535 MATRIX_DIM 8 1 1 /end CHARACTERISTIC
/begin CHARACTERISTIC MisfireDiag_StopRPMAvgCnt "" VALUE 0x80004A96 RecordLayout_2 0 CompuMethod_1 0 255 /end CHARACTERISTIC
/begin CHARACTERISTIC MisfireDiag_TimeSinceRunEnbl "" VALUE 0x80004A97 RecordLayout_7 0 CompuMethod_5 -32768 32767 /end CHARACTERISTIC
/begin CHARACTERISTIC MotoringDeltaRPMLimit "This is the amount RPM must be above the Setpoint RPM to set a Motorin Flag." VALUE 0x80004A99 RecordLayout_7 0 CompuMethod_22 -32768 32767 /end CHARACTERISTIC
/begin CHARACTERISTIC MotoringDtctTimerLimit "Amount of time engine speed has to be above the min gov. rpm set pt to set motoring flag." VALUE 0x80004A9B RecordLayout_4 0 CompuMethod_19 0 100 /end CHARACTERISTIC
/begin CHARACTERISTIC MPRD_new "Directly Override Main Power Relay" VALUE 0x80004A9F RecordLayout_2 0 CompuMethod_132 0 1 /end CHARACTERISTIC
/begin CHARACTERISTIC MPRD_ovr "" VALUE 0x80004AA0 RecordLayout_2 0 CompuMethod_7 0 1 /end CHARACTERISTIC
/begin CHARACTERISTIC NonVolatileRestoreOnFirstStartup "Selects whether to restore from factory defaults the first time an application boots" VALUE 0x80004AA1 RecordLayout_2 0 CompuMethod_133 0 1 /end CHARACTERISTIC
/begin CHARACTERISTIC NonVolatileRestoreOnStartup "Selects whether to restore from factory defaults on next startup" VALUE 0x80004AA2 RecordLayout_2 0 CompuMethod_133 0 1 /end CHARACTERISTIC
/begin CHARACTERISTIC O2ActiveTimeThresh_BankA "Time limit O2 feedback can sit between rich and lean switch points before flagging O2NotActive fault" VALUE 0x80004AA3 RecordLayout_4 0 CompuMethod_45 -1E+17 1E+17 /end CHARACTERISTIC
/begin CHARACTERISTIC O2ActiveTimeThresh_BankB "Time limit O2 feedback can sit between rich and lean switch points before flagging O2NotActive fault" VALUE 0x80004AA7 RecordLayout_4 0 CompuMethod_45 -1E+17 1E+17 /end CHARACTERISTIC
/begin CHARACTERISTIC O2BankA_DelagFilterConst "First-order filter time constant of the pre-catalyst O2 signal." VALUE 0x80004AAB RecordLayout_4 0 CompuMethod_45 -1E+17 1E+17 /end CHARACTERISTIC
/begin CHARACTERISTIC O2BankB_DelagFiltConst "First-order filter time constant of the post-catalyst O2 signal." VALUE 0x80004AAF RecordLayout_4 0 CompuMethod_45 -1E+17 1E+17 /end CHARACTERISTIC
/begin CHARACTERISTIC O2CtrlAdaptDelayTime "O2 Control must be enabled for this amount of time before fuel adaption is enabled" VALUE 0x80004AB4 RecordLayout_4 0 CompuMethod_45 0 1E+17 /end CHARACTERISTIC
/begin CHARACTERISTIC O2CtrlDGain "Base D-gain for the gaseous closed loop O2 controller." VALUE 0x80004AB8 RecordLayout_4 0 CompuMethod_136 -1E+17 1E+17 /end CHARACTERISTIC
/begin CHARACTERISTIC O2CtrlIGain "Base I-gain for the gaseous closed loop O2 controller." VALUE 0x80004ABC RecordLayout_4 0 CompuMethod_136 -1E+17 1E+17 /end CHARACTERISTIC
/begin CHARACTERISTIC O2CtrlPGain "Base P-gain for the gaseous closed loop O2 controller." VALUE 0x80004AC0 RecordLayout_4 0 CompuMethod_136 -1E+17 1E+17 /end CHARACTERISTIC
/begin CHARACTERISTIC O2CtrlPIDOutLowerLimit "Lower limit on gaseous closed loop O2 PID Output." VALUE 0x80004AC4 RecordLayout_4 0 CompuMethod_136 -1E+17 1E+17 /end CHARACTERISTIC
/begin CHARACTERISTIC O2CtrlPIDOutUpperLimit "Upper limit on gaseous closed loop O2 PID Output." VALUE 0x80004AC8 RecordLayout_4 0 CompuMethod_136 -1E+17 1E+17 /end CHARACTERISTIC
/begin CHARACTERISTIC O2Cyl1Select "Select the O2 sensor mapped to cylinder 1" VALUE 0x80004ACC RecordLayout_2 0 CompuMethod_138 0 1 /end CHARACTERISTIC
/begin CHARACTERISTIC O2Cyl2Select "Select the O2 sensor mapped to cylinder 2" VALUE 0x80004ACD RecordLayout_2 0 CompuMethod_138 0 1 /end CHARACTERISTIC
/begin CHARACTERISTIC O2Cyl3Select "Select the O2 sensor mapped to cylinder 3" VALUE 0x80004ACE RecordLayout_2 0 CompuMethod_138 0 1 /end CHARACTERISTIC
/begin CHARACTERISTIC O2Cyl4Select "Select the O2 sensor mapped to cylinder 4" VALUE 0x80004ACF RecordLayout_2 0 CompuMethod_138 0 1 /end CHARACTERISTIC
/begin CHARACTERISTIC O2Cyl5Select "Select the O2 sensor mapped to cylinder 5" VALUE 0x80004AD0 RecordLayout_2 0 CompuMethod_138 0 1 /end CHARACTERISTIC
/begin CHARACTERISTIC O2Cyl6Select "Select the O2 sensor mapped to cylinder 6" VALUE 0x80004AD1 RecordLayout_2 0 CompuMethod_138 0 1 /end CHARACTERISTIC
/begin CHARACTERISTIC O2Cyl7Select "Select the O2 sensor mapped to cylinder 7" VALUE 0x80004AD2 RecordLayout_2 0 CompuMethod_138 0 1 /end CHARACTERISTIC
/begin CHARACTERISTIC O2Cyl8Select "Select the O2 sensor mapped to cylinder 8" VALUE 0x80004AD3 RecordLayout_2 0 CompuMethod_138 0 1 /end CHARACTERISTIC
/begin CHARACTERISTIC O2Diag_Bank2Bank_DiffAlwdMap "" MAP 0x80004AD4 RecordLayout_4 0 CompuMethod_2 -1E+17 1E+17
 /begin AXIS_DESCR COM_AXIS MAP09In CompuMethod_16 9 0 1000 AXIS_PTS_REF MAP09IdxArr /end AXIS_DESCR
 /begin AXIS_DESCR COM_AXIS RPM09In CompuMethod_72 9 0 14000 AXIS_PTS_REF RPM09IdxArr /end AXIS_DESCR
/end CHARACTERISTIC
/begin CHARACTERISTIC O2Diag_Bank2Bank_MaxDesEquivRatio "" VALUE 0x80004C18 RecordLayout_4 0 CompuMethod_2 -1E+17 1E+17 /end CHARACTERISTIC
/begin CHARACTERISTIC O2Diag_Bank2Bank_MinDesEquivRatio "" VALUE 0x80004C1C RecordLayout_4 0 CompuMethod_2 -1E+17 1E+17 /end CHARACTERISTIC
/begin CHARACTERISTIC O2Diag_Bank2Bank_MinECT "" VALUE 0x80004C20 RecordLayout_7 0 CompuMethod_5 -32768 32767 /end CHARACTERISTIC
/begin CHARACTERISTIC O2Diag_Bank2Bank_MinRunTime "" VALUE 0x80004C22 RecordLayout_4 0 CompuMethod_2 -1E+17 1E+17 /end CHARACTERISTIC
/begin CHARACTERISTIC O2Diag_Lam1_StuckInResetThresh "" VALUE 0x80004C26 RecordLayout_4 0 CompuMethod_2 -1E+17 1E+17 /end CHARACTERISTIC
/begin CHARACTERISTIC O2Diag_Lam1_StuckInWarmup "" VALUE 0x80004C2A RecordLayout_4 0 CompuMethod_2 -1E+17 1E+17 /end CHARACTERISTIC
/begin CHARACTERISTIC O2Diag_Lam2_StuckInWarmup "" VALUE 0x80004C2E RecordLayout_4 0 CompuMethod_2 -1E+17 1E+17 /end CHARACTERISTIC
/begin CHARACTERISTIC O2Diag_Lam21_StuckInResetThresh "" VALUE 0x80004C32 RecordLayout_4 0 CompuMethod_2 -1E+17 1E+17 /end CHARACTERISTIC
/begin CHARACTERISTIC O2ITermLowerLimit "Lower limit on gaseous closed loop O2 I Term." VALUE 0x80004C5E RecordLayout_4 0 CompuMethod_136 -1E+17 1E+17 /end CHARACTERISTIC
/begin CHARACTERISTIC O2ITermUpperLimit "Upper limit on gaseous closed loop O2 I Term." VALUE 0x80004C62 RecordLayout_4 0 CompuMethod_136 -1E+17 1E+17 /end CHARACTERISTIC
/begin CHARACTERISTIC O2LeanTimeThresh_BankA "Time limit the O2 feedback can sit below the lean switch point before flagging O2FailedLean fault" VALUE 0x80004C66 RecordLayout_4 0 CompuMethod_45 -1E+17 1E+17 /end CHARACTERISTIC
/begin CHARACTERISTIC O2LeanTimeThresh_BankB "Time limit the O2 feedback can sit below the lean switch point before flagging O2FailedLean fault" VALUE 0x80004C6A RecordLayout_4 0 CompuMethod_45 -1E+17 1E+17 /end CHARACTERISTIC
/begin CHARACTERISTIC O2MAFErrGainMultTbl "O2 PID controller system gain based on MAF port." CURVE 0x80004C6E RecordLayout_4 0 CompuMethod_48 -1E+17 1E+17
 /begin AXIS_DESCR COM_AXIS MAFPort05In CompuMethod_27 5 0 1000000 AXIS_PTS_REF MAFPort05IdxArr /end AXIS_DESCR
/end CHARACTERISTIC
/begin CHARACTERISTIC O2NECCTErrGainMultTbl "O2 PID controller system gain based on NECCT." CURVE 0x80004C82 RecordLayout_4 0 CompuMethod_48 -1E+17 1E+17
 /begin AXIS_DESCR COM_AXIS ECT09In CompuMethod_60 9 -40 200 AXIS_PTS_REF ECT09IdxArr /end AXIS_DESCR
/end CHARACTERISTIC
/begin CHARACTERISTIC O2RichTimeThresh_BankA "Time limit the O2 feedback can sit abovethe rich switch point before flagging O2FailedRich fault" VALUE 0x80004CA6 RecordLayout_4 0 CompuMethod_45 -1E+17 1E+17 /end CHARACTERISTIC
/begin CHARACTERISTIC O2RichTimeThresh_BankB "Time limit the O2 feedback can sit abovethe rich switch point before flagging O2FailedRich fault" VALUE 0x80004CAA RecordLayout_4 0 CompuMethod_45 -1E+17 1E+17 /end CHARACTERISTIC
/begin CHARACTERISTIC OilPres_Filt "Filter time constant" VALUE 0x80004CD2 RecordLayout_4 0 CompuMethod_19 -1E+17 1E+17 /end CHARACTERISTIC
/begin CHARACTERISTIC OilPres_new "Override result of linear sensor characterization, in engineering units" VALUE 0x80004CD6 RecordLayout_4 0 CompuMethod_130 -1E+17 1E+17 /end CHARACTERISTIC
/begin CHARACTERISTIC OilPres_ovr "" VALUE 0x80004CDA RecordLayout_2 0 CompuMethod_7 0 1 /end CHARACTERISTIC
/begin CHARACTERISTIC OilPresDfltValue "This is the initial default value should the sensor be in fault on key-up.  Otherwise the sensors outputs the last value prior to faulting" VALUE 0x80004CDB RecordLayout_4 0 CompuMethod_130 -1E+17 1E+17 /end CHARACTERISTIC
/begin CHARACTERISTIC OilPresFilterConst "Filter time constant" VALUE 0x80004CDF RecordLayout_4 0 CompuMethod_19 -1E+17 1E+17 /end CHARACTERISTIC
/begin CHARACTERISTIC OilPresGain "Scaling from A/D counts to engineering units" VALUE 0x80004CE3 RecordLayout_4 0 CompuMethod_140 -1E+17 1E+17 /end CHARACTERISTIC
/begin CHARACTERISTIC OilPresInputHiFltPos "Maximum allowable input, indicating short or open circuit" VALUE 0x80004CE7 RecordLayout_4 0 CompuMethod_21 -1E+17 1E+17 /end CHARACTERISTIC
/begin CHARACTERISTIC OilPresInputLoFltPos "Minimum allowable input, indicating short or open circuit" VALUE 0x80004CEB RecordLayout_4 0 CompuMethod_21 -1E+17 1E+17 /end CHARACTERISTIC
/begin CHARACTERISTIC OilPresOfst "Offset after gain in engineering units" VALUE 0x80004CEF RecordLayout_4 0 CompuMethod_130 -1E+17 1E+17 /end CHARACTERISTIC
/begin CHARACTERISTIC Overheat_MaxAPP "Max APP command to allow during overheat condition" VALUE 0x80004CF7 RecordLayout_2 0 CompuMethod_24 0 255 /end CHARACTERISTIC
/begin CHARACTERISTIC Overheat_ScaleAPP "Scale APP by this factor when overheating" VALUE 0x80004CF8 RecordLayout_4 0 CompuMethod_141 -1E+17 1E+17 /end CHARACTERISTIC
/begin CHARACTERISTIC OXYTransFuelMultTbl "Transient fuel multiplier based on OXY.  Only engaged during transient fueling" CURVE 0x80004D10 RecordLayout_4 0 CompuMethod_2 -100 100
 /begin AXIS_DESCR COM_AXIS OXY05In CompuMethod_9 5 0 100 AXIS_PTS_REF OXY05IdxArr /end AXIS_DESCR
/end CHARACTERISTIC
/begin CHARACTERISTIC PH1_FiltDecConst "Filter time constant for a decreasing signal." VALUE 0x80004D24 RecordLayout_4 0 CompuMethod_19 -1E+17 1E+17 /end CHARACTERISTIC
/begin CHARACTERISTIC PH1_FiltIncConst "Filter time constant for a increasing signal." VALUE 0x80004D28 RecordLayout_4 0 CompuMethod_19 -1E+17 1E+17 /end CHARACTERISTIC
/begin CHARACTERISTIC PH2_FiltDecConst "Filter time constant for a decreasing signal." VALUE 0x80004D2C RecordLayout_4 0 CompuMethod_19 -1E+17 1E+17 /end CHARACTERISTIC
/begin CHARACTERISTIC PH2_FiltIncConst "Filter time constant for a increasing signal." VALUE 0x80004D30 RecordLayout_4 0 CompuMethod_19 -1E+17 1E+17 /end CHARACTERISTIC
/begin CHARACTERISTIC PHI1_DefaultVal "" VALUE 0x80004D34 RecordLayout_4 0 CompuMethod_2 -1E+17 1E+17 /end CHARACTERISTIC
/begin CHARACTERISTIC PHI2_DefaultVal "" VALUE 0x80004D38 RecordLayout_4 0 CompuMethod_2 -1E+17 1E+17 /end CHARACTERISTIC
/begin CHARACTERISTIC RestoreNVFactoryDefaults "Restores NonVolatile Memory to Factory Defaults" VALUE 0x80004E83 RecordLayout_2 0 CompuMethod_145 0 1 /end CHARACTERISTIC
/begin CHARACTERISTIC RevLimitType "Define the type of sequence to be disable when in Rev Limit" VALUE 0x80004E86 RecordLayout_6 0 CompuMethod_147 -128 127 /end CHARACTERISTIC
/begin CHARACTERISTIC RichSwPtDeltaMap "If actual O2 reaches this point, switch the target to the LeanTargetDelta" MAP 0x80004E87 RecordLayout_4 0 CompuMethod_41 -1E+17 1E+17
 /begin AXIS_DESCR COM_AXIS RPM09In CompuMethod_72 9 0 14000 AXIS_PTS_REF RPM09IdxArr /end AXIS_DESCR
 /begin AXIS_DESCR COM_AXIS MAP09In CompuMethod_16 9 0 1000 AXIS_PTS_REF MAP09IdxArr /end AXIS_DESCR
/end CHARACTERISTIC
/begin CHARACTERISTIC RichTargetDeltaMap "Target on the rich side for perturbation." MAP 0x80004FCB RecordLayout_4 0 CompuMethod_41 -1E+17 1E+17
 /begin AXIS_DESCR COM_AXIS RPM09In CompuMethod_72 9 0 14000 AXIS_PTS_REF RPM09IdxArr /end AXIS_DESCR
 /begin AXIS_DESCR COM_AXIS MAP09In CompuMethod_16 9 0 1000 AXIS_PTS_REF MAP09IdxArr /end AXIS_DESCR
/end CHARACTERISTIC
/begin CHARACTERISTIC Rise_Rate "" VALUE 0x8000510F RecordLayout_4 0 CompuMethod_2 -1E+17 1E+17 /end CHARACTERISTIC
/begin CHARACTERISTIC RPMFallingFiltConst "Filter time constant" VALUE 0x800051D3 RecordLayout_4 0 CompuMethod_19 -1E+17 1E+17 /end CHARACTERISTIC
/begin CHARACTERISTIC RPMFallingRate "The minimum rate of change in RPM that triggers RPMFalling - This should be a positive value" VALUE 0x800051D7 RecordLayout_4 0 CompuMethod_149 0 1000 /end CHARACTERISTIC
/begin CHARACTERISTIC RPMFilt_Enable "" VALUE 0x800051DB RecordLayout_2 0 CompuMethod_91 0 255 /end CHARACTERISTIC
/begin CHARACTERISTIC RPMFilt_LowPass "Filter time constant" VALUE 0x800051DC RecordLayout_4 0 CompuMethod_19 -1E+17 1E+17 /end CHARACTERISTIC
/begin CHARACTERISTIC RPMFilt_RoundValue "RPM round value" VALUE 0x800051E0 RecordLayout_3 0 CompuMethod_22 0 1000 /end CHARACTERISTIC
/begin CHARACTERISTIC SaveCalibrationError "Debug value for SaveCalibrationError" VALUE 0x800051E7 RecordLayout_3 0 CompuMethod_57 0 65535 /end CHARACTERISTIC
/begin CHARACTERISTIC Scramble_new "Override actuator, in engineering units" VALUE 0x800051E9 RecordLayout_2 0 CompuMethod_23 0 1 /end CHARACTERISTIC
/begin CHARACTERISTIC Scramble_ovr "" VALUE 0x800051EA RecordLayout_2 0 CompuMethod_7 0 1 /end CHARACTERISTIC
/begin CHARACTERISTIC ScrambleDebounceDelay "Cruise control debounce time" VALUE 0x800051EB RecordLayout_4 0 CompuMethod_151 -1E+17 1E+17 /end CHARACTERISTIC
/begin CHARACTERISTIC ScramblePolarity "0 = High True    1 = Low True" VALUE 0x800051EF RecordLayout_2 0 CompuMethod_6 0 1 /end CHARACTERISTIC
/begin CHARACTERISTIC ScrambleSwitchPt "Defines switch point in ADC units boolean conversion" VALUE 0x800051F0 RecordLayout_4 0 CompuMethod_21 -1E+17 1E+17 /end CHARACTERISTIC
/begin CHARACTERISTIC SensVolt_new "Override result of linear sensor characterization, in engineering units" VALUE 0x800051F4 RecordLayout_4 0 CompuMethod_152 -1E+17 1E+17 /end CHARACTERISTIC
/begin CHARACTERISTIC SensVolt_ovr "" VALUE 0x800051F8 RecordLayout_2 0 CompuMethod_7 0 1 /end CHARACTERISTIC
/begin CHARACTERISTIC SensVoltDfltValue "This is the initial default value should the sensor be in fault on key-up.  Otherwise the sensors outputs the last value prior to faulting" VALUE 0x800051F9 RecordLayout_4 0 CompuMethod_152 -1E+17 1E+17 /end CHARACTERISTIC
/begin CHARACTERISTIC SensVoltFilterConst "Filter time constant" VALUE 0x800051FD RecordLayout_4 0 CompuMethod_19 -1E+17 1E+17 /end CHARACTERISTIC
/begin CHARACTERISTIC SensVoltGain "Scaling from A/D counts to engineering units" VALUE 0x80005201 RecordLayout_4 0 CompuMethod_153 -1E+17 1E+17 /end CHARACTERISTIC
/begin CHARACTERISTIC SensVoltInputHiFltPos "Maximum allowable input, indicating short or open circuit" VALUE 0x80005205 RecordLayout_4 0 CompuMethod_21 -1E+17 1E+17 /end CHARACTERISTIC
/begin CHARACTERISTIC SensVoltInputLoFltPos "Minimum allowable input, indicating short or open circuit" VALUE 0x80005209 RecordLayout_4 0 CompuMethod_21 -1E+17 1E+17 /end CHARACTERISTIC
/begin CHARACTERISTIC SensVoltOfst "Offset after gain in engineering units" VALUE 0x8000520D RecordLayout_4 0 CompuMethod_152 -1E+17 1E+17 /end CHARACTERISTIC
/begin CHARACTERISTIC SoftCycle1Cyl1 "" VALUE 0x80005217 RecordLayout_6 0 CompuMethod_116 -128 127 /end CHARACTERISTIC
/begin CHARACTERISTIC SoftCycle1Cyl2 "" VALUE 0x80005218 RecordLayout_6 0 CompuMethod_116 -128 127 /end CHARACTERISTIC
/begin CHARACTERISTIC SoftCycle1Cyl3 "" VALUE 0x80005219 RecordLayout_6 0 CompuMethod_116 -128 127 /end CHARACTERISTIC
/begin CHARACTERISTIC SoftCycle1Cyl4 "" VALUE 0x8000521A RecordLayout_6 0 CompuMethod_116 -128 127 /end CHARACTERISTIC
/begin CHARACTERISTIC SoftCycle1Cyl5 "" VALUE 0x8000521B RecordLayout_6 0 CompuMethod_116 -128 127 /end CHARACTERISTIC
/begin CHARACTERISTIC SoftCycle1Cyl6 "" VALUE 0x8000521C RecordLayout_6 0 CompuMethod_116 -128 127 /end CHARACTERISTIC
/begin CHARACTERISTIC SoftCycle1Cyl7 "" VALUE 0x8000521D RecordLayout_6 0 CompuMethod_116 -128 127 /end CHARACTERISTIC
/begin CHARACTERISTIC SoftCycle1Cyl8 "" VALUE 0x8000521E RecordLayout_6 0 CompuMethod_116 -128 127 /end CHARACTERISTIC
/begin CHARACTERISTIC SoftCycle2Cyl1 "" VALUE 0x8000521F RecordLayout_6 0 CompuMethod_116 -128 127 /end CHARACTERISTIC
/begin CHARACTERISTIC SoftCycle2Cyl2 "" VALUE 0x80005220 RecordLayout_6 0 CompuMethod_116 -128 127 /end CHARACTERISTIC
/begin CHARACTERISTIC SoftCycle2Cyl3 "" VALUE 0x80005221 RecordLayout_6 0 CompuMethod_116 -128 127 /end CHARACTERISTIC
/begin CHARACTERISTIC SoftCycle2Cyl4 "" VALUE 0x80005222 RecordLayout_6 0 CompuMethod_116 -128 127 /end CHARACTERISTIC
/begin CHARACTERISTIC SoftCycle2Cyl5 "" VALUE 0x80005223 RecordLayout_6 0 CompuMethod_116 -128 127 /end CHARACTERISTIC
/begin CHARACTERISTIC SoftCycle2Cyl6 "" VALUE 0x80005224 RecordLayout_6 0 CompuMethod_116 -128 127 /end CHARACTERISTIC
/begin CHARACTERISTIC SoftCycle2Cyl7 "" VALUE 0x80005225 RecordLayout_6 0 CompuMethod_116 -128 127 /end CHARACTERISTIC
/begin CHARACTERISTIC SoftCycle2Cyl8 "" VALUE 0x80005226 RecordLayout_6 0 CompuMethod_116 -128 127 /end CHARACTERISTIC
/begin CHARACTERISTIC SoftCycle3Cyl1 "" VALUE 0x80005227 RecordLayout_6 0 CompuMethod_116 -128 127 /end CHARACTERISTIC
/begin CHARACTERISTIC SoftCycle3Cyl2 "" VALUE 0x80005228 RecordLayout_6 0 CompuMethod_116 -128 127 /end CHARACTERISTIC
/begin CHARACTERISTIC SoftCycle3Cyl3 "" VALUE 0x80005229 RecordLayout_6 0 CompuMethod_116 -128 127 /end CHARACTERISTIC
/begin CHARACTERISTIC SoftCycle3Cyl4 "" VALUE 0x8000522A RecordLayout_6 0 CompuMethod_116 -128 127 /end CHARACTERISTIC
/begin CHARACTERISTIC SoftCycle3Cyl5 "" VALUE 0x8000522B RecordLayout_6 0 CompuMethod_116 -128 127 /end CHARACTERISTIC
/begin CHARACTERISTIC SoftCycle3Cyl6 "" VALUE 0x8000522C RecordLayout_6 0 CompuMethod_116 -128 127 /end CHARACTERISTIC
/begin CHARACTERISTIC SoftCycle3Cyl7 "" VALUE 0x8000522D RecordLayout_6 0 CompuMethod_116 -128 127 /end CHARACTERISTIC
/begin CHARACTERISTIC SoftCycle3Cyl8 "" VALUE 0x8000522E RecordLayout_6 0 CompuMethod_116 -128 127 /end CHARACTERISTIC
/begin CHARACTERISTIC SoftCycle4Cyl1 "" VALUE 0x8000522F RecordLayout_6 0 CompuMethod_116 -128 127 /end CHARACTERISTIC
/begin CHARACTERISTIC SoftCycle4Cyl2 "" VALUE 0x80005230 RecordLayout_6 0 CompuMethod_116 -128 127 /end CHARACTERISTIC
/begin CHARACTERISTIC SoftCycle4Cyl3 "" VALUE 0x80005231 RecordLayout_6 0 CompuMethod_116 -128 127 /end CHARACTERISTIC
/begin CHARACTERISTIC SoftCycle4Cyl4 "" VALUE 0x80005232 RecordLayout_6 0 CompuMethod_116 -128 127 /end CHARACTERISTIC
/begin CHARACTERISTIC SoftCycle4Cyl5 "" VALUE 0x80005233 RecordLayout_6 0 CompuMethod_116 -128 127 /end CHARACTERISTIC
/begin CHARACTERISTIC SoftCycle4Cyl6 "" VALUE 0x80005234 RecordLayout_6 0 CompuMethod_116 -128 127 /end CHARACTERISTIC
/begin CHARACTERISTIC SoftCycle4Cyl7 "" VALUE 0x80005235 RecordLayout_6 0 CompuMethod_116 -128 127 /end CHARACTERISTIC
/begin CHARACTERISTIC SoftCycle4Cyl8 "" VALUE 0x80005236 RecordLayout_6 0 CompuMethod_116 -128 127 /end CHARACTERISTIC
/begin CHARACTERISTIC SOI_new "" VALUE 0x8000523B RecordLayout_4 0 CompuMethod_2 -1E+17 1E+17 /end CHARACTERISTIC
/begin CHARACTERISTIC SOI_ovr "" VALUE 0x8000523F RecordLayout_2 0 CompuMethod_7 0 1 /end CHARACTERISTIC
/begin CHARACTERISTIC SparkAdv_DeltaHi "Maximum increasing spark change per 5ms" VALUE 0x80005240 RecordLayout_4 0 CompuMethod_88 0 720 /end CHARACTERISTIC
/begin CHARACTERISTIC SparkAdv_DeltaLo "Maximum decreasing spark change per 5ms" VALUE 0x80005244 RecordLayout_4 0 CompuMethod_70 0 720 /end CHARACTERISTIC
/begin CHARACTERISTIC SparkDwell_offset "" VALUE 0x800056D0 RecordLayout_4 0 CompuMethod_2 -1E+17 1E+17 /end CHARACTERISTIC
/begin CHARACTERISTIC SparkDwell_ovr "" VALUE 0x800056D4 RecordLayout_2 0 CompuMethod_154 0 1 /end CHARACTERISTIC
/begin CHARACTERISTIC SparkStartAngle_offset "Provides a relative offset to input signal" VALUE 0x800056E2 RecordLayout_4 0 CompuMethod_70 -1E+17 1E+17 /end CHARACTERISTIC
/begin CHARACTERISTIC SparkStartAngle_ovr "Provides a relative offset to input signal" VALUE 0x800056E6 RecordLayout_2 0 CompuMethod_156 0 1 /end CHARACTERISTIC
/begin CHARACTERISTIC SparkStopAngle_offset "Provides a relative offset to input signal" VALUE 0x800056E7 RecordLayout_4 0 CompuMethod_70 -1E+17 1E+17 /end CHARACTERISTIC
/begin CHARACTERISTIC SparkStopAngle_ovr "Provides a relative offset to input signal" VALUE 0x800056EB RecordLayout_2 0 CompuMethod_156 0 1 /end CHARACTERISTIC
/begin CHARACTERISTIC SpkMinGovDGain "Base D-gain for the min. governor controller." VALUE 0x80005710 RecordLayout_4 0 CompuMethod_29 -1E+17 1E+17 /end CHARACTERISTIC
/begin CHARACTERISTIC SpkMinGovDGainErrorMultTbl "" CURVE 0x80005714 RecordLayout_4 0 CompuMethod_29 -1E+17 1E+17
 /begin AXIS_DESCR COM_AXIS SpkMinGovSpeedErrorIn CompuMethod_2 9 -1E+17 1E+17 AXIS_PTS_REF SpkMinGovSpeedErrorIdxArr /end AXIS_DESCR
/end CHARACTERISTIC
/begin CHARACTERISTIC SpkMinGovErrorGain "Error gain for the min governor controller. This gain is applied to the RPM error term before it is used to calculate the P, I and D terms." VALUE 0x80005738 RecordLayout_4 0 CompuMethod_29 -1E+17 1E+17 /end CHARACTERISTIC
/begin CHARACTERISTIC SpkMinGovPGain "Base P-gain for the min. governor controller." VALUE 0x8000573C RecordLayout_4 0 CompuMethod_29 -1E+17 1E+17 /end CHARACTERISTIC
/begin CHARACTERISTIC SpkMinGovPGainErrorMultTbl "" CURVE 0x80005740 RecordLayout_4 0 CompuMethod_29 -1E+17 1E+17
 /begin AXIS_DESCR COM_AXIS SpkMinGovSpeedErrorIn CompuMethod_2 9 -1E+17 1E+17 AXIS_PTS_REF SpkMinGovSpeedErrorIdxArr /end AXIS_DESCR
/end CHARACTERISTIC
/begin CHARACTERISTIC SpkMinGovPIDOutLowerLimit "Lower limit on spark min governor PID Output." VALUE 0x80005764 RecordLayout_4 0 CompuMethod_88 -1E+17 1E+17 /end CHARACTERISTIC
/begin CHARACTERISTIC SpkMinGovPIDOutUpperLimit "Upper limit on spark min governor PID Output." VALUE 0x80005768 RecordLayout_4 0 CompuMethod_88 -1E+17 1E+17 /end CHARACTERISTIC
/begin CHARACTERISTIC SSLoadDecFiltC "Filter time constant for a decreasing signal." VALUE 0x80005790 RecordLayout_4 0 CompuMethod_19 -1E+17 1E+17 /end CHARACTERISTIC
/begin CHARACTERISTIC SSLoadIncFiltC "Filter time constant for a increasing signal." VALUE 0x80005794 RecordLayout_4 0 CompuMethod_19 -1E+17 1E+17 /end CHARACTERISTIC
/begin CHARACTERISTIC SSLoadTol "Steady-State Load Tolerance" VALUE 0x80005798 RecordLayout_4 0 CompuMethod_2 -1E+17 1E+17 /end CHARACTERISTIC
/begin CHARACTERISTIC SSRPMDecFiltC "Filter time constant for a decreasing signal." VALUE 0x8000579C RecordLayout_4 0 CompuMethod_19 -1E+17 1E+17 /end CHARACTERISTIC
/begin CHARACTERISTIC SSRPMIncFiltC "Filter time constant for a increasing signal." VALUE 0x800057A0 RecordLayout_4 0 CompuMethod_19 -1E+17 1E+17 /end CHARACTERISTIC
/begin CHARACTERISTIC SSRPMTol "Steady-State RPM Tolerance" VALUE 0x800057A4 RecordLayout_4 0 CompuMethod_72 -1E+17 1E+17 /end CHARACTERISTIC
/begin CHARACTERISTIC StoreNV "Stores RAM-Shadowed memory to serial EEPROM" VALUE 0x800057B2 RecordLayout_2 0 CompuMethod_159 0 1 /end CHARACTERISTIC
/begin CHARACTERISTIC SysVolt_new "Override result of linear sensor characterization, in engineering units" VALUE 0x800057B3 RecordLayout_4 0 CompuMethod_152 -1E+17 1E+17 /end CHARACTERISTIC
/begin CHARACTERISTIC SysVolt_ovr "" VALUE 0x800057B7 RecordLayout_2 0 CompuMethod_7 0 1 /end CHARACTERISTIC
/begin CHARACTERISTIC SysVoltDfltValue "This is the initial default value should the sensor be in fault on key-up.  Otherwise the sensors outputs the last value prior to faulting" VALUE 0x800057DC RecordLayout_4 0 CompuMethod_152 -1E+17 1E+17 /end CHARACTERISTIC
/begin CHARACTERISTIC SysVoltFilterConst "Filter time constant" VALUE 0x800057E0 RecordLayout_4 0 CompuMethod_19 -1E+17 1E+17 /end CHARACTERISTIC
/begin CHARACTERISTIC SysVoltGain "Scaling from A/D counts to engineering units" VALUE 0x800057E4 RecordLayout_4 0 CompuMethod_153 -1E+17 1E+17 /end CHARACTERISTIC
/begin CHARACTERISTIC SysVoltInputHiFltPos "Maximum allowable input, indicating short or open circuit" VALUE 0x800057E8 RecordLayout_4 0 CompuMethod_21 -1E+17 1E+17 /end CHARACTERISTIC
/begin CHARACTERISTIC SysVoltInputLoFltPos "Minimum allowable input, indicating short or open circuit" VALUE 0x800057EC RecordLayout_4 0 CompuMethod_21 -1E+17 1E+17 /end CHARACTERISTIC
/begin CHARACTERISTIC SysVoltOfst "Offset after gain in engineering units" VALUE 0x800057F0 RecordLayout_4 0 CompuMethod_152 -1E+17 1E+17 /end CHARACTERISTIC
/begin CHARACTERISTIC TempOverheat_Fault "ECT limit above which fault is set." VALUE 0x800057F5 RecordLayout_4 0 CompuMethod_60 -1E+17 1E+17 /end CHARACTERISTIC
/begin CHARACTERISTIC TempOverheat_Warn "ECT limit above which warning light comes on" VALUE 0x800057F9 RecordLayout_4 0 CompuMethod_60 -1E+17 1E+17 /end CHARACTERISTIC
/begin CHARACTERISTIC TempOverheatSevere_Fault "ECT limit above which severe overheat fault is set." VALUE 0x800057FD RecordLayout_4 0 CompuMethod_60 -1E+17 1E+17 /end CHARACTERISTIC
/begin CHARACTERISTIC TireRadius "" VALUE 0x80005828 RecordLayout_4 0 CompuMethod_2 -1E+17 1E+17 /end CHARACTERISTIC
/begin CHARACTERISTIC TPS_Filt "Filter time constant" VALUE 0x8000582C RecordLayout_4 0 CompuMethod_19 -1E+17 1E+17 /end CHARACTERISTIC
/begin CHARACTERISTIC TPS1_new "Override result of linear sensor characterization, in engineering units" VALUE 0x80005854 RecordLayout_4 0 CompuMethod_9 -1E+17 1E+17 /end CHARACTERISTIC
/begin CHARACTERISTIC TPS1_ovr "" VALUE 0x80005858 RecordLayout_2 0 CompuMethod_7 0 1 /end CHARACTERISTIC
/begin CHARACTERISTIC TPS1_TPS2_Max_Deviation "Specifies the maximum allowable deviation between the two sensors" VALUE 0x80005859 RecordLayout_4 0 CompuMethod_32 -1E+17 1E+17 /end CHARACTERISTIC
/begin CHARACTERISTIC TPS1Adapt_Delta "Specifies the minimum deviation amount to react to." VALUE 0x8000585D RecordLayout_4 0 CompuMethod_21 -1E+17 1E+17 /end CHARACTERISTIC
/begin CHARACTERISTIC TPS1Adapt_Hi_Max "Specifies for the maximum value of the upper adapt range." VALUE 0x80005861 RecordLayout_4 0 CompuMethod_30 -1E+17 1E+17 /end CHARACTERISTIC
/begin CHARACTERISTIC TPS1Adapt_Hi_Min "Specifies for the minimum value of the upper adapt range." VALUE 0x80005865 RecordLayout_4 0 CompuMethod_30 -1E+17 1E+17 /end CHARACTERISTIC
/begin CHARACTERISTIC TPS1Adapt_Low_Max "Specifies for the maximum value of the lower adapt range." VALUE 0x80005869 RecordLayout_4 0 CompuMethod_30 -1E+17 1E+17 /end CHARACTERISTIC
/begin CHARACTERISTIC TPS1Adapt_Low_Min "Specifies for the minimum value of the lower adapt range." VALUE 0x8000586D RecordLayout_4 0 CompuMethod_30 -1E+17 1E+17 /end CHARACTERISTIC
/begin CHARACTERISTIC TPS1AdaptHiEnable "Enables or disables this adapt." VALUE 0x80005871 RecordLayout_2 0 CompuMethod_10 0 1 /end CHARACTERISTIC
/begin CHARACTERISTIC TPS1AdaptLoEnable "Enables or disables this adapt." VALUE 0x80005872 RecordLayout_2 0 CompuMethod_10 0 1 /end CHARACTERISTIC
/begin CHARACTERISTIC TPS1DfltValue "This is the initial default value should the sensor be in fault on key-up.  Otherwise the sensors outputs the last value prior to faulting" VALUE 0x80005873 RecordLayout_4 0 CompuMethod_9 -1E+17 1E+17 /end CHARACTERISTIC
/begin CHARACTERISTIC TPS1FilterConst "Filter time constant" VALUE 0x80005877 RecordLayout_4 0 CompuMethod_19 -1E+17 1E+17 /end CHARACTERISTIC
/begin CHARACTERISTIC TPS1InputHiFltPos "Hi limit of input signal which sets fault" VALUE 0x8000587B RecordLayout_4 0 CompuMethod_21 -1E+17 1E+17 /end CHARACTERISTIC
/begin CHARACTERISTIC TPS1InputLoFltPos "Low limit of input signal which sets fault" VALUE 0x8000587F RecordLayout_4 0 CompuMethod_21 -1E+17 1E+17 /end CHARACTERISTIC
/begin CHARACTERISTIC TPS1MaxLimit "Sets the upper limit on the potentiometer range." VALUE 0x80005883 RecordLayout_4 0 CompuMethod_9 -1E+17 1E+17 /end CHARACTERISTIC
/begin CHARACTERISTIC TPS1Rev_Polarity "1 = Reverse Polarity (Smaller voltage values indicate larger % travel)" VALUE 0x80005887 RecordLayout_2 0 CompuMethod_31 0 1 /end CHARACTERISTIC
/begin CHARACTERISTIC TPS2_new "Override result of linear sensor characterization, in engineering units" VALUE 0x80005888 RecordLayout_4 0 CompuMethod_9 -1E+17 1E+17 /end CHARACTERISTIC
/begin CHARACTERISTIC TPS2_ovr "" VALUE 0x8000588C RecordLayout_2 0 CompuMethod_7 0 1 /end CHARACTERISTIC
/begin CHARACTERISTIC TPS2Adapt_Delta "Specifies the minimum deviation amount to react to." VALUE 0x8000588D RecordLayout_4 0 CompuMethod_21 -1E+17 1E+17 /end CHARACTERISTIC
/begin CHARACTERISTIC TPS2Adapt_Hi_Max "Specifies for the maximum value of the upper adapt range." VALUE 0x80005891 RecordLayout_4 0 CompuMethod_30 -1E+17 1E+17 /end CHARACTERISTIC
/begin CHARACTERISTIC TPS2Adapt_Hi_Min "Specifies for the minimum value of the upper adapt range." VALUE 0x80005895 RecordLayout_4 0 CompuMethod_30 -1E+17 1E+17 /end CHARACTERISTIC
/begin CHARACTERISTIC TPS2Adapt_Low_Max "Specifies for the maximum value of the lower adapt range." VALUE 0x80005899 RecordLayout_4 0 CompuMethod_30 -1E+17 1E+17 /end CHARACTERISTIC
/begin CHARACTERISTIC TPS2Adapt_Low_Min "Specifies for the minimum value of the lower adapt range." VALUE 0x8000589D RecordLayout_4 0 CompuMethod_30 -1E+17 1E+17 /end CHARACTERISTIC
/begin CHARACTERISTIC TPS2AdaptHiEnable "Enables or disables this adapt." VALUE 0x800058A1 RecordLayout_2 0 CompuMethod_10 0 1 /end CHARACTERISTIC
/begin CHARACTERISTIC TPS2AdaptLoEnable "Enables or disables this adapt." VALUE 0x800058A2 RecordLayout_2 0 CompuMethod_10 0 1 /end CHARACTERISTIC
/begin CHARACTERISTIC TPS2DfltValue "This is the initial default value should the sensor be in fault on key-up.  Otherwise the sensors outputs the last value prior to faulting" VALUE 0x800058A3 RecordLayout_4 0 CompuMethod_9 -1E+17 1E+17 /end CHARACTERISTIC
/begin CHARACTERISTIC TPS2FilterConst "Filter time constant" VALUE 0x800058A7 RecordLayout_4 0 CompuMethod_19 -1E+17 1E+17 /end CHARACTERISTIC
/begin CHARACTERISTIC TPS2InputHiFltPos "Hi limit of input signal which sets fault" VALUE 0x800058AB RecordLayout_4 0 CompuMethod_21 -1E+17 1E+17 /end CHARACTERISTIC
/begin CHARACTERISTIC TPS2InputLoFltPos "Low limit of input signal which sets fault" VALUE 0x800058AF RecordLayout_4 0 CompuMethod_21 -1E+17 1E+17 /end CHARACTERISTIC
/begin CHARACTERISTIC TPS2MaxLimit "Sets the upper limit on the potentiometer range." VALUE 0x800058B3 RecordLayout_4 0 CompuMethod_9 -1E+17 1E+17 /end CHARACTERISTIC
/begin CHARACTERISTIC TPS2Rev_Polarity "1 = Reverse Polarity (Smaller voltage values indicate larger % travel)" VALUE 0x800058B7 RecordLayout_2 0 CompuMethod_31 0 1 /end CHARACTERISTIC
/begin CHARACTERISTIC VEAdaptGainTblTbl "Multiplier on error for adaptation, should always be positive" CURVE 0x800058E1 RecordLayout_4 0 CompuMethod_2 -1E+17 1E+17
 /begin AXIS_DESCR COM_AXIS VE_AdaptErrorIdxArrIn CompuMethod_2 10 -1E+17 1E+17 AXIS_PTS_REF VE_AdaptErrorIdxArrIdxArr /end AXIS_DESCR
/end CHARACTERISTIC
/begin CHARACTERISTIC VEAdaptMax "Determines whether the Volumetric Efficiency map will be adapted using the MAF sensor" VALUE 0x80005909 RecordLayout_4 0 CompuMethod_163 -1E+17 1E+17 /end CHARACTERISTIC
/begin CHARACTERISTIC VEAdaptMin "Determines whether the Volumetric Efficiency map will be adapted using the MAF sensor" VALUE 0x8000590D RecordLayout_4 0 CompuMethod_163 -1E+17 1E+17 /end CHARACTERISTIC
/begin CHARACTERISTIC VPSD_ChangeReject "If VSPD changes by more than this per/second ignore it" VALUE 0x800064ED RecordLayout_4 0 CompuMethod_164 -1E+17 1E+17 /end CHARACTERISTIC
/begin CHARACTERISTIC VSPD_ChangeReject_Enable "Enable for if VSPD changes by more than this per/second ignore it" VALUE 0x800064F1 RecordLayout_2 0 CompuMethod_166 0 1 /end CHARACTERISTIC
/begin CHARACTERISTIC VSPD_DigitalPresent "" VALUE 0x800064F2 RecordLayout_2 0 CompuMethod_10 0 1 /end CHARACTERISTIC
/begin CHARACTERISTIC VSPD_GPSPreferred "" VALUE 0x800064F7 RecordLayout_2 0 CompuMethod_10 0 1 /end CHARACTERISTIC
/begin CHARACTERISTIC VSPD_new "Override result of linear sensor characterization, in engineering units" VALUE 0x800064F8 RecordLayout_4 0 CompuMethod_165 -1E+17 1E+17 /end CHARACTERISTIC
/begin CHARACTERISTIC VSPD_ovr "" VALUE 0x800064FC RecordLayout_2 0 CompuMethod_7 0 1 /end CHARACTERISTIC
/begin CHARACTERISTIC VSPD_RateReject "If VSPD changes by more than this per/second ignore it" VALUE 0x800064FD RecordLayout_4 0 CompuMethod_164 -1E+17 1E+17 /end CHARACTERISTIC
/begin CHARACTERISTIC VSPD_RateReject_Enable "Enable for if VSPD changes by more than this per/second ignore it" VALUE 0x80006501 RecordLayout_2 0 CompuMethod_166 0 1 /end CHARACTERISTIC
/begin CHARACTERISTIC VSPD_RejectHoldTime "TimeToHoldLastValue" VALUE 0x80006502 RecordLayout_2 0 CompuMethod_167 0 255 /end CHARACTERISTIC
/begin CHARACTERISTIC VSPD_ZeroSpeed "What VSPD filter considers zero speed" VALUE 0x80006503 RecordLayout_4 0 CompuMethod_111 -1E+17 1E+17 /end CHARACTERISTIC
/begin CHARACTERISTIC VSPDDefault "This is the initial default value should the sensor be in fault on key-up.  Otherwise the sensors outputs the last value prior to faulting" VALUE 0x8000658B RecordLayout_4 0 CompuMethod_165 -1E+17 1E+17 /end CHARACTERISTIC
/begin CHARACTERISTIC VSPDFiltConst "Filter time constant" VALUE 0x8000658F RecordLayout_4 0 CompuMethod_19 -1E+17 1E+17 /end CHARACTERISTIC
/begin CHARACTERISTIC VSPDMax "Maximum allowable input, indicating short or open circuit" VALUE 0x800065A7 RecordLayout_4 0 CompuMethod_96 -1E+17 1E+17 /end CHARACTERISTIC
/begin CHARACTERISTIC VSPDMin "Minimum allowable input, indicating short or open circuit" VALUE 0x800065AB RecordLayout_4 0 CompuMethod_96 -1E+17 1E+17 /end CHARACTERISTIC
/begin CHARACTERISTIC VSPDTbl "Look up table to allownon-linear characterization of sensors" CURVE 0x800065AF RecordLayout_4 0 CompuMethod_165 -1E+17 1E+17
 /begin AXIS_DESCR COM_AXIS VSPDADC CompuMethod_96 5 -1E+17 1E+17 AXIS_PTS_REF VSPDIdxArr /end AXIS_DESCR
/end CHARACTERISTIC
/begin CHARACTERISTIC Warmup_Time_HoldoffTbl "Time before warmup fuel multiplier active" CURVE 0x800065C3 RecordLayout_4 0 CompuMethod_168 0 3
 /begin AXIS_DESCR COM_AXIS ECT05In CompuMethod_60 5 -40 200 AXIS_PTS_REF ECT05IdxArr /end AXIS_DESCR
/end CHARACTERISTIC
/begin CHARACTERISTIC WASTEGATE_new "Override result of linear sensor characterization, in engineering units" VALUE 0x8000673F RecordLayout_4 0 CompuMethod_9 -1E+17 1E+17 /end CHARACTERISTIC
/begin CHARACTERISTIC WASTEGATE_ovr "" VALUE 0x80006743 RecordLayout_2 0 CompuMethod_7 0 1 /end CHARACTERISTIC
/begin CHARACTERISTIC WASTEGATEFrequency "Frequency of PWM output" VALUE 0x80006744 RecordLayout_4 0 CompuMethod_96 -1E+17 1E+17 /end CHARACTERISTIC
/begin CHARACTERISTIC WASTEGATEGain "Scaling from engineering units to PWM duty cycle" VALUE 0x80006748 RecordLayout_4 0 CompuMethod_102 -1E+17 1E+17 /end CHARACTERISTIC
/begin CHARACTERISTIC WASTEGATEMaxLimit "Maximum limit of PWM signal." VALUE 0x80006750 RecordLayout_4 0 CompuMethod_9 -1E+17 1E+17 /end CHARACTERISTIC
/begin CHARACTERISTIC WASTEGATEMinLimit "Minimum limit of PWM signal." VALUE 0x80006754 RecordLayout_4 0 CompuMethod_9 -1E+17 1E+17 /end CHARACTERISTIC
/begin CHARACTERISTIC WASTEGATEOffset "Offset from engineering units to PWM duty cycle" VALUE 0x80006758 RecordLayout_4 0 CompuMethod_9 -1E+17 1E+17 /end CHARACTERISTIC
/begin AXIS_PTS App05IdxArr "" 0x800002A1 App05In RecordLayout_5 0 CompuMethod_2 5 -1E+17 1E+17 DEPOSIT ABSOLUTE /end AXIS_PTS
/begin AXIS_PTS ECT05IdxArr "Idex of ECT" 0x80001B69 ECT05In RecordLayout_5 0 CompuMethod_60 5 -40 200 DEPOSIT ABSOLUTE /end AXIS_PTS
/begin AXIS_PTS ECT09IdxArr "Index of ECT" 0x80001B99 ECT09In RecordLayout_5 0 CompuMethod_60 9 -40 200 DEPOSIT ABSOLUTE /end AXIS_PTS
/begin AXIS_PTS ETC_ErrorIdxArr "" 0x80001ED3 ETC_ErrorIn RecordLayout_5 0 CompuMethod_2 10 -1E+17 1E+17 DEPOSIT ABSOLUTE /end AXIS_PTS
/begin AXIS_PTS EVAPIdxArr "Look up table to allownon-linear characterization of sensors" 0x800026D7 EVAPADC RecordLayout_5 0 CompuMethod_21 13 -1E+17 1E+17 DEPOSIT ABSOLUTE /end AXIS_PTS
/begin AXIS_PTS Fuel_LvlIdxArr "Look up table to allownon-linear characterization of sensors" 0x8000381B Fuel_LvlADC RecordLayout_5 0 CompuMethod_21 5 -1E+17 1E+17 DEPOSIT ABSOLUTE /end AXIS_PTS
/begin AXIS_PTS FuelLevel_FiltConstColIdxArr "FuelLevel_FiltConst" 0x80003C68 FuelLevel_FiltConstColIn RecordLayout_5 0 CompuMethod_111 7 0 1E+17 DEPOSIT ABSOLUTE /end AXIS_PTS
/begin AXIS_PTS FuelLevel_FiltConstRowIdxArr "FuelLevel_FiltConst" 0x80003D48 FuelLevel_FiltConstRowIn RecordLayout_5 0 CompuMethod_19 7 0 1E+17 DEPOSIT ABSOLUTE /end AXIS_PTS
/begin AXIS_PTS IAT_KeyUp09IdxArr "Index of IAT captured at key-up." 0x80003E47 IAT_KeyUp09In RecordLayout_5 0 CompuMethod_60 9 -1E+17 1E+17 DEPOSIT ABSOLUTE /end AXIS_PTS
/begin AXIS_PTS IATIdxArr "Look up table to allownon-linear characterization of sensors" 0x80004124 IATADC RecordLayout_5 0 CompuMethod_21 13 -1E+17 1E+17 DEPOSIT ABSOLUTE /end AXIS_PTS
/begin AXIS_PTS InjDeltaPress09IdxArr "" 0x800041A2 InjDeltaPress09In RecordLayout_5 0 CompuMethod_2 9 -1E+17 1E+17 DEPOSIT ABSOLUTE /end AXIS_PTS
/begin AXIS_PTS MAFIdxArr "Look up table to allownon-linear characterization of sensors" 0x80004599 MAFADC RecordLayout_5 0 CompuMethod_96 13 -1E+17 1E+17 DEPOSIT ABSOLUTE /end AXIS_PTS
/begin AXIS_PTS MAFPort05IdxArr "Index of MAF" 0x800045D5 MAFPort05In RecordLayout_5 0 CompuMethod_27 5 0 1000000 DEPOSIT ABSOLUTE /end AXIS_PTS
/begin AXIS_PTS MAP09IdxArr "Index of MAP" 0x8000479D MAP09In RecordLayout_5 0 CompuMethod_16 9 0 1000 DEPOSIT ABSOLUTE /end AXIS_PTS
/begin AXIS_PTS MaxGovSpeedErrorIdxArr "" 0x80004943 MaxGovSpeedErrorIn RecordLayout_5 0 CompuMethod_72 9 -1E+17 1E+17 DEPOSIT ABSOLUTE /end AXIS_PTS
/begin AXIS_PTS OXY05IdxArr "Index of fuel oxygenation content" 0x80004CFC OXY05In RecordLayout_5 0 CompuMethod_9 5 0 100 DEPOSIT ABSOLUTE /end AXIS_PTS
/begin AXIS_PTS RPM05IdxArr "Index of RPM" 0x80005113 RPM05In RecordLayout_5 0 CompuMethod_72 5 0 14000 DEPOSIT ABSOLUTE /end AXIS_PTS
/begin AXIS_PTS RPM09IdxArr "Index of RPM" 0x80005127 RPM09In RecordLayout_5 0 CompuMethod_72 9 0 14000 DEPOSIT ABSOLUTE /end AXIS_PTS
/begin AXIS_PTS RPMAccel17IdxArr "" 0x8000518F RPMAccel17In RecordLayout_5 0 CompuMethod_2 17 -1E+17 1E+17 DEPOSIT ABSOLUTE /end AXIS_PTS
/begin AXIS_PTS SpkMinGovSpeedErrorIdxArr "" 0x8000576C SpkMinGovSpeedErrorIn RecordLayout_5 0 CompuMethod_2 9 -1E+17 1E+17 DEPOSIT ABSOLUTE /end AXIS_PTS
/begin AXIS_PTS SysVolt09IdxArr "Index of system voltage" 0x800057B8 SysVolt09In RecordLayout_5 0 CompuMethod_152 9 0 32 DEPOSIT ABSOLUTE /end AXIS_PTS
/begin AXIS_PTS VE_AdaptErrorIdxArrIdxArr "Multiplier on error for adaptation, should always be positive" 0x800058B8 VE_AdaptErrorIdxArrIn RecordLayout_5 0 CompuMethod_2 10 -1E+17 1E+17 DEPOSIT ABSOLUTE /end AXIS_PTS
/begin AXIS_PTS VSPDIdxArr "Look up table to allownon-linear characterization of sensors" 0x80006593 VSPDADC RecordLayout_5 0 CompuMethod_96 5 -1E+17 1E+17 DEPOSIT ABSOLUTE /end AXIS_PTS
/begin RECORD_LAYOUT RecordLayout_2 FNC_VALUES 1 UBYTE ROW_DIR DIRECT /end RECORD_LAYOUT
/begin RECORD_LAYOUT RecordLayout_3 FNC_VALUES 1 UWORD ROW_DIR DIRECT /end RECORD_LAYOUT
/begin RECORD_LAYOUT RecordLayout_4 FNC_VALUES 1 FLOAT32_IEEE ROW_DIR DIRECT /end RECORD_LAYOUT
/begin RECORD_LAYOUT RecordLayout_5 AXIS_PTS_X 1 FLOAT32_IEEE /* IndexIncr */ INDEX_INCR /* Addressing */ DIRECT /end RECORD_LAYOUT
/begin RECORD_LAYOUT RecordLayout_6 FNC_VALUES 1 SBYTE ROW_DIR DIRECT /end RECORD_LAYOUT
/begin RECORD_LAYOUT RecordLayout_7 FNC_VALUES 1 SWORD ROW_DIR DIRECT /end RECORD_LAYOUT
/*~~~~~~~~~ 6.3.31 COMPU_METHODs ~~~~~~~~~*/
/begin COMPU_METHOD CompuMethod_1 "" RAT_FUNC "%3.0" "" COEFFS 0 1 0 0 0 1 /end COMPU_METHOD
/begin COMPU_METHOD CompuMethod_2 "" RAT_FUNC "%6.2" "" COEFFS 0 1 0 0 0 1 /end COMPU_METHOD
/begin COMPU_METHOD CompuMethod_5 "" RAT_FUNC "%5.0" "" COEFFS 0 1 0 0 0 1 /end COMPU_METHOD
/begin COMPU_METHOD CompuMethod_6 "" RAT_FUNC "%1.0" "bool" COEFFS 0 1 0 0 0 1 /end COMPU_METHOD
/begin COMPU_METHOD CompuMethod_7 "" TAB_VERB "%1.0" "" COMPU_TAB_REF CompuVtab_2 /end COMPU_METHOD
/begin COMPU_METHOD CompuMethod_9 "" RAT_FUNC "%6.2" "%" COEFFS 0 1 0 0 0 1 /end COMPU_METHOD
/begin COMPU_METHOD CompuMethod_10 "" TAB_VERB "%1.0" "" COMPU_TAB_REF CompuVtab_3 /end COMPU_METHOD
/begin COMPU_METHOD CompuMethod_12 "" RAT_FUNC "%1.0" "" COEFFS 0 1 0 0 0 1 /end COMPU_METHOD
/begin COMPU_METHOD CompuMethod_13 "" RAT_FUNC "%6.2" "kPaGauge" COEFFS 0 1 0 0 0 1 /end COMPU_METHOD
/begin COMPU_METHOD CompuMethod_14 "" RAT_FUNC "%6.2" "kPa Gauge" COEFFS 0 1 0 0 0 1 /end COMPU_METHOD
/begin COMPU_METHOD CompuMethod_15 "" RAT_FUNC "%6.2" "idx.frac" COEFFS 0 1 0 0 0 0.00195313 /end COMPU_METHOD
/begin COMPU_METHOD CompuMethod_16 "" RAT_FUNC "%6.2" "kPa" COEFFS 0 1 0 0 0 1 /end COMPU_METHOD
/begin COMPU_METHOD CompuMethod_17 "" RAT_FUNC "%5.0" "ADC" COEFFS 0 1 0 0 0 1 /end COMPU_METHOD
/begin COMPU_METHOD CompuMethod_19 "" RAT_FUNC "%6.2" "sec" COEFFS 0 1 0 0 0 1 /end COMPU_METHOD
/begin COMPU_METHOD CompuMethod_20 "" RAT_FUNC "%9.4" "kPa Gauge/ADC" COEFFS 0 1 0 0 0 1 /end COMPU_METHOD
/begin COMPU_METHOD CompuMethod_21 "" RAT_FUNC "%6.2" "ADC" COEFFS 0 1 0 0 0 1 /end COMPU_METHOD
/begin COMPU_METHOD CompuMethod_22 "" RAT_FUNC "%5.0" "RPM" COEFFS 0 1 0 0 0 1 /end COMPU_METHOD
/begin COMPU_METHOD CompuMethod_23 "" RAT_FUNC "%1.0" "Boolean" COEFFS 0 1 0 0 0 1 /end COMPU_METHOD
/begin COMPU_METHOD CompuMethod_24 "" RAT_FUNC "%3.0" "%" COEFFS 0 1 0 0 0 1 /end COMPU_METHOD
/begin COMPU_METHOD CompuMethod_27 "" RAT_FUNC "%6.2" "g/s" COEFFS 0 1 0 0 0 1 /end COMPU_METHOD
/begin COMPU_METHOD CompuMethod_29 "" RAT_FUNC "%6.2" "mult" COEFFS 0 1 0 0 0 1 /end COMPU_METHOD
/begin COMPU_METHOD CompuMethod_30 "" RAT_FUNC "%6.2" "ADC Counts" COEFFS 0 1 0 0 0 1 /end COMPU_METHOD
/begin COMPU_METHOD CompuMethod_31 "" RAT_FUNC "%1.0" "boolean" COEFFS 0 1 0 0 0 1 /end COMPU_METHOD
/begin COMPU_METHOD CompuMethod_32 "" RAT_FUNC "%6.2" "Percent" COEFFS 0 1 0 0 0 1 /end COMPU_METHOD
/begin COMPU_METHOD CompuMethod_41 "" RAT_FUNC "%6.2" "EquivRatio" COEFFS 0 1 0 0 0 1 /end COMPU_METHOD
/begin COMPU_METHOD CompuMethod_45 "" RAT_FUNC "%6.2" "s" COEFFS 0 1 0 0 0 1 /end COMPU_METHOD
/begin COMPU_METHOD CompuMethod_46 "" TAB_VERB "%1.0" "" COMPU_TAB_REF CompuVtab_12 /end COMPU_METHOD
/begin COMPU_METHOD CompuMethod_47 "" RAT_FUNC "%5.4" "" COEFFS 0 1 0 0 0 1 /end COMPU_METHOD
/begin COMPU_METHOD CompuMethod_48 "" RAT_FUNC "%5.4" "mult" COEFFS 0 1 0 0 0 1 /end COMPU_METHOD
/begin COMPU_METHOD CompuMethod_57 "" TAB_VERB "%5.0" "" COMPU_TAB_REF CompuVtab_13 /end COMPU_METHOD
/begin COMPU_METHOD CompuMethod_59 "" RAT_FUNC "%6.2" "C" COEFFS 0 1 0 0 0 1 /end COMPU_METHOD
/begin COMPU_METHOD CompuMethod_60 "" RAT_FUNC "%6.2" "degC" COEFFS 0 1 0 0 0 1 /end COMPU_METHOD
/begin COMPU_METHOD CompuMethod_65 "" RAT_FUNC "%8.0" "" COEFFS 0 1 0 0 0 1 /end COMPU_METHOD
/begin COMPU_METHOD CompuMethod_68 "" RAT_FUNC "%5.3" "ms" COEFFS 0 1 0 0 0 1 /end COMPU_METHOD
/begin COMPU_METHOD CompuMethod_70 "" RAT_FUNC "%6.2" "degBTDC" COEFFS 0 1 0 0 0 1 /end COMPU_METHOD
/begin COMPU_METHOD CompuMethod_72 "" RAT_FUNC "%6.2" "RPM" COEFFS 0 1 0 0 0 1 /end COMPU_METHOD
/begin COMPU_METHOD CompuMethod_88 "" RAT_FUNC "%6.2" "degCA" COEFFS 0 1 0 0 0 1 /end COMPU_METHOD
/begin COMPU_METHOD CompuMethod_91 "" TAB_VERB "%3.0" "" COMPU_TAB_REF CompuVtab_3 /end COMPU_METHOD
/begin COMPU_METHOD CompuMethod_96 "" RAT_FUNC "%6.2" "Hz" COEFFS 0 1 0 0 0 1 /end COMPU_METHOD
/begin COMPU_METHOD CompuMethod_98 "" RAT_FUNC "%6.2" "%/s" COEFFS 0 1 0 0 0 1 /end COMPU_METHOD
/begin COMPU_METHOD CompuMethod_100 "" TAB_VERB "%1.0" "" COMPU_TAB_REF CompuVtab_21 /end COMPU_METHOD
/begin COMPU_METHOD CompuMethod_102 "" RAT_FUNC "%6.2" "%/%" COEFFS 0 1 0 0 0 1 /end COMPU_METHOD
/begin COMPU_METHOD CompuMethod_103 "" TAB_VERB "%3.0" "" COMPU_TAB_REF CompuVtab_23 /end COMPU_METHOD
/begin COMPU_METHOD CompuMethod_109 "" TAB_VERB "%3.0" "" COMPU_TAB_REF CompuVtab_29 /end COMPU_METHOD
/begin COMPU_METHOD CompuMethod_110 "" RAT_FUNC "%6.2" "Time const" COEFFS 0 1 0 0 0 1 /end COMPU_METHOD
/begin COMPU_METHOD CompuMethod_111 "" RAT_FUNC "%6.2" "mph" COEFFS 0 1 0 0 0 1 /end COMPU_METHOD
/begin COMPU_METHOD CompuMethod_112 "" RAT_FUNC "%6.2" "alpha" COEFFS 0 1 0 0 0 1 /end COMPU_METHOD
/begin COMPU_METHOD CompuMethod_113 "" RAT_FUNC "%8.0" "Hz" COEFFS 0 1 0 0 0 1 /end COMPU_METHOD
/begin COMPU_METHOD CompuMethod_114 "" RAT_FUNC "%9.4" "%/ADC" COEFFS 0 1 0 0 0 1 /end COMPU_METHOD
/begin COMPU_METHOD CompuMethod_115 "" RAT_FUNC "%5.0" "ms" COEFFS 0 1 0 0 0 1 /end COMPU_METHOD
/begin COMPU_METHOD CompuMethod_116 "" TAB_VERB "%3.0" "" COMPU_TAB_REF CompuVtab_30 /end COMPU_METHOD
/begin COMPU_METHOD CompuMethod_120 "" RAT_FUNC "%5.3" "" COEFFS 0 1 0 0 0 1 /end COMPU_METHOD
/begin COMPU_METHOD CompuMethod_121 "" RAT_FUNC "%6.4" "ms/mg" COEFFS 0 1 0 0 0 1 /end COMPU_METHOD
/begin COMPU_METHOD CompuMethod_122 "" RAT_FUNC "%7.4" "ms" COEFFS 0 1 0 0 0 1 /end COMPU_METHOD
/begin COMPU_METHOD CompuMethod_123 "" RAT_FUNC "%7.2" "%" COEFFS 0 1 0 0 0 0.0015259 /end COMPU_METHOD
/begin COMPU_METHOD CompuMethod_125 "" RAT_FUNC "%9.4" "kPa/ADC" COEFFS 0 1 0 0 0 1 /end COMPU_METHOD
/begin COMPU_METHOD CompuMethod_126 "" TAB_VERB "%1.0" "" COMPU_TAB_REF CompuVtab_34 /end COMPU_METHOD
/begin COMPU_METHOD CompuMethod_127 "" TAB_VERB "%1.0" "" COMPU_TAB_REF CompuVtab_35 /end COMPU_METHOD
/begin COMPU_METHOD CompuMethod_128 "" TAB_VERB "%3.0" "" COMPU_TAB_REF CompuVtab_36 /end COMPU_METHOD
/begin COMPU_METHOD CompuMethod_129 "" TAB_VERB "%3.0" "" COMPU_TAB_REF CompuVtab_37 /end COMPU_METHOD
/begin COMPU_METHOD CompuMethod_130 "" RAT_FUNC "%6.2" "psi" COEFFS 0 1 0 0 0 1 /end COMPU_METHOD
/begin COMPU_METHOD CompuMethod_132 "" TAB_VERB "%1.0" "boolean" COMPU_TAB_REF CompuVtab_38 /end COMPU_METHOD
/begin COMPU_METHOD CompuMethod_133 "" TAB_VERB "%1.0" "" COMPU_TAB_REF CompuVtab_39 /end COMPU_METHOD
/begin COMPU_METHOD CompuMethod_134 "" TAB_VERB "%1.0" "" COMPU_TAB_REF CompuVtab_40 /end COMPU_METHOD
/begin COMPU_METHOD CompuMethod_136 "" RAT_FUNC "%8.3" "mult" COEFFS 0 1 0 0 0 1 /end COMPU_METHOD
/begin COMPU_METHOD CompuMethod_138 "" TAB_VERB "%1.0" "" COMPU_TAB_REF CompuVtab_42 /end COMPU_METHOD
/begin COMPU_METHOD CompuMethod_139 "" RAT_FUNC "%6.2" "ratio" COEFFS 0 1 0 0 0 1 /end COMPU_METHOD
/begin COMPU_METHOD CompuMethod_140 "" RAT_FUNC "%9.4" "psi/ADC" COEFFS 0 1 0 0 0 1 /end COMPU_METHOD
/begin COMPU_METHOD CompuMethod_141 "" RAT_FUNC "%6.2" "multiplier" COEFFS 0 1 0 0 0 1 /end COMPU_METHOD
/begin COMPU_METHOD CompuMethod_143 "" TAB_VERB "%1.0" "" COMPU_TAB_REF CompuVtab_43 /end COMPU_METHOD
/begin COMPU_METHOD CompuMethod_145 "" TAB_VERB "%1.0" "" COMPU_TAB_REF CompuVtab_45 /end COMPU_METHOD
/begin COMPU_METHOD CompuMethod_146 "" TAB_VERB "%3.0" "" COMPU_TAB_REF CompuVtab_46 /end COMPU_METHOD
/begin COMPU_METHOD CompuMethod_147 "" TAB_VERB "%3.0" "" COMPU_TAB_REF CompuVtab_47 /end COMPU_METHOD
/begin COMPU_METHOD CompuMethod_148 "" TAB_VERB "%1.0" "" COMPU_TAB_REF CompuVtab_48 /end COMPU_METHOD
/begin COMPU_METHOD CompuMethod_149 "" RAT_FUNC "%6.2" "RPM/sec" COEFFS 0 1 0 0 0 1 /end COMPU_METHOD
/begin COMPU_METHOD CompuMethod_151 "" RAT_FUNC "%6.2" "S" COEFFS 0 1 0 0 0 1 /end COMPU_METHOD
/begin COMPU_METHOD CompuMethod_152 "" RAT_FUNC "%6.2" "Volts" COEFFS 0 1 0 0 0 1 /end COMPU_METHOD
/begin COMPU_METHOD CompuMethod_153 "" RAT_FUNC "%9.4" "Volts/ADC" COEFFS 0 1 0 0 0 1 /end COMPU_METHOD
/begin COMPU_METHOD CompuMethod_154 "" TAB_VERB "%1.0" "" COMPU_TAB_REF CompuVtab_11 /end COMPU_METHOD
/begin COMPU_METHOD CompuMethod_156 "" TAB_VERB "%1.0" "degBTDC" COMPU_TAB_REF CompuVtab_11 /end COMPU_METHOD
/begin COMPU_METHOD CompuMethod_157 "" TAB_VERB "%1.0" "" COMPU_TAB_REF CompuVtab_49 /end COMPU_METHOD
/begin COMPU_METHOD CompuMethod_159 "" TAB_VERB "%1.0" "" COMPU_TAB_REF CompuVtab_50 /end COMPU_METHOD
/begin COMPU_METHOD CompuMethod_161 "" RAT_FUNC "%6.2" "mg" COEFFS 0 1 0 0 0 1 /end COMPU_METHOD
/begin COMPU_METHOD CompuMethod_163 "" RAT_FUNC "%6.2" "bool" COEFFS 0 1 0 0 0 1 /end COMPU_METHOD
/begin COMPU_METHOD CompuMethod_164 "" RAT_FUNC "%6.2" "mph/s" COEFFS 0 1 0 0 0 1 /end COMPU_METHOD
/begin COMPU_METHOD CompuMethod_165 "" RAT_FUNC "%6.2" "MPH" COEFFS 0 1 0 0 0 1 /end COMPU_METHOD
/begin COMPU_METHOD CompuMethod_166 "" TAB_VERB "%1.0" "enum" COMPU_TAB_REF CompuVtab_3 /end COMPU_METHOD
/begin COMPU_METHOD CompuMethod_167 "" RAT_FUNC "%3.0" "sec" COEFFS 0 1 0 0 0 1 /end COMPU_METHOD
/begin COMPU_METHOD CompuMethod_168 "" RAT_FUNC "%4.3" "sec" COEFFS 0 1 0 0 0 1 /end COMPU_METHOD
/begin COMPU_VTAB CompuVtab_2 "" TAB_VERB 2 0 "Pass-Through" 1 "Override" /end COMPU_VTAB
/begin COMPU_VTAB CompuVtab_3 "" TAB_VERB 2 0 "Disabled" 1 "Enabled" /end COMPU_VTAB
/begin COMPU_VTAB CompuVtab_11 "" TAB_VERB 2 0 "Unlocked" 1 "Locked" /end COMPU_VTAB
/begin COMPU_VTAB CompuVtab_12 "" TAB_VERB 2 0 "Not Enabled" 1 "Enabled" /end COMPU_VTAB
/begin COMPU_VTAB CompuVtab_13 "" TAB_VERB 41 0 "Normal Operation" 1 "Task Kernel API Usage" 2 "Bad Attribute Data" 3 "Operation timed out" 4 "Operation aborted" 5 "Access from an ISR" 6 "Illegal Handle" 7 "Out of free store memory" 8 "The supplied task information is not valid." 9 "Missing Attribute" 10 "Insufficient FW resource" 11 "TPU Mask incompatible with the eTPU" 12 "Resource Busy" 13 "Data Unavailable" 14 "Function Not Supported" 15 "Flash is not blank" 16 "Flash Prog Voltage Unavailable" 17 "Memory verify" 18 "Uncreated Resource access" 19 "Illegal address" 20 "Hardware overrun" 21 "Alignment" 22 "Hardware timeout" 23 "TPU Function not in mask" 24 "TPU coprocessor not succesfully opened" 25 "Required dependants were not located" 26 "SPI Bus Integrity check failed." 27 "Insufficient param ram for TPU primitive" 28 "Dependent ASIC not created" 29 "Resource Not Capable." 30 "Software overrun" 31 "A Write attempted failed but OK to continue" 32 "Heap free-list distroyed; found while allocating" 33 "Heap freeing already freed or distroyed block" 34 "Heap freeing block outside of pool" 35 "Heap free list crashed; found while reallocating" 36 "An operation to the host operating system failed" 37 "Data Alignment" 38 "Attempt to create resource that is already created" 39 "Attempt to attach an ISR handler that is in use" 40 "Attempt to attach an ISR IRQ that is out of range" /end COMPU_VTAB
/begin COMPU_VTAB CompuVtab_21 "" TAB_VERB 2 0 "Decreasing" 1 "Increasing" /end COMPU_VTAB
/begin COMPU_VTAB CompuVtab_23 "" TAB_VERB 163 0 "ACChargeHigh_Fault" 1 "ACChargeLow_Fault" 2 "ACPresRangeHigh" 3 "ACPresRangeLow" 4 "APP1RangeHigh" 5 "APP1RangeLow" 6 "APP1_AdaptAdaptHiMax" 7 "APP1_AdaptAdaptHiMin" 8 "APP1_AdaptAdaptLoMax" 9 "APP1_AdaptAdaptLoMin" 10 "APP1_AdaptRangeHigh" 11 "APP1_AdaptRangeLow" 12 "APP2RangeHigh" 13 "APP2RangeLow" 14 "APP2_AdaptAdaptHiMax" 15 "APP2_AdaptAdaptHiMin" 16 "APP2_AdaptAdaptLoMax" 17 "APP2_AdaptAdaptLoMin" 18 "APP2_AdaptRangeHigh" 19 "APP2_AdaptRangeLow" 20 "APP_Sensors_Conflict" 21 "AirflowMismatch_Fault" 22 "AltInop_Fault" 23 "Bank1_EquivRatioRangeHigh" 24 "Bank1_EquivRatioRangeLow" 25 "Bank2_EquivRatioRangeHigh" 26 "Bank2_EquivRatioRangeLow" 27 "CATRangeHigh" 28 "CATRangeLow" 29 "CamEdgesFault" 30 "CamSyncFault" 31 "ClutchStuckHigh_Fault" 32 "CrankEdgesFault" 33 "CrankSyncFault" 34 "Cylinder1_HardMisfire" 35 "Cylinder2_HardMisfire" 36 "Cylinder3_HardMisfire" 37 "Cylinder4_HardMisfire" 38 "Cylinder5_HardMisfire" 39 "Cylinder6_HardMisfire" 40 "Cylinder7_HardMisfire" 41 "Cylinder8_HardMisfire" 42 "ECTOverTempFault" 43 "ECTRangeHigh" 44 "ECTRangeLow" 45 "ECTSevereOverTempFault" 46 "EST1_Open" 47 "EST1_Short" 48 "EST2_Open" 49 "EST2_Short" 50 "EST3_Open" 51 "EST3_Short" 52 "EST4_Open" 53 "EST4_Short" 54 "EST5_Open" 55 "EST5_Short" 56 "EST6_Open" 57 "EST6_Short" 58 "EST7_Open" 59 "EST7_Short" 60 "EST8_Open" 61 "EST8_Short" 62 "ETCSpringTest" 63 "ETC_Open_Fault" 64 "ETC_Sticking" 65 "EVAPRangeHigh" 66 "EVAPRangeLow" 67 "FuelAdaptRangeHi_BankA" 68 "FuelAdaptRangeHi_BankB" 69 "FuelAdaptRangeLow_BankA" 70 "FuelAdaptRangeLow_BankB" 71 "FuelPresHigh_Fault" 72 "FuelPresLow_Fault" 73 "FuelPresRangeHigh" 74 "FuelPresRangeLow" 75 "FuelSensRangeHigh" 76 "FuelSensRangeLow" 77 "Fuel_LvlRangeHigh" 78 "Fuel_LvlRangeLow" 79 "GPS_DateTime_Timeout" 80 "GPS_LatLong_Timeout" 81 "GPS_SpeedDir_Timeout" 82 "HardOverBoost_Fault" 83 "HardOverspeed" 84 "IATRangeHigh" 85 "IATRangeLow" 86 "Inj1Open" 87 "Inj2Open" 88 "Inj3Open" 89 "Inj4Open" 90 "Inj5Open" 91 "Inj6Open" 92 "Inj7Open" 93 "Inj8Open" 94 "Lambda1Error_Fault" 95 "Lambda1Fault_Fault" 96 "Lambda1HtrOpen_Fault" 97 "Lambda1HtrShort_Fault" 98 "Lambda1Overcool_Fault" 99 "Lambda1Overheat_Fault" 100 "Lambda1StuckInReset_Fault" 101 "Lambda1StuckInWarmup_Fault" 102 "Lambda1VoltHigh_Fault" 103 "Lambda1VoltLow_Fault" 104 "Lambda2Error_Fault" 105 "Lambda2Fault_Fault" 106 "Lambda2HtrOpen_Fault" 107 "Lambda2HtrShort_Fault" 108 "Lambda2Overcool_Fault" 109 "Lambda2Overheat_Fault" 110 "Lambda2StuckInReset_Fault" 111 "Lambda2StuckInWarmup_Fault" 112 "Lambda2VoltHigh_Fault" 113 "Lambda2VoltLow_Fault" 114 "Lambda_1_Timeout" 115 "Lambda_2_Timeout" 116 "Lambda_Bank2Bank_Fault" 117 "LeanProtect_Fault" 118 "MAFRangeHigh" 119 "MAFRangeLow" 120 "MAPRangeHigh" 121 "MAPRangeLow" 122 "MAPTimeRangeHigh" 123 "MAPTimeRangeLow" 124 "MAP_IR_HI" 125 "MAP_IR_LO" 126 "MAP_STICKING" 127 "MediumOverspeed" 128 "NoOil_Fault" 129 "O2FailedLean_BankA" 130 "O2FailedLean_BankB" 131 "O2FailedRich_BankA" 132 "O2FailedRich_BankB" 133 "O2NotActive_BankA" 134 "O2NotActive_BankB" 135 "OilPresRangeHigh" 136 "OilPresRangeLow" 137 "ScrambleStuckHigh_Fault" 138 "SensVoltRangeHigh" 139 "SensVoltRangeLow" 140 "SoftOverBoost_Fault" 141 "SoftOverspeed" 142 "SysVoltRangeHigh" 143 "SysVoltRangeLow" 144 "TPS1AdaptHiMax" 145 "TPS1AdaptHiMin" 146 "TPS1AdaptLoMax" 147 "TPS1AdaptLoMin" 148 "TPS1RangeHigh" 149 "TPS1RangeLow" 150 "TPS2AdaptHiMax" 151 "TPS2AdaptHiMin" 152 "TPS2AdaptLoMax" 153 "TPS2AdaptLoMin" 154 "TPS2RangeHigh" 155 "TPS2RangeLow" 156 "TPS_Sensors_Conflict" 157 "VSPDRangeHigh" 158 "VSPDRangeLow" 159 "VoltLow_Fault" 160 "VoltTooHigh_Fault" 161 "Wastegate_Fault" 162 "(None)" /end COMPU_VTAB
/begin COMPU_VTAB CompuVtab_29 "" TAB_VERB 3 0 "Rate Limiter" 1 "Low Pass" 2 "Moving Average" /end COMPU_VTAB
/begin COMPU_VTAB CompuVtab_30 "" TAB_VERB 2 0 "Enable" 1 "Cut" /end COMPU_VTAB
/begin COMPU_VTAB CompuVtab_34 "" TAB_VERB 2 0 "Gov Enabled" 1 "Gov Disabled" /end COMPU_VTAB
/begin COMPU_VTAB CompuVtab_35 "" TAB_VERB 2 0 "ETC Req Mode" 1 "PID Mode" /end COMPU_VTAB
/begin COMPU_VTAB CompuVtab_36 "" TAB_VERB 2 0 "Hold Off" 1 "Hold On" /end COMPU_VTAB
/begin COMPU_VTAB CompuVtab_37 "" TAB_VERB 2 0 "Reset Off" 1 "Reset On" /end COMPU_VTAB
/begin COMPU_VTAB CompuVtab_38 "" TAB_VERB 2 0 "Off" 1 "On" /end COMPU_VTAB
/begin COMPU_VTAB CompuVtab_39 "" TAB_VERB 2 0 "Load saved application values on next startup" 1 "Load factory defaults on next startup" /end COMPU_VTAB
/begin COMPU_VTAB CompuVtab_40 "" TAB_VERB 7 0 "Currently loading NV from Factory FLASH to RAM" 1 "Currently loading NV from EEPROM to RAM" 2 "Currently storing NV from RAM to EEPROM" 3 "Detected new program.  Loaded Factory Defaults from FLASH" 4 "CRC failure.  Loaded Factory Defaults from FLASH" 5 "User requested refresh from Factory Defaults in FLASH." 6 "Successful refresh of EEPROM values from last shutdown" /end COMPU_VTAB
/begin COMPU_VTAB CompuVtab_42 "" TAB_VERB 2 0 "O2A" 1 "O2B" /end COMPU_VTAB
/begin COMPU_VTAB CompuVtab_43 "" TAB_VERB 2 0 "Cold Powerup" 1 "Warm Powerup" /end COMPU_VTAB
/begin COMPU_VTAB CompuVtab_45 "" TAB_VERB 2 0 "Run" 1 "Restore To Defaults" /end COMPU_VTAB
/begin COMPU_VTAB CompuVtab_46 "" TAB_VERB 4 0 "Disabled" 1 "Soft" 2 "Medium" 3 "Hard" /end COMPU_VTAB
/begin COMPU_VTAB CompuVtab_47 "" TAB_VERB 3 0 "Cut Spark" 1 "Cut Fuel" 2 "Cut Spark and Fuel" /end COMPU_VTAB
/begin COMPU_VTAB CompuVtab_48 "" TAB_VERB 2 0 "SteadyOrRising" 1 "Falling" /end COMPU_VTAB
/begin COMPU_VTAB CompuVtab_49 "" TAB_VERB 2 0 "Transient" 1 "Steady" /end COMPU_VTAB
/begin COMPU_VTAB CompuVtab_50 "" TAB_VERB 2 0 "Run" 1 "Store To EEPROM" /end COMPU_VTAB
/begin FUNCTION Stall_Throttle ""
 /begin DEF_CHARACTERISTIC ETC_IceBreakEnblTm ETC_IceBreakHoldTm ETC_IceBreakPos ETC_StallAppOvrThesh ETC_StallAppOvrTm /end DEF_CHARACTERISTIC
 /begin OUT_MEASUREMENT ETCStallAppOvrReq ETCStallIceBreakReq ETCStallReq /end OUT_MEASUREMENT
/end FUNCTION
/begin FUNCTION IGain "" /begin DEF_CHARACTERISTIC ETC_IGainMultTbl ETCIGain /end DEF_CHARACTERISTIC /begin OUT_MEASUREMENT ETC_IGainMult /end OUT_MEASUREMENT /end FUNCTION
/begin FUNCTION Setpoint_Manager "" /begin DEF_CHARACTERISTIC ETC_LoAdaptRateLimit /end DEF_CHARACTERISTIC /begin SUB_FUNCTION Tuning /end SUB_FUNCTION /end FUNCTION
/begin FUNCTION ETC_Override "" /begin DEF_CHARACTERISTIC ETC_new ETC_ovr /end DEF_CHARACTERISTIC /end FUNCTION
/begin FUNCTION PGain "" /begin DEF_CHARACTERISTIC ETC_PGainMultTbl ETCPGain /end DEF_CHARACTERISTIC /begin OUT_MEASUREMENT ETC_PGainMult /end OUT_MEASUREMENT /end FUNCTION
/begin FUNCTION ETC_Adapt_Request "" /begin OUT_MEASUREMENT ETC_ShutdownSetpointMode /end OUT_MEASUREMENT /end FUNCTION
/begin FUNCTION ETC_Sticking_Fault "" /begin DEF_CHARACTERISTIC ETC_StickingThresh /end DEF_CHARACTERISTIC /end FUNCTION
/begin FUNCTION DamperSwitch "" /begin DEF_CHARACTERISTIC ETCDamperSwitchHyst ETCDamperSwitchThresh /end DEF_CHARACTERISTIC /begin OUT_MEASUREMENT ETCDamperSwtichState ETCDamperTPS ETCDamperTPSThresh /end OUT_MEASUREMENT /end FUNCTION
/begin FUNCTION ETC_PID_Config "" /begin DEF_CHARACTERISTIC ETCDamperTPSFilt ETCLwrLim ETCUprLim /end DEF_CHARACTERISTIC /end FUNCTION
/begin FUNCTION ETCReq_Override "" /begin DEF_CHARACTERISTIC ETCReq_new ETCReq_ovr /end DEF_CHARACTERISTIC /end FUNCTION
/begin FUNCTION Tuning "" /begin DEF_CHARACTERISTIC ETCTuneAmp ETCTuneEnable ETCTuneFreq ETCTuneOffset /end DEF_CHARACTERISTIC /begin SUB_FUNCTION ETCReq_Override /end SUB_FUNCTION /end FUNCTION
/begin FUNCTION ETCStallShutDown "" /begin DEF_CHARACTERISTIC ETCShutdownTimerThresh /end DEF_CHARACTERISTIC /begin OUT_MEASUREMENT ETCStallStateShutdown /end OUT_MEASUREMENT /end FUNCTION
/begin FUNCTION Ethanol_Spark_Offset "" /begin DEF_CHARACTERISTIC Ethanol_SpkOfstMultMap EthSpkModTbl /end DEF_CHARACTERISTIC /begin OUT_MEASUREMENT Ethanol_Spk_Ofst Ethanol_SpkOfstMult EthSpkMod /end OUT_MEASUREMENT /end FUNCTION
/begin FUNCTION EVAP "" /begin DEF_CHARACTERISTIC EVAPTbl /end DEF_CHARACTERISTIC /begin OUT_MEASUREMENT EVAP EVAPADC EVAPIdx EVAPRaw /end OUT_MEASUREMENT /begin SUB_FUNCTION EVAP_Override EVAP_Config /end SUB_FUNCTION /end FUNCTION
/begin FUNCTION EVAP_Override "" /begin DEF_CHARACTERISTIC EVAP_new EVAP_ovr /end DEF_CHARACTERISTIC /end FUNCTION
/begin FUNCTION EVAP_Config "" /begin DEF_CHARACTERISTIC EVAPDefault EVAPFiltConst EVAPMax EVAPMin /end DEF_CHARACTERISTIC /end FUNCTION
/begin FUNCTION Rate_Limiter "" /begin DEF_CHARACTERISTIC Fall_Rate Rise_Rate /end DEF_CHARACTERISTIC /end FUNCTION
/begin FUNCTION Filter_Options "" /begin DEF_CHARACTERISTIC Filter_Type_Selection /end DEF_CHARACTERISTIC /begin SUB_FUNCTION Rate_Limiter Moving_Average_Filter /end SUB_FUNCTION /end FUNCTION
/begin FUNCTION FuelOxygenationSensor "" /begin SUB_FUNCTION Filter_Options /end SUB_FUNCTION /end FUNCTION
/begin FUNCTION FAN1_PWM_Override "" /begin DEF_CHARACTERISTIC FAN1_PWM_new FAN1_PWM_ovr /end DEF_CHARACTERISTIC /end FUNCTION
/begin FUNCTION FAN1_PWM "" /begin OUT_MEASUREMENT FAN1_PWMDutyCycle /end OUT_MEASUREMENT /begin SUB_FUNCTION FAN1_PWM_Override FAN1_PWM_Config /end SUB_FUNCTION /end FUNCTION
/begin FUNCTION FAN_Control_2 "" /begin SUB_FUNCTION FAN1_PWM FAN2_PWM /end SUB_FUNCTION /end FUNCTION
/begin FUNCTION FAN1_PWM_Config ""
 /begin DEF_CHARACTERISTIC FAN1_PWMFrequency FAN1_PWMGain FAN1_PWMMaxLimit FAN1_PWMMinLimit FAN1_PWMOffset /end DEF_CHARACTERISTIC
/end FUNCTION
/begin FUNCTION FAN2_PWM_Override "" /begin DEF_CHARACTERISTIC FAN2_PWM_new FAN2_PWM_ovr /end DEF_CHARACTERISTIC /end FUNCTION
/begin FUNCTION FAN2_PWM "" /begin OUT_MEASUREMENT FAN2_PWMDutyCycle /end OUT_MEASUREMENT /begin SUB_FUNCTION FAN2_PWM_Override FAN2_PWM_Config /end SUB_FUNCTION /end FUNCTION
/begin FUNCTION FAN2_PWM_Config ""
 /begin DEF_CHARACTERISTIC FAN2_PWMFrequency FAN2_PWMGain FAN2_PWMMaxLimit FAN2_PWMMinLimit FAN2_PWMOffset /end DEF_CHARACTERISTIC
/end FUNCTION
/begin FUNCTION Action_Reasons ""
 /begin OUT_MEASUREMENT FaultActionReason._.CutThrottle FaultActionReason._.DFCODisable FaultActionReason._.DelayedEngineShutdown FaultActionReason._.DisableAC FaultActionReason._.DisableFanRun FaultActionReason._.DisableFanStall FaultActionReason._.DisableO2Ctrl FaultActionReason._.DisableVEAdapt FaultActionReason._.DisableWastegate FaultActionReason._.EngineProtectLED FaultActionReason._.EngineShutdown FaultActionReason._.HardRevLimit FaultActionReason._.MIL_LED FaultActionReason._.MediumRevLimit FaultActionReason._.SoftRevLimit /end OUT_MEASUREMENT
/end FUNCTION
/begin FUNCTION Gear_Estimator ""
 /begin DEF_CHARACTERISTIC FDR Gear1Ratio Gear2Ratio Gear3Ratio Gear4Ratio Gear5Ratio Gear6Ratio GearMatchHyst TireRadius /end DEF_CHARACTERISTIC
 /begin OUT_MEASUREMENT GearEstimated /end OUT_MEASUREMENT
/end FUNCTION
/begin FUNCTION Moving_Average_Filter "" /begin DEF_CHARACTERISTIC FinalGain Gain1 Gain2 Gain3 /end DEF_CHARACTERISTIC /end FUNCTION
/begin FUNCTION Dash_Message_6 "" /begin DEF_CHARACTERISTIC Flex_Filt /end DEF_CHARACTERISTIC /end FUNCTION
/begin FUNCTION Fuel_Economy "" /begin OUT_MEASUREMENT Fuel_Economy_Filtered Fuel_Economy_Inst /end OUT_MEASUREMENT /begin SUB_FUNCTION First_Order_Low_Pass__Tunable_ /end SUB_FUNCTION /end FUNCTION
/begin FUNCTION Fuel_Lvl "" /begin DEF_CHARACTERISTIC Fuel_LvlTbl /end DEF_CHARACTERISTIC /begin OUT_MEASUREMENT Fuel_Lvl Fuel_LvlADC Fuel_LvlIdx Fuel_LvlRaw /end OUT_MEASUREMENT /begin SUB_FUNCTION Fuel_Lvl_Override Fuel_Lvl_Config /end SUB_FUNCTION /end FUNCTION
/begin FUNCTION Fuel_Level "" /begin SUB_FUNCTION Fuel_Lvl /end SUB_FUNCTION /end FUNCTION
/begin FUNCTION Fuel_Lvl_Override "" /begin DEF_CHARACTERISTIC Fuel_Lvl_new Fuel_Lvl_ovr /end DEF_CHARACTERISTIC /end FUNCTION
/begin FUNCTION Fuel_Lvl_Config "" /begin DEF_CHARACTERISTIC Fuel_LvlDefault Fuel_LvlFiltConst Fuel_LvlMax Fuel_LvlMin /end DEF_CHARACTERISTIC /end FUNCTION
/begin FUNCTION Saturation__Tunable__2 "" /begin DEF_CHARACTERISTIC FuelAdaptError_BankALwrLim FuelAdaptError_BankAUprLim /end DEF_CHARACTERISTIC /end FUNCTION
/begin FUNCTION Saturation__Tunable_1 "" /begin DEF_CHARACTERISTIC FuelAdaptError_BankBLwrLim FuelAdaptError_BankBUprLim /end DEF_CHARACTERISTIC /end FUNCTION
/begin FUNCTION DeltaPressureIndex "" /begin OUT_MEASUREMENT FuelDeltaPress InjDeltaPress09Idx InjDeltaPress09In /end OUT_MEASUREMENT /end FUNCTION
/begin FUNCTION Injector_Characterization "" /begin DEF_CHARACTERISTIC InjdPCompTbl InjGain InjOffset InjTurnOffTbl InjTurnOnTbl /end DEF_CHARACTERISTIC
 /begin OUT_MEASUREMENT InjDC InjdPComp InjEPW InjMPW InjTurnOff InjTurnOn MaxAllowableMPW TotalFPC /end OUT_MEASUREMENT
 /begin SUB_FUNCTION DeltaPressureIndex /end SUB_FUNCTION
/end FUNCTION
/begin FUNCTION Fuel_Delta_Pressure_Calculation "" /begin OUT_MEASUREMENT FuelDeltaPressure /end OUT_MEASUREMENT /end FUNCTION
/begin FUNCTION First_Order_Low_Pass__Tunable_ "" /begin DEF_CHARACTERISTIC FuelEconomy_FilterC /end DEF_CHARACTERISTIC /end FUNCTION
/begin FUNCTION Adapt_FuelFlowComp_Map_Bank_B "" /begin DEF_CHARACTERISTIC FuelFlowCompMaxValue FuelFlowCompMinValue /end DEF_CHARACTERISTIC /end FUNCTION
/begin FUNCTION Adapt_FuelFlowComp_Map_Bank_A "" /begin DEF_CHARACTERISTIC FuelFlowCompMaxValue_BankA FuelFlowCompMinValue_BankA /end DEF_CHARACTERISTIC /end FUNCTION
/begin FUNCTION FuelLevel "" /begin DEF_CHARACTERISTIC FuelLevel_FiltConstMap FuelLevel_FuelEevntAlpha /end DEF_CHARACTERISTIC
 /begin OUT_MEASUREMENT FuelLevel_FiltConst FuelLevel_FiltConstColIdx FuelLevel_FiltConstColIn FuelLevel_FiltConstRowIdx FuelLevel_FiltConstRowIn FuelLvl_Fin FuelLvl_NVM_Prb /end OUT_MEASUREMENT
 /begin SUB_FUNCTION RefuelEvent /end SUB_FUNCTION
/end FUNCTION
/begin FUNCTION RefuelEvent "" /begin DEF_CHARACTERISTIC FuelLevel_KeyUpDelay FuelLevl_KeyUpDiff /end DEF_CHARACTERISTIC /begin OUT_MEASUREMENT FuelLevel_RefuelEvent /end OUT_MEASUREMENT /end FUNCTION
/begin FUNCTION FUELP "" /begin OUT_MEASUREMENT FUELP /end OUT_MEASUREMENT /begin SUB_FUNCTION FUELP_Override FUELP_Config /end SUB_FUNCTION /end FUNCTION
/begin FUNCTION FuelPump "" /begin SUB_FUNCTION FUELP /end SUB_FUNCTION /end FUNCTION
/begin FUNCTION FUELP_Override "" /begin DEF_CHARACTERISTIC FUELP_new FUELP_ovr /end DEF_CHARACTERISTIC /end FUNCTION
/begin FUNCTION FUELP_Config "" /begin DEF_CHARACTERISTIC FUELP_Polarity /end DEF_CHARACTERISTIC /end FUNCTION
/begin FUNCTION FuelPres "" /begin OUT_MEASUREMENT FuelPres FuelPresADC FuelPresRaw /end OUT_MEASUREMENT /begin SUB_FUNCTION FuelPres_Override FuelPres_Config /end SUB_FUNCTION /end FUNCTION
/begin FUNCTION Wrong_Fuel_Pressure_Fault_Logic "" /begin DEF_CHARACTERISTIC FuelPres_DeltaTarget FuelPres_DeltaTolerance /end DEF_CHARACTERISTIC /end FUNCTION
/begin FUNCTION Dash_Message_3 "" /begin DEF_CHARACTERISTIC FuelPres_Filt MAP_filt OilPres_Filt /end DEF_CHARACTERISTIC /end FUNCTION
/begin FUNCTION FuelPres_Override "" /begin DEF_CHARACTERISTIC FuelPres_new FuelPres_ovr /end DEF_CHARACTERISTIC /end FUNCTION
/begin FUNCTION FuelPres_Config ""
 /begin DEF_CHARACTERISTIC FuelPresDfltValue FuelPresFilterConst FuelPresGain FuelPresInputHiFltPos FuelPresInputLoFltPos FuelPresOfst /end DEF_CHARACTERISTIC
/end FUNCTION
/begin FUNCTION FuelSens "" /begin OUT_MEASUREMENT FuelSens FuelSensADC FuelSensRaw /end OUT_MEASUREMENT /begin SUB_FUNCTION FuelSens_Override FuelSens_Config /end SUB_FUNCTION /end FUNCTION
/begin FUNCTION FuelSens_Override "" /begin DEF_CHARACTERISTIC FuelSens_new FuelSens_ovr /end DEF_CHARACTERISTIC /end FUNCTION
/begin FUNCTION FuelSens_Config ""
 /begin DEF_CHARACTERISTIC FuelSensDfltValue FuelSensFilterConst FuelSensGain FuelSensInputHiFltPos FuelSensInputLoFltPos FuelSensOfst /end DEF_CHARACTERISTIC
/end FUNCTION
/begin FUNCTION AEM_GPS ""
 /begin DEF_CHARACTERISTIC GPS_DateTime_Timeout GPS_LatLong_Timeout GPS_SpeedDir_Timeout /end DEF_CHARACTERISTIC
 /begin OUT_MEASUREMENT GPS_Altitude_Prb GPS_Course_Prb GPS_DayUTC_Prb GPS_HoursUTC_Prb GPS_Latitude_Prb GPS_Longitude_Prb GPS_MinutesUTC_Prb GPS_MonthUTC_Prb GPS_SatelliteCount_Prb GPS_SecondsUTC_Prb GPS_Speed_Prb GPS_Valid_Prb GPS_YearUTC_Prb /end OUT_MEASUREMENT
/end FUNCTION
/begin FUNCTION Cycle1CutPatter ""
 /begin DEF_CHARACTERISTIC HardCycle1Cyl1 HardCycle1Cyl2 HardCycle1Cyl3 HardCycle1Cyl4 HardCycle1Cyl5 HardCycle1Cyl6 HardCycle1Cyl7 HardCycle1Cyl8 /end DEF_CHARACTERISTIC
/end FUNCTION
/begin FUNCTION Hard_Cycle_Cut_Pattern ""
 /begin SUB_FUNCTION Cycle1CutPatter Cycle2CutPatter Cycle3CutPatter Cycle4CutPatter /end SUB_FUNCTION
/end FUNCTION
/begin FUNCTION SequenceCutPattern "" /begin DEF_CHARACTERISTIC RevLimitType /end DEF_CHARACTERISTIC /begin OUT_MEASUREMENT RevLimiterState /end OUT_MEASUREMENT
 /begin SUB_FUNCTION Hard_Cycle_Cut_Pattern Medium_Cycle_Cut_Pattern Soft_Cycle_Cut_Pattern /end SUB_FUNCTION
/end FUNCTION
/begin FUNCTION Cycle2CutPatter ""
 /begin DEF_CHARACTERISTIC HardCycle2Cyl1 HardCycle2Cyl2 HardCycle2Cyl3 HardCycle2Cyl4 HardCycle2Cyl5 HardCycle2Cyl6 HardCycle2Cyl7 HardCycle2Cyl8 /end DEF_CHARACTERISTIC
/end FUNCTION
/begin FUNCTION Cycle3CutPatter ""
 /begin DEF_CHARACTERISTIC HardCycle3Cyl1 HardCycle3Cyl2 HardCycle3Cyl3 HardCycle3Cyl4 HardCycle3Cyl5 HardCycle3Cyl6 HardCycle3Cyl7 HardCycle3Cyl8 /end DEF_CHARACTERISTIC
/end FUNCTION
/begin FUNCTION Cycle4CutPatter ""
 /begin DEF_CHARACTERISTIC HardCycle4Cyl1 HardCycle4Cyl2 HardCycle4Cyl3 HardCycle4Cyl4 HardCycle4Cyl5 HardCycle4Cyl6 HardCycle4Cyl7 HardCycle4Cyl8 /end DEF_CHARACTERISTIC
/end FUNCTION
/begin FUNCTION IAC_P_Override "" /begin DEF_CHARACTERISTIC IAC_P_new IAC_P_ovr /end DEF_CHARACTERISTIC /end FUNCTION
/begin FUNCTION IAC_P "" /begin OUT_MEASUREMENT IAC_PDutyCycle /end OUT_MEASUREMENT /begin SUB_FUNCTION IAC_P_Override IAC_P_Config /end SUB_FUNCTION /end FUNCTION
/begin FUNCTION IAC_Control "" /begin SUB_FUNCTION IAC_P IAC_S /end SUB_FUNCTION /end FUNCTION
/begin FUNCTION IAC_P_Config ""
 /begin DEF_CHARACTERISTIC IAC_PFrequency IAC_PGain IAC_PMaxLimit IAC_PMinLimit IAC_POffset /end DEF_CHARACTERISTIC
/end FUNCTION
/begin FUNCTION IAC_S_Override "" /begin DEF_CHARACTERISTIC IAC_S_new IAC_S_ovr /end DEF_CHARACTERISTIC /end FUNCTION
/begin FUNCTION IAC_S "" /begin OUT_MEASUREMENT IAC_SDutyCycle /end OUT_MEASUREMENT /begin SUB_FUNCTION IAC_S_Override IAC_S_Config /end SUB_FUNCTION /end FUNCTION
/begin FUNCTION IAC_S_Config ""
 /begin DEF_CHARACTERISTIC IAC_SFrequency IAC_SGain IAC_SMaxLimit IAC_SMinLimit IAC_SOffset /end DEF_CHARACTERISTIC
/end FUNCTION
/begin FUNCTION IAT "" /begin DEF_CHARACTERISTIC IATTbl /end DEF_CHARACTERISTIC /begin OUT_MEASUREMENT IAT IATADC IATIdx IATRaw /end OUT_MEASUREMENT /begin SUB_FUNCTION IAT_Override IAT_Config /end SUB_FUNCTION /end FUNCTION
/begin FUNCTION Capture_IAT_At_Startup "" /begin DEF_CHARACTERISTIC IAT_KeyUp_Count /end DEF_CHARACTERISTIC /begin OUT_MEASUREMENT IAT_KeyUp /end OUT_MEASUREMENT /end FUNCTION
/begin FUNCTION IAT_KeyUp "" /begin OUT_MEASUREMENT IAT_KeyUp09Idx IAT_KeyUp09In /end OUT_MEASUREMENT /end FUNCTION
/begin FUNCTION IAT_Override "" /begin DEF_CHARACTERISTIC IAT_new IAT_ovr /end DEF_CHARACTERISTIC /end FUNCTION
/begin FUNCTION IAT_Indexes "" /begin OUT_MEASUREMENT IAT05Idx IAT05In IAT07Idx IAT07In IAT17Idx IAT17In /end OUT_MEASUREMENT /end FUNCTION
/begin FUNCTION IAT_Config "" /begin DEF_CHARACTERISTIC IATDefault IATFiltConst IATMax IATMin /end DEF_CHARACTERISTIC /end FUNCTION
/begin FUNCTION Ramp_Air_Into_Idle_State "" /begin DEF_CHARACTERISTIC IdleEntryAirRampInFiltC /end DEF_CHARACTERISTIC /end FUNCTION
/begin FUNCTION Ramp_RPM "" /begin DEF_CHARACTERISTIC InGearRPMCtrlEntryFiltC /end DEF_CHARACTERISTIC /begin OUT_MEASUREMENT MinGovRPMSetPt /end OUT_MEASUREMENT /end FUNCTION
/begin FUNCTION InjEnable_Override "" /begin DEF_CHARACTERISTIC InjEnable_new InjEnable_ovr /end DEF_CHARACTERISTIC /end FUNCTION
/begin FUNCTION ISR ""
 /begin OUT_MEASUREMENT ISR_ADCCPU ISR_CANCPU ISR_DecrementorCPU ISR_DMACPU ISR_EMIOSCPU ISR_SCICPU ISR_TPUCPU /end OUT_MEASUREMENT
/end FUNCTION
/begin FUNCTION SensorVolt ""
 /begin DEF_CHARACTERISTIC Lambda1_VoltHighThresh Lambda1_VoltLowThresh Lambda2_VoltHighThresh Lambda2_VoltLowThresh /end DEF_CHARACTERISTIC
/end FUNCTION
/begin FUNCTION O2_Smart_Sensor "" /begin SUB_FUNCTION SensorVolt Bank2Bank SensorStatus /end SUB_FUNCTION /end FUNCTION
/begin FUNCTION Lean_Protect "" /begin DEF_CHARACTERISTIC LeanProtect_Threshold /end DEF_CHARACTERISTIC /end FUNCTION
/begin FUNCTION O2_Control_Switch_Point_Maps ""
 /begin DEF_CHARACTERISTIC LeanSwPtDeltaMap LeanTargetDeltaMap RichSwPtDeltaMap RichTargetDeltaMap /end DEF_CHARACTERISTIC
 /begin OUT_MEASUREMENT LeanSwPtDelta LeanTargetDelta RichSwPtDelta RichTargetDelta /end OUT_MEASUREMENT
/end FUNCTION
/begin FUNCTION O2_PID_Calibrations ""
 /begin DEF_CHARACTERISTIC O2CtrlDGain O2CtrlIGain O2CtrlPGain O2CtrlPIDOutLowerLimit O2CtrlPIDOutUpperLimit O2ITermLowerLimit O2ITermUpperLimit /end DEF_CHARACTERISTIC
 /begin SUB_FUNCTION O2_Control_Switch_Point_Maps Error_Gain_Scheduling /end SUB_FUNCTION
/end FUNCTION
/begin FUNCTION Closed_Loop_O2_PID_Controller ""
 /begin OUT_MEASUREMENT LiquidO2Control_DTerm_BankA LiquidO2Control_ErrorTerm_BankA LiquidO2Control_ITerm_BankA LiquidO2Control_PTerm_BankA /end OUT_MEASUREMENT
/end FUNCTION
/begin FUNCTION O2_PID_Controller_Bank_A "" /begin OUT_MEASUREMENT O2TargetEquivRatio_BankA /end OUT_MEASUREMENT
 /begin SUB_FUNCTION Closed_Loop_O2_PID_Controller Equivalence_Ratio_Perturbation /end SUB_FUNCTION
/end FUNCTION
/begin FUNCTION Closed_Loop_O2_PID_Controller_1 ""
 /begin OUT_MEASUREMENT LiquidO2Control_DTerm_BankB LiquidO2Control_ErrorTerm_BankB LiquidO2Control_ITerm_BankB LiquidO2Control_PTerm_BankB /end OUT_MEASUREMENT
/end FUNCTION
/begin FUNCTION O2_PID_Controller_Bank_B "" /begin OUT_MEASUREMENT O2TargetEquivRatio_BankB /end OUT_MEASUREMENT
 /begin SUB_FUNCTION Closed_Loop_O2_PID_Controller_1 Equivalence_Ratio_Perturbation_1 /end SUB_FUNCTION
/end FUNCTION
/begin FUNCTION Memory_1 "" /begin DEF_CHARACTERISTIC LoadCalibrationError SaveCalibrationError /end DEF_CHARACTERISTIC /end FUNCTION
/begin FUNCTION Low_Voltage "" /begin DEF_CHARACTERISTIC LVDiag_AltInop LVDiag_VoltLow LVDiag_VoltTooHigh /end DEF_CHARACTERISTIC /end FUNCTION
/begin FUNCTION MAF "" /begin DEF_CHARACTERISTIC MAFTbl /end DEF_CHARACTERISTIC /begin OUT_MEASUREMENT MAF MAFADC MAFIdx MAFRaw /end OUT_MEASUREMENT /begin SUB_FUNCTION MAF_Override MAF_Config /end SUB_FUNCTION /end FUNCTION
/begin FUNCTION MAF_Override "" /begin DEF_CHARACTERISTIC MAF_new MAF_ovr /end DEF_CHARACTERISTIC /end FUNCTION
/begin FUNCTION MAF_Config "" /begin DEF_CHARACTERISTIC MAFDefault MAFFiltConst MAFMax MAFMin /end DEF_CHARACTERISTIC /end FUNCTION
/begin FUNCTION MAFPortIndex "" /begin OUT_MEASUREMENT MAFPort05Idx MAFPort05In /end OUT_MEASUREMENT /end FUNCTION
/begin FUNCTION MakeUp_EOI_Override "" /begin DEF_CHARACTERISTIC MakeUp_EOI_new MakeUp_EOI_ovr /end DEF_CHARACTERISTIC /end FUNCTION
/begin FUNCTION _MAP "" /begin OUT_MEASUREMENT MAP MAPADC MAPRaw /end OUT_MEASUREMENT /begin SUB_FUNCTION MAP_Override MAP_Config /end SUB_FUNCTION /end FUNCTION
/begin FUNCTION MAP_Fault_Logic ""
 /begin DEF_CHARACTERISTIC MAP_IR_HI MAP_IR_LO MAP_IR_TPS_CL MAP_IR_TPS_OP MAP_STUCK MAP_TPS_STUCK /end DEF_CHARACTERISTIC
/end FUNCTION
/begin FUNCTION MAP_Override "" /begin DEF_CHARACTERISTIC MAP_new MAP_ovr /end DEF_CHARACTERISTIC /end FUNCTION
/begin FUNCTION MAP_Indexes "" /begin OUT_MEASUREMENT MAP05Idx MAP05In MAP09Idx MAP09In MAP17Idx MAP17In /end OUT_MEASUREMENT /end FUNCTION
/begin FUNCTION MAP_Config ""
 /begin DEF_CHARACTERISTIC MAPDfltValue MAPFilterConst MAPGain MAPInputHiFltPos MAPInputLoFltPos MAPOfst /end DEF_CHARACTERISTIC
/end FUNCTION
/begin FUNCTION MAPTime "" /begin OUT_MEASUREMENT MAPTime MAPTimeADC MAPTimeRaw /end OUT_MEASUREMENT /begin SUB_FUNCTION MAPTime_Override MAPTime_Config /end SUB_FUNCTION /end FUNCTION
/begin FUNCTION MAPTime_Override "" /begin DEF_CHARACTERISTIC MAPTime_new MAPTime_ovr /end DEF_CHARACTERISTIC /end FUNCTION
/begin FUNCTION MAPTime_Config ""
 /begin DEF_CHARACTERISTIC MAPTimeDfltValue MAPTimeFilterConst MAPTimeGain MAPTimeInputHiFltPos MAPTimeInputLoFltPos MAPTimeOfst /end DEF_CHARACTERISTIC
/end FUNCTION
/begin FUNCTION Universal_PID__Tunable___Scheduled__2 ""
 /begin DEF_CHARACTERISTIC MaxGovDGain MaxGovDGainErrorMultTbl MaxGovErrorGain MaxGovIGain MaxGovIGainErrorMultTbl MaxGovITermLowerLimit MaxGovITermUpperLimit MaxGovPGain MaxGovPGainErrorMultTbl MaxGovPIDOutLowerLimit MaxGovPIDOutUpperLimit /end DEF_CHARACTERISTIC
 /begin OUT_MEASUREMENT MaxGovDGainErrorMult MaxGovDTerm MaxGovError MaxGovIGainErrorMult MaxGovITerm MaxGovPGainErrorMult MaxGovPTerm MaxGovSpeedErrorIdx MaxGovSpeedErrorIn /end OUT_MEASUREMENT
/end FUNCTION
/begin FUNCTION MaxGovernor "" /begin OUT_MEASUREMENT MaxGovOutput TPSRequestLookupAirOfst /end OUT_MEASUREMENT
 /begin SUB_FUNCTION Universal_PID__Tunable___Scheduled__2 MaxGovState I_Term_Preload Trigger_Pre_load Ramp_RPM_1 /end SUB_FUNCTION
/end FUNCTION
/begin FUNCTION MaxGovState "" /begin DEF_CHARACTERISTIC MaxGovDisable MaxGovTPSHyst /end DEF_CHARACTERISTIC /begin OUT_MEASUREMENT MaxGovETCMode MaxGovHold MaxGovReset MaxGovState /end OUT_MEASUREMENT /end FUNCTION
/begin FUNCTION I_Term_Preload "" /begin DEF_CHARACTERISTIC MaxGovPreloadITermTbl /end DEF_CHARACTERISTIC /begin OUT_MEASUREMENT MaxGovIC MaxGovPreloadITerm /end OUT_MEASUREMENT /end FUNCTION
/begin FUNCTION InGear ""
 /begin DEF_CHARACTERISTIC MaxGovInGearLowerLim MaxGovInGearRPMSetPt MaxGovInGearRPMThresh MaxGovInGearUpperLim /end DEF_CHARACTERISTIC
/end FUNCTION
/begin FUNCTION Trigger_Pre_load "" /begin SUB_FUNCTION InGear InNeutral /end SUB_FUNCTION /end FUNCTION
/begin FUNCTION InNeutral ""
 /begin DEF_CHARACTERISTIC MaxGovNtrlLowerLim MaxGovNtrlRPMSetPt MaxGovNtrlRPMThresh MaxGovNtrlUpperLim /end DEF_CHARACTERISTIC
/end FUNCTION
/begin FUNCTION Ramp_RPM_1 "" /begin DEF_CHARACTERISTIC MaxGovRPMCtrlEntryFiltC /end DEF_CHARACTERISTIC /begin OUT_MEASUREMENT MaxGovRPMSetpoint /end OUT_MEASUREMENT /end FUNCTION
/begin FUNCTION SparkAdvanceLimiter "" /begin DEF_CHARACTERISTIC MaxSparkLimitOffIdle MaxSparkLimitTbl MinSparkLimit /end DEF_CHARACTERISTIC /begin OUT_MEASUREMENT MaxSparkLimit TotalSparkAdv /end OUT_MEASUREMENT /end FUNCTION
/begin FUNCTION Mech_PW_Override "" /begin DEF_CHARACTERISTIC Mech_PW_new Mech_PW_ovr /end DEF_CHARACTERISTIC /end FUNCTION
/begin FUNCTION Cycle1CutPatter_1 ""
 /begin DEF_CHARACTERISTIC MediumCycle1Cyl1 MediumCycle1Cyl2 MediumCycle1Cyl3 MediumCycle1Cyl4 MediumCycle1Cyl5 MediumCycle1Cyl6 MediumCycle1Cyl7 MediumCycle1Cyl8 /end DEF_CHARACTERISTIC
/end FUNCTION
/begin FUNCTION Medium_Cycle_Cut_Pattern ""
 /begin SUB_FUNCTION Cycle1CutPatter_1 Cycle2CutPatter_1 Cycle3CutPatter_1 Cycle4CutPatter_1 /end SUB_FUNCTION
/end FUNCTION
/begin FUNCTION Cycle2CutPatter_1 ""
 /begin DEF_CHARACTERISTIC MediumCycle2Cyl1 MediumCycle2Cyl2 MediumCycle2Cyl3 MediumCycle2Cyl4 MediumCycle2Cyl5 MediumCycle2Cyl6 MediumCycle2Cyl7 MediumCycle2Cyl8 /end DEF_CHARACTERISTIC
/end FUNCTION
/begin FUNCTION Cycle3CutPatter_1 ""
 /begin DEF_CHARACTERISTIC MediumCycle3Cyl1 MediumCycle3Cyl2 MediumCycle3Cyl3 MediumCycle3Cyl4 MediumCycle3Cyl5 MediumCycle3Cyl6 MediumCycle3Cyl7 MediumCycle3Cyl8 /end DEF_CHARACTERISTIC
/end FUNCTION
/begin FUNCTION Cycle4CutPatter_1 ""
 /begin DEF_CHARACTERISTIC MediumCycle4Cyl1 MediumCycle4Cyl2 MediumCycle4Cyl3 MediumCycle4Cyl4 MediumCycle4Cyl5 MediumCycle4Cyl6 MediumCycle4Cyl7 MediumCycle4Cyl8 /end DEF_CHARACTERISTIC
/end FUNCTION
/begin FUNCTION Base_RPM_Set_Pt "" /begin DEF_CHARACTERISTIC MinGovClntRPMSetPtTbl /end DEF_CHARACTERISTIC /begin OUT_MEASUREMENT MinGovClntRPMSetPt /end OUT_MEASUREMENT /end FUNCTION
/begin FUNCTION Low_Oil_Pressure_Fault_Logic "" /begin DEF_CHARACTERISTIC MinOilPressure_FaultTbl MinOilPressure_WarnTbl /end DEF_CHARACTERISTIC /begin OUT_MEASUREMENT MinOilPressure_Fault MinOilPressure_Warn /end OUT_MEASUREMENT /end FUNCTION
/begin FUNCTION StoreRPMData ""
 /begin DEF_CHARACTERISTIC MisfireDiag_AngleHyst MisfireDiag_StartAngles MisfireDiag_StopAngles /end DEF_CHARACTERISTIC
 /begin OUT_MEASUREMENT MisfireDiag_AverageStartRPM MisfireDiag_AverageStartRPMDR MisfireDiag_AverageStopRPM MisfireDiag_AverageStopRPMDR MisfireDiag_EncoderAngle /end OUT_MEASUREMENT
 /begin SUB_FUNCTION EncoderAngleArb LatchForAverage LatchForAverage1 /end SUB_FUNCTION
/end FUNCTION
/begin FUNCTION MisfireDiagFunc "" /begin SUB_FUNCTION StoreRPMData DetermineMisfire /end SUB_FUNCTION /end FUNCTION
/begin FUNCTION MisfireDiagSub "" /begin SUB_FUNCTION MisfireDiagFunc /end SUB_FUNCTION /end FUNCTION
/begin FUNCTION MISFIRE ""
 /begin DEF_CHARACTERISTIC MisfireDiag_ECTHighEnbl MisfireDiag_ECTLowEnbl MisfireDiag_Enbl MisfireDiag_MAPHighEnbl MisfireDiag_MAPIRDiagEnable MisfireDiag_MAPLowEnbl MisfireDiag_RPMHighEnbl MisfireDiag_RPMLowEnbl MisfireDiag_TimeSinceRunEnbl /end DEF_CHARACTERISTIC
 /begin SUB_FUNCTION MisfireDiagSub /end SUB_FUNCTION
/end FUNCTION
/begin FUNCTION EncoderAngleArb "" /begin DEF_CHARACTERISTIC MisfireDiag_EncoderExtrap_MPC5XX /end DEF_CHARACTERISTIC /end FUNCTION
/begin FUNCTION DetermineMisfire "" /begin DEF_CHARACTERISTIC MisfireDiag_HardMisfireThreshold /end DEF_CHARACTERISTIC /end FUNCTION
/begin FUNCTION LatchForAverage "" /begin DEF_CHARACTERISTIC MisfireDiag_StartRPMAvgCnt /end DEF_CHARACTERISTIC /end FUNCTION
/begin FUNCTION LatchForAverage1 "" /begin DEF_CHARACTERISTIC MisfireDiag_StopRPMAvgCnt /end DEF_CHARACTERISTIC /end FUNCTION
/begin FUNCTION MotoringDetection "" /begin DEF_CHARACTERISTIC MotoringDeltaRPMLimit MotoringDtctTimerLimit /end DEF_CHARACTERISTIC /begin OUT_MEASUREMENT MotoringDetectionFlag MotoringDetectionTime /end OUT_MEASUREMENT /end FUNCTION
/begin FUNCTION MPRD_Override "" /begin DEF_CHARACTERISTIC MPRD_new MPRD_ovr /end DEF_CHARACTERISTIC /end FUNCTION
/begin FUNCTION NonVolatile_Storage "" /begin DEF_CHARACTERISTIC RestoreNVFactoryDefaults StoreNV /end DEF_CHARACTERISTIC /begin OUT_MEASUREMENT NonVolatileCRC NonVolatileFormatID NonVolatileStatus /end OUT_MEASUREMENT /begin SUB_FUNCTION NonVolatile_Storage_Config /end SUB_FUNCTION /end FUNCTION
/begin FUNCTION NonVolatile_Storage_Config ""
 /begin DEF_CHARACTERISTIC NonVolatileRestoreOnFirstStartup NonVolatileRestoreOnStartup /end DEF_CHARACTERISTIC
/end FUNCTION
/begin FUNCTION Equivalence_Ratio_Perturbation ""
 /begin DEF_CHARACTERISTIC O2ActiveTimeThresh_BankA O2LeanTimeThresh_BankA O2RichTimeThresh_BankA /end DEF_CHARACTERISTIC
 /begin OUT_MEASUREMENT O2LeanTime_BankA O2NotActiveTime_BankA O2RichTime_BankA /end OUT_MEASUREMENT
/end FUNCTION
/begin FUNCTION Equivalence_Ratio_Perturbation_1 ""
 /begin DEF_CHARACTERISTIC O2ActiveTimeThresh_BankB O2LeanTimeThresh_BankB O2RichTimeThresh_BankB /end DEF_CHARACTERISTIC
 /begin OUT_MEASUREMENT O2LeanTime_BankB O2NotActiveTime_BankB O2RichTime_BankB /end OUT_MEASUREMENT
/end FUNCTION
/begin FUNCTION O2_De_lag "" /begin DEF_CHARACTERISTIC O2BankA_DelagFilterConst O2BankB_DelagFiltConst /end DEF_CHARACTERISTIC /begin OUT_MEASUREMENT O2BankA_O2Delag O2BankB_O2Delag /end OUT_MEASUREMENT /end FUNCTION
/begin FUNCTION O2_Control_Enable_Delay "" /begin DEF_CHARACTERISTIC O2CtrlAdaptDelayTime /end DEF_CHARACTERISTIC /end FUNCTION
/begin FUNCTION Map_O2_Sensors_to_V8_Cylinders ""
 /begin DEF_CHARACTERISTIC O2Cyl1Select O2Cyl2Select O2Cyl3Select O2Cyl4Select O2Cyl5Select O2Cyl6Select O2Cyl7Select O2Cyl8Select /end DEF_CHARACTERISTIC
/end FUNCTION
/begin FUNCTION Bank2Bank ""
 /begin DEF_CHARACTERISTIC O2Diag_Bank2Bank_DiffAlwdMap O2Diag_Bank2Bank_MaxDesEquivRatio O2Diag_Bank2Bank_MinDesEquivRatio O2Diag_Bank2Bank_MinECT O2Diag_Bank2Bank_MinRunTime /end DEF_CHARACTERISTIC
 /begin OUT_MEASUREMENT O2Diag_Bank2Bank_DiffAlwd /end OUT_MEASUREMENT
/end FUNCTION
/begin FUNCTION SensorStatus ""
 /begin DEF_CHARACTERISTIC O2Diag_Lam1_StuckInResetThresh O2Diag_Lam1_StuckInWarmup O2Diag_Lam2_StuckInWarmup O2Diag_Lam21_StuckInResetThresh /end DEF_CHARACTERISTIC
/end FUNCTION
/begin FUNCTION O2Arb "" /begin OUT_MEASUREMENT O2FuelMult /end OUT_MEASUREMENT /end FUNCTION
/begin FUNCTION Error_Gain_Scheduling "" /begin DEF_CHARACTERISTIC O2MAFErrGainMultTbl O2NECCTErrGainMultTbl /end DEF_CHARACTERISTIC /begin OUT_MEASUREMENT O2MAFErrGainMult O2NECCTErrGainMult /end OUT_MEASUREMENT /end FUNCTION
/begin FUNCTION OilPres "" /begin OUT_MEASUREMENT OilPres OilPresADC OilPresRaw /end OUT_MEASUREMENT /begin SUB_FUNCTION OilPres_Override OilPres_Config /end SUB_FUNCTION /end FUNCTION
/begin FUNCTION OilPres_Override "" /begin DEF_CHARACTERISTIC OilPres_new OilPres_ovr /end DEF_CHARACTERISTIC /end FUNCTION
/begin FUNCTION OilPres_Config ""
 /begin DEF_CHARACTERISTIC OilPresDfltValue OilPresFilterConst OilPresGain OilPresInputHiFltPos OilPresInputLoFltPos OilPresOfst /end DEF_CHARACTERISTIC
/end FUNCTION
/begin FUNCTION CutThrottle_APP_Limiting "" /begin DEF_CHARACTERISTIC Overheat_MaxAPP Overheat_ScaleAPP /end DEF_CHARACTERISTIC /end FUNCTION
/begin FUNCTION OXY_Index "" /begin OUT_MEASUREMENT OXY05Idx OXY05In /end OUT_MEASUREMENT /end FUNCTION
/begin FUNCTION OXY_Transient_Fueling "" /begin DEF_CHARACTERISTIC OXYTransFuelMultTbl /end DEF_CHARACTERISTIC /begin OUT_MEASUREMENT OXYTransFuelMult /end OUT_MEASUREMENT /end FUNCTION
/begin FUNCTION DecreasingFilter "" /begin DEF_CHARACTERISTIC PH1_FiltDecConst /end DEF_CHARACTERISTIC /end FUNCTION
/begin FUNCTION PHI_Filt "" /begin DEF_CHARACTERISTIC PHI1_DefaultVal /end DEF_CHARACTERISTIC /begin OUT_MEASUREMENT PHI1_FiltFin /end OUT_MEASUREMENT /begin SUB_FUNCTION DecreasingFilter IncreasingFilter /end SUB_FUNCTION /end FUNCTION
/begin FUNCTION IncreasingFilter "" /begin DEF_CHARACTERISTIC PH1_FiltIncConst /end DEF_CHARACTERISTIC /end FUNCTION
/begin FUNCTION DecreasingFilter_1 "" /begin DEF_CHARACTERISTIC PH2_FiltDecConst /end DEF_CHARACTERISTIC /end FUNCTION
/begin FUNCTION PHI_Filt1 "" /begin DEF_CHARACTERISTIC PHI2_DefaultVal /end DEF_CHARACTERISTIC /begin OUT_MEASUREMENT PHI2_FiltFin /end OUT_MEASUREMENT /begin SUB_FUNCTION DecreasingFilter_1 IncreasingFilter_1 /end SUB_FUNCTION /end FUNCTION
/begin FUNCTION IncreasingFilter_1 "" /begin DEF_CHARACTERISTIC PH2_FiltIncConst /end DEF_CHARACTERISTIC /end FUNCTION
/begin FUNCTION Status "" /begin OUT_MEASUREMENT PowerUpStatus /end OUT_MEASUREMENT /end FUNCTION
/begin FUNCTION RPM_Indexes "" /begin OUT_MEASUREMENT RPM05Idx RPM05In RPM09Idx RPM09In RPM17Idx RPM17In /end OUT_MEASUREMENT /end FUNCTION
/begin FUNCTION Determine_if_RPM_is_Falling "" /begin DEF_CHARACTERISTIC RPMFallingFiltConst RPMFallingRate /end DEF_CHARACTERISTIC /begin OUT_MEASUREMENT RPMFalling /end OUT_MEASUREMENT /end FUNCTION
/begin FUNCTION RPM_Filt "" /begin DEF_CHARACTERISTIC RPMFilt_Enable RPMFilt_LowPass RPMFilt_RoundValue /end DEF_CHARACTERISTIC /begin OUT_MEASUREMENT RPMFilt_Final RPMFilt_PostLowPass /end OUT_MEASUREMENT /end FUNCTION
/begin FUNCTION Dash_Message_1 "" /begin DEF_CHARACTERISTIC TPS_Filt /end DEF_CHARACTERISTIC /begin SUB_FUNCTION RPM_Filt /end SUB_FUNCTION /end FUNCTION
/begin FUNCTION Scramble "" /begin DEF_CHARACTERISTIC ScrambleDebounceDelay /end DEF_CHARACTERISTIC /begin OUT_MEASUREMENT Scramble Scramble_Raw /end OUT_MEASUREMENT /begin SUB_FUNCTION Scramble_Override Scramble_Config /end SUB_FUNCTION /end FUNCTION
/begin FUNCTION Scramble_Override "" /begin DEF_CHARACTERISTIC Scramble_new Scramble_ovr /end DEF_CHARACTERISTIC /end FUNCTION
/begin FUNCTION Scramble_Config "" /begin DEF_CHARACTERISTIC ScramblePolarity ScrambleSwitchPt /end DEF_CHARACTERISTIC /end FUNCTION
/begin FUNCTION SensVolt "" /begin OUT_MEASUREMENT SensVolt SensVoltADC SensVoltRaw /end OUT_MEASUREMENT /begin SUB_FUNCTION SensVolt_Override SensVolt_Config /end SUB_FUNCTION /end FUNCTION
/begin FUNCTION SensVolt_Override "" /begin DEF_CHARACTERISTIC SensVolt_new SensVolt_ovr /end DEF_CHARACTERISTIC /end FUNCTION
/begin FUNCTION SensVolt_Config ""
 /begin DEF_CHARACTERISTIC SensVoltDfltValue SensVoltFilterConst SensVoltGain SensVoltInputHiFltPos SensVoltInputLoFltPos SensVoltOfst /end DEF_CHARACTERISTIC
/end FUNCTION
/begin FUNCTION Cycle1CutPatter_2 ""
 /begin DEF_CHARACTERISTIC SoftCycle1Cyl1 SoftCycle1Cyl2 SoftCycle1Cyl3 SoftCycle1Cyl4 SoftCycle1Cyl5 SoftCycle1Cyl6 SoftCycle1Cyl7 SoftCycle1Cyl8 /end DEF_CHARACTERISTIC
/end FUNCTION
/begin FUNCTION Soft_Cycle_Cut_Pattern ""
 /begin SUB_FUNCTION Cycle1CutPatter_2 Cycle2CutPatter_2 Cycle3CutPatter_2 Cycle4CutPatter_2 /end SUB_FUNCTION
/end FUNCTION
/begin FUNCTION Cycle2CutPatter_2 ""
 /begin DEF_CHARACTERISTIC SoftCycle2Cyl1 SoftCycle2Cyl2 SoftCycle2Cyl3 SoftCycle2Cyl4 SoftCycle2Cyl5 SoftCycle2Cyl6 SoftCycle2Cyl7 SoftCycle2Cyl8 /end DEF_CHARACTERISTIC
/end FUNCTION
/begin FUNCTION Cycle3CutPatter_2 ""
 /begin DEF_CHARACTERISTIC SoftCycle3Cyl1 SoftCycle3Cyl2 SoftCycle3Cyl3 SoftCycle3Cyl4 SoftCycle3Cyl5 SoftCycle3Cyl6 SoftCycle3Cyl7 SoftCycle3Cyl8 /end DEF_CHARACTERISTIC
/end FUNCTION
/begin FUNCTION Cycle4CutPatter_2 ""
 /begin DEF_CHARACTERISTIC SoftCycle4Cyl1 SoftCycle4Cyl2 SoftCycle4Cyl3 SoftCycle4Cyl4 SoftCycle4Cyl5 SoftCycle4Cyl6 SoftCycle4Cyl7 SoftCycle4Cyl8 /end DEF_CHARACTERISTIC
/end FUNCTION
/begin FUNCTION SOI_Override "" /begin DEF_CHARACTERISTIC SOI_new SOI_ovr /end DEF_CHARACTERISTIC /end FUNCTION
/begin FUNCTION Spark_Advance_Rate_Limiter "" /begin DEF_CHARACTERISTIC SparkAdv_DeltaHi SparkAdv_DeltaLo /end DEF_CHARACTERISTIC /end FUNCTION
/begin FUNCTION SparkDwell_Override "" /begin DEF_CHARACTERISTIC SparkDwell_offset SparkDwell_ovr /end DEF_CHARACTERISTIC /end FUNCTION
/begin FUNCTION SparkStartAngle_Override "" /begin DEF_CHARACTERISTIC SparkStartAngle_offset SparkStartAngle_ovr /end DEF_CHARACTERISTIC /end FUNCTION
/begin FUNCTION SparkStopAngle_Override "" /begin DEF_CHARACTERISTIC SparkStopAngle_offset SparkStopAngle_ovr /end DEF_CHARACTERISTIC /end FUNCTION
/begin FUNCTION PID_Gain_Select ""
 /begin DEF_CHARACTERISTIC SpkMinGovDGain SpkMinGovDGainErrorMultTbl SpkMinGovPGain SpkMinGovPGainErrorMultTbl /end DEF_CHARACTERISTIC
 /begin OUT_MEASUREMENT SpkMinGovDGainErrorMult SpkMinGovPGainErrorMult /end OUT_MEASUREMENT
/end FUNCTION
/begin FUNCTION Universal_PD__Tunable___Scheduled_ ""
 /begin DEF_CHARACTERISTIC SpkMinGovErrorGain SpkMinGovPIDOutLowerLimit SpkMinGovPIDOutUpperLimit /end DEF_CHARACTERISTIC
 /begin OUT_MEASUREMENT SpkMinGovDTerm SpkMinGovError SpkMinGovPTerm SpkMinGovSpeedErrorIdx SpkMinGovSpeedErrorIn /end OUT_MEASUREMENT
 /begin SUB_FUNCTION PID_Gain_Select /end SUB_FUNCTION
/end FUNCTION
/begin FUNCTION LoadBasedCalcs ""
 /begin OUT_MEASUREMENT SSEng SSLoadDirection SSLoadFilterConst SSLoadFiltered SSRPMDirection SSRPMFilterConst SSRPMFiltered /end OUT_MEASUREMENT
 /begin SUB_FUNCTION Engine_Steady_State_Flag LoadBasedCalcs_Config /end SUB_FUNCTION
/end FUNCTION
/begin FUNCTION Engine_Steady_State_Flag "" /begin DEF_CHARACTERISTIC SSLoadTol SSRPMTol /end DEF_CHARACTERISTIC /begin OUT_MEASUREMENT SSEngOpr /end OUT_MEASUREMENT /end FUNCTION
/begin FUNCTION LoadBasedCalcs_Config "" /begin DEF_CHARACTERISTIC SSLoadDecFiltC SSLoadIncFiltC SSRPMDecFiltC SSRPMIncFiltC /end DEF_CHARACTERISTIC /end FUNCTION
/begin FUNCTION SysVolt "" /begin OUT_MEASUREMENT SysVolt SysVoltADC SysVoltRaw /end OUT_MEASUREMENT /begin SUB_FUNCTION SysVolt_Override SysVolt_Config /end SUB_FUNCTION /end FUNCTION
/begin FUNCTION SysVolt_Override "" /begin DEF_CHARACTERISTIC SysVolt_new SysVolt_ovr /end DEF_CHARACTERISTIC /end FUNCTION
/begin FUNCTION SysVolt_Index "" /begin OUT_MEASUREMENT SysVolt09Idx SysVolt09In /end OUT_MEASUREMENT /end FUNCTION
/begin FUNCTION SysVolt_Config ""
 /begin DEF_CHARACTERISTIC SysVoltDfltValue SysVoltFilterConst SysVoltGain SysVoltInputHiFltPos SysVoltInputLoFltPos SysVoltOfst /end DEF_CHARACTERISTIC
/end FUNCTION
/begin FUNCTION Engine_Overheat_Fault_Logic ""
 /begin DEF_CHARACTERISTIC TempOverheat_Fault TempOverheat_Warn TempOverheatSevere_Fault /end DEF_CHARACTERISTIC
/end FUNCTION
/begin FUNCTION Time_Since_Key_On "" /begin OUT_MEASUREMENT TimeSinceKeyOn /end OUT_MEASUREMENT /end FUNCTION
/begin FUNCTION Time_Since_Run "" /begin OUT_MEASUREMENT TimeSinceRun /end OUT_MEASUREMENT /end FUNCTION
/begin FUNCTION Time_Since_Stall "" /begin OUT_MEASUREMENT TimeSinceStall /end OUT_MEASUREMENT /end FUNCTION
/begin FUNCTION TPS_Indexes "" /begin OUT_MEASUREMENT TPS09Idx TPS09In /end OUT_MEASUREMENT /end FUNCTION
/begin FUNCTION TPS1_Override "" /begin DEF_CHARACTERISTIC TPS1_new TPS1_ovr /end DEF_CHARACTERISTIC /end FUNCTION
/begin FUNCTION TPS1 ""
 /begin OUT_MEASUREMENT TPS1Adapt_Hi TPS1Adapt_Low TPS1ADC TPS1Percent TPS1PercentRaw /end OUT_MEASUREMENT
 /begin SUB_FUNCTION TPS1_Override TPS1_Config /end SUB_FUNCTION
/end FUNCTION
/begin FUNCTION TPS__Sensor_Arbitration "" /begin DEF_CHARACTERISTIC TPS1_TPS2_Max_Deviation /end DEF_CHARACTERISTIC /begin OUT_MEASUREMENT TPSFinal /end OUT_MEASUREMENT /end FUNCTION
/begin FUNCTION TPS1_Config ""
 /begin DEF_CHARACTERISTIC TPS1Adapt_Delta TPS1Adapt_Hi_Max TPS1Adapt_Hi_Min TPS1Adapt_Low_Max TPS1Adapt_Low_Min TPS1AdaptHiEnable TPS1AdaptLoEnable TPS1DfltValue TPS1FilterConst TPS1InputHiFltPos TPS1InputLoFltPos TPS1MaxLimit TPS1Rev_Polarity /end DEF_CHARACTERISTIC
/end FUNCTION
/begin FUNCTION TPS2_Override "" /begin DEF_CHARACTERISTIC TPS2_new TPS2_ovr /end DEF_CHARACTERISTIC /end FUNCTION
/begin FUNCTION TPS2 ""
 /begin OUT_MEASUREMENT TPS2Adapt_Hi TPS2Adapt_Low TPS2ADC TPS2Percent TPS2PercentRaw /end OUT_MEASUREMENT
 /begin SUB_FUNCTION TPS2_Override TPS2_Config /end SUB_FUNCTION
/end FUNCTION
/begin FUNCTION TPS2_Config ""
 /begin DEF_CHARACTERISTIC TPS2Adapt_Delta TPS2Adapt_Hi_Max TPS2Adapt_Hi_Min TPS2Adapt_Low_Max TPS2Adapt_Low_Min TPS2AdaptHiEnable TPS2AdaptLoEnable TPS2DfltValue TPS2FilterConst TPS2InputHiFltPos TPS2InputLoFltPos TPS2MaxLimit TPS2Rev_Polarity /end DEF_CHARACTERISTIC
/end FUNCTION
/begin FUNCTION Adapt_VolEff_Map "" /begin DEF_CHARACTERISTIC VEAdaptGainTblTbl VEAdaptMax VEAdaptMin /end DEF_CHARACTERISTIC
 /begin OUT_MEASUREMENT VE_AdaptErrorIdxArrIdx VE_AdaptErrorIdxArrIn VEAdaptGainTbl /end OUT_MEASUREMENT
/end FUNCTION
/begin FUNCTION VSPD_Filt ""
 /begin DEF_CHARACTERISTIC VPSD_ChangeReject VSPD_ChangeReject_Enable VSPD_RateReject VSPD_RateReject_Enable VSPD_RejectHoldTime VSPD_ZeroSpeed /end DEF_CHARACTERISTIC
 /begin OUT_MEASUREMENT VSPD_ChangeReject_Enabled VSPD_DigFinal VSPD_RateReject_Enabled /end OUT_MEASUREMENT
/end FUNCTION
/begin FUNCTION VSPD "" /begin DEF_CHARACTERISTIC VSPDTbl /end DEF_CHARACTERISTIC /begin OUT_MEASUREMENT VSPD VSPDADC VSPDIdx VSPDRaw /end OUT_MEASUREMENT /begin SUB_FUNCTION VSPD_Override VSPD_Config /end SUB_FUNCTION /end FUNCTION
/begin FUNCTION VSPD_Selector "" /begin DEF_CHARACTERISTIC VSPD_DigitalPresent VSPD_GPSPreferred /end DEF_CHARACTERISTIC /begin OUT_MEASUREMENT VSPD_FinalFinal /end OUT_MEASUREMENT /end FUNCTION
/begin FUNCTION VSPD_Override "" /begin DEF_CHARACTERISTIC VSPD_new VSPD_ovr /end DEF_CHARACTERISTIC /end FUNCTION
/begin FUNCTION VSPD_Index "" /begin OUT_MEASUREMENT VSPD07Idx VSPD07In VSPD09Idx VSPD09In VSPD17Idx VSPD17In /end OUT_MEASUREMENT /end FUNCTION
/begin FUNCTION VSPD_Config "" /begin DEF_CHARACTERISTIC VSPDDefault VSPDFiltConst VSPDMax VSPDMin /end DEF_CHARACTERISTIC /end FUNCTION
/begin FUNCTION Warm_Up_Fuel_Holdoff "" /begin DEF_CHARACTERISTIC Warmup_Time_HoldoffTbl /end DEF_CHARACTERISTIC /begin OUT_MEASUREMENT Warmup_Time_Holdoff /end OUT_MEASUREMENT /end FUNCTION
/begin FUNCTION WarmUp_Disable "" /begin OUT_MEASUREMENT WarmUpO2AdaptEnabled /end OUT_MEASUREMENT /end FUNCTION
/begin FUNCTION WASTEGATE_Override "" /begin DEF_CHARACTERISTIC WASTEGATE_new WASTEGATE_ovr /end DEF_CHARACTERISTIC /end FUNCTION
/begin FUNCTION WASTEGATE "" /begin OUT_MEASUREMENT WASTEGATEDutyCycle /end OUT_MEASUREMENT /begin SUB_FUNCTION WASTEGATE_Override WASTEGATE_Config /end SUB_FUNCTION /end FUNCTION
/begin FUNCTION WASTEGATE_Control "" /begin SUB_FUNCTION WASTEGATE /end SUB_FUNCTION /end FUNCTION
/begin FUNCTION WASTEGATE_Config ""
 /begin DEF_CHARACTERISTIC WASTEGATEFrequency WASTEGATEGain WASTEGATEMaxLimit WASTEGATEMinLimit WASTEGATEOffset /end DEF_CHARACTERISTIC
/end FUNCTION
/end MODULE
/end PROJECT
