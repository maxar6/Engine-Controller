/******************************************************************************
* ASAP2 descrition file /
* Generated by Woodward ASAP2 Generator /
* This file was auto-generated on: Tuesday, November 22, 2022 1:23 PM /
******************************************************************************/
ASAP2_VERSION 1 51
/begin PROJECT Project ""
/begin MODULE BaseEngin_034 ""
/begin IF_DATA VISION DEVICE_SETTING "CCP=2.1_ASAP1b" DEVICE_SETTING "DefaultCRCType=5" /end IF_DATA
/begin IF_DATA ASAP1B_CCP
 /begin SOURCE "List 1" 0 0 DISPLAY_IDENTIFIER "DAQ1"
  /begin QP_BLOB 0 LENGTH 8 CAN_ID_FIXED 0x98EF3102 RASTER 0 REDUCTION_ALLOWED FIRST_PID 0 /end QP_BLOB
 /end SOURCE
 /begin SOURCE "List 2" 0 0 DISPLAY_IDENTIFIER "DAQ2"
  /begin QP_BLOB 1 LENGTH 8 CAN_ID_FIXED 0x98EF3102 RASTER 1 REDUCTION_ALLOWED FIRST_PID 8 /end QP_BLOB
 /end SOURCE
 /begin SOURCE "List 3" 0 0 DISPLAY_IDENTIFIER "DAQ3"
  /begin QP_BLOB 2 LENGTH 8 CAN_ID_FIXED 0x98EF3102 RASTER 2 REDUCTION_ALLOWED FIRST_PID 16 /end QP_BLOB
 /end SOURCE
 /begin SOURCE "List 4" 0 0 DISPLAY_IDENTIFIER "DAQ4"
  /begin QP_BLOB 3 LENGTH 8 CAN_ID_FIXED 0x98EF3102 RASTER 3 REDUCTION_ALLOWED FIRST_PID 24 /end QP_BLOB
 /end SOURCE
 /begin SOURCE "List 5" 0 0 DISPLAY_IDENTIFIER "DAQ5"
  /begin QP_BLOB 4 LENGTH 8 CAN_ID_FIXED 0x98EF3102 RASTER 4 REDUCTION_ALLOWED FIRST_PID 32 /end QP_BLOB
 /end SOURCE
 /begin SOURCE "List 6" 0 0 DISPLAY_IDENTIFIER "DAQ6"
  /begin QP_BLOB 5 LENGTH 8 CAN_ID_FIXED 0x98EF3102 RASTER 5 REDUCTION_ALLOWED FIRST_PID 40 /end QP_BLOB
 /end SOURCE
 /begin SOURCE "List 7" 0 0 DISPLAY_IDENTIFIER "DAQ7"
  /begin QP_BLOB 6 LENGTH 8 CAN_ID_FIXED 0x98EF3102 RASTER 6 REDUCTION_ALLOWED FIRST_PID 48 /end QP_BLOB
 /end SOURCE
 /begin SOURCE "List 8" 0 0 DISPLAY_IDENTIFIER "DAQ8"
  /begin QP_BLOB 7 LENGTH 8 CAN_ID_FIXED 0x98EF3102 RASTER 7 REDUCTION_ALLOWED FIRST_PID 56 /end QP_BLOB
 /end SOURCE
 /begin SOURCE "List 9" 0 0 DISPLAY_IDENTIFIER "DAQ9"
  /begin QP_BLOB 8 LENGTH 8 CAN_ID_FIXED 0x98EF3102 RASTER 7 REDUCTION_ALLOWED FIRST_PID 64 /end QP_BLOB
 /end SOURCE
 /begin SOURCE "List 10" 0 0 DISPLAY_IDENTIFIER "DAQ10"
  /begin QP_BLOB 9 LENGTH 8 CAN_ID_FIXED 0x98EF3102 RASTER 7 REDUCTION_ALLOWED FIRST_PID 72 /end QP_BLOB
 /end SOURCE
 /begin RASTER "FGND_RTI_PERIODIC" "FGND_RTI_PERIODIC" 0 3 5 /end RASTER
 /begin RASTER "FGND_5XRTI_PERIODIC" "FGND_5XRTI_PERIODIC" 1 3 25 /end RASTER
 /begin RASTER "FGND_MID_TDC_EVENT" "FGND_MID_TDC_EVENT" 2 103 1 /end RASTER
 /begin RASTER "FGND_20XRTI_PERIODIC" "FGND_20XRTI_PERIODIC" 3 3 100 /end RASTER
 /begin RASTER "BGND_BASE_PERIODIC" "BGND_BASE_PERIODIC" 4 3 50 /end RASTER
 /begin RASTER "BGND_BASEx2_PERIODIC" "BGND_BASEx2_PERIODIC" 5 3 100 /end RASTER
 /begin RASTER "BGND_BASEx10_PERIODIC" "BGND_BASEx10_PERIODIC" 6 3 500 /end RASTER
 /begin RASTER "ONE_SECOND_EVENT" "ONE_SECOND_EVENT" 7 3 1000 /end RASTER
 /* /begin SEED_KEY */ /* DLL for CAL */ /* Uncomment and supply a value "SecurityCAL.dll" */ /* DLL for DAQ */ /* Uncomment and supply a value "SecurityDAQ.dll" */ /* DLL for PGM */ /* Uncomment and supply a value "SecurityPGM.dll" */ /* /end SEED_KEY */
 /begin TP_BLOB /* CCP version */ 0x201 /* Blob version */ 0x204 /* CAN msg ID - send */ 0x98EF0231 /* CAN msg ID - recv */ 0x98EF3102 /* Station address */ 0x31 /* byte order */ 1 BAUDRATE 500000 SAMPLE_RATE 1 SAMPLE_POINT 75 BTL_CYCLES 8 SJW 2 SYNC_EDGE SINGLE DAQ_MODE BURST CONSISTENCY ODT ADDRESS_EXTENSION DAQ
  /begin CHECKSUM_PARAM /* algorithm */ 0x8009 /* limit */ 0x1000 CHECKSUM_CALCULATION ACTIVE_PAGE /end CHECKSUM_PARAM
  /begin DEFINED_PAGES /* Memory page num */ 1 /* Page Name */ "working page" /* address ext. */ 0x00 /* base address */ 0x80000000 /* page length */ 0x00006877 RAM /* memory page in RAM */ RAM_INIT_BY_ECU /* memory page is initialised by ECU start-up */ /end DEFINED_PAGES
  OPTIONAL_CMD 0x5 /* TEST */ OPTIONAL_CMD 0x8 /* START_STOP_ALL */ OPTIONAL_CMD 0xC /* SET_S_STATUS */ OPTIONAL_CMD 0xD /* GET_S_STATUS */ OPTIONAL_CMD 0xE /* BUILD_CHECKSUM */ OPTIONAL_CMD 0xF /* SHORT_UP */ OPTIONAL_CMD 0x12 /* GET_SEED */ OPTIONAL_CMD 0x13 /* UNLOCK */ OPTIONAL_CMD 0x23 /* DNLOAD_6 */ /end TP_BLOB
/end IF_DATA
/*~~~~~~~~~ 6.3.91 MOD_PAR ~~~~~~~~~*/
/begin MOD_PAR /* MOD_PAR Comment*/ "" ECU_CALIBRATION_OFFSET 0x00000000
 /begin MEMORY_SEGMENT CAL "" DATA FLASH INTERN 0x80000000 /* Size */ 0x00006877 /* Offset */ -1 -1 -1 -1 -1 /end MEMORY_SEGMENT
 /begin MEMORY_SEGMENT MeasRAM "" VARIABLES RAM INTERN 0x40000000 /* Size */ 0x00000BED /* Offset */ -1 -1 -1 -1 -1 /end MEMORY_SEGMENT
/end MOD_PAR
/begin MOD_COMMON /* MOD_COMMON Comment */ "" BYTE_ORDER MSB_FIRST ALIGNMENT_BYTE 1 ALIGNMENT_FLOAT32_IEEE 1 ALIGNMENT_FLOAT64_IEEE 1 ALIGNMENT_LONG 1 ALIGNMENT_WORD 1 /end MOD_COMMON
/*~~~~~~~~~ 6.3.86 MEASUREMENTs ~~~~~~~~~*/
/begin MEASUREMENT table_0_rev "VarDec Table0 Revision Number" UBYTE CompuMethod_1 1 0 0 255 ECU_ADDRESS 0x40000000 /end MEASUREMENT
/begin MEASUREMENT table_1_rev "VarDec Table1 Revision Number" UBYTE CompuMethod_1 1 0 0 255 ECU_ADDRESS 0x40000001 /end MEASUREMENT
/begin MEASUREMENT table_2_rev "VarDec Table2 Revision Number" UBYTE CompuMethod_1 1 0 0 255 ECU_ADDRESS 0x40000002 /end MEASUREMENT
/begin MEASUREMENT KeyRev "This is the revision for the key protocol." UBYTE CompuMethod_1 1 0 0 255 ECU_ADDRESS 0x40000003 /end MEASUREMENT
/begin MEASUREMENT EriRev "This is the revision for the ERI protocol." UBYTE CompuMethod_1 1 0 0 255 ECU_ADDRESS 0x40000004 /end MEASUREMENT
/begin MEASUREMENT table_3_rev "VarDec Table3 Revision Number" UBYTE CompuMethod_1 1 0 0 255 ECU_ADDRESS 0x40000005 /end MEASUREMENT
/begin MEASUREMENT table_4_rev "VarDec Table4 Revision Number" UBYTE CompuMethod_1 1 0 0 255 ECU_ADDRESS 0x40000006 /end MEASUREMENT
/begin MEASUREMENT table_5_rev "VarDec Table5 Revision Number" UBYTE CompuMethod_1 1 0 0 255 ECU_ADDRESS 0x40000007 /end MEASUREMENT
/begin MEASUREMENT table_6_rev "VarDec Table6 Revision Number" UBYTE CompuMethod_1 1 0 0 255 ECU_ADDRESS 0x40000008 /end MEASUREMENT
/begin MEASUREMENT table_7_rev "VarDec Table7 Revision Number" UBYTE CompuMethod_1 1 0 0 255 ECU_ADDRESS 0x40000009 /end MEASUREMENT
/begin MEASUREMENT MotProgRev "This is the revision for the MOTPROG protocol." UBYTE CompuMethod_1 1 0 0 255 ECU_ADDRESS 0x40000049 /end MEASUREMENT
/begin MEASUREMENT BootVerMaj "" UBYTE CompuMethod_1 1 0 0 255 ECU_ADDRESS 0x4000004A /end MEASUREMENT
/begin MEASUREMENT BootVerMin "" UBYTE CompuMethod_1 1 0 0 255 ECU_ADDRESS 0x4000004B /end MEASUREMENT
/begin MEASUREMENT EcuHwMaj "" UBYTE CompuMethod_1 1 0 0 255 ECU_ADDRESS 0x4000004C /end MEASUREMENT
/begin MEASUREMENT EcuHwMin "" UBYTE CompuMethod_1 1 0 0 255 ECU_ADDRESS 0x4000004D /end MEASUREMENT
/begin MEASUREMENT ApplicationCompatibilityArr "Software Format ID" UWORD CompuMethod_2 1 0 0 65535 ECU_ADDRESS 0x4000004E MATRIX_DIM 1 50 1 /end MEASUREMENT
/begin MEASUREMENT AC "Display output in engineering units" UBYTE CompuMethod_4 1 0 0 1 ECU_ADDRESS 0x40000116 /end MEASUREMENT
/begin MEASUREMENT ConfigVerMaj "" UBYTE CompuMethod_1 1 0 0 255 ECU_ADDRESS 0x4000034B /end MEASUREMENT
/begin MEASUREMENT ConfigVerMin "" UBYTE CompuMethod_1 1 0 0 255 ECU_ADDRESS 0x4000034C /end MEASUREMENT
/begin MEASUREMENT FaultMarquees.FaultMarquees.Current_Suspected "Displays a rolling marquee for suspected, active and occurred faults." UBYTE CompuMethod_111 1 0 0 255 ECU_ADDRESS 0x40000543 /end MEASUREMENT
/begin MEASUREMENT FaultMarquees.FaultMarquees.Current_Active "Displays a rolling marquee for suspected, active and occurred faults." UBYTE CompuMethod_111 1 0 0 255 ECU_ADDRESS 0x40000544 /end MEASUREMENT
/begin MEASUREMENT FaultMarquees.FaultMarquees.Current_Occurred "Displays a rolling marquee for suspected, active and occurred faults." UBYTE CompuMethod_111 1 0 0 255 ECU_ADDRESS 0x40000545 /end MEASUREMENT
/begin MEASUREMENT LinkStatus "This is the Status of the Comms link." UBYTE CompuMethod_1 1 0 0 255 ECU_ADDRESS 0x400006E7 /end MEASUREMENT
/begin MEASUREMENT ModuleCapability "" UBYTE CompuMethod_148 1 0 0 255 ECU_ADDRESS 0x400007FF /end MEASUREMENT
/begin MEASUREMENT MotoHawkModelSecondsInUse "Total runtime of this MotoHawk software model" ULONG CompuMethod_149 1 0 0 4294970000 ECU_ADDRESS 0x400008F0 /end MEASUREMENT
/begin MEASUREMENT SystemFrequency "The operating CPU frequency." ULONG CompuMethod_177 1 0 0 56 ECU_ADDRESS 0x40000AEC /end MEASUREMENT
/begin MEASUREMENT TPUMaskType "Describes the TPU Mask selected for use." UBYTE CompuMethod_180 1 0 0 0 ECU_ADDRESS 0x40000B72 /end MEASUREMENT
/begin MEASUREMENT TPUMaskVers "Describes the version of the TPU Mask selected." UBYTE CompuMethod_11 1 0 0 255 ECU_ADDRESS 0x40000B73 /end MEASUREMENT
/begin MEASUREMENT Unused "Unused Table Entry" UBYTE CompuMethod_1 1 0 0 255 ECU_ADDRESS 0x40000B7C /end MEASUREMENT
/*~~~~~~~~~ 6.3.27 CHARACTERISTICs ~~~~~~~~~*/
/begin CHARACTERISTIC project_id "This is the Platform ID used by the tools." VALUE 0x80006876 RecordLayout_1 0 CompuMethod_1 0 255 /end CHARACTERISTIC
/begin CHARACTERISTIC SwIdTxt "Software Format ID" ASCII 0x4000000A RecordLayout_2 0 CompuMethod_2 0 255 NUMBER 13 MATRIX_DIM 13 1 1 READ_ONLY /end CHARACTERISTIC
/begin CHARACTERISTIC CalIdTxt "Calibration ID" ASCII 0x80000002 RecordLayout_2 0 CompuMethod_2 0 255 NUMBER 33 MATRIX_DIM 33 1 1 /end CHARACTERISTIC
/begin CHARACTERISTIC SwRevisionTxt "Software Revision ID" ASCII 0x40000017 RecordLayout_2 0 CompuMethod_2 0 255 NUMBER 50 MATRIX_DIM 50 1 1 READ_ONLY /end CHARACTERISTIC
/begin CHARACTERISTIC FriendlyName "The device's friendly name." ASCII 0x8000002C RecordLayout_2 0 CompuMethod_2 0 255 NUMBER 33 MATRIX_DIM 33 1 1 /end CHARACTERISTIC
/begin CHARACTERISTIC ProductID "Customer's ID used by the tools." VALUE 0x8000004D RecordLayout_3 0 CompuMethod_3 0 4294970000 /end CHARACTERISTIC
/begin CHARACTERISTIC SerialNumber "" ASCII 0x400000B2 RecordLayout_2 0 CompuMethod_2 0 255 NUMBER 50 MATRIX_DIM 50 1 1 READ_ONLY /end CHARACTERISTIC
/begin CHARACTERISTIC ModelNumber "" ASCII 0x400000E4 RecordLayout_2 0 CompuMethod_2 0 255 NUMBER 50 MATRIX_DIM 50 1 1 READ_ONLY /end CHARACTERISTIC
/begin CHARACTERISTIC CompilerVersion "Compiler toolchain version used for the MotoHawk build" ASCII 0x400002FB RecordLayout_2 0 CompuMethod_2 0 255 NUMBER 80 MATRIX_DIM 80 1 1 READ_ONLY /end CHARACTERISTIC
/begin CHARACTERISTIC ControlCoreSDKRelease "ControlCoreSDK Build." ASCII 0x4000034D RecordLayout_2 0 CompuMethod_2 0 255 NUMBER 50 MATRIX_DIM 50 1 1 READ_ONLY /end CHARACTERISTIC
/begin CHARACTERISTIC FaultCommand "Select a command to control the fault manager." VALUE 0x800027ED RecordLayout_1 0 CompuMethod_112 0 255 /end CHARACTERISTIC
/begin CHARACTERISTIC FaultManager.ACChargeHigh_Fault.Mode "Fault manager configuration.  Select up to 4 actions for each fault." VALUE 0x800027EE RecordLayout_4 0 CompuMethod_113 0 65535 /end CHARACTERISTIC
/begin CHARACTERISTIC FaultManager.ACChargeHigh_Fault.ID "Fault manager configuration.  Select up to 4 actions for each fault." VALUE 0x800027F0 RecordLayout_4 0 CompuMethod_1 0 65535 /end CHARACTERISTIC
/begin CHARACTERISTIC FaultManager.ACChargeHigh_Fault.Test "Fault manager configuration.  Select up to 4 actions for each fault." VALUE 0x800027F2 RecordLayout_4 0 CompuMethod_114 0 65535 /end CHARACTERISTIC
/begin CHARACTERISTIC FaultManager.ACChargeHigh_Fault.Faulty_Samples__X_ "Fault manager configuration.  Select up to 4 actions for each fault." VALUE 0x800027F4 RecordLayout_4 0 CompuMethod_1 0 65535 /end CHARACTERISTIC
/begin CHARACTERISTIC FaultManager.ACChargeHigh_Fault.Total_Samples__Y_ "Fault manager configuration.  Select up to 4 actions for each fault." VALUE 0x800027F6 RecordLayout_4 0 CompuMethod_1 0 65535 /end CHARACTERISTIC
/begin CHARACTERISTIC FaultManager.ACChargeHigh_Fault.Action_1 "Fault manager configuration.  Select up to 4 actions for each fault." VALUE 0x800027F8 RecordLayout_4 0 CompuMethod_115 0 65535 /end CHARACTERISTIC
/begin CHARACTERISTIC FaultManager.ACChargeHigh_Fault.Action_1_Condition "Fault manager configuration.  Select up to 4 actions for each fault." VALUE 0x800027FA RecordLayout_4 0 CompuMethod_116 0 65535 /end CHARACTERISTIC
/begin CHARACTERISTIC FaultManager.ACChargeHigh_Fault.Action_2 "Fault manager configuration.  Select up to 4 actions for each fault." VALUE 0x800027FC RecordLayout_4 0 CompuMethod_115 0 65535 /end CHARACTERISTIC
/begin CHARACTERISTIC FaultManager.ACChargeHigh_Fault.Action_2_Condition "Fault manager configuration.  Select up to 4 actions for each fault." VALUE 0x800027FE RecordLayout_4 0 CompuMethod_116 0 65535 /end CHARACTERISTIC
/begin CHARACTERISTIC FaultManager.ACChargeHigh_Fault.Action_3 "Fault manager configuration.  Select up to 4 actions for each fault." VALUE 0x80002800 RecordLayout_4 0 CompuMethod_115 0 65535 /end CHARACTERISTIC
/begin CHARACTERISTIC FaultManager.ACChargeHigh_Fault.Action_3_Condition "Fault manager configuration.  Select up to 4 actions for each fault." VALUE 0x80002802 RecordLayout_4 0 CompuMethod_116 0 65535 /end CHARACTERISTIC
/begin CHARACTERISTIC FaultManager.ACChargeHigh_Fault.Action_4 "Fault manager configuration.  Select up to 4 actions for each fault." VALUE 0x80002804 RecordLayout_4 0 CompuMethod_115 0 65535 /end CHARACTERISTIC
/begin CHARACTERISTIC FaultManager.ACChargeHigh_Fault.Action_4_Condition "Fault manager configuration.  Select up to 4 actions for each fault." VALUE 0x80002806 RecordLayout_4 0 CompuMethod_116 0 65535 /end CHARACTERISTIC
/begin CHARACTERISTIC FaultManager.ACChargeLow_Fault.Mode "Fault manager configuration.  Select up to 4 actions for each fault." VALUE 0x80002808 RecordLayout_4 0 CompuMethod_113 0 65535 /end CHARACTERISTIC
/begin CHARACTERISTIC FaultManager.ACChargeLow_Fault.ID "Fault manager configuration.  Select up to 4 actions for each fault." VALUE 0x8000280A RecordLayout_4 0 CompuMethod_1 0 65535 /end CHARACTERISTIC
/begin CHARACTERISTIC FaultManager.ACChargeLow_Fault.Test "Fault manager configuration.  Select up to 4 actions for each fault." VALUE 0x8000280C RecordLayout_4 0 CompuMethod_114 0 65535 /end CHARACTERISTIC
/begin CHARACTERISTIC FaultManager.ACChargeLow_Fault.Faulty_Samples__X_ "Fault manager configuration.  Select up to 4 actions for each fault." VALUE 0x8000280E RecordLayout_4 0 CompuMethod_1 0 65535 /end CHARACTERISTIC
/begin CHARACTERISTIC FaultManager.ACChargeLow_Fault.Total_Samples__Y_ "Fault manager configuration.  Select up to 4 actions for each fault." VALUE 0x80002810 RecordLayout_4 0 CompuMethod_1 0 65535 /end CHARACTERISTIC
/begin CHARACTERISTIC FaultManager.ACChargeLow_Fault.Action_1 "Fault manager configuration.  Select up to 4 actions for each fault." VALUE 0x80002812 RecordLayout_4 0 CompuMethod_115 0 65535 /end CHARACTERISTIC
/begin CHARACTERISTIC FaultManager.ACChargeLow_Fault.Action_1_Condition "Fault manager configuration.  Select up to 4 actions for each fault." VALUE 0x80002814 RecordLayout_4 0 CompuMethod_116 0 65535 /end CHARACTERISTIC
/begin CHARACTERISTIC FaultManager.ACChargeLow_Fault.Action_2 "Fault manager configuration.  Select up to 4 actions for each fault." VALUE 0x80002816 RecordLayout_4 0 CompuMethod_115 0 65535 /end CHARACTERISTIC
/begin CHARACTERISTIC FaultManager.ACChargeLow_Fault.Action_2_Condition "Fault manager configuration.  Select up to 4 actions for each fault." VALUE 0x80002818 RecordLayout_4 0 CompuMethod_116 0 65535 /end CHARACTERISTIC
/begin CHARACTERISTIC FaultManager.ACChargeLow_Fault.Action_3 "Fault manager configuration.  Select up to 4 actions for each fault." VALUE 0x8000281A RecordLayout_4 0 CompuMethod_115 0 65535 /end CHARACTERISTIC
/begin CHARACTERISTIC FaultManager.ACChargeLow_Fault.Action_3_Condition "Fault manager configuration.  Select up to 4 actions for each fault." VALUE 0x8000281C RecordLayout_4 0 CompuMethod_116 0 65535 /end CHARACTERISTIC
/begin CHARACTERISTIC FaultManager.ACChargeLow_Fault.Action_4 "Fault manager configuration.  Select up to 4 actions for each fault." VALUE 0x8000281E RecordLayout_4 0 CompuMethod_115 0 65535 /end CHARACTERISTIC
/begin CHARACTERISTIC FaultManager.ACChargeLow_Fault.Action_4_Condition "Fault manager configuration.  Select up to 4 actions for each fault." VALUE 0x80002820 RecordLayout_4 0 CompuMethod_116 0 65535 /end CHARACTERISTIC
/begin CHARACTERISTIC FaultManager.ACPresRangeHigh.Mode "Fault manager configuration.  Select up to 4 actions for each fault." VALUE 0x80002822 RecordLayout_4 0 CompuMethod_113 0 65535 /end CHARACTERISTIC
/begin CHARACTERISTIC FaultManager.ACPresRangeHigh.ID "Fault manager configuration.  Select up to 4 actions for each fault." VALUE 0x80002824 RecordLayout_4 0 CompuMethod_1 0 65535 /end CHARACTERISTIC
/begin CHARACTERISTIC FaultManager.ACPresRangeHigh.Test "Fault manager configuration.  Select up to 4 actions for each fault." VALUE 0x80002826 RecordLayout_4 0 CompuMethod_114 0 65535 /end CHARACTERISTIC
/begin CHARACTERISTIC FaultManager.ACPresRangeHigh.Faulty_Samples__X_ "Fault manager configuration.  Select up to 4 actions for each fault." VALUE 0x80002828 RecordLayout_4 0 CompuMethod_1 0 65535 /end CHARACTERISTIC
/begin CHARACTERISTIC FaultManager.ACPresRangeHigh.Total_Samples__Y_ "Fault manager configuration.  Select up to 4 actions for each fault." VALUE 0x8000282A RecordLayout_4 0 CompuMethod_1 0 65535 /end CHARACTERISTIC
/begin CHARACTERISTIC FaultManager.ACPresRangeHigh.Action_1 "Fault manager configuration.  Select up to 4 actions for each fault." VALUE 0x8000282C RecordLayout_4 0 CompuMethod_115 0 65535 /end CHARACTERISTIC
/begin CHARACTERISTIC FaultManager.ACPresRangeHigh.Action_1_Condition "Fault manager configuration.  Select up to 4 actions for each fault." VALUE 0x8000282E RecordLayout_4 0 CompuMethod_116 0 65535 /end CHARACTERISTIC
/begin CHARACTERISTIC FaultManager.ACPresRangeHigh.Action_2 "Fault manager configuration.  Select up to 4 actions for each fault." VALUE 0x80002830 RecordLayout_4 0 CompuMethod_115 0 65535 /end CHARACTERISTIC
/begin CHARACTERISTIC FaultManager.ACPresRangeHigh.Action_2_Condition "Fault manager configuration.  Select up to 4 actions for each fault." VALUE 0x80002832 RecordLayout_4 0 CompuMethod_116 0 65535 /end CHARACTERISTIC
/begin CHARACTERISTIC FaultManager.ACPresRangeHigh.Action_3 "Fault manager configuration.  Select up to 4 actions for each fault." VALUE 0x80002834 RecordLayout_4 0 CompuMethod_115 0 65535 /end CHARACTERISTIC
/begin CHARACTERISTIC FaultManager.ACPresRangeHigh.Action_3_Condition "Fault manager configuration.  Select up to 4 actions for each fault." VALUE 0x80002836 RecordLayout_4 0 CompuMethod_116 0 65535 /end CHARACTERISTIC
/begin CHARACTERISTIC FaultManager.ACPresRangeHigh.Action_4 "Fault manager configuration.  Select up to 4 actions for each fault." VALUE 0x80002838 RecordLayout_4 0 CompuMethod_115 0 65535 /end CHARACTERISTIC
/begin CHARACTERISTIC FaultManager.ACPresRangeHigh.Action_4_Condition "Fault manager configuration.  Select up to 4 actions for each fault." VALUE 0x8000283A RecordLayout_4 0 CompuMethod_116 0 65535 /end CHARACTERISTIC
/begin CHARACTERISTIC FaultManager.ACPresRangeLow.Mode "Fault manager configuration.  Select up to 4 actions for each fault." VALUE 0x8000283C RecordLayout_4 0 CompuMethod_113 0 65535 /end CHARACTERISTIC
/begin CHARACTERISTIC FaultManager.ACPresRangeLow.ID "Fault manager configuration.  Select up to 4 actions for each fault." VALUE 0x8000283E RecordLayout_4 0 CompuMethod_1 0 65535 /end CHARACTERISTIC
/begin CHARACTERISTIC FaultManager.ACPresRangeLow.Test "Fault manager configuration.  Select up to 4 actions for each fault." VALUE 0x80002840 RecordLayout_4 0 CompuMethod_114 0 65535 /end CHARACTERISTIC
/begin CHARACTERISTIC FaultManager.ACPresRangeLow.Faulty_Samples__X_ "Fault manager configuration.  Select up to 4 actions for each fault." VALUE 0x80002842 RecordLayout_4 0 CompuMethod_1 0 65535 /end CHARACTERISTIC
/begin CHARACTERISTIC FaultManager.ACPresRangeLow.Total_Samples__Y_ "Fault manager configuration.  Select up to 4 actions for each fault." VALUE 0x80002844 RecordLayout_4 0 CompuMethod_1 0 65535 /end CHARACTERISTIC
/begin CHARACTERISTIC FaultManager.ACPresRangeLow.Action_1 "Fault manager configuration.  Select up to 4 actions for each fault." VALUE 0x80002846 RecordLayout_4 0 CompuMethod_115 0 65535 /end CHARACTERISTIC
/begin CHARACTERISTIC FaultManager.ACPresRangeLow.Action_1_Condition "Fault manager configuration.  Select up to 4 actions for each fault." VALUE 0x80002848 RecordLayout_4 0 CompuMethod_116 0 65535 /end CHARACTERISTIC
/begin CHARACTERISTIC FaultManager.ACPresRangeLow.Action_2 "Fault manager configuration.  Select up to 4 actions for each fault." VALUE 0x8000284A RecordLayout_4 0 CompuMethod_115 0 65535 /end CHARACTERISTIC
/begin CHARACTERISTIC FaultManager.ACPresRangeLow.Action_2_Condition "Fault manager configuration.  Select up to 4 actions for each fault." VALUE 0x8000284C RecordLayout_4 0 CompuMethod_116 0 65535 /end CHARACTERISTIC
/begin CHARACTERISTIC FaultManager.ACPresRangeLow.Action_3 "Fault manager configuration.  Select up to 4 actions for each fault." VALUE 0x8000284E RecordLayout_4 0 CompuMethod_115 0 65535 /end CHARACTERISTIC
/begin CHARACTERISTIC FaultManager.ACPresRangeLow.Action_3_Condition "Fault manager configuration.  Select up to 4 actions for each fault." VALUE 0x80002850 RecordLayout_4 0 CompuMethod_116 0 65535 /end CHARACTERISTIC
/begin CHARACTERISTIC FaultManager.ACPresRangeLow.Action_4 "Fault manager configuration.  Select up to 4 actions for each fault." VALUE 0x80002852 RecordLayout_4 0 CompuMethod_115 0 65535 /end CHARACTERISTIC
/begin CHARACTERISTIC FaultManager.ACPresRangeLow.Action_4_Condition "Fault manager configuration.  Select up to 4 actions for each fault." VALUE 0x80002854 RecordLayout_4 0 CompuMethod_116 0 65535 /end CHARACTERISTIC
/begin CHARACTERISTIC FaultManager.APP1RangeHigh.Mode "Fault manager configuration.  Select up to 4 actions for each fault." VALUE 0x80002856 RecordLayout_4 0 CompuMethod_113 0 65535 /end CHARACTERISTIC
/begin CHARACTERISTIC FaultManager.APP1RangeHigh.ID "Fault manager configuration.  Select up to 4 actions for each fault." VALUE 0x80002858 RecordLayout_4 0 CompuMethod_1 0 65535 /end CHARACTERISTIC
/begin CHARACTERISTIC FaultManager.APP1RangeHigh.Test "Fault manager configuration.  Select up to 4 actions for each fault." VALUE 0x8000285A RecordLayout_4 0 CompuMethod_114 0 65535 /end CHARACTERISTIC
/begin CHARACTERISTIC FaultManager.APP1RangeHigh.Faulty_Samples__X_ "Fault manager configuration.  Select up to 4 actions for each fault." VALUE 0x8000285C RecordLayout_4 0 CompuMethod_1 0 65535 /end CHARACTERISTIC
/begin CHARACTERISTIC FaultManager.APP1RangeHigh.Total_Samples__Y_ "Fault manager configuration.  Select up to 4 actions for each fault." VALUE 0x8000285E RecordLayout_4 0 CompuMethod_1 0 65535 /end CHARACTERISTIC
/begin CHARACTERISTIC FaultManager.APP1RangeHigh.Action_1 "Fault manager configuration.  Select up to 4 actions for each fault." VALUE 0x80002860 RecordLayout_4 0 CompuMethod_115 0 65535 /end CHARACTERISTIC
/begin CHARACTERISTIC FaultManager.APP1RangeHigh.Action_1_Condition "Fault manager configuration.  Select up to 4 actions for each fault." VALUE 0x80002862 RecordLayout_4 0 CompuMethod_116 0 65535 /end CHARACTERISTIC
/begin CHARACTERISTIC FaultManager.APP1RangeHigh.Action_2 "Fault manager configuration.  Select up to 4 actions for each fault." VALUE 0x80002864 RecordLayout_4 0 CompuMethod_115 0 65535 /end CHARACTERISTIC
/begin CHARACTERISTIC FaultManager.APP1RangeHigh.Action_2_Condition "Fault manager configuration.  Select up to 4 actions for each fault." VALUE 0x80002866 RecordLayout_4 0 CompuMethod_116 0 65535 /end CHARACTERISTIC
/begin CHARACTERISTIC FaultManager.APP1RangeHigh.Action_3 "Fault manager configuration.  Select up to 4 actions for each fault." VALUE 0x80002868 RecordLayout_4 0 CompuMethod_115 0 65535 /end CHARACTERISTIC
/begin CHARACTERISTIC FaultManager.APP1RangeHigh.Action_3_Condition "Fault manager configuration.  Select up to 4 actions for each fault." VALUE 0x8000286A RecordLayout_4 0 CompuMethod_116 0 65535 /end CHARACTERISTIC
/begin CHARACTERISTIC FaultManager.APP1RangeHigh.Action_4 "Fault manager configuration.  Select up to 4 actions for each fault." VALUE 0x8000286C RecordLayout_4 0 CompuMethod_115 0 65535 /end CHARACTERISTIC
/begin CHARACTERISTIC FaultManager.APP1RangeHigh.Action_4_Condition "Fault manager configuration.  Select up to 4 actions for each fault." VALUE 0x8000286E RecordLayout_4 0 CompuMethod_116 0 65535 /end CHARACTERISTIC
/begin CHARACTERISTIC FaultManager.APP1RangeLow.Mode "Fault manager configuration.  Select up to 4 actions for each fault." VALUE 0x80002870 RecordLayout_4 0 CompuMethod_113 0 65535 /end CHARACTERISTIC
/begin CHARACTERISTIC FaultManager.APP1RangeLow.ID "Fault manager configuration.  Select up to 4 actions for each fault." VALUE 0x80002872 RecordLayout_4 0 CompuMethod_1 0 65535 /end CHARACTERISTIC
/begin CHARACTERISTIC FaultManager.APP1RangeLow.Test "Fault manager configuration.  Select up to 4 actions for each fault." VALUE 0x80002874 RecordLayout_4 0 CompuMethod_114 0 65535 /end CHARACTERISTIC
/begin CHARACTERISTIC FaultManager.APP1RangeLow.Faulty_Samples__X_ "Fault manager configuration.  Select up to 4 actions for each fault." VALUE 0x80002876 RecordLayout_4 0 CompuMethod_1 0 65535 /end CHARACTERISTIC
/begin CHARACTERISTIC FaultManager.APP1RangeLow.Total_Samples__Y_ "Fault manager configuration.  Select up to 4 actions for each fault." VALUE 0x80002878 RecordLayout_4 0 CompuMethod_1 0 65535 /end CHARACTERISTIC
/begin CHARACTERISTIC FaultManager.APP1RangeLow.Action_1 "Fault manager configuration.  Select up to 4 actions for each fault." VALUE 0x8000287A RecordLayout_4 0 CompuMethod_115 0 65535 /end CHARACTERISTIC
/begin CHARACTERISTIC FaultManager.APP1RangeLow.Action_1_Condition "Fault manager configuration.  Select up to 4 actions for each fault." VALUE 0x8000287C RecordLayout_4 0 CompuMethod_116 0 65535 /end CHARACTERISTIC
/begin CHARACTERISTIC FaultManager.APP1RangeLow.Action_2 "Fault manager configuration.  Select up to 4 actions for each fault." VALUE 0x8000287E RecordLayout_4 0 CompuMethod_115 0 65535 /end CHARACTERISTIC
/begin CHARACTERISTIC FaultManager.APP1RangeLow.Action_2_Condition "Fault manager configuration.  Select up to 4 actions for each fault." VALUE 0x80002880 RecordLayout_4 0 CompuMethod_116 0 65535 /end CHARACTERISTIC
/begin CHARACTERISTIC FaultManager.APP1RangeLow.Action_3 "Fault manager configuration.  Select up to 4 actions for each fault." VALUE 0x80002882 RecordLayout_4 0 CompuMethod_115 0 65535 /end CHARACTERISTIC
/begin CHARACTERISTIC FaultManager.APP1RangeLow.Action_3_Condition "Fault manager configuration.  Select up to 4 actions for each fault." VALUE 0x80002884 RecordLayout_4 0 CompuMethod_116 0 65535 /end CHARACTERISTIC
/begin CHARACTERISTIC FaultManager.APP1RangeLow.Action_4 "Fault manager configuration.  Select up to 4 actions for each fault." VALUE 0x80002886 RecordLayout_4 0 CompuMethod_115 0 65535 /end CHARACTERISTIC
/begin CHARACTERISTIC FaultManager.APP1RangeLow.Action_4_Condition "Fault manager configuration.  Select up to 4 actions for each fault." VALUE 0x80002888 RecordLayout_4 0 CompuMethod_116 0 65535 /end CHARACTERISTIC
/begin CHARACTERISTIC FaultManager.APP1_AdaptAdaptHiMax.Mode "Fault manager configuration.  Select up to 4 actions for each fault." VALUE 0x8000288A RecordLayout_4 0 CompuMethod_113 0 65535 /end CHARACTERISTIC
/begin CHARACTERISTIC FaultManager.APP1_AdaptAdaptHiMax.ID "Fault manager configuration.  Select up to 4 actions for each fault." VALUE 0x8000288C RecordLayout_4 0 CompuMethod_1 0 65535 /end CHARACTERISTIC
/begin CHARACTERISTIC FaultManager.APP1_AdaptAdaptHiMax.Test "Fault manager configuration.  Select up to 4 actions for each fault." VALUE 0x8000288E RecordLayout_4 0 CompuMethod_114 0 65535 /end CHARACTERISTIC
/begin CHARACTERISTIC FaultManager.APP1_AdaptAdaptHiMax.Faulty_Samples__X_ "Fault manager configuration.  Select up to 4 actions for each fault." VALUE 0x80002890 RecordLayout_4 0 CompuMethod_1 0 65535 /end CHARACTERISTIC
/begin CHARACTERISTIC FaultManager.APP1_AdaptAdaptHiMax.Total_Samples__Y_ "Fault manager configuration.  Select up to 4 actions for each fault." VALUE 0x80002892 RecordLayout_4 0 CompuMethod_1 0 65535 /end CHARACTERISTIC
/begin CHARACTERISTIC FaultManager.APP1_AdaptAdaptHiMax.Action_1 "Fault manager configuration.  Select up to 4 actions for each fault." VALUE 0x80002894 RecordLayout_4 0 CompuMethod_115 0 65535 /end CHARACTERISTIC
/begin CHARACTERISTIC FaultManager.APP1_AdaptAdaptHiMax.Action_1_Condition "Fault manager configuration.  Select up to 4 actions for each fault." VALUE 0x80002896 RecordLayout_4 0 CompuMethod_116 0 65535 /end CHARACTERISTIC
/begin CHARACTERISTIC FaultManager.APP1_AdaptAdaptHiMax.Action_2 "Fault manager configuration.  Select up to 4 actions for each fault." VALUE 0x80002898 RecordLayout_4 0 CompuMethod_115 0 65535 /end CHARACTERISTIC
/begin CHARACTERISTIC FaultManager.APP1_AdaptAdaptHiMax.Action_2_Condition "Fault manager configuration.  Select up to 4 actions for each fault." VALUE 0x8000289A RecordLayout_4 0 CompuMethod_116 0 65535 /end CHARACTERISTIC
/begin CHARACTERISTIC FaultManager.APP1_AdaptAdaptHiMax.Action_3 "Fault manager configuration.  Select up to 4 actions for each fault." VALUE 0x8000289C RecordLayout_4 0 CompuMethod_115 0 65535 /end CHARACTERISTIC
/begin CHARACTERISTIC FaultManager.APP1_AdaptAdaptHiMax.Action_3_Condition "Fault manager configuration.  Select up to 4 actions for each fault." VALUE 0x8000289E RecordLayout_4 0 CompuMethod_116 0 65535 /end CHARACTERISTIC
/begin CHARACTERISTIC FaultManager.APP1_AdaptAdaptHiMax.Action_4 "Fault manager configuration.  Select up to 4 actions for each fault." VALUE 0x800028A0 RecordLayout_4 0 CompuMethod_115 0 65535 /end CHARACTERISTIC
/begin CHARACTERISTIC FaultManager.APP1_AdaptAdaptHiMax.Action_4_Condition "Fault manager configuration.  Select up to 4 actions for each fault." VALUE 0x800028A2 RecordLayout_4 0 CompuMethod_116 0 65535 /end CHARACTERISTIC
/begin CHARACTERISTIC FaultManager.APP1_AdaptAdaptHiMin.Mode "Fault manager configuration.  Select up to 4 actions for each fault." VALUE 0x800028A4 RecordLayout_4 0 CompuMethod_113 0 65535 /end CHARACTERISTIC
/begin CHARACTERISTIC FaultManager.APP1_AdaptAdaptHiMin.ID "Fault manager configuration.  Select up to 4 actions for each fault." VALUE 0x800028A6 RecordLayout_4 0 CompuMethod_1 0 65535 /end CHARACTERISTIC
/begin CHARACTERISTIC FaultManager.APP1_AdaptAdaptHiMin.Test "Fault manager configuration.  Select up to 4 actions for each fault." VALUE 0x800028A8 RecordLayout_4 0 CompuMethod_114 0 65535 /end CHARACTERISTIC
/begin CHARACTERISTIC FaultManager.APP1_AdaptAdaptHiMin.Faulty_Samples__X_ "Fault manager configuration.  Select up to 4 actions for each fault." VALUE 0x800028AA RecordLayout_4 0 CompuMethod_1 0 65535 /end CHARACTERISTIC
/begin CHARACTERISTIC FaultManager.APP1_AdaptAdaptHiMin.Total_Samples__Y_ "Fault manager configuration.  Select up to 4 actions for each fault." VALUE 0x800028AC RecordLayout_4 0 CompuMethod_1 0 65535 /end CHARACTERISTIC
/begin CHARACTERISTIC FaultManager.APP1_AdaptAdaptHiMin.Action_1 "Fault manager configuration.  Select up to 4 actions for each fault." VALUE 0x800028AE RecordLayout_4 0 CompuMethod_115 0 65535 /end CHARACTERISTIC
/begin CHARACTERISTIC FaultManager.APP1_AdaptAdaptHiMin.Action_1_Condition "Fault manager configuration.  Select up to 4 actions for each fault." VALUE 0x800028B0 RecordLayout_4 0 CompuMethod_116 0 65535 /end CHARACTERISTIC
/begin CHARACTERISTIC FaultManager.APP1_AdaptAdaptHiMin.Action_2 "Fault manager configuration.  Select up to 4 actions for each fault." VALUE 0x800028B2 RecordLayout_4 0 CompuMethod_115 0 65535 /end CHARACTERISTIC
/begin CHARACTERISTIC FaultManager.APP1_AdaptAdaptHiMin.Action_2_Condition "Fault manager configuration.  Select up to 4 actions for each fault." VALUE 0x800028B4 RecordLayout_4 0 CompuMethod_116 0 65535 /end CHARACTERISTIC
/begin CHARACTERISTIC FaultManager.APP1_AdaptAdaptHiMin.Action_3 "Fault manager configuration.  Select up to 4 actions for each fault." VALUE 0x800028B6 RecordLayout_4 0 CompuMethod_115 0 65535 /end CHARACTERISTIC
/begin CHARACTERISTIC FaultManager.APP1_AdaptAdaptHiMin.Action_3_Condition "Fault manager configuration.  Select up to 4 actions for each fault." VALUE 0x800028B8 RecordLayout_4 0 CompuMethod_116 0 65535 /end CHARACTERISTIC
/begin CHARACTERISTIC FaultManager.APP1_AdaptAdaptHiMin.Action_4 "Fault manager configuration.  Select up to 4 actions for each fault." VALUE 0x800028BA RecordLayout_4 0 CompuMethod_115 0 65535 /end CHARACTERISTIC
/begin CHARACTERISTIC FaultManager.APP1_AdaptAdaptHiMin.Action_4_Condition "Fault manager configuration.  Select up to 4 actions for each fault." VALUE 0x800028BC RecordLayout_4 0 CompuMethod_116 0 65535 /end CHARACTERISTIC
/begin CHARACTERISTIC FaultManager.APP1_AdaptAdaptLoMax.Mode "Fault manager configuration.  Select up to 4 actions for each fault." VALUE 0x800028BE RecordLayout_4 0 CompuMethod_113 0 65535 /end CHARACTERISTIC
/begin CHARACTERISTIC FaultManager.APP1_AdaptAdaptLoMax.ID "Fault manager configuration.  Select up to 4 actions for each fault." VALUE 0x800028C0 RecordLayout_4 0 CompuMethod_1 0 65535 /end CHARACTERISTIC
/begin CHARACTERISTIC FaultManager.APP1_AdaptAdaptLoMax.Test "Fault manager configuration.  Select up to 4 actions for each fault." VALUE 0x800028C2 RecordLayout_4 0 CompuMethod_114 0 65535 /end CHARACTERISTIC
/begin CHARACTERISTIC FaultManager.APP1_AdaptAdaptLoMax.Faulty_Samples__X_ "Fault manager configuration.  Select up to 4 actions for each fault." VALUE 0x800028C4 RecordLayout_4 0 CompuMethod_1 0 65535 /end CHARACTERISTIC
/begin CHARACTERISTIC FaultManager.APP1_AdaptAdaptLoMax.Total_Samples__Y_ "Fault manager configuration.  Select up to 4 actions for each fault." VALUE 0x800028C6 RecordLayout_4 0 CompuMethod_1 0 65535 /end CHARACTERISTIC
/begin CHARACTERISTIC FaultManager.APP1_AdaptAdaptLoMax.Action_1 "Fault manager configuration.  Select up to 4 actions for each fault." VALUE 0x800028C8 RecordLayout_4 0 CompuMethod_115 0 65535 /end CHARACTERISTIC
/begin CHARACTERISTIC FaultManager.APP1_AdaptAdaptLoMax.Action_1_Condition "Fault manager configuration.  Select up to 4 actions for each fault." VALUE 0x800028CA RecordLayout_4 0 CompuMethod_116 0 65535 /end CHARACTERISTIC
/begin CHARACTERISTIC FaultManager.APP1_AdaptAdaptLoMax.Action_2 "Fault manager configuration.  Select up to 4 actions for each fault." VALUE 0x800028CC RecordLayout_4 0 CompuMethod_115 0 65535 /end CHARACTERISTIC
/begin CHARACTERISTIC FaultManager.APP1_AdaptAdaptLoMax.Action_2_Condition "Fault manager configuration.  Select up to 4 actions for each fault." VALUE 0x800028CE RecordLayout_4 0 CompuMethod_116 0 65535 /end CHARACTERISTIC
/begin CHARACTERISTIC FaultManager.APP1_AdaptAdaptLoMax.Action_3 "Fault manager configuration.  Select up to 4 actions for each fault." VALUE 0x800028D0 RecordLayout_4 0 CompuMethod_115 0 65535 /end CHARACTERISTIC
/begin CHARACTERISTIC FaultManager.APP1_AdaptAdaptLoMax.Action_3_Condition "Fault manager configuration.  Select up to 4 actions for each fault." VALUE 0x800028D2 RecordLayout_4 0 CompuMethod_116 0 65535 /end CHARACTERISTIC
/begin CHARACTERISTIC FaultManager.APP1_AdaptAdaptLoMax.Action_4 "Fault manager configuration.  Select up to 4 actions for each fault." VALUE 0x800028D4 RecordLayout_4 0 CompuMethod_115 0 65535 /end CHARACTERISTIC
/begin CHARACTERISTIC FaultManager.APP1_AdaptAdaptLoMax.Action_4_Condition "Fault manager configuration.  Select up to 4 actions for each fault." VALUE 0x800028D6 RecordLayout_4 0 CompuMethod_116 0 65535 /end CHARACTERISTIC
/begin CHARACTERISTIC FaultManager.APP1_AdaptAdaptLoMin.Mode "Fault manager configuration.  Select up to 4 actions for each fault." VALUE 0x800028D8 RecordLayout_4 0 CompuMethod_113 0 65535 /end CHARACTERISTIC
/begin CHARACTERISTIC FaultManager.APP1_AdaptAdaptLoMin.ID "Fault manager configuration.  Select up to 4 actions for each fault." VALUE 0x800028DA RecordLayout_4 0 CompuMethod_1 0 65535 /end CHARACTERISTIC
/begin CHARACTERISTIC FaultManager.APP1_AdaptAdaptLoMin.Test "Fault manager configuration.  Select up to 4 actions for each fault." VALUE 0x800028DC RecordLayout_4 0 CompuMethod_114 0 65535 /end CHARACTERISTIC
/begin CHARACTERISTIC FaultManager.APP1_AdaptAdaptLoMin.Faulty_Samples__X_ "Fault manager configuration.  Select up to 4 actions for each fault." VALUE 0x800028DE RecordLayout_4 0 CompuMethod_1 0 65535 /end CHARACTERISTIC
/begin CHARACTERISTIC FaultManager.APP1_AdaptAdaptLoMin.Total_Samples__Y_ "Fault manager configuration.  Select up to 4 actions for each fault." VALUE 0x800028E0 RecordLayout_4 0 CompuMethod_1 0 65535 /end CHARACTERISTIC
/begin CHARACTERISTIC FaultManager.APP1_AdaptAdaptLoMin.Action_1 "Fault manager configuration.  Select up to 4 actions for each fault." VALUE 0x800028E2 RecordLayout_4 0 CompuMethod_115 0 65535 /end CHARACTERISTIC
/begin CHARACTERISTIC FaultManager.APP1_AdaptAdaptLoMin.Action_1_Condition "Fault manager configuration.  Select up to 4 actions for each fault." VALUE 0x800028E4 RecordLayout_4 0 CompuMethod_116 0 65535 /end CHARACTERISTIC
/begin CHARACTERISTIC FaultManager.APP1_AdaptAdaptLoMin.Action_2 "Fault manager configuration.  Select up to 4 actions for each fault." VALUE 0x800028E6 RecordLayout_4 0 CompuMethod_115 0 65535 /end CHARACTERISTIC
/begin CHARACTERISTIC FaultManager.APP1_AdaptAdaptLoMin.Action_2_Condition "Fault manager configuration.  Select up to 4 actions for each fault." VALUE 0x800028E8 RecordLayout_4 0 CompuMethod_116 0 65535 /end CHARACTERISTIC
/begin CHARACTERISTIC FaultManager.APP1_AdaptAdaptLoMin.Action_3 "Fault manager configuration.  Select up to 4 actions for each fault." VALUE 0x800028EA RecordLayout_4 0 CompuMethod_115 0 65535 /end CHARACTERISTIC
/begin CHARACTERISTIC FaultManager.APP1_AdaptAdaptLoMin.Action_3_Condition "Fault manager configuration.  Select up to 4 actions for each fault." VALUE 0x800028EC RecordLayout_4 0 CompuMethod_116 0 65535 /end CHARACTERISTIC
/begin CHARACTERISTIC FaultManager.APP1_AdaptAdaptLoMin.Action_4 "Fault manager configuration.  Select up to 4 actions for each fault." VALUE 0x800028EE RecordLayout_4 0 CompuMethod_115 0 65535 /end CHARACTERISTIC
/begin CHARACTERISTIC FaultManager.APP1_AdaptAdaptLoMin.Action_4_Condition "Fault manager configuration.  Select up to 4 actions for each fault." VALUE 0x800028F0 RecordLayout_4 0 CompuMethod_116 0 65535 /end CHARACTERISTIC
/begin CHARACTERISTIC FaultManager.APP1_AdaptRangeHigh.Mode "Fault manager configuration.  Select up to 4 actions for each fault." VALUE 0x800028F2 RecordLayout_4 0 CompuMethod_113 0 65535 /end CHARACTERISTIC
/begin CHARACTERISTIC FaultManager.APP1_AdaptRangeHigh.ID "Fault manager configuration.  Select up to 4 actions for each fault." VALUE 0x800028F4 RecordLayout_4 0 CompuMethod_1 0 65535 /end CHARACTERISTIC
/begin CHARACTERISTIC FaultManager.APP1_AdaptRangeHigh.Test "Fault manager configuration.  Select up to 4 actions for each fault." VALUE 0x800028F6 RecordLayout_4 0 CompuMethod_114 0 65535 /end CHARACTERISTIC
/begin CHARACTERISTIC FaultManager.APP1_AdaptRangeHigh.Faulty_Samples__X_ "Fault manager configuration.  Select up to 4 actions for each fault." VALUE 0x800028F8 RecordLayout_4 0 CompuMethod_1 0 65535 /end CHARACTERISTIC
/begin CHARACTERISTIC FaultManager.APP1_AdaptRangeHigh.Total_Samples__Y_ "Fault manager configuration.  Select up to 4 actions for each fault." VALUE 0x800028FA RecordLayout_4 0 CompuMethod_1 0 65535 /end CHARACTERISTIC
/begin CHARACTERISTIC FaultManager.APP1_AdaptRangeHigh.Action_1 "Fault manager configuration.  Select up to 4 actions for each fault." VALUE 0x800028FC RecordLayout_4 0 CompuMethod_115 0 65535 /end CHARACTERISTIC
/begin CHARACTERISTIC FaultManager.APP1_AdaptRangeHigh.Action_1_Condition "Fault manager configuration.  Select up to 4 actions for each fault." VALUE 0x800028FE RecordLayout_4 0 CompuMethod_116 0 65535 /end CHARACTERISTIC
/begin CHARACTERISTIC FaultManager.APP1_AdaptRangeHigh.Action_2 "Fault manager configuration.  Select up to 4 actions for each fault." VALUE 0x80002900 RecordLayout_4 0 CompuMethod_115 0 65535 /end CHARACTERISTIC
/begin CHARACTERISTIC FaultManager.APP1_AdaptRangeHigh.Action_2_Condition "Fault manager configuration.  Select up to 4 actions for each fault." VALUE 0x80002902 RecordLayout_4 0 CompuMethod_116 0 65535 /end CHARACTERISTIC
/begin CHARACTERISTIC FaultManager.APP1_AdaptRangeHigh.Action_3 "Fault manager configuration.  Select up to 4 actions for each fault." VALUE 0x80002904 RecordLayout_4 0 CompuMethod_115 0 65535 /end CHARACTERISTIC
/begin CHARACTERISTIC FaultManager.APP1_AdaptRangeHigh.Action_3_Condition "Fault manager configuration.  Select up to 4 actions for each fault." VALUE 0x80002906 RecordLayout_4 0 CompuMethod_116 0 65535 /end CHARACTERISTIC
/begin CHARACTERISTIC FaultManager.APP1_AdaptRangeHigh.Action_4 "Fault manager configuration.  Select up to 4 actions for each fault." VALUE 0x80002908 RecordLayout_4 0 CompuMethod_115 0 65535 /end CHARACTERISTIC
/begin CHARACTERISTIC FaultManager.APP1_AdaptRangeHigh.Action_4_Condition "Fault manager configuration.  Select up to 4 actions for each fault." VALUE 0x8000290A RecordLayout_4 0 CompuMethod_116 0 65535 /end CHARACTERISTIC
/begin CHARACTERISTIC FaultManager.APP1_AdaptRangeLow.Mode "Fault manager configuration.  Select up to 4 actions for each fault." VALUE 0x8000290C RecordLayout_4 0 CompuMethod_113 0 65535 /end CHARACTERISTIC
/begin CHARACTERISTIC FaultManager.APP1_AdaptRangeLow.ID "Fault manager configuration.  Select up to 4 actions for each fault." VALUE 0x8000290E RecordLayout_4 0 CompuMethod_1 0 65535 /end CHARACTERISTIC
/begin CHARACTERISTIC FaultManager.APP1_AdaptRangeLow.Test "Fault manager configuration.  Select up to 4 actions for each fault." VALUE 0x80002910 RecordLayout_4 0 CompuMethod_114 0 65535 /end CHARACTERISTIC
/begin CHARACTERISTIC FaultManager.APP1_AdaptRangeLow.Faulty_Samples__X_ "Fault manager configuration.  Select up to 4 actions for each fault." VALUE 0x80002912 RecordLayout_4 0 CompuMethod_1 0 65535 /end CHARACTERISTIC
/begin CHARACTERISTIC FaultManager.APP1_AdaptRangeLow.Total_Samples__Y_ "Fault manager configuration.  Select up to 4 actions for each fault." VALUE 0x80002914 RecordLayout_4 0 CompuMethod_1 0 65535 /end CHARACTERISTIC
/begin CHARACTERISTIC FaultManager.APP1_AdaptRangeLow.Action_1 "Fault manager configuration.  Select up to 4 actions for each fault." VALUE 0x80002916 RecordLayout_4 0 CompuMethod_115 0 65535 /end CHARACTERISTIC
/begin CHARACTERISTIC FaultManager.APP1_AdaptRangeLow.Action_1_Condition "Fault manager configuration.  Select up to 4 actions for each fault." VALUE 0x80002918 RecordLayout_4 0 CompuMethod_116 0 65535 /end CHARACTERISTIC
/begin CHARACTERISTIC FaultManager.APP1_AdaptRangeLow.Action_2 "Fault manager configuration.  Select up to 4 actions for each fault." VALUE 0x8000291A RecordLayout_4 0 CompuMethod_115 0 65535 /end CHARACTERISTIC
/begin CHARACTERISTIC FaultManager.APP1_AdaptRangeLow.Action_2_Condition "Fault manager configuration.  Select up to 4 actions for each fault." VALUE 0x8000291C RecordLayout_4 0 CompuMethod_116 0 65535 /end CHARACTERISTIC
/begin CHARACTERISTIC FaultManager.APP1_AdaptRangeLow.Action_3 "Fault manager configuration.  Select up to 4 actions for each fault." VALUE 0x8000291E RecordLayout_4 0 CompuMethod_115 0 65535 /end CHARACTERISTIC
/begin CHARACTERISTIC FaultManager.APP1_AdaptRangeLow.Action_3_Condition "Fault manager configuration.  Select up to 4 actions for each fault." VALUE 0x80002920 RecordLayout_4 0 CompuMethod_116 0 65535 /end CHARACTERISTIC
/begin CHARACTERISTIC FaultManager.APP1_AdaptRangeLow.Action_4 "Fault manager configuration.  Select up to 4 actions for each fault." VALUE 0x80002922 RecordLayout_4 0 CompuMethod_115 0 65535 /end CHARACTERISTIC
/begin CHARACTERISTIC FaultManager.APP1_AdaptRangeLow.Action_4_Condition "Fault manager configuration.  Select up to 4 actions for each fault." VALUE 0x80002924 RecordLayout_4 0 CompuMethod_116 0 65535 /end CHARACTERISTIC
/begin CHARACTERISTIC FaultManager.APP2RangeHigh.Mode "Fault manager configuration.  Select up to 4 actions for each fault." VALUE 0x80002926 RecordLayout_4 0 CompuMethod_113 0 65535 /end CHARACTERISTIC
/begin CHARACTERISTIC FaultManager.APP2RangeHigh.ID "Fault manager configuration.  Select up to 4 actions for each fault." VALUE 0x80002928 RecordLayout_4 0 CompuMethod_1 0 65535 /end CHARACTERISTIC
/begin CHARACTERISTIC FaultManager.APP2RangeHigh.Test "Fault manager configuration.  Select up to 4 actions for each fault." VALUE 0x8000292A RecordLayout_4 0 CompuMethod_114 0 65535 /end CHARACTERISTIC
/begin CHARACTERISTIC FaultManager.APP2RangeHigh.Faulty_Samples__X_ "Fault manager configuration.  Select up to 4 actions for each fault." VALUE 0x8000292C RecordLayout_4 0 CompuMethod_1 0 65535 /end CHARACTERISTIC
/begin CHARACTERISTIC FaultManager.APP2RangeHigh.Total_Samples__Y_ "Fault manager configuration.  Select up to 4 actions for each fault." VALUE 0x8000292E RecordLayout_4 0 CompuMethod_1 0 65535 /end CHARACTERISTIC
/begin CHARACTERISTIC FaultManager.APP2RangeHigh.Action_1 "Fault manager configuration.  Select up to 4 actions for each fault." VALUE 0x80002930 RecordLayout_4 0 CompuMethod_115 0 65535 /end CHARACTERISTIC
/begin CHARACTERISTIC FaultManager.APP2RangeHigh.Action_1_Condition "Fault manager configuration.  Select up to 4 actions for each fault." VALUE 0x80002932 RecordLayout_4 0 CompuMethod_116 0 65535 /end CHARACTERISTIC
/begin CHARACTERISTIC FaultManager.APP2RangeHigh.Action_2 "Fault manager configuration.  Select up to 4 actions for each fault." VALUE 0x80002934 RecordLayout_4 0 CompuMethod_115 0 65535 /end CHARACTERISTIC
/begin CHARACTERISTIC FaultManager.APP2RangeHigh.Action_2_Condition "Fault manager configuration.  Select up to 4 actions for each fault." VALUE 0x80002936 RecordLayout_4 0 CompuMethod_116 0 65535 /end CHARACTERISTIC
/begin CHARACTERISTIC FaultManager.APP2RangeHigh.Action_3 "Fault manager configuration.  Select up to 4 actions for each fault." VALUE 0x80002938 RecordLayout_4 0 CompuMethod_115 0 65535 /end CHARACTERISTIC
/begin CHARACTERISTIC FaultManager.APP2RangeHigh.Action_3_Condition "Fault manager configuration.  Select up to 4 actions for each fault." VALUE 0x8000293A RecordLayout_4 0 CompuMethod_116 0 65535 /end CHARACTERISTIC
/begin CHARACTERISTIC FaultManager.APP2RangeHigh.Action_4 "Fault manager configuration.  Select up to 4 actions for each fault." VALUE 0x8000293C RecordLayout_4 0 CompuMethod_115 0 65535 /end CHARACTERISTIC
/begin CHARACTERISTIC FaultManager.APP2RangeHigh.Action_4_Condition "Fault manager configuration.  Select up to 4 actions for each fault." VALUE 0x8000293E RecordLayout_4 0 CompuMethod_116 0 65535 /end CHARACTERISTIC
/begin CHARACTERISTIC FaultManager.APP2RangeLow.Mode "Fault manager configuration.  Select up to 4 actions for each fault." VALUE 0x80002940 RecordLayout_4 0 CompuMethod_113 0 65535 /end CHARACTERISTIC
/begin CHARACTERISTIC FaultManager.APP2RangeLow.ID "Fault manager configuration.  Select up to 4 actions for each fault." VALUE 0x80002942 RecordLayout_4 0 CompuMethod_1 0 65535 /end CHARACTERISTIC
/begin CHARACTERISTIC FaultManager.APP2RangeLow.Test "Fault manager configuration.  Select up to 4 actions for each fault." VALUE 0x80002944 RecordLayout_4 0 CompuMethod_114 0 65535 /end CHARACTERISTIC
/begin CHARACTERISTIC FaultManager.APP2RangeLow.Faulty_Samples__X_ "Fault manager configuration.  Select up to 4 actions for each fault." VALUE 0x80002946 RecordLayout_4 0 CompuMethod_1 0 65535 /end CHARACTERISTIC
/begin CHARACTERISTIC FaultManager.APP2RangeLow.Total_Samples__Y_ "Fault manager configuration.  Select up to 4 actions for each fault." VALUE 0x80002948 RecordLayout_4 0 CompuMethod_1 0 65535 /end CHARACTERISTIC
/begin CHARACTERISTIC FaultManager.APP2RangeLow.Action_1 "Fault manager configuration.  Select up to 4 actions for each fault." VALUE 0x8000294A RecordLayout_4 0 CompuMethod_115 0 65535 /end CHARACTERISTIC
/begin CHARACTERISTIC FaultManager.APP2RangeLow.Action_1_Condition "Fault manager configuration.  Select up to 4 actions for each fault." VALUE 0x8000294C RecordLayout_4 0 CompuMethod_116 0 65535 /end CHARACTERISTIC
/begin CHARACTERISTIC FaultManager.APP2RangeLow.Action_2 "Fault manager configuration.  Select up to 4 actions for each fault." VALUE 0x8000294E RecordLayout_4 0 CompuMethod_115 0 65535 /end CHARACTERISTIC
/begin CHARACTERISTIC FaultManager.APP2RangeLow.Action_2_Condition "Fault manager configuration.  Select up to 4 actions for each fault." VALUE 0x80002950 RecordLayout_4 0 CompuMethod_116 0 65535 /end CHARACTERISTIC
/begin CHARACTERISTIC FaultManager.APP2RangeLow.Action_3 "Fault manager configuration.  Select up to 4 actions for each fault." VALUE 0x80002952 RecordLayout_4 0 CompuMethod_115 0 65535 /end CHARACTERISTIC
/begin CHARACTERISTIC FaultManager.APP2RangeLow.Action_3_Condition "Fault manager configuration.  Select up to 4 actions for each fault." VALUE 0x80002954 RecordLayout_4 0 CompuMethod_116 0 65535 /end CHARACTERISTIC
/begin CHARACTERISTIC FaultManager.APP2RangeLow.Action_4 "Fault manager configuration.  Select up to 4 actions for each fault." VALUE 0x80002956 RecordLayout_4 0 CompuMethod_115 0 65535 /end CHARACTERISTIC
/begin CHARACTERISTIC FaultManager.APP2RangeLow.Action_4_Condition "Fault manager configuration.  Select up to 4 actions for each fault." VALUE 0x80002958 RecordLayout_4 0 CompuMethod_116 0 65535 /end CHARACTERISTIC
/begin CHARACTERISTIC FaultManager.APP2_AdaptAdaptHiMax.Mode "Fault manager configuration.  Select up to 4 actions for each fault." VALUE 0x8000295A RecordLayout_4 0 CompuMethod_113 0 65535 /end CHARACTERISTIC
/begin CHARACTERISTIC FaultManager.APP2_AdaptAdaptHiMax.ID "Fault manager configuration.  Select up to 4 actions for each fault." VALUE 0x8000295C RecordLayout_4 0 CompuMethod_1 0 65535 /end CHARACTERISTIC
/begin CHARACTERISTIC FaultManager.APP2_AdaptAdaptHiMax.Test "Fault manager configuration.  Select up to 4 actions for each fault." VALUE 0x8000295E RecordLayout_4 0 CompuMethod_114 0 65535 /end CHARACTERISTIC
/begin CHARACTERISTIC FaultManager.APP2_AdaptAdaptHiMax.Faulty_Samples__X_ "Fault manager configuration.  Select up to 4 actions for each fault." VALUE 0x80002960 RecordLayout_4 0 CompuMethod_1 0 65535 /end CHARACTERISTIC
/begin CHARACTERISTIC FaultManager.APP2_AdaptAdaptHiMax.Total_Samples__Y_ "Fault manager configuration.  Select up to 4 actions for each fault." VALUE 0x80002962 RecordLayout_4 0 CompuMethod_1 0 65535 /end CHARACTERISTIC
/begin CHARACTERISTIC FaultManager.APP2_AdaptAdaptHiMax.Action_1 "Fault manager configuration.  Select up to 4 actions for each fault." VALUE 0x80002964 RecordLayout_4 0 CompuMethod_115 0 65535 /end CHARACTERISTIC
/begin CHARACTERISTIC FaultManager.APP2_AdaptAdaptHiMax.Action_1_Condition "Fault manager configuration.  Select up to 4 actions for each fault." VALUE 0x80002966 RecordLayout_4 0 CompuMethod_116 0 65535 /end CHARACTERISTIC
/begin CHARACTERISTIC FaultManager.APP2_AdaptAdaptHiMax.Action_2 "Fault manager configuration.  Select up to 4 actions for each fault." VALUE 0x80002968 RecordLayout_4 0 CompuMethod_115 0 65535 /end CHARACTERISTIC
/begin CHARACTERISTIC FaultManager.APP2_AdaptAdaptHiMax.Action_2_Condition "Fault manager configuration.  Select up to 4 actions for each fault." VALUE 0x8000296A RecordLayout_4 0 CompuMethod_116 0 65535 /end CHARACTERISTIC
/begin CHARACTERISTIC FaultManager.APP2_AdaptAdaptHiMax.Action_3 "Fault manager configuration.  Select up to 4 actions for each fault." VALUE 0x8000296C RecordLayout_4 0 CompuMethod_115 0 65535 /end CHARACTERISTIC
/begin CHARACTERISTIC FaultManager.APP2_AdaptAdaptHiMax.Action_3_Condition "Fault manager configuration.  Select up to 4 actions for each fault." VALUE 0x8000296E RecordLayout_4 0 CompuMethod_116 0 65535 /end CHARACTERISTIC
/begin CHARACTERISTIC FaultManager.APP2_AdaptAdaptHiMax.Action_4 "Fault manager configuration.  Select up to 4 actions for each fault." VALUE 0x80002970 RecordLayout_4 0 CompuMethod_115 0 65535 /end CHARACTERISTIC
/begin CHARACTERISTIC FaultManager.APP2_AdaptAdaptHiMax.Action_4_Condition "Fault manager configuration.  Select up to 4 actions for each fault." VALUE 0x80002972 RecordLayout_4 0 CompuMethod_116 0 65535 /end CHARACTERISTIC
/begin CHARACTERISTIC FaultManager.APP2_AdaptAdaptHiMin.Mode "Fault manager configuration.  Select up to 4 actions for each fault." VALUE 0x80002974 RecordLayout_4 0 CompuMethod_113 0 65535 /end CHARACTERISTIC
/begin CHARACTERISTIC FaultManager.APP2_AdaptAdaptHiMin.ID "Fault manager configuration.  Select up to 4 actions for each fault." VALUE 0x80002976 RecordLayout_4 0 CompuMethod_1 0 65535 /end CHARACTERISTIC
/begin CHARACTERISTIC FaultManager.APP2_AdaptAdaptHiMin.Test "Fault manager configuration.  Select up to 4 actions for each fault." VALUE 0x80002978 RecordLayout_4 0 CompuMethod_114 0 65535 /end CHARACTERISTIC
/begin CHARACTERISTIC FaultManager.APP2_AdaptAdaptHiMin.Faulty_Samples__X_ "Fault manager configuration.  Select up to 4 actions for each fault." VALUE 0x8000297A RecordLayout_4 0 CompuMethod_1 0 65535 /end CHARACTERISTIC
/begin CHARACTERISTIC FaultManager.APP2_AdaptAdaptHiMin.Total_Samples__Y_ "Fault manager configuration.  Select up to 4 actions for each fault." VALUE 0x8000297C RecordLayout_4 0 CompuMethod_1 0 65535 /end CHARACTERISTIC
/begin CHARACTERISTIC FaultManager.APP2_AdaptAdaptHiMin.Action_1 "Fault manager configuration.  Select up to 4 actions for each fault." VALUE 0x8000297E RecordLayout_4 0 CompuMethod_115 0 65535 /end CHARACTERISTIC
/begin CHARACTERISTIC FaultManager.APP2_AdaptAdaptHiMin.Action_1_Condition "Fault manager configuration.  Select up to 4 actions for each fault." VALUE 0x80002980 RecordLayout_4 0 CompuMethod_116 0 65535 /end CHARACTERISTIC
/begin CHARACTERISTIC FaultManager.APP2_AdaptAdaptHiMin.Action_2 "Fault manager configuration.  Select up to 4 actions for each fault." VALUE 0x80002982 RecordLayout_4 0 CompuMethod_115 0 65535 /end CHARACTERISTIC
/begin CHARACTERISTIC FaultManager.APP2_AdaptAdaptHiMin.Action_2_Condition "Fault manager configuration.  Select up to 4 actions for each fault." VALUE 0x80002984 RecordLayout_4 0 CompuMethod_116 0 65535 /end CHARACTERISTIC
/begin CHARACTERISTIC FaultManager.APP2_AdaptAdaptHiMin.Action_3 "Fault manager configuration.  Select up to 4 actions for each fault." VALUE 0x80002986 RecordLayout_4 0 CompuMethod_115 0 65535 /end CHARACTERISTIC
/begin CHARACTERISTIC FaultManager.APP2_AdaptAdaptHiMin.Action_3_Condition "Fault manager configuration.  Select up to 4 actions for each fault." VALUE 0x80002988 RecordLayout_4 0 CompuMethod_116 0 65535 /end CHARACTERISTIC
/begin CHARACTERISTIC FaultManager.APP2_AdaptAdaptHiMin.Action_4 "Fault manager configuration.  Select up to 4 actions for each fault." VALUE 0x8000298A RecordLayout_4 0 CompuMethod_115 0 65535 /end CHARACTERISTIC
/begin CHARACTERISTIC FaultManager.APP2_AdaptAdaptHiMin.Action_4_Condition "Fault manager configuration.  Select up to 4 actions for each fault." VALUE 0x8000298C RecordLayout_4 0 CompuMethod_116 0 65535 /end CHARACTERISTIC
/begin CHARACTERISTIC FaultManager.APP2_AdaptAdaptLoMax.Mode "Fault manager configuration.  Select up to 4 actions for each fault." VALUE 0x8000298E RecordLayout_4 0 CompuMethod_113 0 65535 /end CHARACTERISTIC
/begin CHARACTERISTIC FaultManager.APP2_AdaptAdaptLoMax.ID "Fault manager configuration.  Select up to 4 actions for each fault." VALUE 0x80002990 RecordLayout_4 0 CompuMethod_1 0 65535 /end CHARACTERISTIC
/begin CHARACTERISTIC FaultManager.APP2_AdaptAdaptLoMax.Test "Fault manager configuration.  Select up to 4 actions for each fault." VALUE 0x80002992 RecordLayout_4 0 CompuMethod_114 0 65535 /end CHARACTERISTIC
/begin CHARACTERISTIC FaultManager.APP2_AdaptAdaptLoMax.Faulty_Samples__X_ "Fault manager configuration.  Select up to 4 actions for each fault." VALUE 0x80002994 RecordLayout_4 0 CompuMethod_1 0 65535 /end CHARACTERISTIC
/begin CHARACTERISTIC FaultManager.APP2_AdaptAdaptLoMax.Total_Samples__Y_ "Fault manager configuration.  Select up to 4 actions for each fault." VALUE 0x80002996 RecordLayout_4 0 CompuMethod_1 0 65535 /end CHARACTERISTIC
/begin CHARACTERISTIC FaultManager.APP2_AdaptAdaptLoMax.Action_1 "Fault manager configuration.  Select up to 4 actions for each fault." VALUE 0x80002998 RecordLayout_4 0 CompuMethod_115 0 65535 /end CHARACTERISTIC
/begin CHARACTERISTIC FaultManager.APP2_AdaptAdaptLoMax.Action_1_Condition "Fault manager configuration.  Select up to 4 actions for each fault." VALUE 0x8000299A RecordLayout_4 0 CompuMethod_116 0 65535 /end CHARACTERISTIC
/begin CHARACTERISTIC FaultManager.APP2_AdaptAdaptLoMax.Action_2 "Fault manager configuration.  Select up to 4 actions for each fault." VALUE 0x8000299C RecordLayout_4 0 CompuMethod_115 0 65535 /end CHARACTERISTIC
/begin CHARACTERISTIC FaultManager.APP2_AdaptAdaptLoMax.Action_2_Condition "Fault manager configuration.  Select up to 4 actions for each fault." VALUE 0x8000299E RecordLayout_4 0 CompuMethod_116 0 65535 /end CHARACTERISTIC
/begin CHARACTERISTIC FaultManager.APP2_AdaptAdaptLoMax.Action_3 "Fault manager configuration.  Select up to 4 actions for each fault." VALUE 0x800029A0 RecordLayout_4 0 CompuMethod_115 0 65535 /end CHARACTERISTIC
/begin CHARACTERISTIC FaultManager.APP2_AdaptAdaptLoMax.Action_3_Condition "Fault manager configuration.  Select up to 4 actions for each fault." VALUE 0x800029A2 RecordLayout_4 0 CompuMethod_116 0 65535 /end CHARACTERISTIC
/begin CHARACTERISTIC FaultManager.APP2_AdaptAdaptLoMax.Action_4 "Fault manager configuration.  Select up to 4 actions for each fault." VALUE 0x800029A4 RecordLayout_4 0 CompuMethod_115 0 65535 /end CHARACTERISTIC
/begin CHARACTERISTIC FaultManager.APP2_AdaptAdaptLoMax.Action_4_Condition "Fault manager configuration.  Select up to 4 actions for each fault." VALUE 0x800029A6 RecordLayout_4 0 CompuMethod_116 0 65535 /end CHARACTERISTIC
/begin CHARACTERISTIC FaultManager.APP2_AdaptAdaptLoMin.Mode "Fault manager configuration.  Select up to 4 actions for each fault." VALUE 0x800029A8 RecordLayout_4 0 CompuMethod_113 0 65535 /end CHARACTERISTIC
/begin CHARACTERISTIC FaultManager.APP2_AdaptAdaptLoMin.ID "Fault manager configuration.  Select up to 4 actions for each fault." VALUE 0x800029AA RecordLayout_4 0 CompuMethod_1 0 65535 /end CHARACTERISTIC
/begin CHARACTERISTIC FaultManager.APP2_AdaptAdaptLoMin.Test "Fault manager configuration.  Select up to 4 actions for each fault." VALUE 0x800029AC RecordLayout_4 0 CompuMethod_114 0 65535 /end CHARACTERISTIC
/begin CHARACTERISTIC FaultManager.APP2_AdaptAdaptLoMin.Faulty_Samples__X_ "Fault manager configuration.  Select up to 4 actions for each fault." VALUE 0x800029AE RecordLayout_4 0 CompuMethod_1 0 65535 /end CHARACTERISTIC
/begin CHARACTERISTIC FaultManager.APP2_AdaptAdaptLoMin.Total_Samples__Y_ "Fault manager configuration.  Select up to 4 actions for each fault." VALUE 0x800029B0 RecordLayout_4 0 CompuMethod_1 0 65535 /end CHARACTERISTIC
/begin CHARACTERISTIC FaultManager.APP2_AdaptAdaptLoMin.Action_1 "Fault manager configuration.  Select up to 4 actions for each fault." VALUE 0x800029B2 RecordLayout_4 0 CompuMethod_115 0 65535 /end CHARACTERISTIC
/begin CHARACTERISTIC FaultManager.APP2_AdaptAdaptLoMin.Action_1_Condition "Fault manager configuration.  Select up to 4 actions for each fault." VALUE 0x800029B4 RecordLayout_4 0 CompuMethod_116 0 65535 /end CHARACTERISTIC
/begin CHARACTERISTIC FaultManager.APP2_AdaptAdaptLoMin.Action_2 "Fault manager configuration.  Select up to 4 actions for each fault." VALUE 0x800029B6 RecordLayout_4 0 CompuMethod_115 0 65535 /end CHARACTERISTIC
/begin CHARACTERISTIC FaultManager.APP2_AdaptAdaptLoMin.Action_2_Condition "Fault manager configuration.  Select up to 4 actions for each fault." VALUE 0x800029B8 RecordLayout_4 0 CompuMethod_116 0 65535 /end CHARACTERISTIC
/begin CHARACTERISTIC FaultManager.APP2_AdaptAdaptLoMin.Action_3 "Fault manager configuration.  Select up to 4 actions for each fault." VALUE 0x800029BA RecordLayout_4 0 CompuMethod_115 0 65535 /end CHARACTERISTIC
/begin CHARACTERISTIC FaultManager.APP2_AdaptAdaptLoMin.Action_3_Condition "Fault manager configuration.  Select up to 4 actions for each fault." VALUE 0x800029BC RecordLayout_4 0 CompuMethod_116 0 65535 /end CHARACTERISTIC
/begin CHARACTERISTIC FaultManager.APP2_AdaptAdaptLoMin.Action_4 "Fault manager configuration.  Select up to 4 actions for each fault." VALUE 0x800029BE RecordLayout_4 0 CompuMethod_115 0 65535 /end CHARACTERISTIC
/begin CHARACTERISTIC FaultManager.APP2_AdaptAdaptLoMin.Action_4_Condition "Fault manager configuration.  Select up to 4 actions for each fault." VALUE 0x800029C0 RecordLayout_4 0 CompuMethod_116 0 65535 /end CHARACTERISTIC
/begin CHARACTERISTIC FaultManager.APP2_AdaptRangeHigh.Mode "Fault manager configuration.  Select up to 4 actions for each fault." VALUE 0x800029C2 RecordLayout_4 0 CompuMethod_113 0 65535 /end CHARACTERISTIC
/begin CHARACTERISTIC FaultManager.APP2_AdaptRangeHigh.ID "Fault manager configuration.  Select up to 4 actions for each fault." VALUE 0x800029C4 RecordLayout_4 0 CompuMethod_1 0 65535 /end CHARACTERISTIC
/begin CHARACTERISTIC FaultManager.APP2_AdaptRangeHigh.Test "Fault manager configuration.  Select up to 4 actions for each fault." VALUE 0x800029C6 RecordLayout_4 0 CompuMethod_114 0 65535 /end CHARACTERISTIC
/begin CHARACTERISTIC FaultManager.APP2_AdaptRangeHigh.Faulty_Samples__X_ "Fault manager configuration.  Select up to 4 actions for each fault." VALUE 0x800029C8 RecordLayout_4 0 CompuMethod_1 0 65535 /end CHARACTERISTIC
/begin CHARACTERISTIC FaultManager.APP2_AdaptRangeHigh.Total_Samples__Y_ "Fault manager configuration.  Select up to 4 actions for each fault." VALUE 0x800029CA RecordLayout_4 0 CompuMethod_1 0 65535 /end CHARACTERISTIC
/begin CHARACTERISTIC FaultManager.APP2_AdaptRangeHigh.Action_1 "Fault manager configuration.  Select up to 4 actions for each fault." VALUE 0x800029CC RecordLayout_4 0 CompuMethod_115 0 65535 /end CHARACTERISTIC
/begin CHARACTERISTIC FaultManager.APP2_AdaptRangeHigh.Action_1_Condition "Fault manager configuration.  Select up to 4 actions for each fault." VALUE 0x800029CE RecordLayout_4 0 CompuMethod_116 0 65535 /end CHARACTERISTIC
/begin CHARACTERISTIC FaultManager.APP2_AdaptRangeHigh.Action_2 "Fault manager configuration.  Select up to 4 actions for each fault." VALUE 0x800029D0 RecordLayout_4 0 CompuMethod_115 0 65535 /end CHARACTERISTIC
/begin CHARACTERISTIC FaultManager.APP2_AdaptRangeHigh.Action_2_Condition "Fault manager configuration.  Select up to 4 actions for each fault." VALUE 0x800029D2 RecordLayout_4 0 CompuMethod_116 0 65535 /end CHARACTERISTIC
/begin CHARACTERISTIC FaultManager.APP2_AdaptRangeHigh.Action_3 "Fault manager configuration.  Select up to 4 actions for each fault." VALUE 0x800029D4 RecordLayout_4 0 CompuMethod_115 0 65535 /end CHARACTERISTIC
/begin CHARACTERISTIC FaultManager.APP2_AdaptRangeHigh.Action_3_Condition "Fault manager configuration.  Select up to 4 actions for each fault." VALUE 0x800029D6 RecordLayout_4 0 CompuMethod_116 0 65535 /end CHARACTERISTIC
/begin CHARACTERISTIC FaultManager.APP2_AdaptRangeHigh.Action_4 "Fault manager configuration.  Select up to 4 actions for each fault." VALUE 0x800029D8 RecordLayout_4 0 CompuMethod_115 0 65535 /end CHARACTERISTIC
/begin CHARACTERISTIC FaultManager.APP2_AdaptRangeHigh.Action_4_Condition "Fault manager configuration.  Select up to 4 actions for each fault." VALUE 0x800029DA RecordLayout_4 0 CompuMethod_116 0 65535 /end CHARACTERISTIC
/begin CHARACTERISTIC FaultManager.APP2_AdaptRangeLow.Mode "Fault manager configuration.  Select up to 4 actions for each fault." VALUE 0x800029DC RecordLayout_4 0 CompuMethod_113 0 65535 /end CHARACTERISTIC
/begin CHARACTERISTIC FaultManager.APP2_AdaptRangeLow.ID "Fault manager configuration.  Select up to 4 actions for each fault." VALUE 0x800029DE RecordLayout_4 0 CompuMethod_1 0 65535 /end CHARACTERISTIC
/begin CHARACTERISTIC FaultManager.APP2_AdaptRangeLow.Test "Fault manager configuration.  Select up to 4 actions for each fault." VALUE 0x800029E0 RecordLayout_4 0 CompuMethod_114 0 65535 /end CHARACTERISTIC
/begin CHARACTERISTIC FaultManager.APP2_AdaptRangeLow.Faulty_Samples__X_ "Fault manager configuration.  Select up to 4 actions for each fault." VALUE 0x800029E2 RecordLayout_4 0 CompuMethod_1 0 65535 /end CHARACTERISTIC
/begin CHARACTERISTIC FaultManager.APP2_AdaptRangeLow.Total_Samples__Y_ "Fault manager configuration.  Select up to 4 actions for each fault." VALUE 0x800029E4 RecordLayout_4 0 CompuMethod_1 0 65535 /end CHARACTERISTIC
/begin CHARACTERISTIC FaultManager.APP2_AdaptRangeLow.Action_1 "Fault manager configuration.  Select up to 4 actions for each fault." VALUE 0x800029E6 RecordLayout_4 0 CompuMethod_115 0 65535 /end CHARACTERISTIC
/begin CHARACTERISTIC FaultManager.APP2_AdaptRangeLow.Action_1_Condition "Fault manager configuration.  Select up to 4 actions for each fault." VALUE 0x800029E8 RecordLayout_4 0 CompuMethod_116 0 65535 /end CHARACTERISTIC
/begin CHARACTERISTIC FaultManager.APP2_AdaptRangeLow.Action_2 "Fault manager configuration.  Select up to 4 actions for each fault." VALUE 0x800029EA RecordLayout_4 0 CompuMethod_115 0 65535 /end CHARACTERISTIC
/begin CHARACTERISTIC FaultManager.APP2_AdaptRangeLow.Action_2_Condition "Fault manager configuration.  Select up to 4 actions for each fault." VALUE 0x800029EC RecordLayout_4 0 CompuMethod_116 0 65535 /end CHARACTERISTIC
/begin CHARACTERISTIC FaultManager.APP2_AdaptRangeLow.Action_3 "Fault manager configuration.  Select up to 4 actions for each fault." VALUE 0x800029EE RecordLayout_4 0 CompuMethod_115 0 65535 /end CHARACTERISTIC
/begin CHARACTERISTIC FaultManager.APP2_AdaptRangeLow.Action_3_Condition "Fault manager configuration.  Select up to 4 actions for each fault." VALUE 0x800029F0 RecordLayout_4 0 CompuMethod_116 0 65535 /end CHARACTERISTIC
/begin CHARACTERISTIC FaultManager.APP2_AdaptRangeLow.Action_4 "Fault manager configuration.  Select up to 4 actions for each fault." VALUE 0x800029F2 RecordLayout_4 0 CompuMethod_115 0 65535 /end CHARACTERISTIC
/begin CHARACTERISTIC FaultManager.APP2_AdaptRangeLow.Action_4_Condition "Fault manager configuration.  Select up to 4 actions for each fault." VALUE 0x800029F4 RecordLayout_4 0 CompuMethod_116 0 65535 /end CHARACTERISTIC
/begin CHARACTERISTIC FaultManager.APP_Sensors_Conflict.Mode "Fault manager configuration.  Select up to 4 actions for each fault." VALUE 0x800029F6 RecordLayout_4 0 CompuMethod_113 0 65535 /end CHARACTERISTIC
/begin CHARACTERISTIC FaultManager.APP_Sensors_Conflict.ID "Fault manager configuration.  Select up to 4 actions for each fault." VALUE 0x800029F8 RecordLayout_4 0 CompuMethod_1 0 65535 /end CHARACTERISTIC
/begin CHARACTERISTIC FaultManager.APP_Sensors_Conflict.Test "Fault manager configuration.  Select up to 4 actions for each fault." VALUE 0x800029FA RecordLayout_4 0 CompuMethod_114 0 65535 /end CHARACTERISTIC
/begin CHARACTERISTIC FaultManager.APP_Sensors_Conflict.Faulty_Samples__X_ "Fault manager configuration.  Select up to 4 actions for each fault." VALUE 0x800029FC RecordLayout_4 0 CompuMethod_1 0 65535 /end CHARACTERISTIC
/begin CHARACTERISTIC FaultManager.APP_Sensors_Conflict.Total_Samples__Y_ "Fault manager configuration.  Select up to 4 actions for each fault." VALUE 0x800029FE RecordLayout_4 0 CompuMethod_1 0 65535 /end CHARACTERISTIC
/begin CHARACTERISTIC FaultManager.APP_Sensors_Conflict.Action_1 "Fault manager configuration.  Select up to 4 actions for each fault." VALUE 0x80002A00 RecordLayout_4 0 CompuMethod_115 0 65535 /end CHARACTERISTIC
/begin CHARACTERISTIC FaultManager.APP_Sensors_Conflict.Action_1_Condition "Fault manager configuration.  Select up to 4 actions for each fault." VALUE 0x80002A02 RecordLayout_4 0 CompuMethod_116 0 65535 /end CHARACTERISTIC
/begin CHARACTERISTIC FaultManager.APP_Sensors_Conflict.Action_2 "Fault manager configuration.  Select up to 4 actions for each fault." VALUE 0x80002A04 RecordLayout_4 0 CompuMethod_115 0 65535 /end CHARACTERISTIC
/begin CHARACTERISTIC FaultManager.APP_Sensors_Conflict.Action_2_Condition "Fault manager configuration.  Select up to 4 actions for each fault." VALUE 0x80002A06 RecordLayout_4 0 CompuMethod_116 0 65535 /end CHARACTERISTIC
/begin CHARACTERISTIC FaultManager.APP_Sensors_Conflict.Action_3 "Fault manager configuration.  Select up to 4 actions for each fault." VALUE 0x80002A08 RecordLayout_4 0 CompuMethod_115 0 65535 /end CHARACTERISTIC
/begin CHARACTERISTIC FaultManager.APP_Sensors_Conflict.Action_3_Condition "Fault manager configuration.  Select up to 4 actions for each fault." VALUE 0x80002A0A RecordLayout_4 0 CompuMethod_116 0 65535 /end CHARACTERISTIC
/begin CHARACTERISTIC FaultManager.APP_Sensors_Conflict.Action_4 "Fault manager configuration.  Select up to 4 actions for each fault." VALUE 0x80002A0C RecordLayout_4 0 CompuMethod_115 0 65535 /end CHARACTERISTIC
/begin CHARACTERISTIC FaultManager.APP_Sensors_Conflict.Action_4_Condition "Fault manager configuration.  Select up to 4 actions for each fault." VALUE 0x80002A0E RecordLayout_4 0 CompuMethod_116 0 65535 /end CHARACTERISTIC
/begin CHARACTERISTIC FaultManager.AirflowMismatch_Fault.Mode "Fault manager configuration.  Select up to 4 actions for each fault." VALUE 0x80002A10 RecordLayout_4 0 CompuMethod_113 0 65535 /end CHARACTERISTIC
/begin CHARACTERISTIC FaultManager.AirflowMismatch_Fault.ID "Fault manager configuration.  Select up to 4 actions for each fault." VALUE 0x80002A12 RecordLayout_4 0 CompuMethod_1 0 65535 /end CHARACTERISTIC
/begin CHARACTERISTIC FaultManager.AirflowMismatch_Fault.Test "Fault manager configuration.  Select up to 4 actions for each fault." VALUE 0x80002A14 RecordLayout_4 0 CompuMethod_114 0 65535 /end CHARACTERISTIC
/begin CHARACTERISTIC FaultManager.AirflowMismatch_Fault.Faulty_Samples__X_ "Fault manager configuration.  Select up to 4 actions for each fault." VALUE 0x80002A16 RecordLayout_4 0 CompuMethod_1 0 65535 /end CHARACTERISTIC
/begin CHARACTERISTIC FaultManager.AirflowMismatch_Fault.Total_Samples__Y_ "Fault manager configuration.  Select up to 4 actions for each fault." VALUE 0x80002A18 RecordLayout_4 0 CompuMethod_1 0 65535 /end CHARACTERISTIC
/begin CHARACTERISTIC FaultManager.AirflowMismatch_Fault.Action_1 "Fault manager configuration.  Select up to 4 actions for each fault." VALUE 0x80002A1A RecordLayout_4 0 CompuMethod_115 0 65535 /end CHARACTERISTIC
/begin CHARACTERISTIC FaultManager.AirflowMismatch_Fault.Action_1_Condition "Fault manager configuration.  Select up to 4 actions for each fault." VALUE 0x80002A1C RecordLayout_4 0 CompuMethod_116 0 65535 /end CHARACTERISTIC
/begin CHARACTERISTIC FaultManager.AirflowMismatch_Fault.Action_2 "Fault manager configuration.  Select up to 4 actions for each fault." VALUE 0x80002A1E RecordLayout_4 0 CompuMethod_115 0 65535 /end CHARACTERISTIC
/begin CHARACTERISTIC FaultManager.AirflowMismatch_Fault.Action_2_Condition "Fault manager configuration.  Select up to 4 actions for each fault." VALUE 0x80002A20 RecordLayout_4 0 CompuMethod_116 0 65535 /end CHARACTERISTIC
/begin CHARACTERISTIC FaultManager.AirflowMismatch_Fault.Action_3 "Fault manager configuration.  Select up to 4 actions for each fault." VALUE 0x80002A22 RecordLayout_4 0 CompuMethod_115 0 65535 /end CHARACTERISTIC
/begin CHARACTERISTIC FaultManager.AirflowMismatch_Fault.Action_3_Condition "Fault manager configuration.  Select up to 4 actions for each fault." VALUE 0x80002A24 RecordLayout_4 0 CompuMethod_116 0 65535 /end CHARACTERISTIC
/begin CHARACTERISTIC FaultManager.AirflowMismatch_Fault.Action_4 "Fault manager configuration.  Select up to 4 actions for each fault." VALUE 0x80002A26 RecordLayout_4 0 CompuMethod_115 0 65535 /end CHARACTERISTIC
/begin CHARACTERISTIC FaultManager.AirflowMismatch_Fault.Action_4_Condition "Fault manager configuration.  Select up to 4 actions for each fault." VALUE 0x80002A28 RecordLayout_4 0 CompuMethod_116 0 65535 /end CHARACTERISTIC
/begin CHARACTERISTIC FaultManager.AltInop_Fault.Mode "Fault manager configuration.  Select up to 4 actions for each fault." VALUE 0x80002A2A RecordLayout_4 0 CompuMethod_113 0 65535 /end CHARACTERISTIC
/begin CHARACTERISTIC FaultManager.AltInop_Fault.ID "Fault manager configuration.  Select up to 4 actions for each fault." VALUE 0x80002A2C RecordLayout_4 0 CompuMethod_1 0 65535 /end CHARACTERISTIC
/begin CHARACTERISTIC FaultManager.AltInop_Fault.Test "Fault manager configuration.  Select up to 4 actions for each fault." VALUE 0x80002A2E RecordLayout_4 0 CompuMethod_114 0 65535 /end CHARACTERISTIC
/begin CHARACTERISTIC FaultManager.AltInop_Fault.Faulty_Samples__X_ "Fault manager configuration.  Select up to 4 actions for each fault." VALUE 0x80002A30 RecordLayout_4 0 CompuMethod_1 0 65535 /end CHARACTERISTIC
/begin CHARACTERISTIC FaultManager.AltInop_Fault.Total_Samples__Y_ "Fault manager configuration.  Select up to 4 actions for each fault." VALUE 0x80002A32 RecordLayout_4 0 CompuMethod_1 0 65535 /end CHARACTERISTIC
/begin CHARACTERISTIC FaultManager.AltInop_Fault.Action_1 "Fault manager configuration.  Select up to 4 actions for each fault." VALUE 0x80002A34 RecordLayout_4 0 CompuMethod_115 0 65535 /end CHARACTERISTIC
/begin CHARACTERISTIC FaultManager.AltInop_Fault.Action_1_Condition "Fault manager configuration.  Select up to 4 actions for each fault." VALUE 0x80002A36 RecordLayout_4 0 CompuMethod_116 0 65535 /end CHARACTERISTIC
/begin CHARACTERISTIC FaultManager.AltInop_Fault.Action_2 "Fault manager configuration.  Select up to 4 actions for each fault." VALUE 0x80002A38 RecordLayout_4 0 CompuMethod_115 0 65535 /end CHARACTERISTIC
/begin CHARACTERISTIC FaultManager.AltInop_Fault.Action_2_Condition "Fault manager configuration.  Select up to 4 actions for each fault." VALUE 0x80002A3A RecordLayout_4 0 CompuMethod_116 0 65535 /end CHARACTERISTIC
/begin CHARACTERISTIC FaultManager.AltInop_Fault.Action_3 "Fault manager configuration.  Select up to 4 actions for each fault." VALUE 0x80002A3C RecordLayout_4 0 CompuMethod_115 0 65535 /end CHARACTERISTIC
/begin CHARACTERISTIC FaultManager.AltInop_Fault.Action_3_Condition "Fault manager configuration.  Select up to 4 actions for each fault." VALUE 0x80002A3E RecordLayout_4 0 CompuMethod_116 0 65535 /end CHARACTERISTIC
/begin CHARACTERISTIC FaultManager.AltInop_Fault.Action_4 "Fault manager configuration.  Select up to 4 actions for each fault." VALUE 0x80002A40 RecordLayout_4 0 CompuMethod_115 0 65535 /end CHARACTERISTIC
/begin CHARACTERISTIC FaultManager.AltInop_Fault.Action_4_Condition "Fault manager configuration.  Select up to 4 actions for each fault." VALUE 0x80002A42 RecordLayout_4 0 CompuMethod_116 0 65535 /end CHARACTERISTIC
/begin CHARACTERISTIC FaultManager.Bank1_EquivRatioRangeHigh.Mode "Fault manager configuration.  Select up to 4 actions for each fault." VALUE 0x80002A44 RecordLayout_4 0 CompuMethod_113 0 65535 /end CHARACTERISTIC
/begin CHARACTERISTIC FaultManager.Bank1_EquivRatioRangeHigh.ID "Fault manager configuration.  Select up to 4 actions for each fault." VALUE 0x80002A46 RecordLayout_4 0 CompuMethod_1 0 65535 /end CHARACTERISTIC
/begin CHARACTERISTIC FaultManager.Bank1_EquivRatioRangeHigh.Test "Fault manager configuration.  Select up to 4 actions for each fault." VALUE 0x80002A48 RecordLayout_4 0 CompuMethod_114 0 65535 /end CHARACTERISTIC
/begin CHARACTERISTIC FaultManager.Bank1_EquivRatioRangeHigh.Faulty_Samples__X_ "Fault manager configuration.  Select up to 4 actions for each fault." VALUE 0x80002A4A RecordLayout_4 0 CompuMethod_1 0 65535 /end CHARACTERISTIC
/begin CHARACTERISTIC FaultManager.Bank1_EquivRatioRangeHigh.Total_Samples__Y_ "Fault manager configuration.  Select up to 4 actions for each fault." VALUE 0x80002A4C RecordLayout_4 0 CompuMethod_1 0 65535 /end CHARACTERISTIC
/begin CHARACTERISTIC FaultManager.Bank1_EquivRatioRangeHigh.Action_1 "Fault manager configuration.  Select up to 4 actions for each fault." VALUE 0x80002A4E RecordLayout_4 0 CompuMethod_115 0 65535 /end CHARACTERISTIC
/begin CHARACTERISTIC FaultManager.Bank1_EquivRatioRangeHigh.Action_1_Condition "Fault manager configuration.  Select up to 4 actions for each fault." VALUE 0x80002A50 RecordLayout_4 0 CompuMethod_116 0 65535 /end CHARACTERISTIC
/begin CHARACTERISTIC FaultManager.Bank1_EquivRatioRangeHigh.Action_2 "Fault manager configuration.  Select up to 4 actions for each fault." VALUE 0x80002A52 RecordLayout_4 0 CompuMethod_115 0 65535 /end CHARACTERISTIC
/begin CHARACTERISTIC FaultManager.Bank1_EquivRatioRangeHigh.Action_2_Condition "Fault manager configuration.  Select up to 4 actions for each fault." VALUE 0x80002A54 RecordLayout_4 0 CompuMethod_116 0 65535 /end CHARACTERISTIC
/begin CHARACTERISTIC FaultManager.Bank1_EquivRatioRangeHigh.Action_3 "Fault manager configuration.  Select up to 4 actions for each fault." VALUE 0x80002A56 RecordLayout_4 0 CompuMethod_115 0 65535 /end CHARACTERISTIC
/begin CHARACTERISTIC FaultManager.Bank1_EquivRatioRangeHigh.Action_3_Condition "Fault manager configuration.  Select up to 4 actions for each fault." VALUE 0x80002A58 RecordLayout_4 0 CompuMethod_116 0 65535 /end CHARACTERISTIC
/begin CHARACTERISTIC FaultManager.Bank1_EquivRatioRangeHigh.Action_4 "Fault manager configuration.  Select up to 4 actions for each fault." VALUE 0x80002A5A RecordLayout_4 0 CompuMethod_115 0 65535 /end CHARACTERISTIC
/begin CHARACTERISTIC FaultManager.Bank1_EquivRatioRangeHigh.Action_4_Condition "Fault manager configuration.  Select up to 4 actions for each fault." VALUE 0x80002A5C RecordLayout_4 0 CompuMethod_116 0 65535 /end CHARACTERISTIC
/begin CHARACTERISTIC FaultManager.Bank1_EquivRatioRangeLow.Mode "Fault manager configuration.  Select up to 4 actions for each fault." VALUE 0x80002A5E RecordLayout_4 0 CompuMethod_113 0 65535 /end CHARACTERISTIC
/begin CHARACTERISTIC FaultManager.Bank1_EquivRatioRangeLow.ID "Fault manager configuration.  Select up to 4 actions for each fault." VALUE 0x80002A60 RecordLayout_4 0 CompuMethod_1 0 65535 /end CHARACTERISTIC
/begin CHARACTERISTIC FaultManager.Bank1_EquivRatioRangeLow.Test "Fault manager configuration.  Select up to 4 actions for each fault." VALUE 0x80002A62 RecordLayout_4 0 CompuMethod_114 0 65535 /end CHARACTERISTIC
/begin CHARACTERISTIC FaultManager.Bank1_EquivRatioRangeLow.Faulty_Samples__X_ "Fault manager configuration.  Select up to 4 actions for each fault." VALUE 0x80002A64 RecordLayout_4 0 CompuMethod_1 0 65535 /end CHARACTERISTIC
/begin CHARACTERISTIC FaultManager.Bank1_EquivRatioRangeLow.Total_Samples__Y_ "Fault manager configuration.  Select up to 4 actions for each fault." VALUE 0x80002A66 RecordLayout_4 0 CompuMethod_1 0 65535 /end CHARACTERISTIC
/begin CHARACTERISTIC FaultManager.Bank1_EquivRatioRangeLow.Action_1 "Fault manager configuration.  Select up to 4 actions for each fault." VALUE 0x80002A68 RecordLayout_4 0 CompuMethod_115 0 65535 /end CHARACTERISTIC
/begin CHARACTERISTIC FaultManager.Bank1_EquivRatioRangeLow.Action_1_Condition "Fault manager configuration.  Select up to 4 actions for each fault." VALUE 0x80002A6A RecordLayout_4 0 CompuMethod_116 0 65535 /end CHARACTERISTIC
/begin CHARACTERISTIC FaultManager.Bank1_EquivRatioRangeLow.Action_2 "Fault manager configuration.  Select up to 4 actions for each fault." VALUE 0x80002A6C RecordLayout_4 0 CompuMethod_115 0 65535 /end CHARACTERISTIC
/begin CHARACTERISTIC FaultManager.Bank1_EquivRatioRangeLow.Action_2_Condition "Fault manager configuration.  Select up to 4 actions for each fault." VALUE 0x80002A6E RecordLayout_4 0 CompuMethod_116 0 65535 /end CHARACTERISTIC
/begin CHARACTERISTIC FaultManager.Bank1_EquivRatioRangeLow.Action_3 "Fault manager configuration.  Select up to 4 actions for each fault." VALUE 0x80002A70 RecordLayout_4 0 CompuMethod_115 0 65535 /end CHARACTERISTIC
/begin CHARACTERISTIC FaultManager.Bank1_EquivRatioRangeLow.Action_3_Condition "Fault manager configuration.  Select up to 4 actions for each fault." VALUE 0x80002A72 RecordLayout_4 0 CompuMethod_116 0 65535 /end CHARACTERISTIC
/begin CHARACTERISTIC FaultManager.Bank1_EquivRatioRangeLow.Action_4 "Fault manager configuration.  Select up to 4 actions for each fault." VALUE 0x80002A74 RecordLayout_4 0 CompuMethod_115 0 65535 /end CHARACTERISTIC
/begin CHARACTERISTIC FaultManager.Bank1_EquivRatioRangeLow.Action_4_Condition "Fault manager configuration.  Select up to 4 actions for each fault." VALUE 0x80002A76 RecordLayout_4 0 CompuMethod_116 0 65535 /end CHARACTERISTIC
/begin CHARACTERISTIC FaultManager.Bank2_EquivRatioRangeHigh.Mode "Fault manager configuration.  Select up to 4 actions for each fault." VALUE 0x80002A78 RecordLayout_4 0 CompuMethod_113 0 65535 /end CHARACTERISTIC
/begin CHARACTERISTIC FaultManager.Bank2_EquivRatioRangeHigh.ID "Fault manager configuration.  Select up to 4 actions for each fault." VALUE 0x80002A7A RecordLayout_4 0 CompuMethod_1 0 65535 /end CHARACTERISTIC
/begin CHARACTERISTIC FaultManager.Bank2_EquivRatioRangeHigh.Test "Fault manager configuration.  Select up to 4 actions for each fault." VALUE 0x80002A7C RecordLayout_4 0 CompuMethod_114 0 65535 /end CHARACTERISTIC
/begin CHARACTERISTIC FaultManager.Bank2_EquivRatioRangeHigh.Faulty_Samples__X_ "Fault manager configuration.  Select up to 4 actions for each fault." VALUE 0x80002A7E RecordLayout_4 0 CompuMethod_1 0 65535 /end CHARACTERISTIC
/begin CHARACTERISTIC FaultManager.Bank2_EquivRatioRangeHigh.Total_Samples__Y_ "Fault manager configuration.  Select up to 4 actions for each fault." VALUE 0x80002A80 RecordLayout_4 0 CompuMethod_1 0 65535 /end CHARACTERISTIC
/begin CHARACTERISTIC FaultManager.Bank2_EquivRatioRangeHigh.Action_1 "Fault manager configuration.  Select up to 4 actions for each fault." VALUE 0x80002A82 RecordLayout_4 0 CompuMethod_115 0 65535 /end CHARACTERISTIC
/begin CHARACTERISTIC FaultManager.Bank2_EquivRatioRangeHigh.Action_1_Condition "Fault manager configuration.  Select up to 4 actions for each fault." VALUE 0x80002A84 RecordLayout_4 0 CompuMethod_116 0 65535 /end CHARACTERISTIC
/begin CHARACTERISTIC FaultManager.Bank2_EquivRatioRangeHigh.Action_2 "Fault manager configuration.  Select up to 4 actions for each fault." VALUE 0x80002A86 RecordLayout_4 0 CompuMethod_115 0 65535 /end CHARACTERISTIC
/begin CHARACTERISTIC FaultManager.Bank2_EquivRatioRangeHigh.Action_2_Condition "Fault manager configuration.  Select up to 4 actions for each fault." VALUE 0x80002A88 RecordLayout_4 0 CompuMethod_116 0 65535 /end CHARACTERISTIC
/begin CHARACTERISTIC FaultManager.Bank2_EquivRatioRangeHigh.Action_3 "Fault manager configuration.  Select up to 4 actions for each fault." VALUE 0x80002A8A RecordLayout_4 0 CompuMethod_115 0 65535 /end CHARACTERISTIC
/begin CHARACTERISTIC FaultManager.Bank2_EquivRatioRangeHigh.Action_3_Condition "Fault manager configuration.  Select up to 4 actions for each fault." VALUE 0x80002A8C RecordLayout_4 0 CompuMethod_116 0 65535 /end CHARACTERISTIC
/begin CHARACTERISTIC FaultManager.Bank2_EquivRatioRangeHigh.Action_4 "Fault manager configuration.  Select up to 4 actions for each fault." VALUE 0x80002A8E RecordLayout_4 0 CompuMethod_115 0 65535 /end CHARACTERISTIC
/begin CHARACTERISTIC FaultManager.Bank2_EquivRatioRangeHigh.Action_4_Condition "Fault manager configuration.  Select up to 4 actions for each fault." VALUE 0x80002A90 RecordLayout_4 0 CompuMethod_116 0 65535 /end CHARACTERISTIC
/begin CHARACTERISTIC FaultManager.Bank2_EquivRatioRangeLow.Mode "Fault manager configuration.  Select up to 4 actions for each fault." VALUE 0x80002A92 RecordLayout_4 0 CompuMethod_113 0 65535 /end CHARACTERISTIC
/begin CHARACTERISTIC FaultManager.Bank2_EquivRatioRangeLow.ID "Fault manager configuration.  Select up to 4 actions for each fault." VALUE 0x80002A94 RecordLayout_4 0 CompuMethod_1 0 65535 /end CHARACTERISTIC
/begin CHARACTERISTIC FaultManager.Bank2_EquivRatioRangeLow.Test "Fault manager configuration.  Select up to 4 actions for each fault." VALUE 0x80002A96 RecordLayout_4 0 CompuMethod_114 0 65535 /end CHARACTERISTIC
/begin CHARACTERISTIC FaultManager.Bank2_EquivRatioRangeLow.Faulty_Samples__X_ "Fault manager configuration.  Select up to 4 actions for each fault." VALUE 0x80002A98 RecordLayout_4 0 CompuMethod_1 0 65535 /end CHARACTERISTIC
/begin CHARACTERISTIC FaultManager.Bank2_EquivRatioRangeLow.Total_Samples__Y_ "Fault manager configuration.  Select up to 4 actions for each fault." VALUE 0x80002A9A RecordLayout_4 0 CompuMethod_1 0 65535 /end CHARACTERISTIC
/begin CHARACTERISTIC FaultManager.Bank2_EquivRatioRangeLow.Action_1 "Fault manager configuration.  Select up to 4 actions for each fault." VALUE 0x80002A9C RecordLayout_4 0 CompuMethod_115 0 65535 /end CHARACTERISTIC
/begin CHARACTERISTIC FaultManager.Bank2_EquivRatioRangeLow.Action_1_Condition "Fault manager configuration.  Select up to 4 actions for each fault." VALUE 0x80002A9E RecordLayout_4 0 CompuMethod_116 0 65535 /end CHARACTERISTIC
/begin CHARACTERISTIC FaultManager.Bank2_EquivRatioRangeLow.Action_2 "Fault manager configuration.  Select up to 4 actions for each fault." VALUE 0x80002AA0 RecordLayout_4 0 CompuMethod_115 0 65535 /end CHARACTERISTIC
/begin CHARACTERISTIC FaultManager.Bank2_EquivRatioRangeLow.Action_2_Condition "Fault manager configuration.  Select up to 4 actions for each fault." VALUE 0x80002AA2 RecordLayout_4 0 CompuMethod_116 0 65535 /end CHARACTERISTIC
/begin CHARACTERISTIC FaultManager.Bank2_EquivRatioRangeLow.Action_3 "Fault manager configuration.  Select up to 4 actions for each fault." VALUE 0x80002AA4 RecordLayout_4 0 CompuMethod_115 0 65535 /end CHARACTERISTIC
/begin CHARACTERISTIC FaultManager.Bank2_EquivRatioRangeLow.Action_3_Condition "Fault manager configuration.  Select up to 4 actions for each fault." VALUE 0x80002AA6 RecordLayout_4 0 CompuMethod_116 0 65535 /end CHARACTERISTIC
/begin CHARACTERISTIC FaultManager.Bank2_EquivRatioRangeLow.Action_4 "Fault manager configuration.  Select up to 4 actions for each fault." VALUE 0x80002AA8 RecordLayout_4 0 CompuMethod_115 0 65535 /end CHARACTERISTIC
/begin CHARACTERISTIC FaultManager.Bank2_EquivRatioRangeLow.Action_4_Condition "Fault manager configuration.  Select up to 4 actions for each fault." VALUE 0x80002AAA RecordLayout_4 0 CompuMethod_116 0 65535 /end CHARACTERISTIC
/begin CHARACTERISTIC FaultManager.CATRangeHigh.Mode "Fault manager configuration.  Select up to 4 actions for each fault." VALUE 0x80002AAC RecordLayout_4 0 CompuMethod_113 0 65535 /end CHARACTERISTIC
/begin CHARACTERISTIC FaultManager.CATRangeHigh.ID "Fault manager configuration.  Select up to 4 actions for each fault." VALUE 0x80002AAE RecordLayout_4 0 CompuMethod_1 0 65535 /end CHARACTERISTIC
/begin CHARACTERISTIC FaultManager.CATRangeHigh.Test "Fault manager configuration.  Select up to 4 actions for each fault." VALUE 0x80002AB0 RecordLayout_4 0 CompuMethod_114 0 65535 /end CHARACTERISTIC
/begin CHARACTERISTIC FaultManager.CATRangeHigh.Faulty_Samples__X_ "Fault manager configuration.  Select up to 4 actions for each fault." VALUE 0x80002AB2 RecordLayout_4 0 CompuMethod_1 0 65535 /end CHARACTERISTIC
/begin CHARACTERISTIC FaultManager.CATRangeHigh.Total_Samples__Y_ "Fault manager configuration.  Select up to 4 actions for each fault." VALUE 0x80002AB4 RecordLayout_4 0 CompuMethod_1 0 65535 /end CHARACTERISTIC
/begin CHARACTERISTIC FaultManager.CATRangeHigh.Action_1 "Fault manager configuration.  Select up to 4 actions for each fault." VALUE 0x80002AB6 RecordLayout_4 0 CompuMethod_115 0 65535 /end CHARACTERISTIC
/begin CHARACTERISTIC FaultManager.CATRangeHigh.Action_1_Condition "Fault manager configuration.  Select up to 4 actions for each fault." VALUE 0x80002AB8 RecordLayout_4 0 CompuMethod_116 0 65535 /end CHARACTERISTIC
/begin CHARACTERISTIC FaultManager.CATRangeHigh.Action_2 "Fault manager configuration.  Select up to 4 actions for each fault." VALUE 0x80002ABA RecordLayout_4 0 CompuMethod_115 0 65535 /end CHARACTERISTIC
/begin CHARACTERISTIC FaultManager.CATRangeHigh.Action_2_Condition "Fault manager configuration.  Select up to 4 actions for each fault." VALUE 0x80002ABC RecordLayout_4 0 CompuMethod_116 0 65535 /end CHARACTERISTIC
/begin CHARACTERISTIC FaultManager.CATRangeHigh.Action_3 "Fault manager configuration.  Select up to 4 actions for each fault." VALUE 0x80002ABE RecordLayout_4 0 CompuMethod_115 0 65535 /end CHARACTERISTIC
/begin CHARACTERISTIC FaultManager.CATRangeHigh.Action_3_Condition "Fault manager configuration.  Select up to 4 actions for each fault." VALUE 0x80002AC0 RecordLayout_4 0 CompuMethod_116 0 65535 /end CHARACTERISTIC
/begin CHARACTERISTIC FaultManager.CATRangeHigh.Action_4 "Fault manager configuration.  Select up to 4 actions for each fault." VALUE 0x80002AC2 RecordLayout_4 0 CompuMethod_115 0 65535 /end CHARACTERISTIC
/begin CHARACTERISTIC FaultManager.CATRangeHigh.Action_4_Condition "Fault manager configuration.  Select up to 4 actions for each fault." VALUE 0x80002AC4 RecordLayout_4 0 CompuMethod_116 0 65535 /end CHARACTERISTIC
/begin CHARACTERISTIC FaultManager.CATRangeLow.Mode "Fault manager configuration.  Select up to 4 actions for each fault." VALUE 0x80002AC6 RecordLayout_4 0 CompuMethod_113 0 65535 /end CHARACTERISTIC
/begin CHARACTERISTIC FaultManager.CATRangeLow.ID "Fault manager configuration.  Select up to 4 actions for each fault." VALUE 0x80002AC8 RecordLayout_4 0 CompuMethod_1 0 65535 /end CHARACTERISTIC
/begin CHARACTERISTIC FaultManager.CATRangeLow.Test "Fault manager configuration.  Select up to 4 actions for each fault." VALUE 0x80002ACA RecordLayout_4 0 CompuMethod_114 0 65535 /end CHARACTERISTIC
/begin CHARACTERISTIC FaultManager.CATRangeLow.Faulty_Samples__X_ "Fault manager configuration.  Select up to 4 actions for each fault." VALUE 0x80002ACC RecordLayout_4 0 CompuMethod_1 0 65535 /end CHARACTERISTIC
/begin CHARACTERISTIC FaultManager.CATRangeLow.Total_Samples__Y_ "Fault manager configuration.  Select up to 4 actions for each fault." VALUE 0x80002ACE RecordLayout_4 0 CompuMethod_1 0 65535 /end CHARACTERISTIC
/begin CHARACTERISTIC FaultManager.CATRangeLow.Action_1 "Fault manager configuration.  Select up to 4 actions for each fault." VALUE 0x80002AD0 RecordLayout_4 0 CompuMethod_115 0 65535 /end CHARACTERISTIC
/begin CHARACTERISTIC FaultManager.CATRangeLow.Action_1_Condition "Fault manager configuration.  Select up to 4 actions for each fault." VALUE 0x80002AD2 RecordLayout_4 0 CompuMethod_116 0 65535 /end CHARACTERISTIC
/begin CHARACTERISTIC FaultManager.CATRangeLow.Action_2 "Fault manager configuration.  Select up to 4 actions for each fault." VALUE 0x80002AD4 RecordLayout_4 0 CompuMethod_115 0 65535 /end CHARACTERISTIC
/begin CHARACTERISTIC FaultManager.CATRangeLow.Action_2_Condition "Fault manager configuration.  Select up to 4 actions for each fault." VALUE 0x80002AD6 RecordLayout_4 0 CompuMethod_116 0 65535 /end CHARACTERISTIC
/begin CHARACTERISTIC FaultManager.CATRangeLow.Action_3 "Fault manager configuration.  Select up to 4 actions for each fault." VALUE 0x80002AD8 RecordLayout_4 0 CompuMethod_115 0 65535 /end CHARACTERISTIC
/begin CHARACTERISTIC FaultManager.CATRangeLow.Action_3_Condition "Fault manager configuration.  Select up to 4 actions for each fault." VALUE 0x80002ADA RecordLayout_4 0 CompuMethod_116 0 65535 /end CHARACTERISTIC
/begin CHARACTERISTIC FaultManager.CATRangeLow.Action_4 "Fault manager configuration.  Select up to 4 actions for each fault." VALUE 0x80002ADC RecordLayout_4 0 CompuMethod_115 0 65535 /end CHARACTERISTIC
/begin CHARACTERISTIC FaultManager.CATRangeLow.Action_4_Condition "Fault manager configuration.  Select up to 4 actions for each fault." VALUE 0x80002ADE RecordLayout_4 0 CompuMethod_116 0 65535 /end CHARACTERISTIC
/begin CHARACTERISTIC FaultManager.CamEdgesFault.Mode "Fault manager configuration.  Select up to 4 actions for each fault." VALUE 0x80002AE0 RecordLayout_4 0 CompuMethod_113 0 65535 /end CHARACTERISTIC
/begin CHARACTERISTIC FaultManager.CamEdgesFault.ID "Fault manager configuration.  Select up to 4 actions for each fault." VALUE 0x80002AE2 RecordLayout_4 0 CompuMethod_1 0 65535 /end CHARACTERISTIC
/begin CHARACTERISTIC FaultManager.CamEdgesFault.Test "Fault manager configuration.  Select up to 4 actions for each fault." VALUE 0x80002AE4 RecordLayout_4 0 CompuMethod_114 0 65535 /end CHARACTERISTIC
/begin CHARACTERISTIC FaultManager.CamEdgesFault.Faulty_Samples__X_ "Fault manager configuration.  Select up to 4 actions for each fault." VALUE 0x80002AE6 RecordLayout_4 0 CompuMethod_1 0 65535 /end CHARACTERISTIC
/begin CHARACTERISTIC FaultManager.CamEdgesFault.Total_Samples__Y_ "Fault manager configuration.  Select up to 4 actions for each fault." VALUE 0x80002AE8 RecordLayout_4 0 CompuMethod_1 0 65535 /end CHARACTERISTIC
/begin CHARACTERISTIC FaultManager.CamEdgesFault.Action_1 "Fault manager configuration.  Select up to 4 actions for each fault." VALUE 0x80002AEA RecordLayout_4 0 CompuMethod_115 0 65535 /end CHARACTERISTIC
/begin CHARACTERISTIC FaultManager.CamEdgesFault.Action_1_Condition "Fault manager configuration.  Select up to 4 actions for each fault." VALUE 0x80002AEC RecordLayout_4 0 CompuMethod_116 0 65535 /end CHARACTERISTIC
/begin CHARACTERISTIC FaultManager.CamEdgesFault.Action_2 "Fault manager configuration.  Select up to 4 actions for each fault." VALUE 0x80002AEE RecordLayout_4 0 CompuMethod_115 0 65535 /end CHARACTERISTIC
/begin CHARACTERISTIC FaultManager.CamEdgesFault.Action_2_Condition "Fault manager configuration.  Select up to 4 actions for each fault." VALUE 0x80002AF0 RecordLayout_4 0 CompuMethod_116 0 65535 /end CHARACTERISTIC
/begin CHARACTERISTIC FaultManager.CamEdgesFault.Action_3 "Fault manager configuration.  Select up to 4 actions for each fault." VALUE 0x80002AF2 RecordLayout_4 0 CompuMethod_115 0 65535 /end CHARACTERISTIC
/begin CHARACTERISTIC FaultManager.CamEdgesFault.Action_3_Condition "Fault manager configuration.  Select up to 4 actions for each fault." VALUE 0x80002AF4 RecordLayout_4 0 CompuMethod_116 0 65535 /end CHARACTERISTIC
/begin CHARACTERISTIC FaultManager.CamEdgesFault.Action_4 "Fault manager configuration.  Select up to 4 actions for each fault." VALUE 0x80002AF6 RecordLayout_4 0 CompuMethod_115 0 65535 /end CHARACTERISTIC
/begin CHARACTERISTIC FaultManager.CamEdgesFault.Action_4_Condition "Fault manager configuration.  Select up to 4 actions for each fault." VALUE 0x80002AF8 RecordLayout_4 0 CompuMethod_116 0 65535 /end CHARACTERISTIC
/begin CHARACTERISTIC FaultManager.CamSyncFault.Mode "Fault manager configuration.  Select up to 4 actions for each fault." VALUE 0x80002AFA RecordLayout_4 0 CompuMethod_113 0 65535 /end CHARACTERISTIC
/begin CHARACTERISTIC FaultManager.CamSyncFault.ID "Fault manager configuration.  Select up to 4 actions for each fault." VALUE 0x80002AFC RecordLayout_4 0 CompuMethod_1 0 65535 /end CHARACTERISTIC
/begin CHARACTERISTIC FaultManager.CamSyncFault.Test "Fault manager configuration.  Select up to 4 actions for each fault." VALUE 0x80002AFE RecordLayout_4 0 CompuMethod_114 0 65535 /end CHARACTERISTIC
/begin CHARACTERISTIC FaultManager.CamSyncFault.Faulty_Samples__X_ "Fault manager configuration.  Select up to 4 actions for each fault." VALUE 0x80002B00 RecordLayout_4 0 CompuMethod_1 0 65535 /end CHARACTERISTIC
/begin CHARACTERISTIC FaultManager.CamSyncFault.Total_Samples__Y_ "Fault manager configuration.  Select up to 4 actions for each fault." VALUE 0x80002B02 RecordLayout_4 0 CompuMethod_1 0 65535 /end CHARACTERISTIC
/begin CHARACTERISTIC FaultManager.CamSyncFault.Action_1 "Fault manager configuration.  Select up to 4 actions for each fault." VALUE 0x80002B04 RecordLayout_4 0 CompuMethod_115 0 65535 /end CHARACTERISTIC
/begin CHARACTERISTIC FaultManager.CamSyncFault.Action_1_Condition "Fault manager configuration.  Select up to 4 actions for each fault." VALUE 0x80002B06 RecordLayout_4 0 CompuMethod_116 0 65535 /end CHARACTERISTIC
/begin CHARACTERISTIC FaultManager.CamSyncFault.Action_2 "Fault manager configuration.  Select up to 4 actions for each fault." VALUE 0x80002B08 RecordLayout_4 0 CompuMethod_115 0 65535 /end CHARACTERISTIC
/begin CHARACTERISTIC FaultManager.CamSyncFault.Action_2_Condition "Fault manager configuration.  Select up to 4 actions for each fault." VALUE 0x80002B0A RecordLayout_4 0 CompuMethod_116 0 65535 /end CHARACTERISTIC
/begin CHARACTERISTIC FaultManager.CamSyncFault.Action_3 "Fault manager configuration.  Select up to 4 actions for each fault." VALUE 0x80002B0C RecordLayout_4 0 CompuMethod_115 0 65535 /end CHARACTERISTIC
/begin CHARACTERISTIC FaultManager.CamSyncFault.Action_3_Condition "Fault manager configuration.  Select up to 4 actions for each fault." VALUE 0x80002B0E RecordLayout_4 0 CompuMethod_116 0 65535 /end CHARACTERISTIC
/begin CHARACTERISTIC FaultManager.CamSyncFault.Action_4 "Fault manager configuration.  Select up to 4 actions for each fault." VALUE 0x80002B10 RecordLayout_4 0 CompuMethod_115 0 65535 /end CHARACTERISTIC
/begin CHARACTERISTIC FaultManager.CamSyncFault.Action_4_Condition "Fault manager configuration.  Select up to 4 actions for each fault." VALUE 0x80002B12 RecordLayout_4 0 CompuMethod_116 0 65535 /end CHARACTERISTIC
/begin CHARACTERISTIC FaultManager.ClutchStuckHigh_Fault.Mode "Fault manager configuration.  Select up to 4 actions for each fault." VALUE 0x80002B14 RecordLayout_4 0 CompuMethod_113 0 65535 /end CHARACTERISTIC
/begin CHARACTERISTIC FaultManager.ClutchStuckHigh_Fault.ID "Fault manager configuration.  Select up to 4 actions for each fault." VALUE 0x80002B16 RecordLayout_4 0 CompuMethod_1 0 65535 /end CHARACTERISTIC
/begin CHARACTERISTIC FaultManager.ClutchStuckHigh_Fault.Test "Fault manager configuration.  Select up to 4 actions for each fault." VALUE 0x80002B18 RecordLayout_4 0 CompuMethod_114 0 65535 /end CHARACTERISTIC
/begin CHARACTERISTIC FaultManager.ClutchStuckHigh_Fault.Faulty_Samples__X_ "Fault manager configuration.  Select up to 4 actions for each fault." VALUE 0x80002B1A RecordLayout_4 0 CompuMethod_1 0 65535 /end CHARACTERISTIC
/begin CHARACTERISTIC FaultManager.ClutchStuckHigh_Fault.Total_Samples__Y_ "Fault manager configuration.  Select up to 4 actions for each fault." VALUE 0x80002B1C RecordLayout_4 0 CompuMethod_1 0 65535 /end CHARACTERISTIC
/begin CHARACTERISTIC FaultManager.ClutchStuckHigh_Fault.Action_1 "Fault manager configuration.  Select up to 4 actions for each fault." VALUE 0x80002B1E RecordLayout_4 0 CompuMethod_115 0 65535 /end CHARACTERISTIC
/begin CHARACTERISTIC FaultManager.ClutchStuckHigh_Fault.Action_1_Condition "Fault manager configuration.  Select up to 4 actions for each fault." VALUE 0x80002B20 RecordLayout_4 0 CompuMethod_116 0 65535 /end CHARACTERISTIC
/begin CHARACTERISTIC FaultManager.ClutchStuckHigh_Fault.Action_2 "Fault manager configuration.  Select up to 4 actions for each fault." VALUE 0x80002B22 RecordLayout_4 0 CompuMethod_115 0 65535 /end CHARACTERISTIC
/begin CHARACTERISTIC FaultManager.ClutchStuckHigh_Fault.Action_2_Condition "Fault manager configuration.  Select up to 4 actions for each fault." VALUE 0x80002B24 RecordLayout_4 0 CompuMethod_116 0 65535 /end CHARACTERISTIC
/begin CHARACTERISTIC FaultManager.ClutchStuckHigh_Fault.Action_3 "Fault manager configuration.  Select up to 4 actions for each fault." VALUE 0x80002B26 RecordLayout_4 0 CompuMethod_115 0 65535 /end CHARACTERISTIC
/begin CHARACTERISTIC FaultManager.ClutchStuckHigh_Fault.Action_3_Condition "Fault manager configuration.  Select up to 4 actions for each fault." VALUE 0x80002B28 RecordLayout_4 0 CompuMethod_116 0 65535 /end CHARACTERISTIC
/begin CHARACTERISTIC FaultManager.ClutchStuckHigh_Fault.Action_4 "Fault manager configuration.  Select up to 4 actions for each fault." VALUE 0x80002B2A RecordLayout_4 0 CompuMethod_115 0 65535 /end CHARACTERISTIC
/begin CHARACTERISTIC FaultManager.ClutchStuckHigh_Fault.Action_4_Condition "Fault manager configuration.  Select up to 4 actions for each fault." VALUE 0x80002B2C RecordLayout_4 0 CompuMethod_116 0 65535 /end CHARACTERISTIC
/begin CHARACTERISTIC FaultManager.CrankEdgesFault.Mode "Fault manager configuration.  Select up to 4 actions for each fault." VALUE 0x80002B2E RecordLayout_4 0 CompuMethod_113 0 65535 /end CHARACTERISTIC
/begin CHARACTERISTIC FaultManager.CrankEdgesFault.ID "Fault manager configuration.  Select up to 4 actions for each fault." VALUE 0x80002B30 RecordLayout_4 0 CompuMethod_1 0 65535 /end CHARACTERISTIC
/begin CHARACTERISTIC FaultManager.CrankEdgesFault.Test "Fault manager configuration.  Select up to 4 actions for each fault." VALUE 0x80002B32 RecordLayout_4 0 CompuMethod_114 0 65535 /end CHARACTERISTIC
/begin CHARACTERISTIC FaultManager.CrankEdgesFault.Faulty_Samples__X_ "Fault manager configuration.  Select up to 4 actions for each fault." VALUE 0x80002B34 RecordLayout_4 0 CompuMethod_1 0 65535 /end CHARACTERISTIC
/begin CHARACTERISTIC FaultManager.CrankEdgesFault.Total_Samples__Y_ "Fault manager configuration.  Select up to 4 actions for each fault." VALUE 0x80002B36 RecordLayout_4 0 CompuMethod_1 0 65535 /end CHARACTERISTIC
/begin CHARACTERISTIC FaultManager.CrankEdgesFault.Action_1 "Fault manager configuration.  Select up to 4 actions for each fault." VALUE 0x80002B38 RecordLayout_4 0 CompuMethod_115 0 65535 /end CHARACTERISTIC
/begin CHARACTERISTIC FaultManager.CrankEdgesFault.Action_1_Condition "Fault manager configuration.  Select up to 4 actions for each fault." VALUE 0x80002B3A RecordLayout_4 0 CompuMethod_116 0 65535 /end CHARACTERISTIC
/begin CHARACTERISTIC FaultManager.CrankEdgesFault.Action_2 "Fault manager configuration.  Select up to 4 actions for each fault." VALUE 0x80002B3C RecordLayout_4 0 CompuMethod_115 0 65535 /end CHARACTERISTIC
/begin CHARACTERISTIC FaultManager.CrankEdgesFault.Action_2_Condition "Fault manager configuration.  Select up to 4 actions for each fault." VALUE 0x80002B3E RecordLayout_4 0 CompuMethod_116 0 65535 /end CHARACTERISTIC
/begin CHARACTERISTIC FaultManager.CrankEdgesFault.Action_3 "Fault manager configuration.  Select up to 4 actions for each fault." VALUE 0x80002B40 RecordLayout_4 0 CompuMethod_115 0 65535 /end CHARACTERISTIC
/begin CHARACTERISTIC FaultManager.CrankEdgesFault.Action_3_Condition "Fault manager configuration.  Select up to 4 actions for each fault." VALUE 0x80002B42 RecordLayout_4 0 CompuMethod_116 0 65535 /end CHARACTERISTIC
/begin CHARACTERISTIC FaultManager.CrankEdgesFault.Action_4 "Fault manager configuration.  Select up to 4 actions for each fault." VALUE 0x80002B44 RecordLayout_4 0 CompuMethod_115 0 65535 /end CHARACTERISTIC
/begin CHARACTERISTIC FaultManager.CrankEdgesFault.Action_4_Condition "Fault manager configuration.  Select up to 4 actions for each fault." VALUE 0x80002B46 RecordLayout_4 0 CompuMethod_116 0 65535 /end CHARACTERISTIC
/begin CHARACTERISTIC FaultManager.CrankSyncFault.Mode "Fault manager configuration.  Select up to 4 actions for each fault." VALUE 0x80002B48 RecordLayout_4 0 CompuMethod_113 0 65535 /end CHARACTERISTIC
/begin CHARACTERISTIC FaultManager.CrankSyncFault.ID "Fault manager configuration.  Select up to 4 actions for each fault." VALUE 0x80002B4A RecordLayout_4 0 CompuMethod_1 0 65535 /end CHARACTERISTIC
/begin CHARACTERISTIC FaultManager.CrankSyncFault.Test "Fault manager configuration.  Select up to 4 actions for each fault." VALUE 0x80002B4C RecordLayout_4 0 CompuMethod_114 0 65535 /end CHARACTERISTIC
/begin CHARACTERISTIC FaultManager.CrankSyncFault.Faulty_Samples__X_ "Fault manager configuration.  Select up to 4 actions for each fault." VALUE 0x80002B4E RecordLayout_4 0 CompuMethod_1 0 65535 /end CHARACTERISTIC
/begin CHARACTERISTIC FaultManager.CrankSyncFault.Total_Samples__Y_ "Fault manager configuration.  Select up to 4 actions for each fault." VALUE 0x80002B50 RecordLayout_4 0 CompuMethod_1 0 65535 /end CHARACTERISTIC
/begin CHARACTERISTIC FaultManager.CrankSyncFault.Action_1 "Fault manager configuration.  Select up to 4 actions for each fault." VALUE 0x80002B52 RecordLayout_4 0 CompuMethod_115 0 65535 /end CHARACTERISTIC
/begin CHARACTERISTIC FaultManager.CrankSyncFault.Action_1_Condition "Fault manager configuration.  Select up to 4 actions for each fault." VALUE 0x80002B54 RecordLayout_4 0 CompuMethod_116 0 65535 /end CHARACTERISTIC
/begin CHARACTERISTIC FaultManager.CrankSyncFault.Action_2 "Fault manager configuration.  Select up to 4 actions for each fault." VALUE 0x80002B56 RecordLayout_4 0 CompuMethod_115 0 65535 /end CHARACTERISTIC
/begin CHARACTERISTIC FaultManager.CrankSyncFault.Action_2_Condition "Fault manager configuration.  Select up to 4 actions for each fault." VALUE 0x80002B58 RecordLayout_4 0 CompuMethod_116 0 65535 /end CHARACTERISTIC
/begin CHARACTERISTIC FaultManager.CrankSyncFault.Action_3 "Fault manager configuration.  Select up to 4 actions for each fault." VALUE 0x80002B5A RecordLayout_4 0 CompuMethod_115 0 65535 /end CHARACTERISTIC
/begin CHARACTERISTIC FaultManager.CrankSyncFault.Action_3_Condition "Fault manager configuration.  Select up to 4 actions for each fault." VALUE 0x80002B5C RecordLayout_4 0 CompuMethod_116 0 65535 /end CHARACTERISTIC
/begin CHARACTERISTIC FaultManager.CrankSyncFault.Action_4 "Fault manager configuration.  Select up to 4 actions for each fault." VALUE 0x80002B5E RecordLayout_4 0 CompuMethod_115 0 65535 /end CHARACTERISTIC
/begin CHARACTERISTIC FaultManager.CrankSyncFault.Action_4_Condition "Fault manager configuration.  Select up to 4 actions for each fault." VALUE 0x80002B60 RecordLayout_4 0 CompuMethod_116 0 65535 /end CHARACTERISTIC
/begin CHARACTERISTIC FaultManager.Cylinder1_HardMisfire.Mode "Fault manager configuration.  Select up to 4 actions for each fault." VALUE 0x80002B62 RecordLayout_4 0 CompuMethod_113 0 65535 /end CHARACTERISTIC
/begin CHARACTERISTIC FaultManager.Cylinder1_HardMisfire.ID "Fault manager configuration.  Select up to 4 actions for each fault." VALUE 0x80002B64 RecordLayout_4 0 CompuMethod_1 0 65535 /end CHARACTERISTIC
/begin CHARACTERISTIC FaultManager.Cylinder1_HardMisfire.Test "Fault manager configuration.  Select up to 4 actions for each fault." VALUE 0x80002B66 RecordLayout_4 0 CompuMethod_114 0 65535 /end CHARACTERISTIC
/begin CHARACTERISTIC FaultManager.Cylinder1_HardMisfire.Faulty_Samples__X_ "Fault manager configuration.  Select up to 4 actions for each fault." VALUE 0x80002B68 RecordLayout_4 0 CompuMethod_1 0 65535 /end CHARACTERISTIC
/begin CHARACTERISTIC FaultManager.Cylinder1_HardMisfire.Total_Samples__Y_ "Fault manager configuration.  Select up to 4 actions for each fault." VALUE 0x80002B6A RecordLayout_4 0 CompuMethod_1 0 65535 /end CHARACTERISTIC
/begin CHARACTERISTIC FaultManager.Cylinder1_HardMisfire.Action_1 "Fault manager configuration.  Select up to 4 actions for each fault." VALUE 0x80002B6C RecordLayout_4 0 CompuMethod_115 0 65535 /end CHARACTERISTIC
/begin CHARACTERISTIC FaultManager.Cylinder1_HardMisfire.Action_1_Condition "Fault manager configuration.  Select up to 4 actions for each fault." VALUE 0x80002B6E RecordLayout_4 0 CompuMethod_116 0 65535 /end CHARACTERISTIC
/begin CHARACTERISTIC FaultManager.Cylinder1_HardMisfire.Action_2 "Fault manager configuration.  Select up to 4 actions for each fault." VALUE 0x80002B70 RecordLayout_4 0 CompuMethod_115 0 65535 /end CHARACTERISTIC
/begin CHARACTERISTIC FaultManager.Cylinder1_HardMisfire.Action_2_Condition "Fault manager configuration.  Select up to 4 actions for each fault." VALUE 0x80002B72 RecordLayout_4 0 CompuMethod_116 0 65535 /end CHARACTERISTIC
/begin CHARACTERISTIC FaultManager.Cylinder1_HardMisfire.Action_3 "Fault manager configuration.  Select up to 4 actions for each fault." VALUE 0x80002B74 RecordLayout_4 0 CompuMethod_115 0 65535 /end CHARACTERISTIC
/begin CHARACTERISTIC FaultManager.Cylinder1_HardMisfire.Action_3_Condition "Fault manager configuration.  Select up to 4 actions for each fault." VALUE 0x80002B76 RecordLayout_4 0 CompuMethod_116 0 65535 /end CHARACTERISTIC
/begin CHARACTERISTIC FaultManager.Cylinder1_HardMisfire.Action_4 "Fault manager configuration.  Select up to 4 actions for each fault." VALUE 0x80002B78 RecordLayout_4 0 CompuMethod_115 0 65535 /end CHARACTERISTIC
/begin CHARACTERISTIC FaultManager.Cylinder1_HardMisfire.Action_4_Condition "Fault manager configuration.  Select up to 4 actions for each fault." VALUE 0x80002B7A RecordLayout_4 0 CompuMethod_116 0 65535 /end CHARACTERISTIC
/begin CHARACTERISTIC FaultManager.Cylinder2_HardMisfire.Mode "Fault manager configuration.  Select up to 4 actions for each fault." VALUE 0x80002B7C RecordLayout_4 0 CompuMethod_113 0 65535 /end CHARACTERISTIC
/begin CHARACTERISTIC FaultManager.Cylinder2_HardMisfire.ID "Fault manager configuration.  Select up to 4 actions for each fault." VALUE 0x80002B7E RecordLayout_4 0 CompuMethod_1 0 65535 /end CHARACTERISTIC
/begin CHARACTERISTIC FaultManager.Cylinder2_HardMisfire.Test "Fault manager configuration.  Select up to 4 actions for each fault." VALUE 0x80002B80 RecordLayout_4 0 CompuMethod_114 0 65535 /end CHARACTERISTIC
/begin CHARACTERISTIC FaultManager.Cylinder2_HardMisfire.Faulty_Samples__X_ "Fault manager configuration.  Select up to 4 actions for each fault." VALUE 0x80002B82 RecordLayout_4 0 CompuMethod_1 0 65535 /end CHARACTERISTIC
/begin CHARACTERISTIC FaultManager.Cylinder2_HardMisfire.Total_Samples__Y_ "Fault manager configuration.  Select up to 4 actions for each fault." VALUE 0x80002B84 RecordLayout_4 0 CompuMethod_1 0 65535 /end CHARACTERISTIC
/begin CHARACTERISTIC FaultManager.Cylinder2_HardMisfire.Action_1 "Fault manager configuration.  Select up to 4 actions for each fault." VALUE 0x80002B86 RecordLayout_4 0 CompuMethod_115 0 65535 /end CHARACTERISTIC
/begin CHARACTERISTIC FaultManager.Cylinder2_HardMisfire.Action_1_Condition "Fault manager configuration.  Select up to 4 actions for each fault." VALUE 0x80002B88 RecordLayout_4 0 CompuMethod_116 0 65535 /end CHARACTERISTIC
/begin CHARACTERISTIC FaultManager.Cylinder2_HardMisfire.Action_2 "Fault manager configuration.  Select up to 4 actions for each fault." VALUE 0x80002B8A RecordLayout_4 0 CompuMethod_115 0 65535 /end CHARACTERISTIC
/begin CHARACTERISTIC FaultManager.Cylinder2_HardMisfire.Action_2_Condition "Fault manager configuration.  Select up to 4 actions for each fault." VALUE 0x80002B8C RecordLayout_4 0 CompuMethod_116 0 65535 /end CHARACTERISTIC
/begin CHARACTERISTIC FaultManager.Cylinder2_HardMisfire.Action_3 "Fault manager configuration.  Select up to 4 actions for each fault." VALUE 0x80002B8E RecordLayout_4 0 CompuMethod_115 0 65535 /end CHARACTERISTIC
/begin CHARACTERISTIC FaultManager.Cylinder2_HardMisfire.Action_3_Condition "Fault manager configuration.  Select up to 4 actions for each fault." VALUE 0x80002B90 RecordLayout_4 0 CompuMethod_116 0 65535 /end CHARACTERISTIC
/begin CHARACTERISTIC FaultManager.Cylinder2_HardMisfire.Action_4 "Fault manager configuration.  Select up to 4 actions for each fault." VALUE 0x80002B92 RecordLayout_4 0 CompuMethod_115 0 65535 /end CHARACTERISTIC
/begin CHARACTERISTIC FaultManager.Cylinder2_HardMisfire.Action_4_Condition "Fault manager configuration.  Select up to 4 actions for each fault." VALUE 0x80002B94 RecordLayout_4 0 CompuMethod_116 0 65535 /end CHARACTERISTIC
/begin CHARACTERISTIC FaultManager.Cylinder3_HardMisfire.Mode "Fault manager configuration.  Select up to 4 actions for each fault." VALUE 0x80002B96 RecordLayout_4 0 CompuMethod_113 0 65535 /end CHARACTERISTIC
/begin CHARACTERISTIC FaultManager.Cylinder3_HardMisfire.ID "Fault manager configuration.  Select up to 4 actions for each fault." VALUE 0x80002B98 RecordLayout_4 0 CompuMethod_1 0 65535 /end CHARACTERISTIC
/begin CHARACTERISTIC FaultManager.Cylinder3_HardMisfire.Test "Fault manager configuration.  Select up to 4 actions for each fault." VALUE 0x80002B9A RecordLayout_4 0 CompuMethod_114 0 65535 /end CHARACTERISTIC
/begin CHARACTERISTIC FaultManager.Cylinder3_HardMisfire.Faulty_Samples__X_ "Fault manager configuration.  Select up to 4 actions for each fault." VALUE 0x80002B9C RecordLayout_4 0 CompuMethod_1 0 65535 /end CHARACTERISTIC
/begin CHARACTERISTIC FaultManager.Cylinder3_HardMisfire.Total_Samples__Y_ "Fault manager configuration.  Select up to 4 actions for each fault." VALUE 0x80002B9E RecordLayout_4 0 CompuMethod_1 0 65535 /end CHARACTERISTIC
/begin CHARACTERISTIC FaultManager.Cylinder3_HardMisfire.Action_1 "Fault manager configuration.  Select up to 4 actions for each fault." VALUE 0x80002BA0 RecordLayout_4 0 CompuMethod_115 0 65535 /end CHARACTERISTIC
/begin CHARACTERISTIC FaultManager.Cylinder3_HardMisfire.Action_1_Condition "Fault manager configuration.  Select up to 4 actions for each fault." VALUE 0x80002BA2 RecordLayout_4 0 CompuMethod_116 0 65535 /end CHARACTERISTIC
/begin CHARACTERISTIC FaultManager.Cylinder3_HardMisfire.Action_2 "Fault manager configuration.  Select up to 4 actions for each fault." VALUE 0x80002BA4 RecordLayout_4 0 CompuMethod_115 0 65535 /end CHARACTERISTIC
/begin CHARACTERISTIC FaultManager.Cylinder3_HardMisfire.Action_2_Condition "Fault manager configuration.  Select up to 4 actions for each fault." VALUE 0x80002BA6 RecordLayout_4 0 CompuMethod_116 0 65535 /end CHARACTERISTIC
/begin CHARACTERISTIC FaultManager.Cylinder3_HardMisfire.Action_3 "Fault manager configuration.  Select up to 4 actions for each fault." VALUE 0x80002BA8 RecordLayout_4 0 CompuMethod_115 0 65535 /end CHARACTERISTIC
/begin CHARACTERISTIC FaultManager.Cylinder3_HardMisfire.Action_3_Condition "Fault manager configuration.  Select up to 4 actions for each fault." VALUE 0x80002BAA RecordLayout_4 0 CompuMethod_116 0 65535 /end CHARACTERISTIC
/begin CHARACTERISTIC FaultManager.Cylinder3_HardMisfire.Action_4 "Fault manager configuration.  Select up to 4 actions for each fault." VALUE 0x80002BAC RecordLayout_4 0 CompuMethod_115 0 65535 /end CHARACTERISTIC
/begin CHARACTERISTIC FaultManager.Cylinder3_HardMisfire.Action_4_Condition "Fault manager configuration.  Select up to 4 actions for each fault." VALUE 0x80002BAE RecordLayout_4 0 CompuMethod_116 0 65535 /end CHARACTERISTIC
/begin CHARACTERISTIC FaultManager.Cylinder4_HardMisfire.Mode "Fault manager configuration.  Select up to 4 actions for each fault." VALUE 0x80002BB0 RecordLayout_4 0 CompuMethod_113 0 65535 /end CHARACTERISTIC
/begin CHARACTERISTIC FaultManager.Cylinder4_HardMisfire.ID "Fault manager configuration.  Select up to 4 actions for each fault." VALUE 0x80002BB2 RecordLayout_4 0 CompuMethod_1 0 65535 /end CHARACTERISTIC
/begin CHARACTERISTIC FaultManager.Cylinder4_HardMisfire.Test "Fault manager configuration.  Select up to 4 actions for each fault." VALUE 0x80002BB4 RecordLayout_4 0 CompuMethod_114 0 65535 /end CHARACTERISTIC
/begin CHARACTERISTIC FaultManager.Cylinder4_HardMisfire.Faulty_Samples__X_ "Fault manager configuration.  Select up to 4 actions for each fault." VALUE 0x80002BB6 RecordLayout_4 0 CompuMethod_1 0 65535 /end CHARACTERISTIC
/begin CHARACTERISTIC FaultManager.Cylinder4_HardMisfire.Total_Samples__Y_ "Fault manager configuration.  Select up to 4 actions for each fault." VALUE 0x80002BB8 RecordLayout_4 0 CompuMethod_1 0 65535 /end CHARACTERISTIC
/begin CHARACTERISTIC FaultManager.Cylinder4_HardMisfire.Action_1 "Fault manager configuration.  Select up to 4 actions for each fault." VALUE 0x80002BBA RecordLayout_4 0 CompuMethod_115 0 65535 /end CHARACTERISTIC
/begin CHARACTERISTIC FaultManager.Cylinder4_HardMisfire.Action_1_Condition "Fault manager configuration.  Select up to 4 actions for each fault." VALUE 0x80002BBC RecordLayout_4 0 CompuMethod_116 0 65535 /end CHARACTERISTIC
/begin CHARACTERISTIC FaultManager.Cylinder4_HardMisfire.Action_2 "Fault manager configuration.  Select up to 4 actions for each fault." VALUE 0x80002BBE RecordLayout_4 0 CompuMethod_115 0 65535 /end CHARACTERISTIC
/begin CHARACTERISTIC FaultManager.Cylinder4_HardMisfire.Action_2_Condition "Fault manager configuration.  Select up to 4 actions for each fault." VALUE 0x80002BC0 RecordLayout_4 0 CompuMethod_116 0 65535 /end CHARACTERISTIC
/begin CHARACTERISTIC FaultManager.Cylinder4_HardMisfire.Action_3 "Fault manager configuration.  Select up to 4 actions for each fault." VALUE 0x80002BC2 RecordLayout_4 0 CompuMethod_115 0 65535 /end CHARACTERISTIC
/begin CHARACTERISTIC FaultManager.Cylinder4_HardMisfire.Action_3_Condition "Fault manager configuration.  Select up to 4 actions for each fault." VALUE 0x80002BC4 RecordLayout_4 0 CompuMethod_116 0 65535 /end CHARACTERISTIC
/begin CHARACTERISTIC FaultManager.Cylinder4_HardMisfire.Action_4 "Fault manager configuration.  Select up to 4 actions for each fault." VALUE 0x80002BC6 RecordLayout_4 0 CompuMethod_115 0 65535 /end CHARACTERISTIC
/begin CHARACTERISTIC FaultManager.Cylinder4_HardMisfire.Action_4_Condition "Fault manager configuration.  Select up to 4 actions for each fault." VALUE 0x80002BC8 RecordLayout_4 0 CompuMethod_116 0 65535 /end CHARACTERISTIC
/begin CHARACTERISTIC FaultManager.Cylinder5_HardMisfire.Mode "Fault manager configuration.  Select up to 4 actions for each fault." VALUE 0x80002BCA RecordLayout_4 0 CompuMethod_113 0 65535 /end CHARACTERISTIC
/begin CHARACTERISTIC FaultManager.Cylinder5_HardMisfire.ID "Fault manager configuration.  Select up to 4 actions for each fault." VALUE 0x80002BCC RecordLayout_4 0 CompuMethod_1 0 65535 /end CHARACTERISTIC
/begin CHARACTERISTIC FaultManager.Cylinder5_HardMisfire.Test "Fault manager configuration.  Select up to 4 actions for each fault." VALUE 0x80002BCE RecordLayout_4 0 CompuMethod_114 0 65535 /end CHARACTERISTIC
/begin CHARACTERISTIC FaultManager.Cylinder5_HardMisfire.Faulty_Samples__X_ "Fault manager configuration.  Select up to 4 actions for each fault." VALUE 0x80002BD0 RecordLayout_4 0 CompuMethod_1 0 65535 /end CHARACTERISTIC
/begin CHARACTERISTIC FaultManager.Cylinder5_HardMisfire.Total_Samples__Y_ "Fault manager configuration.  Select up to 4 actions for each fault." VALUE 0x80002BD2 RecordLayout_4 0 CompuMethod_1 0 65535 /end CHARACTERISTIC
/begin CHARACTERISTIC FaultManager.Cylinder5_HardMisfire.Action_1 "Fault manager configuration.  Select up to 4 actions for each fault." VALUE 0x80002BD4 RecordLayout_4 0 CompuMethod_115 0 65535 /end CHARACTERISTIC
/begin CHARACTERISTIC FaultManager.Cylinder5_HardMisfire.Action_1_Condition "Fault manager configuration.  Select up to 4 actions for each fault." VALUE 0x80002BD6 RecordLayout_4 0 CompuMethod_116 0 65535 /end CHARACTERISTIC
/begin CHARACTERISTIC FaultManager.Cylinder5_HardMisfire.Action_2 "Fault manager configuration.  Select up to 4 actions for each fault." VALUE 0x80002BD8 RecordLayout_4 0 CompuMethod_115 0 65535 /end CHARACTERISTIC
/begin CHARACTERISTIC FaultManager.Cylinder5_HardMisfire.Action_2_Condition "Fault manager configuration.  Select up to 4 actions for each fault." VALUE 0x80002BDA RecordLayout_4 0 CompuMethod_116 0 65535 /end CHARACTERISTIC
/begin CHARACTERISTIC FaultManager.Cylinder5_HardMisfire.Action_3 "Fault manager configuration.  Select up to 4 actions for each fault." VALUE 0x80002BDC RecordLayout_4 0 CompuMethod_115 0 65535 /end CHARACTERISTIC
/begin CHARACTERISTIC FaultManager.Cylinder5_HardMisfire.Action_3_Condition "Fault manager configuration.  Select up to 4 actions for each fault." VALUE 0x80002BDE RecordLayout_4 0 CompuMethod_116 0 65535 /end CHARACTERISTIC
/begin CHARACTERISTIC FaultManager.Cylinder5_HardMisfire.Action_4 "Fault manager configuration.  Select up to 4 actions for each fault." VALUE 0x80002BE0 RecordLayout_4 0 CompuMethod_115 0 65535 /end CHARACTERISTIC
/begin CHARACTERISTIC FaultManager.Cylinder5_HardMisfire.Action_4_Condition "Fault manager configuration.  Select up to 4 actions for each fault." VALUE 0x80002BE2 RecordLayout_4 0 CompuMethod_116 0 65535 /end CHARACTERISTIC
/begin CHARACTERISTIC FaultManager.Cylinder6_HardMisfire.Mode "Fault manager configuration.  Select up to 4 actions for each fault." VALUE 0x80002BE4 RecordLayout_4 0 CompuMethod_113 0 65535 /end CHARACTERISTIC
/begin CHARACTERISTIC FaultManager.Cylinder6_HardMisfire.ID "Fault manager configuration.  Select up to 4 actions for each fault." VALUE 0x80002BE6 RecordLayout_4 0 CompuMethod_1 0 65535 /end CHARACTERISTIC
/begin CHARACTERISTIC FaultManager.Cylinder6_HardMisfire.Test "Fault manager configuration.  Select up to 4 actions for each fault." VALUE 0x80002BE8 RecordLayout_4 0 CompuMethod_114 0 65535 /end CHARACTERISTIC
/begin CHARACTERISTIC FaultManager.Cylinder6_HardMisfire.Faulty_Samples__X_ "Fault manager configuration.  Select up to 4 actions for each fault." VALUE 0x80002BEA RecordLayout_4 0 CompuMethod_1 0 65535 /end CHARACTERISTIC
/begin CHARACTERISTIC FaultManager.Cylinder6_HardMisfire.Total_Samples__Y_ "Fault manager configuration.  Select up to 4 actions for each fault." VALUE 0x80002BEC RecordLayout_4 0 CompuMethod_1 0 65535 /end CHARACTERISTIC
/begin CHARACTERISTIC FaultManager.Cylinder6_HardMisfire.Action_1 "Fault manager configuration.  Select up to 4 actions for each fault." VALUE 0x80002BEE RecordLayout_4 0 CompuMethod_115 0 65535 /end CHARACTERISTIC
/begin CHARACTERISTIC FaultManager.Cylinder6_HardMisfire.Action_1_Condition "Fault manager configuration.  Select up to 4 actions for each fault." VALUE 0x80002BF0 RecordLayout_4 0 CompuMethod_116 0 65535 /end CHARACTERISTIC
/begin CHARACTERISTIC FaultManager.Cylinder6_HardMisfire.Action_2 "Fault manager configuration.  Select up to 4 actions for each fault." VALUE 0x80002BF2 RecordLayout_4 0 CompuMethod_115 0 65535 /end CHARACTERISTIC
/begin CHARACTERISTIC FaultManager.Cylinder6_HardMisfire.Action_2_Condition "Fault manager configuration.  Select up to 4 actions for each fault." VALUE 0x80002BF4 RecordLayout_4 0 CompuMethod_116 0 65535 /end CHARACTERISTIC
/begin CHARACTERISTIC FaultManager.Cylinder6_HardMisfire.Action_3 "Fault manager configuration.  Select up to 4 actions for each fault." VALUE 0x80002BF6 RecordLayout_4 0 CompuMethod_115 0 65535 /end CHARACTERISTIC
/begin CHARACTERISTIC FaultManager.Cylinder6_HardMisfire.Action_3_Condition "Fault manager configuration.  Select up to 4 actions for each fault." VALUE 0x80002BF8 RecordLayout_4 0 CompuMethod_116 0 65535 /end CHARACTERISTIC
/begin CHARACTERISTIC FaultManager.Cylinder6_HardMisfire.Action_4 "Fault manager configuration.  Select up to 4 actions for each fault." VALUE 0x80002BFA RecordLayout_4 0 CompuMethod_115 0 65535 /end CHARACTERISTIC
/begin CHARACTERISTIC FaultManager.Cylinder6_HardMisfire.Action_4_Condition "Fault manager configuration.  Select up to 4 actions for each fault." VALUE 0x80002BFC RecordLayout_4 0 CompuMethod_116 0 65535 /end CHARACTERISTIC
/begin CHARACTERISTIC FaultManager.Cylinder7_HardMisfire.Mode "Fault manager configuration.  Select up to 4 actions for each fault." VALUE 0x80002BFE RecordLayout_4 0 CompuMethod_113 0 65535 /end CHARACTERISTIC
/begin CHARACTERISTIC FaultManager.Cylinder7_HardMisfire.ID "Fault manager configuration.  Select up to 4 actions for each fault." VALUE 0x80002C00 RecordLayout_4 0 CompuMethod_1 0 65535 /end CHARACTERISTIC
/begin CHARACTERISTIC FaultManager.Cylinder7_HardMisfire.Test "Fault manager configuration.  Select up to 4 actions for each fault." VALUE 0x80002C02 RecordLayout_4 0 CompuMethod_114 0 65535 /end CHARACTERISTIC
/begin CHARACTERISTIC FaultManager.Cylinder7_HardMisfire.Faulty_Samples__X_ "Fault manager configuration.  Select up to 4 actions for each fault." VALUE 0x80002C04 RecordLayout_4 0 CompuMethod_1 0 65535 /end CHARACTERISTIC
/begin CHARACTERISTIC FaultManager.Cylinder7_HardMisfire.Total_Samples__Y_ "Fault manager configuration.  Select up to 4 actions for each fault." VALUE 0x80002C06 RecordLayout_4 0 CompuMethod_1 0 65535 /end CHARACTERISTIC
/begin CHARACTERISTIC FaultManager.Cylinder7_HardMisfire.Action_1 "Fault manager configuration.  Select up to 4 actions for each fault." VALUE 0x80002C08 RecordLayout_4 0 CompuMethod_115 0 65535 /end CHARACTERISTIC
/begin CHARACTERISTIC FaultManager.Cylinder7_HardMisfire.Action_1_Condition "Fault manager configuration.  Select up to 4 actions for each fault." VALUE 0x80002C0A RecordLayout_4 0 CompuMethod_116 0 65535 /end CHARACTERISTIC
/begin CHARACTERISTIC FaultManager.Cylinder7_HardMisfire.Action_2 "Fault manager configuration.  Select up to 4 actions for each fault." VALUE 0x80002C0C RecordLayout_4 0 CompuMethod_115 0 65535 /end CHARACTERISTIC
/begin CHARACTERISTIC FaultManager.Cylinder7_HardMisfire.Action_2_Condition "Fault manager configuration.  Select up to 4 actions for each fault." VALUE 0x80002C0E RecordLayout_4 0 CompuMethod_116 0 65535 /end CHARACTERISTIC
/begin CHARACTERISTIC FaultManager.Cylinder7_HardMisfire.Action_3 "Fault manager configuration.  Select up to 4 actions for each fault." VALUE 0x80002C10 RecordLayout_4 0 CompuMethod_115 0 65535 /end CHARACTERISTIC
/begin CHARACTERISTIC FaultManager.Cylinder7_HardMisfire.Action_3_Condition "Fault manager configuration.  Select up to 4 actions for each fault." VALUE 0x80002C12 RecordLayout_4 0 CompuMethod_116 0 65535 /end CHARACTERISTIC
/begin CHARACTERISTIC FaultManager.Cylinder7_HardMisfire.Action_4 "Fault manager configuration.  Select up to 4 actions for each fault." VALUE 0x80002C14 RecordLayout_4 0 CompuMethod_115 0 65535 /end CHARACTERISTIC
/begin CHARACTERISTIC FaultManager.Cylinder7_HardMisfire.Action_4_Condition "Fault manager configuration.  Select up to 4 actions for each fault." VALUE 0x80002C16 RecordLayout_4 0 CompuMethod_116 0 65535 /end CHARACTERISTIC
/begin CHARACTERISTIC FaultManager.Cylinder8_HardMisfire.Mode "Fault manager configuration.  Select up to 4 actions for each fault." VALUE 0x80002C18 RecordLayout_4 0 CompuMethod_113 0 65535 /end CHARACTERISTIC
/begin CHARACTERISTIC FaultManager.Cylinder8_HardMisfire.ID "Fault manager configuration.  Select up to 4 actions for each fault." VALUE 0x80002C1A RecordLayout_4 0 CompuMethod_1 0 65535 /end CHARACTERISTIC
/begin CHARACTERISTIC FaultManager.Cylinder8_HardMisfire.Test "Fault manager configuration.  Select up to 4 actions for each fault." VALUE 0x80002C1C RecordLayout_4 0 CompuMethod_114 0 65535 /end CHARACTERISTIC
/begin CHARACTERISTIC FaultManager.Cylinder8_HardMisfire.Faulty_Samples__X_ "Fault manager configuration.  Select up to 4 actions for each fault." VALUE 0x80002C1E RecordLayout_4 0 CompuMethod_1 0 65535 /end CHARACTERISTIC
/begin CHARACTERISTIC FaultManager.Cylinder8_HardMisfire.Total_Samples__Y_ "Fault manager configuration.  Select up to 4 actions for each fault." VALUE 0x80002C20 RecordLayout_4 0 CompuMethod_1 0 65535 /end CHARACTERISTIC
/begin CHARACTERISTIC FaultManager.Cylinder8_HardMisfire.Action_1 "Fault manager configuration.  Select up to 4 actions for each fault." VALUE 0x80002C22 RecordLayout_4 0 CompuMethod_115 0 65535 /end CHARACTERISTIC
/begin CHARACTERISTIC FaultManager.Cylinder8_HardMisfire.Action_1_Condition "Fault manager configuration.  Select up to 4 actions for each fault." VALUE 0x80002C24 RecordLayout_4 0 CompuMethod_116 0 65535 /end CHARACTERISTIC
/begin CHARACTERISTIC FaultManager.Cylinder8_HardMisfire.Action_2 "Fault manager configuration.  Select up to 4 actions for each fault." VALUE 0x80002C26 RecordLayout_4 0 CompuMethod_115 0 65535 /end CHARACTERISTIC
/begin CHARACTERISTIC FaultManager.Cylinder8_HardMisfire.Action_2_Condition "Fault manager configuration.  Select up to 4 actions for each fault." VALUE 0x80002C28 RecordLayout_4 0 CompuMethod_116 0 65535 /end CHARACTERISTIC
/begin CHARACTERISTIC FaultManager.Cylinder8_HardMisfire.Action_3 "Fault manager configuration.  Select up to 4 actions for each fault." VALUE 0x80002C2A RecordLayout_4 0 CompuMethod_115 0 65535 /end CHARACTERISTIC
/begin CHARACTERISTIC FaultManager.Cylinder8_HardMisfire.Action_3_Condition "Fault manager configuration.  Select up to 4 actions for each fault." VALUE 0x80002C2C RecordLayout_4 0 CompuMethod_116 0 65535 /end CHARACTERISTIC
/begin CHARACTERISTIC FaultManager.Cylinder8_HardMisfire.Action_4 "Fault manager configuration.  Select up to 4 actions for each fault." VALUE 0x80002C2E RecordLayout_4 0 CompuMethod_115 0 65535 /end CHARACTERISTIC
/begin CHARACTERISTIC FaultManager.Cylinder8_HardMisfire.Action_4_Condition "Fault manager configuration.  Select up to 4 actions for each fault." VALUE 0x80002C30 RecordLayout_4 0 CompuMethod_116 0 65535 /end CHARACTERISTIC
/begin CHARACTERISTIC FaultManager.ECTOverTempFault.Mode "Fault manager configuration.  Select up to 4 actions for each fault." VALUE 0x80002C32 RecordLayout_4 0 CompuMethod_113 0 65535 /end CHARACTERISTIC
/begin CHARACTERISTIC FaultManager.ECTOverTempFault.ID "Fault manager configuration.  Select up to 4 actions for each fault." VALUE 0x80002C34 RecordLayout_4 0 CompuMethod_1 0 65535 /end CHARACTERISTIC
/begin CHARACTERISTIC FaultManager.ECTOverTempFault.Test "Fault manager configuration.  Select up to 4 actions for each fault." VALUE 0x80002C36 RecordLayout_4 0 CompuMethod_114 0 65535 /end CHARACTERISTIC
/begin CHARACTERISTIC FaultManager.ECTOverTempFault.Faulty_Samples__X_ "Fault manager configuration.  Select up to 4 actions for each fault." VALUE 0x80002C38 RecordLayout_4 0 CompuMethod_1 0 65535 /end CHARACTERISTIC
/begin CHARACTERISTIC FaultManager.ECTOverTempFault.Total_Samples__Y_ "Fault manager configuration.  Select up to 4 actions for each fault." VALUE 0x80002C3A RecordLayout_4 0 CompuMethod_1 0 65535 /end CHARACTERISTIC
/begin CHARACTERISTIC FaultManager.ECTOverTempFault.Action_1 "Fault manager configuration.  Select up to 4 actions for each fault." VALUE 0x80002C3C RecordLayout_4 0 CompuMethod_115 0 65535 /end CHARACTERISTIC
/begin CHARACTERISTIC FaultManager.ECTOverTempFault.Action_1_Condition "Fault manager configuration.  Select up to 4 actions for each fault." VALUE 0x80002C3E RecordLayout_4 0 CompuMethod_116 0 65535 /end CHARACTERISTIC
/begin CHARACTERISTIC FaultManager.ECTOverTempFault.Action_2 "Fault manager configuration.  Select up to 4 actions for each fault." VALUE 0x80002C40 RecordLayout_4 0 CompuMethod_115 0 65535 /end CHARACTERISTIC
/begin CHARACTERISTIC FaultManager.ECTOverTempFault.Action_2_Condition "Fault manager configuration.  Select up to 4 actions for each fault." VALUE 0x80002C42 RecordLayout_4 0 CompuMethod_116 0 65535 /end CHARACTERISTIC
/begin CHARACTERISTIC FaultManager.ECTOverTempFault.Action_3 "Fault manager configuration.  Select up to 4 actions for each fault." VALUE 0x80002C44 RecordLayout_4 0 CompuMethod_115 0 65535 /end CHARACTERISTIC
/begin CHARACTERISTIC FaultManager.ECTOverTempFault.Action_3_Condition "Fault manager configuration.  Select up to 4 actions for each fault." VALUE 0x80002C46 RecordLayout_4 0 CompuMethod_116 0 65535 /end CHARACTERISTIC
/begin CHARACTERISTIC FaultManager.ECTOverTempFault.Action_4 "Fault manager configuration.  Select up to 4 actions for each fault." VALUE 0x80002C48 RecordLayout_4 0 CompuMethod_115 0 65535 /end CHARACTERISTIC
/begin CHARACTERISTIC FaultManager.ECTOverTempFault.Action_4_Condition "Fault manager configuration.  Select up to 4 actions for each fault." VALUE 0x80002C4A RecordLayout_4 0 CompuMethod_116 0 65535 /end CHARACTERISTIC
/begin CHARACTERISTIC FaultManager.ECTRangeHigh.Mode "Fault manager configuration.  Select up to 4 actions for each fault." VALUE 0x80002C4C RecordLayout_4 0 CompuMethod_113 0 65535 /end CHARACTERISTIC
/begin CHARACTERISTIC FaultManager.ECTRangeHigh.ID "Fault manager configuration.  Select up to 4 actions for each fault." VALUE 0x80002C4E RecordLayout_4 0 CompuMethod_1 0 65535 /end CHARACTERISTIC
/begin CHARACTERISTIC FaultManager.ECTRangeHigh.Test "Fault manager configuration.  Select up to 4 actions for each fault." VALUE 0x80002C50 RecordLayout_4 0 CompuMethod_114 0 65535 /end CHARACTERISTIC
/begin CHARACTERISTIC FaultManager.ECTRangeHigh.Faulty_Samples__X_ "Fault manager configuration.  Select up to 4 actions for each fault." VALUE 0x80002C52 RecordLayout_4 0 CompuMethod_1 0 65535 /end CHARACTERISTIC
/begin CHARACTERISTIC FaultManager.ECTRangeHigh.Total_Samples__Y_ "Fault manager configuration.  Select up to 4 actions for each fault." VALUE 0x80002C54 RecordLayout_4 0 CompuMethod_1 0 65535 /end CHARACTERISTIC
/begin CHARACTERISTIC FaultManager.ECTRangeHigh.Action_1 "Fault manager configuration.  Select up to 4 actions for each fault." VALUE 0x80002C56 RecordLayout_4 0 CompuMethod_115 0 65535 /end CHARACTERISTIC
/begin CHARACTERISTIC FaultManager.ECTRangeHigh.Action_1_Condition "Fault manager configuration.  Select up to 4 actions for each fault." VALUE 0x80002C58 RecordLayout_4 0 CompuMethod_116 0 65535 /end CHARACTERISTIC
/begin CHARACTERISTIC FaultManager.ECTRangeHigh.Action_2 "Fault manager configuration.  Select up to 4 actions for each fault." VALUE 0x80002C5A RecordLayout_4 0 CompuMethod_115 0 65535 /end CHARACTERISTIC
/begin CHARACTERISTIC FaultManager.ECTRangeHigh.Action_2_Condition "Fault manager configuration.  Select up to 4 actions for each fault." VALUE 0x80002C5C RecordLayout_4 0 CompuMethod_116 0 65535 /end CHARACTERISTIC
/begin CHARACTERISTIC FaultManager.ECTRangeHigh.Action_3 "Fault manager configuration.  Select up to 4 actions for each fault." VALUE 0x80002C5E RecordLayout_4 0 CompuMethod_115 0 65535 /end CHARACTERISTIC
/begin CHARACTERISTIC FaultManager.ECTRangeHigh.Action_3_Condition "Fault manager configuration.  Select up to 4 actions for each fault." VALUE 0x80002C60 RecordLayout_4 0 CompuMethod_116 0 65535 /end CHARACTERISTIC
/begin CHARACTERISTIC FaultManager.ECTRangeHigh.Action_4 "Fault manager configuration.  Select up to 4 actions for each fault." VALUE 0x80002C62 RecordLayout_4 0 CompuMethod_115 0 65535 /end CHARACTERISTIC
/begin CHARACTERISTIC FaultManager.ECTRangeHigh.Action_4_Condition "Fault manager configuration.  Select up to 4 actions for each fault." VALUE 0x80002C64 RecordLayout_4 0 CompuMethod_116 0 65535 /end CHARACTERISTIC
/begin CHARACTERISTIC FaultManager.ECTRangeLow.Mode "Fault manager configuration.  Select up to 4 actions for each fault." VALUE 0x80002C66 RecordLayout_4 0 CompuMethod_113 0 65535 /end CHARACTERISTIC
/begin CHARACTERISTIC FaultManager.ECTRangeLow.ID "Fault manager configuration.  Select up to 4 actions for each fault." VALUE 0x80002C68 RecordLayout_4 0 CompuMethod_1 0 65535 /end CHARACTERISTIC
/begin CHARACTERISTIC FaultManager.ECTRangeLow.Test "Fault manager configuration.  Select up to 4 actions for each fault." VALUE 0x80002C6A RecordLayout_4 0 CompuMethod_114 0 65535 /end CHARACTERISTIC
/begin CHARACTERISTIC FaultManager.ECTRangeLow.Faulty_Samples__X_ "Fault manager configuration.  Select up to 4 actions for each fault." VALUE 0x80002C6C RecordLayout_4 0 CompuMethod_1 0 65535 /end CHARACTERISTIC
/begin CHARACTERISTIC FaultManager.ECTRangeLow.Total_Samples__Y_ "Fault manager configuration.  Select up to 4 actions for each fault." VALUE 0x80002C6E RecordLayout_4 0 CompuMethod_1 0 65535 /end CHARACTERISTIC
/begin CHARACTERISTIC FaultManager.ECTRangeLow.Action_1 "Fault manager configuration.  Select up to 4 actions for each fault." VALUE 0x80002C70 RecordLayout_4 0 CompuMethod_115 0 65535 /end CHARACTERISTIC
/begin CHARACTERISTIC FaultManager.ECTRangeLow.Action_1_Condition "Fault manager configuration.  Select up to 4 actions for each fault." VALUE 0x80002C72 RecordLayout_4 0 CompuMethod_116 0 65535 /end CHARACTERISTIC
/begin CHARACTERISTIC FaultManager.ECTRangeLow.Action_2 "Fault manager configuration.  Select up to 4 actions for each fault." VALUE 0x80002C74 RecordLayout_4 0 CompuMethod_115 0 65535 /end CHARACTERISTIC
/begin CHARACTERISTIC FaultManager.ECTRangeLow.Action_2_Condition "Fault manager configuration.  Select up to 4 actions for each fault." VALUE 0x80002C76 RecordLayout_4 0 CompuMethod_116 0 65535 /end CHARACTERISTIC
/begin CHARACTERISTIC FaultManager.ECTRangeLow.Action_3 "Fault manager configuration.  Select up to 4 actions for each fault." VALUE 0x80002C78 RecordLayout_4 0 CompuMethod_115 0 65535 /end CHARACTERISTIC
/begin CHARACTERISTIC FaultManager.ECTRangeLow.Action_3_Condition "Fault manager configuration.  Select up to 4 actions for each fault." VALUE 0x80002C7A RecordLayout_4 0 CompuMethod_116 0 65535 /end CHARACTERISTIC
/begin CHARACTERISTIC FaultManager.ECTRangeLow.Action_4 "Fault manager configuration.  Select up to 4 actions for each fault." VALUE 0x80002C7C RecordLayout_4 0 CompuMethod_115 0 65535 /end CHARACTERISTIC
/begin CHARACTERISTIC FaultManager.ECTRangeLow.Action_4_Condition "Fault manager configuration.  Select up to 4 actions for each fault." VALUE 0x80002C7E RecordLayout_4 0 CompuMethod_116 0 65535 /end CHARACTERISTIC
/begin CHARACTERISTIC FaultManager.ECTSevereOverTempFault.Mode "Fault manager configuration.  Select up to 4 actions for each fault." VALUE 0x80002C80 RecordLayout_4 0 CompuMethod_113 0 65535 /end CHARACTERISTIC
/begin CHARACTERISTIC FaultManager.ECTSevereOverTempFault.ID "Fault manager configuration.  Select up to 4 actions for each fault." VALUE 0x80002C82 RecordLayout_4 0 CompuMethod_1 0 65535 /end CHARACTERISTIC
/begin CHARACTERISTIC FaultManager.ECTSevereOverTempFault.Test "Fault manager configuration.  Select up to 4 actions for each fault." VALUE 0x80002C84 RecordLayout_4 0 CompuMethod_114 0 65535 /end CHARACTERISTIC
/begin CHARACTERISTIC FaultManager.ECTSevereOverTempFault.Faulty_Samples__X_ "Fault manager configuration.  Select up to 4 actions for each fault." VALUE 0x80002C86 RecordLayout_4 0 CompuMethod_1 0 65535 /end CHARACTERISTIC
/begin CHARACTERISTIC FaultManager.ECTSevereOverTempFault.Total_Samples__Y_ "Fault manager configuration.  Select up to 4 actions for each fault." VALUE 0x80002C88 RecordLayout_4 0 CompuMethod_1 0 65535 /end CHARACTERISTIC
/begin CHARACTERISTIC FaultManager.ECTSevereOverTempFault.Action_1 "Fault manager configuration.  Select up to 4 actions for each fault." VALUE 0x80002C8A RecordLayout_4 0 CompuMethod_115 0 65535 /end CHARACTERISTIC
/begin CHARACTERISTIC FaultManager.ECTSevereOverTempFault.Action_1_Condition "Fault manager configuration.  Select up to 4 actions for each fault." VALUE 0x80002C8C RecordLayout_4 0 CompuMethod_116 0 65535 /end CHARACTERISTIC
/begin CHARACTERISTIC FaultManager.ECTSevereOverTempFault.Action_2 "Fault manager configuration.  Select up to 4 actions for each fault." VALUE 0x80002C8E RecordLayout_4 0 CompuMethod_115 0 65535 /end CHARACTERISTIC
/begin CHARACTERISTIC FaultManager.ECTSevereOverTempFault.Action_2_Condition "Fault manager configuration.  Select up to 4 actions for each fault." VALUE 0x80002C90 RecordLayout_4 0 CompuMethod_116 0 65535 /end CHARACTERISTIC
/begin CHARACTERISTIC FaultManager.ECTSevereOverTempFault.Action_3 "Fault manager configuration.  Select up to 4 actions for each fault." VALUE 0x80002C92 RecordLayout_4 0 CompuMethod_115 0 65535 /end CHARACTERISTIC
/begin CHARACTERISTIC FaultManager.ECTSevereOverTempFault.Action_3_Condition "Fault manager configuration.  Select up to 4 actions for each fault." VALUE 0x80002C94 RecordLayout_4 0 CompuMethod_116 0 65535 /end CHARACTERISTIC
/begin CHARACTERISTIC FaultManager.ECTSevereOverTempFault.Action_4 "Fault manager configuration.  Select up to 4 actions for each fault." VALUE 0x80002C96 RecordLayout_4 0 CompuMethod_115 0 65535 /end CHARACTERISTIC
/begin CHARACTERISTIC FaultManager.ECTSevereOverTempFault.Action_4_Condition "Fault manager configuration.  Select up to 4 actions for each fault." VALUE 0x80002C98 RecordLayout_4 0 CompuMethod_116 0 65535 /end CHARACTERISTIC
/begin CHARACTERISTIC FaultManager.EST1_Open.Mode "Fault manager configuration.  Select up to 4 actions for each fault." VALUE 0x80002C9A RecordLayout_4 0 CompuMethod_113 0 65535 /end CHARACTERISTIC
/begin CHARACTERISTIC FaultManager.EST1_Open.ID "Fault manager configuration.  Select up to 4 actions for each fault." VALUE 0x80002C9C RecordLayout_4 0 CompuMethod_1 0 65535 /end CHARACTERISTIC
/begin CHARACTERISTIC FaultManager.EST1_Open.Test "Fault manager configuration.  Select up to 4 actions for each fault." VALUE 0x80002C9E RecordLayout_4 0 CompuMethod_114 0 65535 /end CHARACTERISTIC
/begin CHARACTERISTIC FaultManager.EST1_Open.Faulty_Samples__X_ "Fault manager configuration.  Select up to 4 actions for each fault." VALUE 0x80002CA0 RecordLayout_4 0 CompuMethod_1 0 65535 /end CHARACTERISTIC
/begin CHARACTERISTIC FaultManager.EST1_Open.Total_Samples__Y_ "Fault manager configuration.  Select up to 4 actions for each fault." VALUE 0x80002CA2 RecordLayout_4 0 CompuMethod_1 0 65535 /end CHARACTERISTIC
/begin CHARACTERISTIC FaultManager.EST1_Open.Action_1 "Fault manager configuration.  Select up to 4 actions for each fault." VALUE 0x80002CA4 RecordLayout_4 0 CompuMethod_115 0 65535 /end CHARACTERISTIC
/begin CHARACTERISTIC FaultManager.EST1_Open.Action_1_Condition "Fault manager configuration.  Select up to 4 actions for each fault." VALUE 0x80002CA6 RecordLayout_4 0 CompuMethod_116 0 65535 /end CHARACTERISTIC
/begin CHARACTERISTIC FaultManager.EST1_Open.Action_2 "Fault manager configuration.  Select up to 4 actions for each fault." VALUE 0x80002CA8 RecordLayout_4 0 CompuMethod_115 0 65535 /end CHARACTERISTIC
/begin CHARACTERISTIC FaultManager.EST1_Open.Action_2_Condition "Fault manager configuration.  Select up to 4 actions for each fault." VALUE 0x80002CAA RecordLayout_4 0 CompuMethod_116 0 65535 /end CHARACTERISTIC
/begin CHARACTERISTIC FaultManager.EST1_Open.Action_3 "Fault manager configuration.  Select up to 4 actions for each fault." VALUE 0x80002CAC RecordLayout_4 0 CompuMethod_115 0 65535 /end CHARACTERISTIC
/begin CHARACTERISTIC FaultManager.EST1_Open.Action_3_Condition "Fault manager configuration.  Select up to 4 actions for each fault." VALUE 0x80002CAE RecordLayout_4 0 CompuMethod_116 0 65535 /end CHARACTERISTIC
/begin CHARACTERISTIC FaultManager.EST1_Open.Action_4 "Fault manager configuration.  Select up to 4 actions for each fault." VALUE 0x80002CB0 RecordLayout_4 0 CompuMethod_115 0 65535 /end CHARACTERISTIC
/begin CHARACTERISTIC FaultManager.EST1_Open.Action_4_Condition "Fault manager configuration.  Select up to 4 actions for each fault." VALUE 0x80002CB2 RecordLayout_4 0 CompuMethod_116 0 65535 /end CHARACTERISTIC
/begin CHARACTERISTIC FaultManager.EST1_Short.Mode "Fault manager configuration.  Select up to 4 actions for each fault." VALUE 0x80002CB4 RecordLayout_4 0 CompuMethod_113 0 65535 /end CHARACTERISTIC
/begin CHARACTERISTIC FaultManager.EST1_Short.ID "Fault manager configuration.  Select up to 4 actions for each fault." VALUE 0x80002CB6 RecordLayout_4 0 CompuMethod_1 0 65535 /end CHARACTERISTIC
/begin CHARACTERISTIC FaultManager.EST1_Short.Test "Fault manager configuration.  Select up to 4 actions for each fault." VALUE 0x80002CB8 RecordLayout_4 0 CompuMethod_114 0 65535 /end CHARACTERISTIC
/begin CHARACTERISTIC FaultManager.EST1_Short.Faulty_Samples__X_ "Fault manager configuration.  Select up to 4 actions for each fault." VALUE 0x80002CBA RecordLayout_4 0 CompuMethod_1 0 65535 /end CHARACTERISTIC
/begin CHARACTERISTIC FaultManager.EST1_Short.Total_Samples__Y_ "Fault manager configuration.  Select up to 4 actions for each fault." VALUE 0x80002CBC RecordLayout_4 0 CompuMethod_1 0 65535 /end CHARACTERISTIC
/begin CHARACTERISTIC FaultManager.EST1_Short.Action_1 "Fault manager configuration.  Select up to 4 actions for each fault." VALUE 0x80002CBE RecordLayout_4 0 CompuMethod_115 0 65535 /end CHARACTERISTIC
/begin CHARACTERISTIC FaultManager.EST1_Short.Action_1_Condition "Fault manager configuration.  Select up to 4 actions for each fault." VALUE 0x80002CC0 RecordLayout_4 0 CompuMethod_116 0 65535 /end CHARACTERISTIC
/begin CHARACTERISTIC FaultManager.EST1_Short.Action_2 "Fault manager configuration.  Select up to 4 actions for each fault." VALUE 0x80002CC2 RecordLayout_4 0 CompuMethod_115 0 65535 /end CHARACTERISTIC
/begin CHARACTERISTIC FaultManager.EST1_Short.Action_2_Condition "Fault manager configuration.  Select up to 4 actions for each fault." VALUE 0x80002CC4 RecordLayout_4 0 CompuMethod_116 0 65535 /end CHARACTERISTIC
/begin CHARACTERISTIC FaultManager.EST1_Short.Action_3 "Fault manager configuration.  Select up to 4 actions for each fault." VALUE 0x80002CC6 RecordLayout_4 0 CompuMethod_115 0 65535 /end CHARACTERISTIC
/begin CHARACTERISTIC FaultManager.EST1_Short.Action_3_Condition "Fault manager configuration.  Select up to 4 actions for each fault." VALUE 0x80002CC8 RecordLayout_4 0 CompuMethod_116 0 65535 /end CHARACTERISTIC
/begin CHARACTERISTIC FaultManager.EST1_Short.Action_4 "Fault manager configuration.  Select up to 4 actions for each fault." VALUE 0x80002CCA RecordLayout_4 0 CompuMethod_115 0 65535 /end CHARACTERISTIC
/begin CHARACTERISTIC FaultManager.EST1_Short.Action_4_Condition "Fault manager configuration.  Select up to 4 actions for each fault." VALUE 0x80002CCC RecordLayout_4 0 CompuMethod_116 0 65535 /end CHARACTERISTIC
/begin CHARACTERISTIC FaultManager.EST2_Open.Mode "Fault manager configuration.  Select up to 4 actions for each fault." VALUE 0x80002CCE RecordLayout_4 0 CompuMethod_113 0 65535 /end CHARACTERISTIC
/begin CHARACTERISTIC FaultManager.EST2_Open.ID "Fault manager configuration.  Select up to 4 actions for each fault." VALUE 0x80002CD0 RecordLayout_4 0 CompuMethod_1 0 65535 /end CHARACTERISTIC
/begin CHARACTERISTIC FaultManager.EST2_Open.Test "Fault manager configuration.  Select up to 4 actions for each fault." VALUE 0x80002CD2 RecordLayout_4 0 CompuMethod_114 0 65535 /end CHARACTERISTIC
/begin CHARACTERISTIC FaultManager.EST2_Open.Faulty_Samples__X_ "Fault manager configuration.  Select up to 4 actions for each fault." VALUE 0x80002CD4 RecordLayout_4 0 CompuMethod_1 0 65535 /end CHARACTERISTIC
/begin CHARACTERISTIC FaultManager.EST2_Open.Total_Samples__Y_ "Fault manager configuration.  Select up to 4 actions for each fault." VALUE 0x80002CD6 RecordLayout_4 0 CompuMethod_1 0 65535 /end CHARACTERISTIC
/begin CHARACTERISTIC FaultManager.EST2_Open.Action_1 "Fault manager configuration.  Select up to 4 actions for each fault." VALUE 0x80002CD8 RecordLayout_4 0 CompuMethod_115 0 65535 /end CHARACTERISTIC
/begin CHARACTERISTIC FaultManager.EST2_Open.Action_1_Condition "Fault manager configuration.  Select up to 4 actions for each fault." VALUE 0x80002CDA RecordLayout_4 0 CompuMethod_116 0 65535 /end CHARACTERISTIC
/begin CHARACTERISTIC FaultManager.EST2_Open.Action_2 "Fault manager configuration.  Select up to 4 actions for each fault." VALUE 0x80002CDC RecordLayout_4 0 CompuMethod_115 0 65535 /end CHARACTERISTIC
/begin CHARACTERISTIC FaultManager.EST2_Open.Action_2_Condition "Fault manager configuration.  Select up to 4 actions for each fault." VALUE 0x80002CDE RecordLayout_4 0 CompuMethod_116 0 65535 /end CHARACTERISTIC
/begin CHARACTERISTIC FaultManager.EST2_Open.Action_3 "Fault manager configuration.  Select up to 4 actions for each fault." VALUE 0x80002CE0 RecordLayout_4 0 CompuMethod_115 0 65535 /end CHARACTERISTIC
/begin CHARACTERISTIC FaultManager.EST2_Open.Action_3_Condition "Fault manager configuration.  Select up to 4 actions for each fault." VALUE 0x80002CE2 RecordLayout_4 0 CompuMethod_116 0 65535 /end CHARACTERISTIC
/begin CHARACTERISTIC FaultManager.EST2_Open.Action_4 "Fault manager configuration.  Select up to 4 actions for each fault." VALUE 0x80002CE4 RecordLayout_4 0 CompuMethod_115 0 65535 /end CHARACTERISTIC
/begin CHARACTERISTIC FaultManager.EST2_Open.Action_4_Condition "Fault manager configuration.  Select up to 4 actions for each fault." VALUE 0x80002CE6 RecordLayout_4 0 CompuMethod_116 0 65535 /end CHARACTERISTIC
/begin CHARACTERISTIC FaultManager.EST2_Short.Mode "Fault manager configuration.  Select up to 4 actions for each fault." VALUE 0x80002CE8 RecordLayout_4 0 CompuMethod_113 0 65535 /end CHARACTERISTIC
/begin CHARACTERISTIC FaultManager.EST2_Short.ID "Fault manager configuration.  Select up to 4 actions for each fault." VALUE 0x80002CEA RecordLayout_4 0 CompuMethod_1 0 65535 /end CHARACTERISTIC
/begin CHARACTERISTIC FaultManager.EST2_Short.Test "Fault manager configuration.  Select up to 4 actions for each fault." VALUE 0x80002CEC RecordLayout_4 0 CompuMethod_114 0 65535 /end CHARACTERISTIC
/begin CHARACTERISTIC FaultManager.EST2_Short.Faulty_Samples__X_ "Fault manager configuration.  Select up to 4 actions for each fault." VALUE 0x80002CEE RecordLayout_4 0 CompuMethod_1 0 65535 /end CHARACTERISTIC
/begin CHARACTERISTIC FaultManager.EST2_Short.Total_Samples__Y_ "Fault manager configuration.  Select up to 4 actions for each fault." VALUE 0x80002CF0 RecordLayout_4 0 CompuMethod_1 0 65535 /end CHARACTERISTIC
/begin CHARACTERISTIC FaultManager.EST2_Short.Action_1 "Fault manager configuration.  Select up to 4 actions for each fault." VALUE 0x80002CF2 RecordLayout_4 0 CompuMethod_115 0 65535 /end CHARACTERISTIC
/begin CHARACTERISTIC FaultManager.EST2_Short.Action_1_Condition "Fault manager configuration.  Select up to 4 actions for each fault." VALUE 0x80002CF4 RecordLayout_4 0 CompuMethod_116 0 65535 /end CHARACTERISTIC
/begin CHARACTERISTIC FaultManager.EST2_Short.Action_2 "Fault manager configuration.  Select up to 4 actions for each fault." VALUE 0x80002CF6 RecordLayout_4 0 CompuMethod_115 0 65535 /end CHARACTERISTIC
/begin CHARACTERISTIC FaultManager.EST2_Short.Action_2_Condition "Fault manager configuration.  Select up to 4 actions for each fault." VALUE 0x80002CF8 RecordLayout_4 0 CompuMethod_116 0 65535 /end CHARACTERISTIC
/begin CHARACTERISTIC FaultManager.EST2_Short.Action_3 "Fault manager configuration.  Select up to 4 actions for each fault." VALUE 0x80002CFA RecordLayout_4 0 CompuMethod_115 0 65535 /end CHARACTERISTIC
/begin CHARACTERISTIC FaultManager.EST2_Short.Action_3_Condition "Fault manager configuration.  Select up to 4 actions for each fault." VALUE 0x80002CFC RecordLayout_4 0 CompuMethod_116 0 65535 /end CHARACTERISTIC
/begin CHARACTERISTIC FaultManager.EST2_Short.Action_4 "Fault manager configuration.  Select up to 4 actions for each fault." VALUE 0x80002CFE RecordLayout_4 0 CompuMethod_115 0 65535 /end CHARACTERISTIC
/begin CHARACTERISTIC FaultManager.EST2_Short.Action_4_Condition "Fault manager configuration.  Select up to 4 actions for each fault." VALUE 0x80002D00 RecordLayout_4 0 CompuMethod_116 0 65535 /end CHARACTERISTIC
/begin CHARACTERISTIC FaultManager.EST3_Open.Mode "Fault manager configuration.  Select up to 4 actions for each fault." VALUE 0x80002D02 RecordLayout_4 0 CompuMethod_113 0 65535 /end CHARACTERISTIC
/begin CHARACTERISTIC FaultManager.EST3_Open.ID "Fault manager configuration.  Select up to 4 actions for each fault." VALUE 0x80002D04 RecordLayout_4 0 CompuMethod_1 0 65535 /end CHARACTERISTIC
/begin CHARACTERISTIC FaultManager.EST3_Open.Test "Fault manager configuration.  Select up to 4 actions for each fault." VALUE 0x80002D06 RecordLayout_4 0 CompuMethod_114 0 65535 /end CHARACTERISTIC
/begin CHARACTERISTIC FaultManager.EST3_Open.Faulty_Samples__X_ "Fault manager configuration.  Select up to 4 actions for each fault." VALUE 0x80002D08 RecordLayout_4 0 CompuMethod_1 0 65535 /end CHARACTERISTIC
/begin CHARACTERISTIC FaultManager.EST3_Open.Total_Samples__Y_ "Fault manager configuration.  Select up to 4 actions for each fault." VALUE 0x80002D0A RecordLayout_4 0 CompuMethod_1 0 65535 /end CHARACTERISTIC
/begin CHARACTERISTIC FaultManager.EST3_Open.Action_1 "Fault manager configuration.  Select up to 4 actions for each fault." VALUE 0x80002D0C RecordLayout_4 0 CompuMethod_115 0 65535 /end CHARACTERISTIC
/begin CHARACTERISTIC FaultManager.EST3_Open.Action_1_Condition "Fault manager configuration.  Select up to 4 actions for each fault." VALUE 0x80002D0E RecordLayout_4 0 CompuMethod_116 0 65535 /end CHARACTERISTIC
/begin CHARACTERISTIC FaultManager.EST3_Open.Action_2 "Fault manager configuration.  Select up to 4 actions for each fault." VALUE 0x80002D10 RecordLayout_4 0 CompuMethod_115 0 65535 /end CHARACTERISTIC
/begin CHARACTERISTIC FaultManager.EST3_Open.Action_2_Condition "Fault manager configuration.  Select up to 4 actions for each fault." VALUE 0x80002D12 RecordLayout_4 0 CompuMethod_116 0 65535 /end CHARACTERISTIC
/begin CHARACTERISTIC FaultManager.EST3_Open.Action_3 "Fault manager configuration.  Select up to 4 actions for each fault." VALUE 0x80002D14 RecordLayout_4 0 CompuMethod_115 0 65535 /end CHARACTERISTIC
/begin CHARACTERISTIC FaultManager.EST3_Open.Action_3_Condition "Fault manager configuration.  Select up to 4 actions for each fault." VALUE 0x80002D16 RecordLayout_4 0 CompuMethod_116 0 65535 /end CHARACTERISTIC
/begin CHARACTERISTIC FaultManager.EST3_Open.Action_4 "Fault manager configuration.  Select up to 4 actions for each fault." VALUE 0x80002D18 RecordLayout_4 0 CompuMethod_115 0 65535 /end CHARACTERISTIC
/begin CHARACTERISTIC FaultManager.EST3_Open.Action_4_Condition "Fault manager configuration.  Select up to 4 actions for each fault." VALUE 0x80002D1A RecordLayout_4 0 CompuMethod_116 0 65535 /end CHARACTERISTIC
/begin CHARACTERISTIC FaultManager.EST3_Short.Mode "Fault manager configuration.  Select up to 4 actions for each fault." VALUE 0x80002D1C RecordLayout_4 0 CompuMethod_113 0 65535 /end CHARACTERISTIC
/begin CHARACTERISTIC FaultManager.EST3_Short.ID "Fault manager configuration.  Select up to 4 actions for each fault." VALUE 0x80002D1E RecordLayout_4 0 CompuMethod_1 0 65535 /end CHARACTERISTIC
/begin CHARACTERISTIC FaultManager.EST3_Short.Test "Fault manager configuration.  Select up to 4 actions for each fault." VALUE 0x80002D20 RecordLayout_4 0 CompuMethod_114 0 65535 /end CHARACTERISTIC
/begin CHARACTERISTIC FaultManager.EST3_Short.Faulty_Samples__X_ "Fault manager configuration.  Select up to 4 actions for each fault." VALUE 0x80002D22 RecordLayout_4 0 CompuMethod_1 0 65535 /end CHARACTERISTIC
/begin CHARACTERISTIC FaultManager.EST3_Short.Total_Samples__Y_ "Fault manager configuration.  Select up to 4 actions for each fault." VALUE 0x80002D24 RecordLayout_4 0 CompuMethod_1 0 65535 /end CHARACTERISTIC
/begin CHARACTERISTIC FaultManager.EST3_Short.Action_1 "Fault manager configuration.  Select up to 4 actions for each fault." VALUE 0x80002D26 RecordLayout_4 0 CompuMethod_115 0 65535 /end CHARACTERISTIC
/begin CHARACTERISTIC FaultManager.EST3_Short.Action_1_Condition "Fault manager configuration.  Select up to 4 actions for each fault." VALUE 0x80002D28 RecordLayout_4 0 CompuMethod_116 0 65535 /end CHARACTERISTIC
/begin CHARACTERISTIC FaultManager.EST3_Short.Action_2 "Fault manager configuration.  Select up to 4 actions for each fault." VALUE 0x80002D2A RecordLayout_4 0 CompuMethod_115 0 65535 /end CHARACTERISTIC
/begin CHARACTERISTIC FaultManager.EST3_Short.Action_2_Condition "Fault manager configuration.  Select up to 4 actions for each fault." VALUE 0x80002D2C RecordLayout_4 0 CompuMethod_116 0 65535 /end CHARACTERISTIC
/begin CHARACTERISTIC FaultManager.EST3_Short.Action_3 "Fault manager configuration.  Select up to 4 actions for each fault." VALUE 0x80002D2E RecordLayout_4 0 CompuMethod_115 0 65535 /end CHARACTERISTIC
/begin CHARACTERISTIC FaultManager.EST3_Short.Action_3_Condition "Fault manager configuration.  Select up to 4 actions for each fault." VALUE 0x80002D30 RecordLayout_4 0 CompuMethod_116 0 65535 /end CHARACTERISTIC
/begin CHARACTERISTIC FaultManager.EST3_Short.Action_4 "Fault manager configuration.  Select up to 4 actions for each fault." VALUE 0x80002D32 RecordLayout_4 0 CompuMethod_115 0 65535 /end CHARACTERISTIC
/begin CHARACTERISTIC FaultManager.EST3_Short.Action_4_Condition "Fault manager configuration.  Select up to 4 actions for each fault." VALUE 0x80002D34 RecordLayout_4 0 CompuMethod_116 0 65535 /end CHARACTERISTIC
/begin CHARACTERISTIC FaultManager.EST4_Open.Mode "Fault manager configuration.  Select up to 4 actions for each fault." VALUE 0x80002D36 RecordLayout_4 0 CompuMethod_113 0 65535 /end CHARACTERISTIC
/begin CHARACTERISTIC FaultManager.EST4_Open.ID "Fault manager configuration.  Select up to 4 actions for each fault." VALUE 0x80002D38 RecordLayout_4 0 CompuMethod_1 0 65535 /end CHARACTERISTIC
/begin CHARACTERISTIC FaultManager.EST4_Open.Test "Fault manager configuration.  Select up to 4 actions for each fault." VALUE 0x80002D3A RecordLayout_4 0 CompuMethod_114 0 65535 /end CHARACTERISTIC
/begin CHARACTERISTIC FaultManager.EST4_Open.Faulty_Samples__X_ "Fault manager configuration.  Select up to 4 actions for each fault." VALUE 0x80002D3C RecordLayout_4 0 CompuMethod_1 0 65535 /end CHARACTERISTIC
/begin CHARACTERISTIC FaultManager.EST4_Open.Total_Samples__Y_ "Fault manager configuration.  Select up to 4 actions for each fault." VALUE 0x80002D3E RecordLayout_4 0 CompuMethod_1 0 65535 /end CHARACTERISTIC
/begin CHARACTERISTIC FaultManager.EST4_Open.Action_1 "Fault manager configuration.  Select up to 4 actions for each fault." VALUE 0x80002D40 RecordLayout_4 0 CompuMethod_115 0 65535 /end CHARACTERISTIC
/begin CHARACTERISTIC FaultManager.EST4_Open.Action_1_Condition "Fault manager configuration.  Select up to 4 actions for each fault." VALUE 0x80002D42 RecordLayout_4 0 CompuMethod_116 0 65535 /end CHARACTERISTIC
/begin CHARACTERISTIC FaultManager.EST4_Open.Action_2 "Fault manager configuration.  Select up to 4 actions for each fault." VALUE 0x80002D44 RecordLayout_4 0 CompuMethod_115 0 65535 /end CHARACTERISTIC
/begin CHARACTERISTIC MatlabVersionTxt "MATLAB version used to build the application." ASCII 0x40000752 RecordLayout_2 0 CompuMethod_2 0 255 NUMBER 80 MATRIX_DIM 80 1 1 READ_ONLY /end CHARACTERISTIC
/begin CHARACTERISTIC MotoHawkBuildGUID "GUID identifying the MotoHawk build session" ASCII 0x40000800 RecordLayout_2 0 CompuMethod_2 0 255 NUMBER 80 MATRIX_DIM 80 1 1 READ_ONLY /end CHARACTERISTIC
/begin CHARACTERISTIC MotoHawkModelGUID "GUID identifying the MotoHawk model" ASCII 0x40000850 RecordLayout_2 0 CompuMethod_2 0 255 NUMBER 80 MATRIX_DIM 80 1 1 READ_ONLY /end CHARACTERISTIC
/begin CHARACTERISTIC MotoHawkModelName "Simulink model name used for the MotoHawk build" ASCII 0x400008A0 RecordLayout_2 0 CompuMethod_2 0 255 NUMBER 80 MATRIX_DIM 80 1 1 READ_ONLY /end CHARACTERISTIC
/begin CHARACTERISTIC MotoHawkTokenGUID "GUID identifying the token inserted during the build.  May be empty if no token was available" ASCII 0x400008F4 RecordLayout_2 0 CompuMethod_2 0 255 NUMBER 80 MATRIX_DIM 80 1 1 READ_ONLY /end CHARACTERISTIC
/begin CHARACTERISTIC MotoHawkVersionTxt "MotoHawk version used to build the application." ASCII 0x40000944 RecordLayout_2 0 CompuMethod_2 0 255 NUMBER 50 MATRIX_DIM 50 1 1 READ_ONLY /end CHARACTERISTIC
/begin CHARACTERISTIC PartNumber "" ASCII 0x40000A11 RecordLayout_2 0 CompuMethod_2 0 255 NUMBER 40 MATRIX_DIM 40 1 1 READ_ONLY /end CHARACTERISTIC
/begin CHARACTERISTIC PasswordTxt "Password protection for this calibration" ASCII 0x80004DDE RecordLayout_2 0 CompuMethod_2 0 255 NUMBER 33 MATRIX_DIM 33 1 1 /end CHARACTERISTIC
/*~~~~~~~~~ 6.3.106 RECORD_LAYOUTs ~~~~~~~~~*/
/begin RECORD_LAYOUT RecordLayout_1 FNC_VALUES 1 UBYTE ROW_DIR DIRECT /end RECORD_LAYOUT
/begin RECORD_LAYOUT RecordLayout_2 FNC_VALUES 1 UBYTE ROW_DIR DIRECT /end RECORD_LAYOUT
/begin RECORD_LAYOUT RecordLayout_3 FNC_VALUES 1 ULONG ROW_DIR DIRECT /end RECORD_LAYOUT
/begin RECORD_LAYOUT RecordLayout_4 FNC_VALUES 1 UWORD ROW_DIR DIRECT /end RECORD_LAYOUT
/*~~~~~~~~~ 6.3.31 COMPU_METHODs ~~~~~~~~~*/
/begin COMPU_METHOD CompuMethod_1 "" RAT_FUNC "%3.0" "" COEFFS 0 1 0 0 0 1 /end COMPU_METHOD
/begin COMPU_METHOD CompuMethod_2 "" RAT_FUNC "%6.2" "" COEFFS 0 1 0 0 0 1 /end COMPU_METHOD
/begin COMPU_METHOD CompuMethod_3 "" RAT_FUNC "%6.2" "ID" COEFFS 0 1 0 0 0 1 /end COMPU_METHOD
/begin COMPU_METHOD CompuMethod_4 "" RAT_FUNC "%1.0" "bool" COEFFS 0 1 0 0 0 1 /end COMPU_METHOD
/begin COMPU_METHOD CompuMethod_11 "" RAT_FUNC "%1.0" "" COEFFS 0 1 0 0 0 1 /end COMPU_METHOD
/begin COMPU_METHOD CompuMethod_111 "" TAB_VERB "%3.0" "" COMPU_TAB_REF CompuVtab_31 /end COMPU_METHOD
/begin COMPU_METHOD CompuMethod_112 "" TAB_VERB "%3.0" "" COMPU_TAB_REF CompuVtab_32 /end COMPU_METHOD
/begin COMPU_METHOD CompuMethod_113 "" TAB_VERB "%3.0" "" COMPU_TAB_REF CompuVtab_33 /end COMPU_METHOD
/begin COMPU_METHOD CompuMethod_114 "" TAB_VERB "%3.0" "" COMPU_TAB_REF CompuVtab_34 /end COMPU_METHOD
/begin COMPU_METHOD CompuMethod_115 "" TAB_VERB "%3.0" "" COMPU_TAB_REF CompuVtab_35 /end COMPU_METHOD
/begin COMPU_METHOD CompuMethod_116 "" TAB_VERB "%3.0" "" COMPU_TAB_REF CompuVtab_36 /end COMPU_METHOD
/begin COMPU_METHOD CompuMethod_148 "" TAB_VERB "%3.0" "" COMPU_TAB_REF CompuVtab_53 /end COMPU_METHOD
/begin COMPU_METHOD CompuMethod_149 "" RAT_FUNC "%8.0" "seconds" COEFFS 0 1 0 0 0 1 /end COMPU_METHOD
/begin COMPU_METHOD CompuMethod_177 "" RAT_FUNC "%5.0" "MHz" COEFFS 0 1 0 0 0 1E-06 /end COMPU_METHOD
/begin COMPU_METHOD CompuMethod_180 "" TAB_VERB "%1.0" "" COMPU_TAB_REF CompuVtab_68 /end COMPU_METHOD
/begin COMPU_VTAB CompuVtab_31 "" TAB_VERB 163 0 "ACChargeHigh_Fault" 1 "ACChargeLow_Fault" 2 "ACPresRangeHigh" 3 "ACPresRangeLow" 4 "APP1RangeHigh" 5 "APP1RangeLow" 6 "APP1_AdaptAdaptHiMax" 7 "APP1_AdaptAdaptHiMin" 8 "APP1_AdaptAdaptLoMax" 9 "APP1_AdaptAdaptLoMin" 10 "APP1_AdaptRangeHigh" 11 "APP1_AdaptRangeLow" 12 "APP2RangeHigh" 13 "APP2RangeLow" 14 "APP2_AdaptAdaptHiMax" 15 "APP2_AdaptAdaptHiMin" 16 "APP2_AdaptAdaptLoMax" 17 "APP2_AdaptAdaptLoMin" 18 "APP2_AdaptRangeHigh" 19 "APP2_AdaptRangeLow" 20 "APP_Sensors_Conflict" 21 "AirflowMismatch_Fault" 22 "AltInop_Fault" 23 "Bank1_EquivRatioRangeHigh" 24 "Bank1_EquivRatioRangeLow" 25 "Bank2_EquivRatioRangeHigh" 26 "Bank2_EquivRatioRangeLow" 27 "CATRangeHigh" 28 "CATRangeLow" 29 "CamEdgesFault" 30 "CamSyncFault" 31 "ClutchStuckHigh_Fault" 32 "CrankEdgesFault" 33 "CrankSyncFault" 34 "Cylinder1_HardMisfire" 35 "Cylinder2_HardMisfire" 36 "Cylinder3_HardMisfire" 37 "Cylinder4_HardMisfire" 38 "Cylinder5_HardMisfire" 39 "Cylinder6_HardMisfire" 40 "Cylinder7_HardMisfire" 41 "Cylinder8_HardMisfire" 42 "ECTOverTempFault" 43 "ECTRangeHigh" 44 "ECTRangeLow" 45 "ECTSevereOverTempFault" 46 "EST1_Open" 47 "EST1_Short" 48 "EST2_Open" 49 "EST2_Short" 50 "EST3_Open" 51 "EST3_Short" 52 "EST4_Open" 53 "EST4_Short" 54 "EST5_Open" 55 "EST5_Short" 56 "EST6_Open" 57 "EST6_Short" 58 "EST7_Open" 59 "EST7_Short" 60 "EST8_Open" 61 "EST8_Short" 62 "ETCSpringTest" 63 "ETC_Open_Fault" 64 "ETC_Sticking" 65 "EVAPRangeHigh" 66 "EVAPRangeLow" 67 "FuelAdaptRangeHi_BankA" 68 "FuelAdaptRangeHi_BankB" 69 "FuelAdaptRangeLow_BankA" 70 "FuelAdaptRangeLow_BankB" 71 "FuelPresHigh_Fault" 72 "FuelPresLow_Fault" 73 "FuelPresRangeHigh" 74 "FuelPresRangeLow" 75 "FuelSensRangeHigh" 76 "FuelSensRangeLow" 77 "Fuel_LvlRangeHigh" 78 "Fuel_LvlRangeLow" 79 "GPS_DateTime_Timeout" 80 "GPS_LatLong_Timeout" 81 "GPS_SpeedDir_Timeout" 82 "HardOverBoost_Fault" 83 "HardOverspeed" 84 "IATRangeHigh" 85 "IATRangeLow" 86 "Inj1Open" 87 "Inj2Open" 88 "Inj3Open" 89 "Inj4Open" 90 "Inj5Open" 91 "Inj6Open" 92 "Inj7Open" 93 "Inj8Open" 94 "Lambda1Error_Fault" 95 "Lambda1Fault_Fault" 96 "Lambda1HtrOpen_Fault" 97 "Lambda1HtrShort_Fault" 98 "Lambda1Overcool_Fault" 99 "Lambda1Overheat_Fault" 100 "Lambda1StuckInReset_Fault" 101 "Lambda1StuckInWarmup_Fault" 102 "Lambda1VoltHigh_Fault" 103 "Lambda1VoltLow_Fault" 104 "Lambda2Error_Fault" 105 "Lambda2Fault_Fault" 106 "Lambda2HtrOpen_Fault" 107 "Lambda2HtrShort_Fault" 108 "Lambda2Overcool_Fault" 109 "Lambda2Overheat_Fault" 110 "Lambda2StuckInReset_Fault" 111 "Lambda2StuckInWarmup_Fault" 112 "Lambda2VoltHigh_Fault" 113 "Lambda2VoltLow_Fault" 114 "Lambda_1_Timeout" 115 "Lambda_2_Timeout" 116 "Lambda_Bank2Bank_Fault" 117 "LeanProtect_Fault" 118 "MAFRangeHigh" 119 "MAFRangeLow" 120 "MAPRangeHigh" 121 "MAPRangeLow" 122 "MAPTimeRangeHigh" 123 "MAPTimeRangeLow" 124 "MAP_IR_HI" 125 "MAP_IR_LO" 126 "MAP_STICKING" 127 "MediumOverspeed" 128 "NoOil_Fault" 129 "O2FailedLean_BankA" 130 "O2FailedLean_BankB" 131 "O2FailedRich_BankA" 132 "O2FailedRich_BankB" 133 "O2NotActive_BankA" 134 "O2NotActive_BankB" 135 "OilPresRangeHigh" 136 "OilPresRangeLow" 137 "ScrambleStuckHigh_Fault" 138 "SensVoltRangeHigh" 139 "SensVoltRangeLow" 140 "SoftOverBoost_Fault" 141 "SoftOverspeed" 142 "SysVoltRangeHigh" 143 "SysVoltRangeLow" 144 "TPS1AdaptHiMax" 145 "TPS1AdaptHiMin" 146 "TPS1AdaptLoMax" 147 "TPS1AdaptLoMin" 148 "TPS1RangeHigh" 149 "TPS1RangeLow" 150 "TPS2AdaptHiMax" 151 "TPS2AdaptHiMin" 152 "TPS2AdaptLoMax" 153 "TPS2AdaptLoMin" 154 "TPS2RangeHigh" 155 "TPS2RangeLow" 156 "TPS_Sensors_Conflict" 157 "VSPDRangeHigh" 158 "VSPDRangeLow" 159 "VoltLow_Fault" 160 "VoltTooHigh_Fault" 161 "Wastegate_Fault" 162 "(None)" /end COMPU_VTAB
/begin COMPU_VTAB CompuVtab_32 "" TAB_VERB 2 0 "-" 1 "Clear All Faults" /end COMPU_VTAB
/begin COMPU_VTAB CompuVtab_33 "" TAB_VERB 6 0 "Disabled" 1 "Enabled" 2 "Sticky" 3 "Enabled - Persistent" 4 "Sticky - Persistent" 5 "Save Occurred" /end COMPU_VTAB
/begin COMPU_VTAB CompuVtab_34 "" TAB_VERB 2 0 "-" 1 "Test" /end COMPU_VTAB
/begin COMPU_VTAB CompuVtab_35 "" TAB_VERB 16 0 "CutThrottle" 1 "DFCODisable" 2 "DelayedEngineShutdown" 3 "DisableAC" 4 "DisableFanRun" 5 "DisableFanStall" 6 "DisableO2Ctrl" 7 "DisableVEAdapt" 8 "DisableWastegate" 9 "EngineProtectLED" 10 "EngineShutdown" 11 "HardRevLimit" 12 "MIL_LED" 13 "MediumRevLimit" 14 "SoftRevLimit" 15 "(None)" /end COMPU_VTAB
/begin COMPU_VTAB CompuVtab_36 "" TAB_VERB 8 0 "(None)" 1 "Suspected" 2 "Active" 3 "Suspected or Active" 4 "Occurred" 5 "Suspected or Occurred" 6 "Active or Occurred" 7 "Suspected or Active or Occurred" /end COMPU_VTAB
/begin COMPU_VTAB CompuVtab_53 "" TAB_VERB 6 0 "Calibratable Development Module" 1 "Non-Calibratable Production Module" 2 "Software Dev Module (with RAM overlay only)" 3 "Software Dev Module (with Trace Pod & RAM)" 4 "Calibratable Development Module with Censorship disabled" 5 "Non-Calibratable Production Module with Censorship disabled" /end COMPU_VTAB
/begin COMPU_VTAB CompuVtab_68 "" TAB_VERB 40 0 "TPU Mask Undefined" 1 "60-6" 2 "GM24Xe" 3 "GM24Xe on Cam" 4 "N-1/N-2 [Half Moon Cam]" 5 "NX Encoder" 6 "NX Encoder on Cam" 7 "30-5 on Cnk" 8 "Hyundai 60" 9 "X Plus 1 on Cnk with ToothCam" 10 "X Shift 1 on Cnk" 11 "N Encoder" 12 "N-1/N-2 [Tooth Cam]" 13 "ISDL" 14 "X Pulse Width on Cam" 15 "X Pulse Width on Cnk" 16 "1 Pulse on Cnk" 17 "1 Pulse on Cam" 18 "N-1/N-2 Dual Redundancy" 19 "N-1/N-2 Variable Cam" 20 "N-1/N-2 [Duramax CAM] [Multiplexed EST (1,2, or 4,5,6,7,8) (9,10,11 or 13,14,15)]" 21 "X Plus 1 on Cnk + MuxPSP on EST > 9" 22 "NX Encoder with Hyundai 4 Tooth CAM with one wide" 23 "NX Encoder with 360Deg CAM Providing Crank Sync" 24 "NissanZ 36-6 Encoder, sync on custom CAM" 25 "36-1 Encoder, sync on custom Coyote CAM" 26 "N Groups of 4 teeth - 2, sync on CAM" 27 "NissanZ 36-6 Encoder, sync on 6Tooth 2Missing Plus2 Variable CAM" 28 "EVO9 2X Encoder with 1X_PLUS1 CAM on Exhaust and 4X Variable CAM on Intake" 29 "N-1/N-2 Variable Cam with Windowed Sync" 30 "36M4 (2x18 teeth sectors with 2 missing) and Kohki Cam" 31 "N-3/N-4 [ToothCam]" 32 "N-3/N-4 [Plus1Cam (X+1)]" 33 "Hyundai 60 with EncoderSynthesizer variant on TPUC" 34 "N-1/N-2 [Half Moon Cam]" 35 "X Plus 1 on Cnk with X Plus 1 Cam" 36 "X Plus 1 on Cnk with X Plus 1 Cam with Encoder Synthesizer" 37 "N-1/N-2 [XPlus1 Cam]" 38 "X Shift 1 Retarded [ToothCam]" 39 "N-1/N-2 [Tooth Cam] with MuxPSP" /end COMPU_VTAB
/*~~~~~~~~~ 6.3.65 FUNCTIONs ~~~~~~~~~*/
/begin FUNCTION Project_Config "" /begin DEF_CHARACTERISTIC project_id ProductID /end DEF_CHARACTERISTIC /end FUNCTION
/begin FUNCTION System_Config "" /begin DEF_CHARACTERISTIC FriendlyName PasswordTxt /end DEF_CHARACTERISTIC /begin SUB_FUNCTION Project_Config Trigger_Config Communication_Config /end SUB_FUNCTION /end FUNCTION
/begin FUNCTION System ""
 /begin SUB_FUNCTION System_Config Version Status I_O_Pins Debug CCP Performance Main_Power_Relay NonVolatile_Storage /end SUB_FUNCTION
/end FUNCTION
/begin FUNCTION Version ""
 /begin DEF_CHARACTERISTIC SwIdTxt CalIdTxt SwRevisionTxt CompilerVersion ControlCoreSDKRelease MatlabVersionTxt MotoHawkBuildGUID MotoHawkModelGUID MotoHawkModelName MotoHawkTokenGUID MotoHawkVersionTxt /end DEF_CHARACTERISTIC
 /begin OUT_MEASUREMENT table_0_rev table_1_rev table_2_rev KeyRev EriRev table_3_rev table_4_rev table_5_rev table_6_rev table_7_rev MotProgRev ApplicationCompatibilityArr LinkStatus MotoHawkModelSecondsInUse SystemFrequency TPUMaskType TPUMaskVers Unused /end OUT_MEASUREMENT
/end FUNCTION
/begin FUNCTION Module_Config "" /begin DEF_CHARACTERISTIC SerialNumber ModelNumber PartNumber /end DEF_CHARACTERISTIC
 /begin OUT_MEASUREMENT BootVerMaj BootVerMin EcuHwMaj EcuHwMin ConfigVerMaj ConfigVerMin ModuleCapability /end OUT_MEASUREMENT
/end FUNCTION
/begin FUNCTION Status "" /begin SUB_FUNCTION Module_Config OS Framework /end SUB_FUNCTION /end FUNCTION
/begin FUNCTION AC "" /begin OUT_MEASUREMENT AC /end OUT_MEASUREMENT /begin SUB_FUNCTION AC_Override AC_Config /end SUB_FUNCTION /end FUNCTION
/begin FUNCTION AC_Control "" /begin SUB_FUNCTION AC /end SUB_FUNCTION /end FUNCTION
/begin FUNCTION Outputs ""
 /begin SUB_FUNCTION AC_Control AEM_Infinity_Dash Coil_Control Injector_Control HBridge ETC_CutPower FAN_Control_2 FuelPump IAC_Control WASTEGATE_Control /end SUB_FUNCTION
/end FUNCTION
/begin FUNCTION Foreground "" /begin SUB_FUNCTION Outputs Control Inputs /end SUB_FUNCTION /end FUNCTION
/begin FUNCTION BaseEngineController_LS_128 ""
 /begin DEF_CHARACTERISTIC FaultCommand FaultManager.ACChargeHigh_Fault.Mode FaultManager.ACChargeHigh_Fault.ID FaultManager.ACChargeHigh_Fault.Test FaultManager.ACChargeHigh_Fault.Faulty_Samples__X_ FaultManager.ACChargeHigh_Fault.Total_Samples__Y_ FaultManager.ACChargeHigh_Fault.Action_1 FaultManager.ACChargeHigh_Fault.Action_1_Condition FaultManager.ACChargeHigh_Fault.Action_2 FaultManager.ACChargeHigh_Fault.Action_2_Condition FaultManager.ACChargeHigh_Fault.Action_3 FaultManager.ACChargeHigh_Fault.Action_3_Condition FaultManager.ACChargeHigh_Fault.Action_4 FaultManager.ACChargeHigh_Fault.Action_4_Condition FaultManager.ACChargeLow_Fault.Mode FaultManager.ACChargeLow_Fault.ID FaultManager.ACChargeLow_Fault.Test FaultManager.ACChargeLow_Fault.Faulty_Samples__X_ FaultManager.ACChargeLow_Fault.Total_Samples__Y_ FaultManager.ACChargeLow_Fault.Action_1 FaultManager.ACChargeLow_Fault.Action_1_Condition FaultManager.ACChargeLow_Fault.Action_2 FaultManager.ACChargeLow_Fault.Action_2_Condition FaultManager.ACChargeLow_Fault.Action_3 FaultManager.ACChargeLow_Fault.Action_3_Condition FaultManager.ACChargeLow_Fault.Action_4 FaultManager.ACChargeLow_Fault.Action_4_Condition FaultManager.ACPresRangeHigh.Mode FaultManager.ACPresRangeHigh.ID FaultManager.ACPresRangeHigh.Test FaultManager.ACPresRangeHigh.Faulty_Samples__X_ FaultManager.ACPresRangeHigh.Total_Samples__Y_ FaultManager.ACPresRangeHigh.Action_1 FaultManager.ACPresRangeHigh.Action_1_Condition FaultManager.ACPresRangeHigh.Action_2 FaultManager.ACPresRangeHigh.Action_2_Condition FaultManager.ACPresRangeHigh.Action_3 FaultManager.ACPresRangeHigh.Action_3_Condition FaultManager.ACPresRangeHigh.Action_4 FaultManager.ACPresRangeHigh.Action_4_Condition FaultManager.ACPresRangeLow.Mode FaultManager.ACPresRangeLow.ID FaultManager.ACPresRangeLow.Test FaultManager.ACPresRangeLow.Faulty_Samples__X_ FaultManager.ACPresRangeLow.Total_Samples__Y_ FaultManager.ACPresRangeLow.Action_1 FaultManager.ACPresRangeLow.Action_1_Condition FaultManager.ACPresRangeLow.Action_2 FaultManager.ACPresRangeLow.Action_2_Condition FaultManager.ACPresRangeLow.Action_3 FaultManager.ACPresRangeLow.Action_3_Condition FaultManager.ACPresRangeLow.Action_4 FaultManager.ACPresRangeLow.Action_4_Condition FaultManager.APP1RangeHigh.Mode FaultManager.APP1RangeHigh.ID FaultManager.APP1RangeHigh.Test FaultManager.APP1RangeHigh.Faulty_Samples__X_ FaultManager.APP1RangeHigh.Total_Samples__Y_ FaultManager.APP1RangeHigh.Action_1 FaultManager.APP1RangeHigh.Action_1_Condition FaultManager.APP1RangeHigh.Action_2 FaultManager.APP1RangeHigh.Action_2_Condition FaultManager.APP1RangeHigh.Action_3 FaultManager.APP1RangeHigh.Action_3_Condition FaultManager.APP1RangeHigh.Action_4 FaultManager.APP1RangeHigh.Action_4_Condition FaultManager.APP1RangeLow.Mode FaultManager.APP1RangeLow.ID FaultManager.APP1RangeLow.Test FaultManager.APP1RangeLow.Faulty_Samples__X_ FaultManager.APP1RangeLow.Total_Samples__Y_ FaultManager.APP1RangeLow.Action_1 FaultManager.APP1RangeLow.Action_1_Condition FaultManager.APP1RangeLow.Action_2 FaultManager.APP1RangeLow.Action_2_Condition FaultManager.APP1RangeLow.Action_3 FaultManager.APP1RangeLow.Action_3_Condition FaultManager.APP1RangeLow.Action_4 FaultManager.APP1RangeLow.Action_4_Condition FaultManager.APP1_AdaptAdaptHiMax.Mode FaultManager.APP1_AdaptAdaptHiMax.ID FaultManager.APP1_AdaptAdaptHiMax.Test FaultManager.APP1_AdaptAdaptHiMax.Faulty_Samples__X_ FaultManager.APP1_AdaptAdaptHiMax.Total_Samples__Y_ FaultManager.APP1_AdaptAdaptHiMax.Action_1 FaultManager.APP1_AdaptAdaptHiMax.Action_1_Condition FaultManager.APP1_AdaptAdaptHiMax.Action_2 FaultManager.APP1_AdaptAdaptHiMax.Action_2_Condition FaultManager.APP1_AdaptAdaptHiMax.Action_3 FaultManager.APP1_AdaptAdaptHiMax.Action_3_Condition FaultManager.APP1_AdaptAdaptHiMax.Action_4 FaultManager.APP1_AdaptAdaptHiMax.Action_4_Condition FaultManager.APP1_AdaptAdaptHiMin.Mode FaultManager.APP1_AdaptAdaptHiMin.ID FaultManager.APP1_AdaptAdaptHiMin.Test FaultManager.APP1_AdaptAdaptHiMin.Faulty_Samples__X_ FaultManager.APP1_AdaptAdaptHiMin.Total_Samples__Y_ FaultManager.APP1_AdaptAdaptHiMin.Action_1 FaultManager.APP1_AdaptAdaptHiMin.Action_1_Condition FaultManager.APP1_AdaptAdaptHiMin.Action_2 FaultManager.APP1_AdaptAdaptHiMin.Action_2_Condition FaultManager.APP1_AdaptAdaptHiMin.Action_3 FaultManager.APP1_AdaptAdaptHiMin.Action_3_Condition FaultManager.APP1_AdaptAdaptHiMin.Action_4 FaultManager.APP1_AdaptAdaptHiMin.Action_4_Condition FaultManager.APP1_AdaptAdaptLoMax.Mode FaultManager.APP1_AdaptAdaptLoMax.ID FaultManager.APP1_AdaptAdaptLoMax.Test FaultManager.APP1_AdaptAdaptLoMax.Faulty_Samples__X_ FaultManager.APP1_AdaptAdaptLoMax.Total_Samples__Y_ FaultManager.APP1_AdaptAdaptLoMax.Action_1 FaultManager.APP1_AdaptAdaptLoMax.Action_1_Condition FaultManager.APP1_AdaptAdaptLoMax.Action_2 FaultManager.APP1_AdaptAdaptLoMax.Action_2_Condition FaultManager.APP1_AdaptAdaptLoMax.Action_3 FaultManager.APP1_AdaptAdaptLoMax.Action_3_Condition FaultManager.APP1_AdaptAdaptLoMax.Action_4 FaultManager.APP1_AdaptAdaptLoMax.Action_4_Condition FaultManager.APP1_AdaptAdaptLoMin.Mode FaultManager.APP1_AdaptAdaptLoMin.ID FaultManager.APP1_AdaptAdaptLoMin.Test FaultManager.APP1_AdaptAdaptLoMin.Faulty_Samples__X_ FaultManager.APP1_AdaptAdaptLoMin.Total_Samples__Y_ FaultManager.APP1_AdaptAdaptLoMin.Action_1 FaultManager.APP1_AdaptAdaptLoMin.Action_1_Condition FaultManager.APP1_AdaptAdaptLoMin.Action_2 FaultManager.APP1_AdaptAdaptLoMin.Action_2_Condition FaultManager.APP1_AdaptAdaptLoMin.Action_3 FaultManager.APP1_AdaptAdaptLoMin.Action_3_Condition FaultManager.APP1_AdaptAdaptLoMin.Action_4 FaultManager.APP1_AdaptAdaptLoMin.Action_4_Condition FaultManager.APP1_AdaptRangeHigh.Mode FaultManager.APP1_AdaptRangeHigh.ID FaultManager.APP1_AdaptRangeHigh.Test FaultManager.APP1_AdaptRangeHigh.Faulty_Samples__X_ FaultManager.APP1_AdaptRangeHigh.Total_Samples__Y_ FaultManager.APP1_AdaptRangeHigh.Action_1 FaultManager.APP1_AdaptRangeHigh.Action_1_Condition FaultManager.APP1_AdaptRangeHigh.Action_2 FaultManager.APP1_AdaptRangeHigh.Action_2_Condition FaultManager.APP1_AdaptRangeHigh.Action_3 FaultManager.APP1_AdaptRangeHigh.Action_3_Condition FaultManager.APP1_AdaptRangeHigh.Action_4 FaultManager.APP1_AdaptRangeHigh.Action_4_Condition FaultManager.APP1_AdaptRangeLow.Mode FaultManager.APP1_AdaptRangeLow.ID FaultManager.APP1_AdaptRangeLow.Test FaultManager.APP1_AdaptRangeLow.Faulty_Samples__X_ FaultManager.APP1_AdaptRangeLow.Total_Samples__Y_ FaultManager.APP1_AdaptRangeLow.Action_1 FaultManager.APP1_AdaptRangeLow.Action_1_Condition FaultManager.APP1_AdaptRangeLow.Action_2 FaultManager.APP1_AdaptRangeLow.Action_2_Condition FaultManager.APP1_AdaptRangeLow.Action_3 FaultManager.APP1_AdaptRangeLow.Action_3_Condition FaultManager.APP1_AdaptRangeLow.Action_4 FaultManager.APP1_AdaptRangeLow.Action_4_Condition FaultManager.APP2RangeHigh.Mode FaultManager.APP2RangeHigh.ID FaultManager.APP2RangeHigh.Test FaultManager.APP2RangeHigh.Faulty_Samples__X_ FaultManager.APP2RangeHigh.Total_Samples__Y_ FaultManager.APP2RangeHigh.Action_1 FaultManager.APP2RangeHigh.Action_1_Condition FaultManager.APP2RangeHigh.Action_2 FaultManager.APP2RangeHigh.Action_2_Condition FaultManager.APP2RangeHigh.Action_3 FaultManager.APP2RangeHigh.Action_3_Condition FaultManager.APP2RangeHigh.Action_4 FaultManager.APP2RangeHigh.Action_4_Condition FaultManager.APP2RangeLow.Mode FaultManager.APP2RangeLow.ID FaultManager.APP2RangeLow.Test FaultManager.APP2RangeLow.Faulty_Samples__X_ FaultManager.APP2RangeLow.Total_Samples__Y_ FaultManager.APP2RangeLow.Action_1 FaultManager.APP2RangeLow.Action_1_Condition FaultManager.APP2RangeLow.Action_2 FaultManager.APP2RangeLow.Action_2_Condition FaultManager.APP2RangeLow.Action_3 FaultManager.APP2RangeLow.Action_3_Condition FaultManager.APP2RangeLow.Action_4 FaultManager.APP2RangeLow.Action_4_Condition FaultManager.APP2_AdaptAdaptHiMax.Mode FaultManager.APP2_AdaptAdaptHiMax.ID FaultManager.APP2_AdaptAdaptHiMax.Test FaultManager.APP2_AdaptAdaptHiMax.Faulty_Samples__X_ FaultManager.APP2_AdaptAdaptHiMax.Total_Samples__Y_ FaultManager.APP2_AdaptAdaptHiMax.Action_1 FaultManager.APP2_AdaptAdaptHiMax.Action_1_Condition FaultManager.APP2_AdaptAdaptHiMax.Action_2 FaultManager.APP2_AdaptAdaptHiMax.Action_2_Condition FaultManager.APP2_AdaptAdaptHiMax.Action_3 FaultManager.APP2_AdaptAdaptHiMax.Action_3_Condition FaultManager.APP2_AdaptAdaptHiMax.Action_4 FaultManager.APP2_AdaptAdaptHiMax.Action_4_Condition FaultManager.APP2_AdaptAdaptHiMin.Mode FaultManager.APP2_AdaptAdaptHiMin.ID FaultManager.APP2_AdaptAdaptHiMin.Test FaultManager.APP2_AdaptAdaptHiMin.Faulty_Samples__X_ FaultManager.APP2_AdaptAdaptHiMin.Total_Samples__Y_ FaultManager.APP2_AdaptAdaptHiMin.Action_1 FaultManager.APP2_AdaptAdaptHiMin.Action_1_Condition FaultManager.APP2_AdaptAdaptHiMin.Action_2 FaultManager.APP2_AdaptAdaptHiMin.Action_2_Condition FaultManager.APP2_AdaptAdaptHiMin.Action_3 FaultManager.APP2_AdaptAdaptHiMin.Action_3_Condition FaultManager.APP2_AdaptAdaptHiMin.Action_4 FaultManager.APP2_AdaptAdaptHiMin.Action_4_Condition FaultManager.APP2_AdaptAdaptLoMax.Mode FaultManager.APP2_AdaptAdaptLoMax.ID FaultManager.APP2_AdaptAdaptLoMax.Test FaultManager.APP2_AdaptAdaptLoMax.Faulty_Samples__X_ FaultManager.APP2_AdaptAdaptLoMax.Total_Samples__Y_ FaultManager.APP2_AdaptAdaptLoMax.Action_1 FaultManager.APP2_AdaptAdaptLoMax.Action_1_Condition FaultManager.APP2_AdaptAdaptLoMax.Action_2 FaultManager.APP2_AdaptAdaptLoMax.Action_2_Condition FaultManager.APP2_AdaptAdaptLoMax.Action_3 FaultManager.APP2_AdaptAdaptLoMax.Action_3_Condition FaultManager.APP2_AdaptAdaptLoMax.Action_4 FaultManager.APP2_AdaptAdaptLoMax.Action_4_Condition FaultManager.APP2_AdaptAdaptLoMin.Mode FaultManager.APP2_AdaptAdaptLoMin.ID FaultManager.APP2_AdaptAdaptLoMin.Test FaultManager.APP2_AdaptAdaptLoMin.Faulty_Samples__X_ FaultManager.APP2_AdaptAdaptLoMin.Total_Samples__Y_ FaultManager.APP2_AdaptAdaptLoMin.Action_1 FaultManager.APP2_AdaptAdaptLoMin.Action_1_Condition FaultManager.APP2_AdaptAdaptLoMin.Action_2 FaultManager.APP2_AdaptAdaptLoMin.Action_2_Condition FaultManager.APP2_AdaptAdaptLoMin.Action_3 FaultManager.APP2_AdaptAdaptLoMin.Action_3_Condition FaultManager.APP2_AdaptAdaptLoMin.Action_4 FaultManager.APP2_AdaptAdaptLoMin.Action_4_Condition FaultManager.APP2_AdaptRangeHigh.Mode FaultManager.APP2_AdaptRangeHigh.ID FaultManager.APP2_AdaptRangeHigh.Test FaultManager.APP2_AdaptRangeHigh.Faulty_Samples__X_ FaultManager.APP2_AdaptRangeHigh.Total_Samples__Y_ FaultManager.APP2_AdaptRangeHigh.Action_1 FaultManager.APP2_AdaptRangeHigh.Action_1_Condition FaultManager.APP2_AdaptRangeHigh.Action_2 FaultManager.APP2_AdaptRangeHigh.Action_2_Condition FaultManager.APP2_AdaptRangeHigh.Action_3 FaultManager.APP2_AdaptRangeHigh.Action_3_Condition FaultManager.APP2_AdaptRangeHigh.Action_4 FaultManager.APP2_AdaptRangeHigh.Action_4_Condition FaultManager.APP2_AdaptRangeLow.Mode FaultManager.APP2_AdaptRangeLow.ID FaultManager.APP2_AdaptRangeLow.Test FaultManager.APP2_AdaptRangeLow.Faulty_Samples__X_ FaultManager.APP2_AdaptRangeLow.Total_Samples__Y_ FaultManager.APP2_AdaptRangeLow.Action_1 FaultManager.APP2_AdaptRangeLow.Action_1_Condition FaultManager.APP2_AdaptRangeLow.Action_2 FaultManager.APP2_AdaptRangeLow.Action_2_Condition FaultManager.APP2_AdaptRangeLow.Action_3 FaultManager.APP2_AdaptRangeLow.Action_3_Condition FaultManager.APP2_AdaptRangeLow.Action_4 FaultManager.APP2_AdaptRangeLow.Action_4_Condition FaultManager.APP_Sensors_Conflict.Mode FaultManager.APP_Sensors_Conflict.ID FaultManager.APP_Sensors_Conflict.Test FaultManager.APP_Sensors_Conflict.Faulty_Samples__X_ FaultManager.APP_Sensors_Conflict.Total_Samples__Y_ FaultManager.APP_Sensors_Conflict.Action_1 FaultManager.APP_Sensors_Conflict.Action_1_Condition FaultManager.APP_Sensors_Conflict.Action_2 FaultManager.APP_Sensors_Conflict.Action_2_Condition FaultManager.APP_Sensors_Conflict.Action_3 FaultManager.APP_Sensors_Conflict.Action_3_Condition FaultManager.APP_Sensors_Conflict.Action_4 FaultManager.APP_Sensors_Conflict.Action_4_Condition FaultManager.AirflowMismatch_Fault.Mode FaultManager.AirflowMismatch_Fault.ID FaultManager.AirflowMismatch_Fault.Test FaultManager.AirflowMismatch_Fault.Faulty_Samples__X_ FaultManager.AirflowMismatch_Fault.Total_Samples__Y_ FaultManager.AirflowMismatch_Fault.Action_1 FaultManager.AirflowMismatch_Fault.Action_1_Condition FaultManager.AirflowMismatch_Fault.Action_2 FaultManager.AirflowMismatch_Fault.Action_2_Condition FaultManager.AirflowMismatch_Fault.Action_3 FaultManager.AirflowMismatch_Fault.Action_3_Condition FaultManager.AirflowMismatch_Fault.Action_4 FaultManager.AirflowMismatch_Fault.Action_4_Condition FaultManager.AltInop_Fault.Mode FaultManager.AltInop_Fault.ID FaultManager.AltInop_Fault.Test FaultManager.AltInop_Fault.Faulty_Samples__X_ FaultManager.AltInop_Fault.Total_Samples__Y_ FaultManager.AltInop_Fault.Action_1 FaultManager.AltInop_Fault.Action_1_Condition FaultManager.AltInop_Fault.Action_2 FaultManager.AltInop_Fault.Action_2_Condition FaultManager.AltInop_Fault.Action_3 FaultManager.AltInop_Fault.Action_3_Condition FaultManager.AltInop_Fault.Action_4 FaultManager.AltInop_Fault.Action_4_Condition FaultManager.Bank1_EquivRatioRangeHigh.Mode FaultManager.Bank1_EquivRatioRangeHigh.ID FaultManager.Bank1_EquivRatioRangeHigh.Test FaultManager.Bank1_EquivRatioRangeHigh.Faulty_Samples__X_ FaultManager.Bank1_EquivRatioRangeHigh.Total_Samples__Y_ FaultManager.Bank1_EquivRatioRangeHigh.Action_1 FaultManager.Bank1_EquivRatioRangeHigh.Action_1_Condition FaultManager.Bank1_EquivRatioRangeHigh.Action_2 FaultManager.Bank1_EquivRatioRangeHigh.Action_2_Condition FaultManager.Bank1_EquivRatioRangeHigh.Action_3 FaultManager.Bank1_EquivRatioRangeHigh.Action_3_Condition FaultManager.Bank1_EquivRatioRangeHigh.Action_4 FaultManager.Bank1_EquivRatioRangeHigh.Action_4_Condition FaultManager.Bank1_EquivRatioRangeLow.Mode FaultManager.Bank1_EquivRatioRangeLow.ID FaultManager.Bank1_EquivRatioRangeLow.Test FaultManager.Bank1_EquivRatioRangeLow.Faulty_Samples__X_ FaultManager.Bank1_EquivRatioRangeLow.Total_Samples__Y_ FaultManager.Bank1_EquivRatioRangeLow.Action_1 FaultManager.Bank1_EquivRatioRangeLow.Action_1_Condition FaultManager.Bank1_EquivRatioRangeLow.Action_2 FaultManager.Bank1_EquivRatioRangeLow.Action_2_Condition FaultManager.Bank1_EquivRatioRangeLow.Action_3 FaultManager.Bank1_EquivRatioRangeLow.Action_3_Condition FaultManager.Bank1_EquivRatioRangeLow.Action_4 FaultManager.Bank1_EquivRatioRangeLow.Action_4_Condition FaultManager.Bank2_EquivRatioRangeHigh.Mode FaultManager.Bank2_EquivRatioRangeHigh.ID FaultManager.Bank2_EquivRatioRangeHigh.Test FaultManager.Bank2_EquivRatioRangeHigh.Faulty_Samples__X_ FaultManager.Bank2_EquivRatioRangeHigh.Total_Samples__Y_ FaultManager.Bank2_EquivRatioRangeHigh.Action_1 FaultManager.Bank2_EquivRatioRangeHigh.Action_1_Condition FaultManager.Bank2_EquivRatioRangeHigh.Action_2 FaultManager.Bank2_EquivRatioRangeHigh.Action_2_Condition FaultManager.Bank2_EquivRatioRangeHigh.Action_3 FaultManager.Bank2_EquivRatioRangeHigh.Action_3_Condition FaultManager.Bank2_EquivRatioRangeHigh.Action_4 FaultManager.Bank2_EquivRatioRangeHigh.Action_4_Condition FaultManager.Bank2_EquivRatioRangeLow.Mode FaultManager.Bank2_EquivRatioRangeLow.ID FaultManager.Bank2_EquivRatioRangeLow.Test FaultManager.Bank2_EquivRatioRangeLow.Faulty_Samples__X_ FaultManager.Bank2_EquivRatioRangeLow.Total_Samples__Y_ FaultManager.Bank2_EquivRatioRangeLow.Action_1 FaultManager.Bank2_EquivRatioRangeLow.Action_1_Condition FaultManager.Bank2_EquivRatioRangeLow.Action_2 FaultManager.Bank2_EquivRatioRangeLow.Action_2_Condition FaultManager.Bank2_EquivRatioRangeLow.Action_3 FaultManager.Bank2_EquivRatioRangeLow.Action_3_Condition FaultManager.Bank2_EquivRatioRangeLow.Action_4 FaultManager.Bank2_EquivRatioRangeLow.Action_4_Condition FaultManager.CATRangeHigh.Mode FaultManager.CATRangeHigh.ID FaultManager.CATRangeHigh.Test FaultManager.CATRangeHigh.Faulty_Samples__X_ FaultManager.CATRangeHigh.Total_Samples__Y_ FaultManager.CATRangeHigh.Action_1 FaultManager.CATRangeHigh.Action_1_Condition FaultManager.CATRangeHigh.Action_2 FaultManager.CATRangeHigh.Action_2_Condition FaultManager.CATRangeHigh.Action_3 FaultManager.CATRangeHigh.Action_3_Condition FaultManager.CATRangeHigh.Action_4 FaultManager.CATRangeHigh.Action_4_Condition FaultManager.CATRangeLow.Mode FaultManager.CATRangeLow.ID FaultManager.CATRangeLow.Test FaultManager.CATRangeLow.Faulty_Samples__X_ FaultManager.CATRangeLow.Total_Samples__Y_ FaultManager.CATRangeLow.Action_1 FaultManager.CATRangeLow.Action_1_Condition FaultManager.CATRangeLow.Action_2 FaultManager.CATRangeLow.Action_2_Condition FaultManager.CATRangeLow.Action_3 FaultManager.CATRangeLow.Action_3_Condition FaultManager.CATRangeLow.Action_4 FaultManager.CATRangeLow.Action_4_Condition FaultManager.CamEdgesFault.Mode FaultManager.CamEdgesFault.ID FaultManager.CamEdgesFault.Test FaultManager.CamEdgesFault.Faulty_Samples__X_ FaultManager.CamEdgesFault.Total_Samples__Y_ FaultManager.CamEdgesFault.Action_1 FaultManager.CamEdgesFault.Action_1_Condition FaultManager.CamEdgesFault.Action_2 FaultManager.CamEdgesFault.Action_2_Condition FaultManager.CamEdgesFault.Action_3 FaultManager.CamEdgesFault.Action_3_Condition FaultManager.CamEdgesFault.Action_4 FaultManager.CamEdgesFault.Action_4_Condition FaultManager.CamSyncFault.Mode FaultManager.CamSyncFault.ID FaultManager.CamSyncFault.Test FaultManager.CamSyncFault.Faulty_Samples__X_ FaultManager.CamSyncFault.Total_Samples__Y_ FaultManager.CamSyncFault.Action_1 FaultManager.CamSyncFault.Action_1_Condition FaultManager.CamSyncFault.Action_2 FaultManager.CamSyncFault.Action_2_Condition FaultManager.CamSyncFault.Action_3 FaultManager.CamSyncFault.Action_3_Condition FaultManager.CamSyncFault.Action_4 FaultManager.CamSyncFault.Action_4_Condition FaultManager.ClutchStuckHigh_Fault.Mode FaultManager.ClutchStuckHigh_Fault.ID FaultManager.ClutchStuckHigh_Fault.Test FaultManager.ClutchStuckHigh_Fault.Faulty_Samples__X_ FaultManager.ClutchStuckHigh_Fault.Total_Samples__Y_ FaultManager.ClutchStuckHigh_Fault.Action_1 FaultManager.ClutchStuckHigh_Fault.Action_1_Condition FaultManager.ClutchStuckHigh_Fault.Action_2 FaultManager.ClutchStuckHigh_Fault.Action_2_Condition FaultManager.ClutchStuckHigh_Fault.Action_3 FaultManager.ClutchStuckHigh_Fault.Action_3_Condition FaultManager.ClutchStuckHigh_Fault.Action_4 FaultManager.ClutchStuckHigh_Fault.Action_4_Condition FaultManager.CrankEdgesFault.Mode FaultManager.CrankEdgesFault.ID FaultManager.CrankEdgesFault.Test FaultManager.CrankEdgesFault.Faulty_Samples__X_ FaultManager.CrankEdgesFault.Total_Samples__Y_ FaultManager.CrankEdgesFault.Action_1 FaultManager.CrankEdgesFault.Action_1_Condition FaultManager.CrankEdgesFault.Action_2 FaultManager.CrankEdgesFault.Action_2_Condition FaultManager.CrankEdgesFault.Action_3 FaultManager.CrankEdgesFault.Action_3_Condition FaultManager.CrankEdgesFault.Action_4 FaultManager.CrankEdgesFault.Action_4_Condition FaultManager.CrankSyncFault.Mode FaultManager.CrankSyncFault.ID FaultManager.CrankSyncFault.Test FaultManager.CrankSyncFault.Faulty_Samples__X_ FaultManager.CrankSyncFault.Total_Samples__Y_ FaultManager.CrankSyncFault.Action_1 FaultManager.CrankSyncFault.Action_1_Condition FaultManager.CrankSyncFault.Action_2 FaultManager.CrankSyncFault.Action_2_Condition FaultManager.CrankSyncFault.Action_3 FaultManager.CrankSyncFault.Action_3_Condition FaultManager.CrankSyncFault.Action_4 FaultManager.CrankSyncFault.Action_4_Condition FaultManager.Cylinder1_HardMisfire.Mode FaultManager.Cylinder1_HardMisfire.ID FaultManager.Cylinder1_HardMisfire.Test FaultManager.Cylinder1_HardMisfire.Faulty_Samples__X_ FaultManager.Cylinder1_HardMisfire.Total_Samples__Y_ FaultManager.Cylinder1_HardMisfire.Action_1 FaultManager.Cylinder1_HardMisfire.Action_1_Condition FaultManager.Cylinder1_HardMisfire.Action_2 FaultManager.Cylinder1_HardMisfire.Action_2_Condition FaultManager.Cylinder1_HardMisfire.Action_3 FaultManager.Cylinder1_HardMisfire.Action_3_Condition FaultManager.Cylinder1_HardMisfire.Action_4 FaultManager.Cylinder1_HardMisfire.Action_4_Condition FaultManager.Cylinder2_HardMisfire.Mode FaultManager.Cylinder2_HardMisfire.ID FaultManager.Cylinder2_HardMisfire.Test FaultManager.Cylinder2_HardMisfire.Faulty_Samples__X_ FaultManager.Cylinder2_HardMisfire.Total_Samples__Y_ FaultManager.Cylinder2_HardMisfire.Action_1 FaultManager.Cylinder2_HardMisfire.Action_1_Condition FaultManager.Cylinder2_HardMisfire.Action_2 FaultManager.Cylinder2_HardMisfire.Action_2_Condition FaultManager.Cylinder2_HardMisfire.Action_3 FaultManager.Cylinder2_HardMisfire.Action_3_Condition FaultManager.Cylinder2_HardMisfire.Action_4 FaultManager.Cylinder2_HardMisfire.Action_4_Condition FaultManager.Cylinder3_HardMisfire.Mode FaultManager.Cylinder3_HardMisfire.ID FaultManager.Cylinder3_HardMisfire.Test FaultManager.Cylinder3_HardMisfire.Faulty_Samples__X_ FaultManager.Cylinder3_HardMisfire.Total_Samples__Y_ FaultManager.Cylinder3_HardMisfire.Action_1 FaultManager.Cylinder3_HardMisfire.Action_1_Condition FaultManager.Cylinder3_HardMisfire.Action_2 FaultManager.Cylinder3_HardMisfire.Action_2_Condition FaultManager.Cylinder3_HardMisfire.Action_3 FaultManager.Cylinder3_HardMisfire.Action_3_Condition FaultManager.Cylinder3_HardMisfire.Action_4 FaultManager.Cylinder3_HardMisfire.Action_4_Condition FaultManager.Cylinder4_HardMisfire.Mode FaultManager.Cylinder4_HardMisfire.ID FaultManager.Cylinder4_HardMisfire.Test FaultManager.Cylinder4_HardMisfire.Faulty_Samples__X_ FaultManager.Cylinder4_HardMisfire.Total_Samples__Y_ FaultManager.Cylinder4_HardMisfire.Action_1 FaultManager.Cylinder4_HardMisfire.Action_1_Condition FaultManager.Cylinder4_HardMisfire.Action_2 FaultManager.Cylinder4_HardMisfire.Action_2_Condition FaultManager.Cylinder4_HardMisfire.Action_3 FaultManager.Cylinder4_HardMisfire.Action_3_Condition FaultManager.Cylinder4_HardMisfire.Action_4 FaultManager.Cylinder4_HardMisfire.Action_4_Condition FaultManager.Cylinder5_HardMisfire.Mode FaultManager.Cylinder5_HardMisfire.ID FaultManager.Cylinder5_HardMisfire.Test FaultManager.Cylinder5_HardMisfire.Faulty_Samples__X_ FaultManager.Cylinder5_HardMisfire.Total_Samples__Y_ FaultManager.Cylinder5_HardMisfire.Action_1 FaultManager.Cylinder5_HardMisfire.Action_1_Condition FaultManager.Cylinder5_HardMisfire.Action_2 FaultManager.Cylinder5_HardMisfire.Action_2_Condition FaultManager.Cylinder5_HardMisfire.Action_3 FaultManager.Cylinder5_HardMisfire.Action_3_Condition FaultManager.Cylinder5_HardMisfire.Action_4 FaultManager.Cylinder5_HardMisfire.Action_4_Condition FaultManager.Cylinder6_HardMisfire.Mode FaultManager.Cylinder6_HardMisfire.ID FaultManager.Cylinder6_HardMisfire.Test FaultManager.Cylinder6_HardMisfire.Faulty_Samples__X_ FaultManager.Cylinder6_HardMisfire.Total_Samples__Y_ FaultManager.Cylinder6_HardMisfire.Action_1 FaultManager.Cylinder6_HardMisfire.Action_1_Condition FaultManager.Cylinder6_HardMisfire.Action_2 FaultManager.Cylinder6_HardMisfire.Action_2_Condition FaultManager.Cylinder6_HardMisfire.Action_3 FaultManager.Cylinder6_HardMisfire.Action_3_Condition FaultManager.Cylinder6_HardMisfire.Action_4 FaultManager.Cylinder6_HardMisfire.Action_4_Condition FaultManager.Cylinder7_HardMisfire.Mode FaultManager.Cylinder7_HardMisfire.ID FaultManager.Cylinder7_HardMisfire.Test FaultManager.Cylinder7_HardMisfire.Faulty_Samples__X_ FaultManager.Cylinder7_HardMisfire.Total_Samples__Y_ FaultManager.Cylinder7_HardMisfire.Action_1 FaultManager.Cylinder7_HardMisfire.Action_1_Condition FaultManager.Cylinder7_HardMisfire.Action_2 FaultManager.Cylinder7_HardMisfire.Action_2_Condition FaultManager.Cylinder7_HardMisfire.Action_3 FaultManager.Cylinder7_HardMisfire.Action_3_Condition FaultManager.Cylinder7_HardMisfire.Action_4 FaultManager.Cylinder7_HardMisfire.Action_4_Condition FaultManager.Cylinder8_HardMisfire.Mode FaultManager.Cylinder8_HardMisfire.ID FaultManager.Cylinder8_HardMisfire.Test FaultManager.Cylinder8_HardMisfire.Faulty_Samples__X_ FaultManager.Cylinder8_HardMisfire.Total_Samples__Y_ FaultManager.Cylinder8_HardMisfire.Action_1 FaultManager.Cylinder8_HardMisfire.Action_1_Condition FaultManager.Cylinder8_HardMisfire.Action_2 FaultManager.Cylinder8_HardMisfire.Action_2_Condition FaultManager.Cylinder8_HardMisfire.Action_3 FaultManager.Cylinder8_HardMisfire.Action_3_Condition FaultManager.Cylinder8_HardMisfire.Action_4 FaultManager.Cylinder8_HardMisfire.Action_4_Condition FaultManager.ECTOverTempFault.Mode FaultManager.ECTOverTempFault.ID FaultManager.ECTOverTempFault.Test FaultManager.ECTOverTempFault.Faulty_Samples__X_ FaultManager.ECTOverTempFault.Total_Samples__Y_ FaultManager.ECTOverTempFault.Action_1 FaultManager.ECTOverTempFault.Action_1_Condition FaultManager.ECTOverTempFault.Action_2 FaultManager.ECTOverTempFault.Action_2_Condition FaultManager.ECTOverTempFault.Action_3 FaultManager.ECTOverTempFault.Action_3_Condition FaultManager.ECTOverTempFault.Action_4 FaultManager.ECTOverTempFault.Action_4_Condition FaultManager.ECTRangeHigh.Mode FaultManager.ECTRangeHigh.ID FaultManager.ECTRangeHigh.Test FaultManager.ECTRangeHigh.Faulty_Samples__X_ FaultManager.ECTRangeHigh.Total_Samples__Y_ FaultManager.ECTRangeHigh.Action_1 FaultManager.ECTRangeHigh.Action_1_Condition FaultManager.ECTRangeHigh.Action_2 FaultManager.ECTRangeHigh.Action_2_Condition FaultManager.ECTRangeHigh.Action_3 FaultManager.ECTRangeHigh.Action_3_Condition FaultManager.ECTRangeHigh.Action_4 FaultManager.ECTRangeHigh.Action_4_Condition FaultManager.ECTRangeLow.Mode FaultManager.ECTRangeLow.ID FaultManager.ECTRangeLow.Test FaultManager.ECTRangeLow.Faulty_Samples__X_ FaultManager.ECTRangeLow.Total_Samples__Y_ FaultManager.ECTRangeLow.Action_1 FaultManager.ECTRangeLow.Action_1_Condition FaultManager.ECTRangeLow.Action_2 FaultManager.ECTRangeLow.Action_2_Condition FaultManager.ECTRangeLow.Action_3 FaultManager.ECTRangeLow.Action_3_Condition FaultManager.ECTRangeLow.Action_4 FaultManager.ECTRangeLow.Action_4_Condition FaultManager.ECTSevereOverTempFault.Mode FaultManager.ECTSevereOverTempFault.ID FaultManager.ECTSevereOverTempFault.Test FaultManager.ECTSevereOverTempFault.Faulty_Samples__X_ FaultManager.ECTSevereOverTempFault.Total_Samples__Y_ FaultManager.ECTSevereOverTempFault.Action_1 FaultManager.ECTSevereOverTempFault.Action_1_Condition FaultManager.ECTSevereOverTempFault.Action_2 FaultManager.ECTSevereOverTempFault.Action_2_Condition FaultManager.ECTSevereOverTempFault.Action_3 FaultManager.ECTSevereOverTempFault.Action_3_Condition FaultManager.ECTSevereOverTempFault.Action_4 FaultManager.ECTSevereOverTempFault.Action_4_Condition FaultManager.EST1_Open.Mode FaultManager.EST1_Open.ID FaultManager.EST1_Open.Test FaultManager.EST1_Open.Faulty_Samples__X_ FaultManager.EST1_Open.Total_Samples__Y_ FaultManager.EST1_Open.Action_1 FaultManager.EST1_Open.Action_1_Condition FaultManager.EST1_Open.Action_2 FaultManager.EST1_Open.Action_2_Condition FaultManager.EST1_Open.Action_3 FaultManager.EST1_Open.Action_3_Condition FaultManager.EST1_Open.Action_4 FaultManager.EST1_Open.Action_4_Condition FaultManager.EST1_Short.Mode FaultManager.EST1_Short.ID FaultManager.EST1_Short.Test FaultManager.EST1_Short.Faulty_Samples__X_ FaultManager.EST1_Short.Total_Samples__Y_ FaultManager.EST1_Short.Action_1 FaultManager.EST1_Short.Action_1_Condition FaultManager.EST1_Short.Action_2 FaultManager.EST1_Short.Action_2_Condition FaultManager.EST1_Short.Action_3 FaultManager.EST1_Short.Action_3_Condition FaultManager.EST1_Short.Action_4 FaultManager.EST1_Short.Action_4_Condition FaultManager.EST2_Open.Mode FaultManager.EST2_Open.ID FaultManager.EST2_Open.Test FaultManager.EST2_Open.Faulty_Samples__X_ FaultManager.EST2_Open.Total_Samples__Y_ FaultManager.EST2_Open.Action_1 FaultManager.EST2_Open.Action_1_Condition FaultManager.EST2_Open.Action_2 FaultManager.EST2_Open.Action_2_Condition FaultManager.EST2_Open.Action_3 FaultManager.EST2_Open.Action_3_Condition FaultManager.EST2_Open.Action_4 FaultManager.EST2_Open.Action_4_Condition FaultManager.EST2_Short.Mode FaultManager.EST2_Short.ID FaultManager.EST2_Short.Test FaultManager.EST2_Short.Faulty_Samples__X_ FaultManager.EST2_Short.Total_Samples__Y_ FaultManager.EST2_Short.Action_1 FaultManager.EST2_Short.Action_1_Condition FaultManager.EST2_Short.Action_2 FaultManager.EST2_Short.Action_2_Condition FaultManager.EST2_Short.Action_3 FaultManager.EST2_Short.Action_3_Condition FaultManager.EST2_Short.Action_4 FaultManager.EST2_Short.Action_4_Condition FaultManager.EST3_Open.Mode FaultManager.EST3_Open.ID FaultManager.EST3_Open.Test FaultManager.EST3_Open.Faulty_Samples__X_ FaultManager.EST3_Open.Total_Samples__Y_ FaultManager.EST3_Open.Action_1 FaultManager.EST3_Open.Action_1_Condition FaultManager.EST3_Open.Action_2 FaultManager.EST3_Open.Action_2_Condition FaultManager.EST3_Open.Action_3 FaultManager.EST3_Open.Action_3_Condition FaultManager.EST3_Open.Action_4 FaultManager.EST3_Open.Action_4_Condition FaultManager.EST3_Short.Mode FaultManager.EST3_Short.ID FaultManager.EST3_Short.Test FaultManager.EST3_Short.Faulty_Samples__X_ FaultManager.EST3_Short.Total_Samples__Y_ FaultManager.EST3_Short.Action_1 FaultManager.EST3_Short.Action_1_Condition FaultManager.EST3_Short.Action_2 FaultManager.EST3_Short.Action_2_Condition FaultManager.EST3_Short.Action_3 FaultManager.EST3_Short.Action_3_Condition FaultManager.EST3_Short.Action_4 FaultManager.EST3_Short.Action_4_Condition FaultManager.EST4_Open.Mode FaultManager.EST4_Open.ID FaultManager.EST4_Open.Test FaultManager.EST4_Open.Faulty_Samples__X_ FaultManager.EST4_Open.Total_Samples__Y_ FaultManager.EST4_Open.Action_1 FaultManager.EST4_Open.Action_1_Condition FaultManager.EST4_Open.Action_2 /end DEF_CHARACTERISTIC
 /begin OUT_MEASUREMENT FaultMarquees.FaultMarquees.Current_Suspected FaultMarquees.FaultMarquees.Current_Active FaultMarquees.FaultMarquees.Current_Occurred /end OUT_MEASUREMENT
 /begin SUB_FUNCTION Foreground Action_Reasons /end SUB_FUNCTION
/end FUNCTION
/end MODULE
/end PROJECT
