ASAP2_VERSION 1 51
/begin PROJECT Project ""
/begin MODULE BaseEngin_034 ""
/begin MOD_COMMON /* MOD_COMMON Comment */ "" BYTE_ORDER MSB_FIRST ALIGNMENT_BYTE 1 ALIGNMENT_FLOAT32_IEEE 1 ALIGNMENT_FLOAT64_IEEE 1 ALIGNMENT_LONG 1 ALIGNMENT_WORD 1 /end MOD_COMMON
/begin MEASUREMENT ACAirFlowOfst "AC air position in based on ECT." FLOAT32_IEEE CompuMethod_7 1 0 -1E+17 1E+17 ECU_ADDRESS 0x40000117 /end MEASUREMENT
/begin MEASUREMENT ACLowChrg "" UBYTE CompuMethod_11 1 0 0 1 ECU_ADDRESS 0x4000011B /end MEASUREMENT
/begin MEASUREMENT ACOutput "" UBYTE CompuMethod_11 1 0 0 1 ECU_ADDRESS 0x4000011C /end MEASUREMENT
/begin MEASUREMENT ACOverPressure "" UBYTE CompuMethod_11 1 0 0 1 ECU_ADDRESS 0x4000011D /end MEASUREMENT
/begin MEASUREMENT ACPres "Final value after Linear Sensor Characterization" FLOAT32_IEEE CompuMethod_13 1 0 -1E+17 1E+17 ECU_ADDRESS 0x4000011E /end MEASUREMENT
/begin MEASUREMENT ACPres05Idx "Index of AC system high side pressure" UWORD CompuMethod_15 1 0 0 127.998 ECU_ADDRESS 0x40000122 /end MEASUREMENT
/begin MEASUREMENT ACPres05In "Index of AC system high side pressure" FLOAT32_IEEE CompuMethod_16 1 0 -1E+17 1E+17 ECU_ADDRESS 0x40000124 /end MEASUREMENT
/begin MEASUREMENT ACPres07Idx "Index of AC system high side pressure" UWORD CompuMethod_15 1 0 0 127.998 ECU_ADDRESS 0x40000128 /end MEASUREMENT
/begin MEASUREMENT ACPres07In "Index of AC system high side pressure" FLOAT32_IEEE CompuMethod_16 1 0 -1E+17 1E+17 ECU_ADDRESS 0x4000012A /end MEASUREMENT
/begin MEASUREMENT ACPresADC "Singal measured directly from sensor" UWORD CompuMethod_17 1 0 0 65535 ECU_ADDRESS 0x4000012E /end MEASUREMENT
/begin MEASUREMENT ACPresFanSpeed "" FLOAT32_IEEE CompuMethod_2 1 0 -1E+17 1E+17 ECU_ADDRESS 0x40000130 /end MEASUREMENT
/begin MEASUREMENT ACPresFanSpeed_Stall "" FLOAT32_IEEE CompuMethod_2 1 0 -1E+17 1E+17 ECU_ADDRESS 0x40000134 /end MEASUREMENT
/begin MEASUREMENT ACPresRaw "After conversion to engineering units, before range checking" FLOAT32_IEEE CompuMethod_13 1 0 -1E+17 1E+17 ECU_ADDRESS 0x40000138 /end MEASUREMENT
/begin MEASUREMENT ACRpmHighEnbl "" UBYTE CompuMethod_11 1 0 0 1 ECU_ADDRESS 0x4000013C /end MEASUREMENT
/begin MEASUREMENT ACRpmLowEnbl "" UBYTE CompuMethod_11 1 0 0 1 ECU_ADDRESS 0x4000013D /end MEASUREMENT
/begin MEASUREMENT ACTempEnbl "" UBYTE CompuMethod_11 1 0 0 1 ECU_ADDRESS 0x40000143 /end MEASUREMENT
/begin MEASUREMENT ACTpsEnble "" UBYTE CompuMethod_11 1 0 0 1 ECU_ADDRESS 0x40000144 /end MEASUREMENT
/begin MEASUREMENT AirMinGovOutput "Total output from min. gov. air PID controller." FLOAT32_IEEE CompuMethod_7 1 0 -1E+17 1E+17 ECU_ADDRESS 0x400001A0 /end MEASUREMENT
/begin MEASUREMENT BaseAirflowOfst "Base air position in based on ECT." FLOAT32_IEEE CompuMethod_7 1 0 -1E+17 1E+17 ECU_ADDRESS 0x40000258 /end MEASUREMENT
/begin MEASUREMENT BaseAirOffset "Base air request position, includes ramp into idle manager." FLOAT32_IEEE CompuMethod_50 1 0 -1E+17 1E+17 ECU_ADDRESS 0x4000025C /end MEASUREMENT
/begin MEASUREMENT ECTFanSpeed "" FLOAT32_IEEE CompuMethod_2 1 0 -1E+17 1E+17 ECU_ADDRESS 0x40000447 /end MEASUREMENT
/begin MEASUREMENT ECTFanSpeed_Stall "" FLOAT32_IEEE CompuMethod_2 1 0 -1E+17 1E+17 ECU_ADDRESS 0x4000044B /end MEASUREMENT
/begin MEASUREMENT Fan1Cmd "FAN 1 final request" FLOAT32_IEEE CompuMethod_7 1 0 -1E+17 1E+17 ECU_ADDRESS 0x40000528 /end MEASUREMENT
/begin MEASUREMENT Fan2Cmd "Fan 2 final command" FLOAT32_IEEE CompuMethod_7 1 0 -1E+17 1E+17 ECU_ADDRESS 0x40000530 /end MEASUREMENT
/begin MEASUREMENT IATFanSpeed "" FLOAT32_IEEE CompuMethod_2 1 0 -1E+17 1E+17 ECU_ADDRESS 0x4000065A /end MEASUREMENT
/begin MEASUREMENT IATFanSpeed_Stall "" FLOAT32_IEEE CompuMethod_2 1 0 -1E+17 1E+17 ECU_ADDRESS 0x4000065E /end MEASUREMENT
/begin MEASUREMENT IdleHandOffMult "" FLOAT32_IEEE CompuMethod_2 1 0 -1E+17 1E+17 ECU_ADDRESS 0x40000668 /end MEASUREMENT
/begin MEASUREMENT MinGovReset "" UBYTE CompuMethod_11 1 0 0 1 ECU_ADDRESS 0x400007EA /end MEASUREMENT
/begin MEASUREMENT SpkMinGovOutput "" FLOAT32_IEEE CompuMethod_2 1 0 -1E+17 1E+17 ECU_ADDRESS 0x40000AC1 /end MEASUREMENT
/begin CHARACTERISTIC AC_new "Override actuator, in engineering units" VALUE 0x80000051 RecordLayout_1 0 CompuMethod_4 0 1 /end CHARACTERISTIC
/begin CHARACTERISTIC AC_ovr "" VALUE 0x80000052 RecordLayout_1 0 CompuMethod_5 0 1 /end CHARACTERISTIC
/begin CHARACTERISTIC AC_Polarity "Inverts the output of the actuator relative to the desired command - 0 = High True    1 = Low True" VALUE 0x80000053 RecordLayout_1 0 CompuMethod_4 0 1 /end CHARACTERISTIC
/begin CHARACTERISTIC AC_TPSOff "Throttle position at which AC gets disengaged" VALUE 0x80000054 RecordLayout_4 0 CompuMethod_6 0 65535 /end CHARACTERISTIC
/begin CHARACTERISTIC AC_TPSOn "Throttle position at which AC gets engaged" VALUE 0x80000056 RecordLayout_4 0 CompuMethod_6 0 65535 /end CHARACTERISTIC
/begin CHARACTERISTIC ACAirFlowOfst_Enab "Enables AC airflow adder" VALUE 0x80000058 RecordLayout_1 0 CompuMethod_8 0 1 /end CHARACTERISTIC
/begin CHARACTERISTIC ACAirFlowOfstTbl "AC air position in based on ECT." CURVE 0x80000059 RecordLayout_5 0 CompuMethod_7 -1E+17 1E+17
 /begin AXIS_DESCR COM_AXIS ACPres05In CompuMethod_16 5 -150 10000 AXIS_PTS_REF ACPres05IdxArr /end AXIS_DESCR
/end CHARACTERISTIC
/begin CHARACTERISTIC ACHighPresOff "" VALUE 0x8000006D RecordLayout_4 0 CompuMethod_9 0 65535 /end CHARACTERISTIC
/begin CHARACTERISTIC ACHighPresOn "" VALUE 0x8000006F RecordLayout_4 0 CompuMethod_9 0 65535 /end CHARACTERISTIC
/begin CHARACTERISTIC ACHighPressureDisable "Pressure when ac gets disabled" VALUE 0x80000071 RecordLayout_4 0 CompuMethod_10 0 65535 /end CHARACTERISTIC
/begin CHARACTERISTIC ACLowPresOff "" VALUE 0x80000073 RecordLayout_4 0 CompuMethod_9 0 65535 /end CHARACTERISTIC
/begin CHARACTERISTIC ACLowPresOn "" VALUE 0x80000075 RecordLayout_4 0 CompuMethod_9 0 65535 /end CHARACTERISTIC
/begin CHARACTERISTIC ACLowPressureDisable "Pressure when ac gets disabled" VALUE 0x80000077 RecordLayout_4 0 CompuMethod_10 0 65535 /end CHARACTERISTIC
/begin CHARACTERISTIC ACPin "Digital output pin selection for DOut10176p0004" VALUE 0x80000079 RecordLayout_6 0 CompuMethod_12 -32768 32767 /end CHARACTERISTIC
/begin CHARACTERISTIC ACPres_new "Override result of linear sensor characterization, in engineering units" VALUE 0x8000007B RecordLayout_5 0 CompuMethod_14 -1E+17 1E+17 /end CHARACTERISTIC
/begin CHARACTERISTIC ACPres_ovr "" VALUE 0x8000007F RecordLayout_1 0 CompuMethod_5 0 1 /end CHARACTERISTIC
/begin CHARACTERISTIC ACPresDfltValue "This is the initial default value should the sensor be in fault on key-up.  Otherwise the sensors outputs the last value prior to faulting" VALUE 0x800000B0 RecordLayout_5 0 CompuMethod_14 -1E+17 1E+17 /end CHARACTERISTIC
/begin CHARACTERISTIC ACPresFanOff "AC pressure when the fan turns off" VALUE 0x800000B4 RecordLayout_5 0 CompuMethod_18 -1E+17 1E+17 /end CHARACTERISTIC
/begin CHARACTERISTIC ACPresFanOn "AC pressure when the fan turns on" VALUE 0x800000B8 RecordLayout_5 0 CompuMethod_18 -1E+17 1E+17 /end CHARACTERISTIC
/begin CHARACTERISTIC ACPresFanSpeed_StallTbl "" CURVE 0x800000BC RecordLayout_5 0 CompuMethod_2 -1E+17 1E+17
 /begin AXIS_DESCR COM_AXIS ACPres05In CompuMethod_16 5 -150 10000 AXIS_PTS_REF ACPres05IdxArr /end AXIS_DESCR
/end CHARACTERISTIC
/begin CHARACTERISTIC ACPresFanSpeedMap "" MAP 0x800000D0 RecordLayout_5 0 CompuMethod_2 -1E+17 1E+17
 /begin AXIS_DESCR COM_AXIS VSPD07In CompuMethod_184 7 -100 200 AXIS_PTS_REF VSPD07IdxArr /end AXIS_DESCR
 /begin AXIS_DESCR COM_AXIS ACPres07In CompuMethod_16 7 -150 10000 AXIS_PTS_REF ACPres07IdxArr /end AXIS_DESCR
/end CHARACTERISTIC
/begin CHARACTERISTIC ACPresFilterConst "Filter time constant" VALUE 0x80000194 RecordLayout_5 0 CompuMethod_19 -1E+17 1E+17 /end CHARACTERISTIC
/begin CHARACTERISTIC ACPresGain "Scaling from A/D counts to engineering units" VALUE 0x80000198 RecordLayout_5 0 CompuMethod_20 -1E+17 1E+17 /end CHARACTERISTIC
/begin CHARACTERISTIC ACPresInputHiFltPos "Maximum allowable input, indicating short or open circuit" VALUE 0x8000019C RecordLayout_5 0 CompuMethod_21 -1E+17 1E+17 /end CHARACTERISTIC
/begin CHARACTERISTIC ACPresInputLoFltPos "Minimum allowable input, indicating short or open circuit" VALUE 0x800001A0 RecordLayout_5 0 CompuMethod_21 -1E+17 1E+17 /end CHARACTERISTIC
/begin CHARACTERISTIC ACPresOfst "Offset after gain in engineering units" VALUE 0x800001A4 RecordLayout_5 0 CompuMethod_14 -1E+17 1E+17 /end CHARACTERISTIC
/begin CHARACTERISTIC ACSpdFastOff "Engine speed at which the compressor turns off at high side" VALUE 0x800001AB RecordLayout_4 0 CompuMethod_24 0 65535 /end CHARACTERISTIC
/begin CHARACTERISTIC ACSpdFastOn "Engine speed at which the compressor turns on at high side" VALUE 0x800001AD RecordLayout_4 0 CompuMethod_24 0 65535 /end CHARACTERISTIC
/begin CHARACTERISTIC ACSpdSlowOff "Engine speed at which the compressor turns off at low side" VALUE 0x800001AF RecordLayout_4 0 CompuMethod_24 0 65535 /end CHARACTERISTIC
/begin CHARACTERISTIC ACSpdSlowOn "Engine speed at which the compressor turns on at low side" VALUE 0x800001B1 RecordLayout_4 0 CompuMethod_24 0 65535 /end CHARACTERISTIC
/begin CHARACTERISTIC ACSwFanSpeed "Fan speed % req for AC Sw 0 to disable" VALUE 0x800001B5 RecordLayout_1 0 CompuMethod_26 0 100 /end CHARACTERISTIC
/begin CHARACTERISTIC ACSwFanSpeed_Stall "Fan speed % req for AC Sw 0 to disable" VALUE 0x800001B6 RecordLayout_5 0 CompuMethod_7 0 100 /end CHARACTERISTIC
/begin CHARACTERISTIC ACTempOff "" VALUE 0x800001C2 RecordLayout_5 0 CompuMethod_2 -1E+17 1E+17 /end CHARACTERISTIC
/begin CHARACTERISTIC ACTempOn "" VALUE 0x800001C6 RecordLayout_5 0 CompuMethod_2 -1E+17 1E+17 /end CHARACTERISTIC
/begin CHARACTERISTIC ACTimeFromStartDelay "Time from start AC enable delay" VALUE 0x800001CA RecordLayout_5 0 CompuMethod_27 0 1E+17 /end CHARACTERISTIC
/begin CHARACTERISTIC BaseAirflowOfstTbl "Base air position in based on ECT." CURVE 0x80000503 RecordLayout_5 0 CompuMethod_7 -1E+17 1E+17
 /begin AXIS_DESCR COM_AXIS ECT05In CompuMethod_63 5 -40 200 AXIS_PTS_REF ECT05IdxArr /end AXIS_DESCR
/end CHARACTERISTIC
/begin CHARACTERISTIC ECTFanOff "ECT temp when the fan turns off" VALUE 0x80001C11 RecordLayout_5 0 CompuMethod_63 -1E+17 1E+17 /end CHARACTERISTIC
/begin CHARACTERISTIC ECTFanOn "ECT temp when the fan turns on" VALUE 0x80001C15 RecordLayout_5 0 CompuMethod_63 -1E+17 1E+17 /end CHARACTERISTIC
/begin CHARACTERISTIC ECTFanSpeed_StallTbl "" CURVE 0x80001C19 RecordLayout_5 0 CompuMethod_2 -1E+17 1E+17
 /begin AXIS_DESCR COM_AXIS ECT05In CompuMethod_63 5 -40 200 AXIS_PTS_REF ECT05IdxArr /end AXIS_DESCR
/end CHARACTERISTIC
/begin CHARACTERISTIC ECTFanSpeedMap "" MAP 0x80001C2D RecordLayout_5 0 CompuMethod_2 -1E+17 1E+17
 /begin AXIS_DESCR COM_AXIS VSPD07In CompuMethod_184 7 -100 200 AXIS_PTS_REF VSPD07IdxArr /end AXIS_DESCR
 /begin AXIS_DESCR COM_AXIS ECT07In CompuMethod_63 7 -40 200 AXIS_PTS_REF ECT07IdxArr /end AXIS_DESCR
/end CHARACTERISTIC
/begin CHARACTERISTIC EST_InitialPin "First pin selection for Spark Sequence.  Goes up from here depending on the Sequence Type and number of cylinders" VALUE 0x80001F1C RecordLayout_6 0 CompuMethod_96 -32768 32767 /end CHARACTERISTIC
/begin CHARACTERISTIC EST_OpenThreshold "ADC counts for the diagnostic inputs, above which the driver is considered an open-circuit" VALUE 0x80001F1E RecordLayout_4 0 CompuMethod_9 0 1023 /end CHARACTERISTIC
/begin CHARACTERISTIC EST_SequenceType "Select the type of spark sequence.  The number of pins used will depend on this selection" VALUE 0x80001F20 RecordLayout_1 0 CompuMethod_97 0 255 /end CHARACTERISTIC
/begin CHARACTERISTIC ETCPin "PWM output pin selection for ETCPin" VALUE 0x800020DE RecordLayout_6 0 CompuMethod_106 -32768 32767 /end CHARACTERISTIC
/begin CHARACTERISTIC FAN_Mode "" VALUE 0x800027AE RecordLayout_1 0 CompuMethod_109 0 1 /end CHARACTERISTIC
/begin CHARACTERISTIC Fan1ACPres "Fan Enabler" VALUE 0x800027C8 RecordLayout_1 0 CompuMethod_8 0 1 /end CHARACTERISTIC
/begin CHARACTERISTIC Fan1ACSw "Fan Enabler" VALUE 0x800027C9 RecordLayout_1 0 CompuMethod_8 0 1 /end CHARACTERISTIC
/begin CHARACTERISTIC Fan1ECT "Fan Enabler" VALUE 0x800027CA RecordLayout_1 0 CompuMethod_8 0 1 /end CHARACTERISTIC
/begin CHARACTERISTIC Fan1IAT "Fan Enabler" VALUE 0x800027CB RecordLayout_1 0 CompuMethod_8 0 1 /end CHARACTERISTIC
/begin CHARACTERISTIC FAN1Pin_PWM "PWM output pin selection for FAN1Pin_PWM" VALUE 0x800027CC RecordLayout_6 0 CompuMethod_106 -32768 32767 /end CHARACTERISTIC
/begin CHARACTERISTIC Fan2ACPres "Fan Enabler" VALUE 0x800027E7 RecordLayout_1 0 CompuMethod_8 0 1 /end CHARACTERISTIC
/begin CHARACTERISTIC Fan2ACSw "Fan Enabler" VALUE 0x800027E8 RecordLayout_1 0 CompuMethod_8 0 1 /end CHARACTERISTIC
/begin CHARACTERISTIC Fan2ECT "Fan Enabler" VALUE 0x800027E9 RecordLayout_1 0 CompuMethod_8 0 1 /end CHARACTERISTIC
/begin CHARACTERISTIC Fan2IAT "Fan Enabler" VALUE 0x800027EA RecordLayout_1 0 CompuMethod_8 0 1 /end CHARACTERISTIC
/begin CHARACTERISTIC FAN2Pin_PWM "PWM output pin selection for FAN2Pin_PWM" VALUE 0x800027EB RecordLayout_6 0 CompuMethod_106 -32768 32767 /end CHARACTERISTIC
/begin CHARACTERISTIC FaultManager.Lambda2VoltHigh_Fault.Test "Fault manager configuration.  Select up to 4 actions for each fault." VALUE 0x80003352 RecordLayout_4 0 CompuMethod_114 0 65535 /end CHARACTERISTIC
/begin CHARACTERISTIC FaultManager.Lambda2VoltHigh_Fault.Faulty_Samples__X_ "Fault manager configuration.  Select up to 4 actions for each fault." VALUE 0x80003354 RecordLayout_4 0 CompuMethod_1 0 65535 /end CHARACTERISTIC
/begin CHARACTERISTIC FaultManager.Lambda2VoltHigh_Fault.Total_Samples__Y_ "Fault manager configuration.  Select up to 4 actions for each fault." VALUE 0x80003356 RecordLayout_4 0 CompuMethod_1 0 65535 /end CHARACTERISTIC
/begin CHARACTERISTIC FaultManager.Lambda2VoltHigh_Fault.Action_1 "Fault manager configuration.  Select up to 4 actions for each fault." VALUE 0x80003358 RecordLayout_4 0 CompuMethod_115 0 65535 /end CHARACTERISTIC
/begin CHARACTERISTIC FaultManager.Lambda2VoltHigh_Fault.Action_1_Condition "Fault manager configuration.  Select up to 4 actions for each fault." VALUE 0x8000335A RecordLayout_4 0 CompuMethod_116 0 65535 /end CHARACTERISTIC
/begin CHARACTERISTIC FaultManager.Lambda2VoltHigh_Fault.Action_2 "Fault manager configuration.  Select up to 4 actions for each fault." VALUE 0x8000335C RecordLayout_4 0 CompuMethod_115 0 65535 /end CHARACTERISTIC
/begin CHARACTERISTIC FaultManager.Lambda2VoltHigh_Fault.Action_2_Condition "Fault manager configuration.  Select up to 4 actions for each fault." VALUE 0x8000335E RecordLayout_4 0 CompuMethod_116 0 65535 /end CHARACTERISTIC
/begin CHARACTERISTIC FaultManager.Lambda2VoltHigh_Fault.Action_3 "Fault manager configuration.  Select up to 4 actions for each fault." VALUE 0x80003360 RecordLayout_4 0 CompuMethod_115 0 65535 /end CHARACTERISTIC
/begin CHARACTERISTIC FaultManager.Lambda2VoltHigh_Fault.Action_3_Condition "Fault manager configuration.  Select up to 4 actions for each fault." VALUE 0x80003362 RecordLayout_4 0 CompuMethod_116 0 65535 /end CHARACTERISTIC
/begin CHARACTERISTIC FaultManager.Lambda2VoltHigh_Fault.Action_4 "Fault manager configuration.  Select up to 4 actions for each fault." VALUE 0x80003364 RecordLayout_4 0 CompuMethod_115 0 65535 /end CHARACTERISTIC
/begin CHARACTERISTIC FaultManager.Lambda2VoltHigh_Fault.Action_4_Condition "Fault manager configuration.  Select up to 4 actions for each fault." VALUE 0x80003366 RecordLayout_4 0 CompuMethod_116 0 65535 /end CHARACTERISTIC
/begin CHARACTERISTIC FaultManager.Lambda2VoltLow_Fault.Mode "Fault manager configuration.  Select up to 4 actions for each fault." VALUE 0x80003368 RecordLayout_4 0 CompuMethod_113 0 65535 /end CHARACTERISTIC
/begin CHARACTERISTIC FaultManager.Lambda2VoltLow_Fault.ID "Fault manager configuration.  Select up to 4 actions for each fault." VALUE 0x8000336A RecordLayout_4 0 CompuMethod_1 0 65535 /end CHARACTERISTIC
/begin CHARACTERISTIC FaultManager.Lambda2VoltLow_Fault.Test "Fault manager configuration.  Select up to 4 actions for each fault." VALUE 0x8000336C RecordLayout_4 0 CompuMethod_114 0 65535 /end CHARACTERISTIC
/begin CHARACTERISTIC FaultManager.Lambda2VoltLow_Fault.Faulty_Samples__X_ "Fault manager configuration.  Select up to 4 actions for each fault." VALUE 0x8000336E RecordLayout_4 0 CompuMethod_1 0 65535 /end CHARACTERISTIC
/begin CHARACTERISTIC FaultManager.Lambda2VoltLow_Fault.Total_Samples__Y_ "Fault manager configuration.  Select up to 4 actions for each fault." VALUE 0x80003370 RecordLayout_4 0 CompuMethod_1 0 65535 /end CHARACTERISTIC
/begin CHARACTERISTIC FaultManager.Lambda2VoltLow_Fault.Action_1 "Fault manager configuration.  Select up to 4 actions for each fault." VALUE 0x80003372 RecordLayout_4 0 CompuMethod_115 0 65535 /end CHARACTERISTIC
/begin CHARACTERISTIC FaultManager.Lambda2VoltLow_Fault.Action_1_Condition "Fault manager configuration.  Select up to 4 actions for each fault." VALUE 0x80003374 RecordLayout_4 0 CompuMethod_116 0 65535 /end CHARACTERISTIC
/begin CHARACTERISTIC FaultManager.Lambda2VoltLow_Fault.Action_2 "Fault manager configuration.  Select up to 4 actions for each fault." VALUE 0x80003376 RecordLayout_4 0 CompuMethod_115 0 65535 /end CHARACTERISTIC
/begin CHARACTERISTIC FaultManager.Lambda2VoltLow_Fault.Action_2_Condition "Fault manager configuration.  Select up to 4 actions for each fault." VALUE 0x80003378 RecordLayout_4 0 CompuMethod_116 0 65535 /end CHARACTERISTIC
/begin CHARACTERISTIC FaultManager.Lambda2VoltLow_Fault.Action_3 "Fault manager configuration.  Select up to 4 actions for each fault." VALUE 0x8000337A RecordLayout_4 0 CompuMethod_115 0 65535 /end CHARACTERISTIC
/begin CHARACTERISTIC FaultManager.Lambda2VoltLow_Fault.Action_3_Condition "Fault manager configuration.  Select up to 4 actions for each fault." VALUE 0x8000337C RecordLayout_4 0 CompuMethod_116 0 65535 /end CHARACTERISTIC
/begin CHARACTERISTIC FaultManager.Lambda2VoltLow_Fault.Action_4 "Fault manager configuration.  Select up to 4 actions for each fault." VALUE 0x8000337E RecordLayout_4 0 CompuMethod_115 0 65535 /end CHARACTERISTIC
/begin CHARACTERISTIC FaultManager.Lambda2VoltLow_Fault.Action_4_Condition "Fault manager configuration.  Select up to 4 actions for each fault." VALUE 0x80003380 RecordLayout_4 0 CompuMethod_116 0 65535 /end CHARACTERISTIC
/begin CHARACTERISTIC FaultManager.Lambda_1_Timeout.Mode "Fault manager configuration.  Select up to 4 actions for each fault." VALUE 0x80003382 RecordLayout_4 0 CompuMethod_113 0 65535 /end CHARACTERISTIC
/begin CHARACTERISTIC FaultManager.Lambda_1_Timeout.ID "Fault manager configuration.  Select up to 4 actions for each fault." VALUE 0x80003384 RecordLayout_4 0 CompuMethod_1 0 65535 /end CHARACTERISTIC
/begin CHARACTERISTIC FaultManager.Lambda_1_Timeout.Test "Fault manager configuration.  Select up to 4 actions for each fault." VALUE 0x80003386 RecordLayout_4 0 CompuMethod_114 0 65535 /end CHARACTERISTIC
/begin CHARACTERISTIC FaultManager.Lambda_1_Timeout.Faulty_Samples__X_ "Fault manager configuration.  Select up to 4 actions for each fault." VALUE 0x80003388 RecordLayout_4 0 CompuMethod_1 0 65535 /end CHARACTERISTIC
/begin CHARACTERISTIC FaultManager.Lambda_1_Timeout.Total_Samples__Y_ "Fault manager configuration.  Select up to 4 actions for each fault." VALUE 0x8000338A RecordLayout_4 0 CompuMethod_1 0 65535 /end CHARACTERISTIC
/begin CHARACTERISTIC FaultManager.Lambda_1_Timeout.Action_1 "Fault manager configuration.  Select up to 4 actions for each fault." VALUE 0x8000338C RecordLayout_4 0 CompuMethod_115 0 65535 /end CHARACTERISTIC
/begin CHARACTERISTIC FaultManager.Lambda_1_Timeout.Action_1_Condition "Fault manager configuration.  Select up to 4 actions for each fault." VALUE 0x8000338E RecordLayout_4 0 CompuMethod_116 0 65535 /end CHARACTERISTIC
/begin CHARACTERISTIC FaultManager.Lambda_1_Timeout.Action_2 "Fault manager configuration.  Select up to 4 actions for each fault." VALUE 0x80003390 RecordLayout_4 0 CompuMethod_115 0 65535 /end CHARACTERISTIC
/begin CHARACTERISTIC FaultManager.Lambda_1_Timeout.Action_2_Condition "Fault manager configuration.  Select up to 4 actions for each fault." VALUE 0x80003392 RecordLayout_4 0 CompuMethod_116 0 65535 /end CHARACTERISTIC
/begin CHARACTERISTIC FaultManager.Lambda_1_Timeout.Action_3 "Fault manager configuration.  Select up to 4 actions for each fault." VALUE 0x80003394 RecordLayout_4 0 CompuMethod_115 0 65535 /end CHARACTERISTIC
/begin CHARACTERISTIC FaultManager.Lambda_1_Timeout.Action_3_Condition "Fault manager configuration.  Select up to 4 actions for each fault." VALUE 0x80003396 RecordLayout_4 0 CompuMethod_116 0 65535 /end CHARACTERISTIC
/begin CHARACTERISTIC FaultManager.Lambda_1_Timeout.Action_4 "Fault manager configuration.  Select up to 4 actions for each fault." VALUE 0x80003398 RecordLayout_4 0 CompuMethod_115 0 65535 /end CHARACTERISTIC
/begin CHARACTERISTIC FaultManager.Lambda_1_Timeout.Action_4_Condition "Fault manager configuration.  Select up to 4 actions for each fault." VALUE 0x8000339A RecordLayout_4 0 CompuMethod_116 0 65535 /end CHARACTERISTIC
/begin CHARACTERISTIC FaultManager.Lambda_2_Timeout.Mode "Fault manager configuration.  Select up to 4 actions for each fault." VALUE 0x8000339C RecordLayout_4 0 CompuMethod_113 0 65535 /end CHARACTERISTIC
/begin CHARACTERISTIC FaultManager.Lambda_2_Timeout.ID "Fault manager configuration.  Select up to 4 actions for each fault." VALUE 0x8000339E RecordLayout_4 0 CompuMethod_1 0 65535 /end CHARACTERISTIC
/begin CHARACTERISTIC FaultManager.Lambda_2_Timeout.Test "Fault manager configuration.  Select up to 4 actions for each fault." VALUE 0x800033A0 RecordLayout_4 0 CompuMethod_114 0 65535 /end CHARACTERISTIC
/begin CHARACTERISTIC FaultManager.Lambda_2_Timeout.Faulty_Samples__X_ "Fault manager configuration.  Select up to 4 actions for each fault." VALUE 0x800033A2 RecordLayout_4 0 CompuMethod_1 0 65535 /end CHARACTERISTIC
/begin CHARACTERISTIC FaultManager.Lambda_2_Timeout.Total_Samples__Y_ "Fault manager configuration.  Select up to 4 actions for each fault." VALUE 0x800033A4 RecordLayout_4 0 CompuMethod_1 0 65535 /end CHARACTERISTIC
/begin CHARACTERISTIC FaultManager.Lambda_2_Timeout.Action_1 "Fault manager configuration.  Select up to 4 actions for each fault." VALUE 0x800033A6 RecordLayout_4 0 CompuMethod_115 0 65535 /end CHARACTERISTIC
/begin CHARACTERISTIC FaultManager.Lambda_2_Timeout.Action_1_Condition "Fault manager configuration.  Select up to 4 actions for each fault." VALUE 0x800033A8 RecordLayout_4 0 CompuMethod_116 0 65535 /end CHARACTERISTIC
/begin CHARACTERISTIC FaultManager.Lambda_2_Timeout.Action_2 "Fault manager configuration.  Select up to 4 actions for each fault." VALUE 0x800033AA RecordLayout_4 0 CompuMethod_115 0 65535 /end CHARACTERISTIC
/begin CHARACTERISTIC FaultManager.Lambda_2_Timeout.Action_2_Condition "Fault manager configuration.  Select up to 4 actions for each fault." VALUE 0x800033AC RecordLayout_4 0 CompuMethod_116 0 65535 /end CHARACTERISTIC
/begin CHARACTERISTIC FaultManager.Lambda_2_Timeout.Action_3 "Fault manager configuration.  Select up to 4 actions for each fault." VALUE 0x800033AE RecordLayout_4 0 CompuMethod_115 0 65535 /end CHARACTERISTIC
/begin CHARACTERISTIC FaultManager.Lambda_2_Timeout.Action_3_Condition "Fault manager configuration.  Select up to 4 actions for each fault." VALUE 0x800033B0 RecordLayout_4 0 CompuMethod_116 0 65535 /end CHARACTERISTIC
/begin CHARACTERISTIC FaultManager.Lambda_2_Timeout.Action_4 "Fault manager configuration.  Select up to 4 actions for each fault." VALUE 0x800033B2 RecordLayout_4 0 CompuMethod_115 0 65535 /end CHARACTERISTIC
/begin CHARACTERISTIC FaultManager.Lambda_2_Timeout.Action_4_Condition "Fault manager configuration.  Select up to 4 actions for each fault." VALUE 0x800033B4 RecordLayout_4 0 CompuMethod_116 0 65535 /end CHARACTERISTIC
/begin CHARACTERISTIC FaultManager.Lambda_Bank2Bank_Fault.Mode "Fault manager configuration.  Select up to 4 actions for each fault." VALUE 0x800033B6 RecordLayout_4 0 CompuMethod_113 0 65535 /end CHARACTERISTIC
/begin CHARACTERISTIC FaultManager.Lambda_Bank2Bank_Fault.ID "Fault manager configuration.  Select up to 4 actions for each fault." VALUE 0x800033B8 RecordLayout_4 0 CompuMethod_1 0 65535 /end CHARACTERISTIC
/begin CHARACTERISTIC FaultManager.Lambda_Bank2Bank_Fault.Test "Fault manager configuration.  Select up to 4 actions for each fault." VALUE 0x800033BA RecordLayout_4 0 CompuMethod_114 0 65535 /end CHARACTERISTIC
/begin CHARACTERISTIC FaultManager.Lambda_Bank2Bank_Fault.Faulty_Samples__X_ "Fault manager configuration.  Select up to 4 actions for each fault." VALUE 0x800033BC RecordLayout_4 0 CompuMethod_1 0 65535 /end CHARACTERISTIC
/begin CHARACTERISTIC FaultManager.Lambda_Bank2Bank_Fault.Total_Samples__Y_ "Fault manager configuration.  Select up to 4 actions for each fault." VALUE 0x800033BE RecordLayout_4 0 CompuMethod_1 0 65535 /end CHARACTERISTIC
/begin CHARACTERISTIC FaultManager.Lambda_Bank2Bank_Fault.Action_1 "Fault manager configuration.  Select up to 4 actions for each fault." VALUE 0x800033C0 RecordLayout_4 0 CompuMethod_115 0 65535 /end CHARACTERISTIC
/begin CHARACTERISTIC FaultManager.Lambda_Bank2Bank_Fault.Action_1_Condition "Fault manager configuration.  Select up to 4 actions for each fault." VALUE 0x800033C2 RecordLayout_4 0 CompuMethod_116 0 65535 /end CHARACTERISTIC
/begin CHARACTERISTIC FaultManager.Lambda_Bank2Bank_Fault.Action_2 "Fault manager configuration.  Select up to 4 actions for each fault." VALUE 0x800033C4 RecordLayout_4 0 CompuMethod_115 0 65535 /end CHARACTERISTIC
/begin CHARACTERISTIC FaultManager.Lambda_Bank2Bank_Fault.Action_2_Condition "Fault manager configuration.  Select up to 4 actions for each fault." VALUE 0x800033C6 RecordLayout_4 0 CompuMethod_116 0 65535 /end CHARACTERISTIC
/begin CHARACTERISTIC FaultManager.Lambda_Bank2Bank_Fault.Action_3 "Fault manager configuration.  Select up to 4 actions for each fault." VALUE 0x800033C8 RecordLayout_4 0 CompuMethod_115 0 65535 /end CHARACTERISTIC
/begin CHARACTERISTIC FaultManager.Lambda_Bank2Bank_Fault.Action_3_Condition "Fault manager configuration.  Select up to 4 actions for each fault." VALUE 0x800033CA RecordLayout_4 0 CompuMethod_116 0 65535 /end CHARACTERISTIC
/begin CHARACTERISTIC FaultManager.Lambda_Bank2Bank_Fault.Action_4 "Fault manager configuration.  Select up to 4 actions for each fault." VALUE 0x800033CC RecordLayout_4 0 CompuMethod_115 0 65535 /end CHARACTERISTIC
/begin CHARACTERISTIC FaultManager.Lambda_Bank2Bank_Fault.Action_4_Condition "Fault manager configuration.  Select up to 4 actions for each fault." VALUE 0x800033CE RecordLayout_4 0 CompuMethod_116 0 65535 /end CHARACTERISTIC
/begin CHARACTERISTIC FaultManager.LeanProtect_Fault.Mode "Fault manager configuration.  Select up to 4 actions for each fault." VALUE 0x800033D0 RecordLayout_4 0 CompuMethod_113 0 65535 /end CHARACTERISTIC
/begin CHARACTERISTIC FaultManager.LeanProtect_Fault.ID "Fault manager configuration.  Select up to 4 actions for each fault." VALUE 0x800033D2 RecordLayout_4 0 CompuMethod_1 0 65535 /end CHARACTERISTIC
/begin CHARACTERISTIC FaultManager.LeanProtect_Fault.Test "Fault manager configuration.  Select up to 4 actions for each fault." VALUE 0x800033D4 RecordLayout_4 0 CompuMethod_114 0 65535 /end CHARACTERISTIC
/begin CHARACTERISTIC FaultManager.LeanProtect_Fault.Faulty_Samples__X_ "Fault manager configuration.  Select up to 4 actions for each fault." VALUE 0x800033D6 RecordLayout_4 0 CompuMethod_1 0 65535 /end CHARACTERISTIC
/begin CHARACTERISTIC FaultManager.LeanProtect_Fault.Total_Samples__Y_ "Fault manager configuration.  Select up to 4 actions for each fault." VALUE 0x800033D8 RecordLayout_4 0 CompuMethod_1 0 65535 /end CHARACTERISTIC
/begin CHARACTERISTIC FaultManager.LeanProtect_Fault.Action_1 "Fault manager configuration.  Select up to 4 actions for each fault." VALUE 0x800033DA RecordLayout_4 0 CompuMethod_115 0 65535 /end CHARACTERISTIC
/begin CHARACTERISTIC FaultManager.LeanProtect_Fault.Action_1_Condition "Fault manager configuration.  Select up to 4 actions for each fault." VALUE 0x800033DC RecordLayout_4 0 CompuMethod_116 0 65535 /end CHARACTERISTIC
/begin CHARACTERISTIC FaultManager.LeanProtect_Fault.Action_2 "Fault manager configuration.  Select up to 4 actions for each fault." VALUE 0x800033DE RecordLayout_4 0 CompuMethod_115 0 65535 /end CHARACTERISTIC
/begin CHARACTERISTIC FaultManager.LeanProtect_Fault.Action_2_Condition "Fault manager configuration.  Select up to 4 actions for each fault." VALUE 0x800033E0 RecordLayout_4 0 CompuMethod_116 0 65535 /end CHARACTERISTIC
/begin CHARACTERISTIC FaultManager.LeanProtect_Fault.Action_3 "Fault manager configuration.  Select up to 4 actions for each fault." VALUE 0x800033E2 RecordLayout_4 0 CompuMethod_115 0 65535 /end CHARACTERISTIC
/begin CHARACTERISTIC FaultManager.LeanProtect_Fault.Action_3_Condition "Fault manager configuration.  Select up to 4 actions for each fault." VALUE 0x800033E4 RecordLayout_4 0 CompuMethod_116 0 65535 /end CHARACTERISTIC
/begin CHARACTERISTIC FaultManager.LeanProtect_Fault.Action_4 "Fault manager configuration.  Select up to 4 actions for each fault." VALUE 0x800033E6 RecordLayout_4 0 CompuMethod_115 0 65535 /end CHARACTERISTIC
/begin CHARACTERISTIC FaultManager.LeanProtect_Fault.Action_4_Condition "Fault manager configuration.  Select up to 4 actions for each fault." VALUE 0x800033E8 RecordLayout_4 0 CompuMethod_116 0 65535 /end CHARACTERISTIC
/begin CHARACTERISTIC FaultManager.MAFRangeHigh.Mode "Fault manager configuration.  Select up to 4 actions for each fault." VALUE 0x800033EA RecordLayout_4 0 CompuMethod_113 0 65535 /end CHARACTERISTIC
/begin CHARACTERISTIC FaultManager.MAFRangeHigh.ID "Fault manager configuration.  Select up to 4 actions for each fault." VALUE 0x800033EC RecordLayout_4 0 CompuMethod_1 0 65535 /end CHARACTERISTIC
/begin CHARACTERISTIC FaultManager.MAFRangeHigh.Test "Fault manager configuration.  Select up to 4 actions for each fault." VALUE 0x800033EE RecordLayout_4 0 CompuMethod_114 0 65535 /end CHARACTERISTIC
/begin CHARACTERISTIC FaultManager.MAFRangeHigh.Faulty_Samples__X_ "Fault manager configuration.  Select up to 4 actions for each fault." VALUE 0x800033F0 RecordLayout_4 0 CompuMethod_1 0 65535 /end CHARACTERISTIC
/begin CHARACTERISTIC FaultManager.MAFRangeHigh.Total_Samples__Y_ "Fault manager configuration.  Select up to 4 actions for each fault." VALUE 0x800033F2 RecordLayout_4 0 CompuMethod_1 0 65535 /end CHARACTERISTIC
/begin CHARACTERISTIC FaultManager.MAFRangeHigh.Action_1 "Fault manager configuration.  Select up to 4 actions for each fault." VALUE 0x800033F4 RecordLayout_4 0 CompuMethod_115 0 65535 /end CHARACTERISTIC
/begin CHARACTERISTIC FaultManager.MAFRangeHigh.Action_1_Condition "Fault manager configuration.  Select up to 4 actions for each fault." VALUE 0x800033F6 RecordLayout_4 0 CompuMethod_116 0 65535 /end CHARACTERISTIC
/begin CHARACTERISTIC FaultManager.MAFRangeHigh.Action_2 "Fault manager configuration.  Select up to 4 actions for each fault." VALUE 0x800033F8 RecordLayout_4 0 CompuMethod_115 0 65535 /end CHARACTERISTIC
/begin CHARACTERISTIC FaultManager.MAFRangeHigh.Action_2_Condition "Fault manager configuration.  Select up to 4 actions for each fault." VALUE 0x800033FA RecordLayout_4 0 CompuMethod_116 0 65535 /end CHARACTERISTIC
/begin CHARACTERISTIC FaultManager.MAFRangeHigh.Action_3 "Fault manager configuration.  Select up to 4 actions for each fault." VALUE 0x800033FC RecordLayout_4 0 CompuMethod_115 0 65535 /end CHARACTERISTIC
/begin CHARACTERISTIC FaultManager.MAFRangeHigh.Action_3_Condition "Fault manager configuration.  Select up to 4 actions for each fault." VALUE 0x800033FE RecordLayout_4 0 CompuMethod_116 0 65535 /end CHARACTERISTIC
/begin CHARACTERISTIC FaultManager.MAFRangeHigh.Action_4 "Fault manager configuration.  Select up to 4 actions for each fault." VALUE 0x80003400 RecordLayout_4 0 CompuMethod_115 0 65535 /end CHARACTERISTIC
/begin CHARACTERISTIC FaultManager.MAFRangeHigh.Action_4_Condition "Fault manager configuration.  Select up to 4 actions for each fault." VALUE 0x80003402 RecordLayout_4 0 CompuMethod_116 0 65535 /end CHARACTERISTIC
/begin CHARACTERISTIC FaultManager.MAFRangeLow.Mode "Fault manager configuration.  Select up to 4 actions for each fault." VALUE 0x80003404 RecordLayout_4 0 CompuMethod_113 0 65535 /end CHARACTERISTIC
/begin CHARACTERISTIC FaultManager.MAFRangeLow.ID "Fault manager configuration.  Select up to 4 actions for each fault." VALUE 0x80003406 RecordLayout_4 0 CompuMethod_1 0 65535 /end CHARACTERISTIC
/begin CHARACTERISTIC FaultManager.MAFRangeLow.Test "Fault manager configuration.  Select up to 4 actions for each fault." VALUE 0x80003408 RecordLayout_4 0 CompuMethod_114 0 65535 /end CHARACTERISTIC
/begin CHARACTERISTIC FaultManager.MAFRangeLow.Faulty_Samples__X_ "Fault manager configuration.  Select up to 4 actions for each fault." VALUE 0x8000340A RecordLayout_4 0 CompuMethod_1 0 65535 /end CHARACTERISTIC
/begin CHARACTERISTIC FaultManager.MAFRangeLow.Total_Samples__Y_ "Fault manager configuration.  Select up to 4 actions for each fault." VALUE 0x8000340C RecordLayout_4 0 CompuMethod_1 0 65535 /end CHARACTERISTIC
/begin CHARACTERISTIC FaultManager.MAFRangeLow.Action_1 "Fault manager configuration.  Select up to 4 actions for each fault." VALUE 0x8000340E RecordLayout_4 0 CompuMethod_115 0 65535 /end CHARACTERISTIC
/begin CHARACTERISTIC FaultManager.MAFRangeLow.Action_1_Condition "Fault manager configuration.  Select up to 4 actions for each fault." VALUE 0x80003410 RecordLayout_4 0 CompuMethod_116 0 65535 /end CHARACTERISTIC
/begin CHARACTERISTIC FaultManager.MAFRangeLow.Action_2 "Fault manager configuration.  Select up to 4 actions for each fault." VALUE 0x80003412 RecordLayout_4 0 CompuMethod_115 0 65535 /end CHARACTERISTIC
/begin CHARACTERISTIC FaultManager.MAFRangeLow.Action_2_Condition "Fault manager configuration.  Select up to 4 actions for each fault." VALUE 0x80003414 RecordLayout_4 0 CompuMethod_116 0 65535 /end CHARACTERISTIC
/begin CHARACTERISTIC FaultManager.MAFRangeLow.Action_3 "Fault manager configuration.  Select up to 4 actions for each fault." VALUE 0x80003416 RecordLayout_4 0 CompuMethod_115 0 65535 /end CHARACTERISTIC
/begin CHARACTERISTIC FaultManager.MAFRangeLow.Action_3_Condition "Fault manager configuration.  Select up to 4 actions for each fault." VALUE 0x80003418 RecordLayout_4 0 CompuMethod_116 0 65535 /end CHARACTERISTIC
/begin CHARACTERISTIC FaultManager.MAFRangeLow.Action_4 "Fault manager configuration.  Select up to 4 actions for each fault." VALUE 0x8000341A RecordLayout_4 0 CompuMethod_115 0 65535 /end CHARACTERISTIC
/begin CHARACTERISTIC FaultManager.MAFRangeLow.Action_4_Condition "Fault manager configuration.  Select up to 4 actions for each fault." VALUE 0x8000341C RecordLayout_4 0 CompuMethod_116 0 65535 /end CHARACTERISTIC
/begin CHARACTERISTIC FaultManager.MAPRangeHigh.Mode "Fault manager configuration.  Select up to 4 actions for each fault." VALUE 0x8000341E RecordLayout_4 0 CompuMethod_113 0 65535 /end CHARACTERISTIC
/begin CHARACTERISTIC FaultManager.MAPRangeHigh.ID "Fault manager configuration.  Select up to 4 actions for each fault." VALUE 0x80003420 RecordLayout_4 0 CompuMethod_1 0 65535 /end CHARACTERISTIC
/begin CHARACTERISTIC FaultManager.MAPRangeHigh.Test "Fault manager configuration.  Select up to 4 actions for each fault." VALUE 0x80003422 RecordLayout_4 0 CompuMethod_114 0 65535 /end CHARACTERISTIC
/begin CHARACTERISTIC FaultManager.MAPRangeHigh.Faulty_Samples__X_ "Fault manager configuration.  Select up to 4 actions for each fault." VALUE 0x80003424 RecordLayout_4 0 CompuMethod_1 0 65535 /end CHARACTERISTIC
/begin CHARACTERISTIC FaultManager.MAPRangeHigh.Total_Samples__Y_ "Fault manager configuration.  Select up to 4 actions for each fault." VALUE 0x80003426 RecordLayout_4 0 CompuMethod_1 0 65535 /end CHARACTERISTIC
/begin CHARACTERISTIC FaultManager.MAPRangeHigh.Action_1 "Fault manager configuration.  Select up to 4 actions for each fault." VALUE 0x80003428 RecordLayout_4 0 CompuMethod_115 0 65535 /end CHARACTERISTIC
/begin CHARACTERISTIC FaultManager.MAPRangeHigh.Action_1_Condition "Fault manager configuration.  Select up to 4 actions for each fault." VALUE 0x8000342A RecordLayout_4 0 CompuMethod_116 0 65535 /end CHARACTERISTIC
/begin CHARACTERISTIC FaultManager.MAPRangeHigh.Action_2 "Fault manager configuration.  Select up to 4 actions for each fault." VALUE 0x8000342C RecordLayout_4 0 CompuMethod_115 0 65535 /end CHARACTERISTIC
/begin CHARACTERISTIC FaultManager.MAPRangeHigh.Action_2_Condition "Fault manager configuration.  Select up to 4 actions for each fault." VALUE 0x8000342E RecordLayout_4 0 CompuMethod_116 0 65535 /end CHARACTERISTIC
/begin CHARACTERISTIC FaultManager.MAPRangeHigh.Action_3 "Fault manager configuration.  Select up to 4 actions for each fault." VALUE 0x80003430 RecordLayout_4 0 CompuMethod_115 0 65535 /end CHARACTERISTIC
/begin CHARACTERISTIC FaultManager.MAPRangeHigh.Action_3_Condition "Fault manager configuration.  Select up to 4 actions for each fault." VALUE 0x80003432 RecordLayout_4 0 CompuMethod_116 0 65535 /end CHARACTERISTIC
/begin CHARACTERISTIC FaultManager.MAPRangeHigh.Action_4 "Fault manager configuration.  Select up to 4 actions for each fault." VALUE 0x80003434 RecordLayout_4 0 CompuMethod_115 0 65535 /end CHARACTERISTIC
/begin CHARACTERISTIC FaultManager.MAPRangeHigh.Action_4_Condition "Fault manager configuration.  Select up to 4 actions for each fault." VALUE 0x80003436 RecordLayout_4 0 CompuMethod_116 0 65535 /end CHARACTERISTIC
/begin CHARACTERISTIC FaultManager.MAPRangeLow.Mode "Fault manager configuration.  Select up to 4 actions for each fault." VALUE 0x80003438 RecordLayout_4 0 CompuMethod_113 0 65535 /end CHARACTERISTIC
/begin CHARACTERISTIC FaultManager.MAPRangeLow.ID "Fault manager configuration.  Select up to 4 actions for each fault." VALUE 0x8000343A RecordLayout_4 0 CompuMethod_1 0 65535 /end CHARACTERISTIC
/begin CHARACTERISTIC FaultManager.MAPRangeLow.Test "Fault manager configuration.  Select up to 4 actions for each fault." VALUE 0x8000343C RecordLayout_4 0 CompuMethod_114 0 65535 /end CHARACTERISTIC
/begin CHARACTERISTIC FaultManager.MAPRangeLow.Faulty_Samples__X_ "Fault manager configuration.  Select up to 4 actions for each fault." VALUE 0x8000343E RecordLayout_4 0 CompuMethod_1 0 65535 /end CHARACTERISTIC
/begin CHARACTERISTIC FaultManager.MAPRangeLow.Total_Samples__Y_ "Fault manager configuration.  Select up to 4 actions for each fault." VALUE 0x80003440 RecordLayout_4 0 CompuMethod_1 0 65535 /end CHARACTERISTIC
/begin CHARACTERISTIC FaultManager.MAPRangeLow.Action_1 "Fault manager configuration.  Select up to 4 actions for each fault." VALUE 0x80003442 RecordLayout_4 0 CompuMethod_115 0 65535 /end CHARACTERISTIC
/begin CHARACTERISTIC FaultManager.MAPRangeLow.Action_1_Condition "Fault manager configuration.  Select up to 4 actions for each fault." VALUE 0x80003444 RecordLayout_4 0 CompuMethod_116 0 65535 /end CHARACTERISTIC
/begin CHARACTERISTIC FaultManager.MAPRangeLow.Action_2 "Fault manager configuration.  Select up to 4 actions for each fault." VALUE 0x80003446 RecordLayout_4 0 CompuMethod_115 0 65535 /end CHARACTERISTIC
/begin CHARACTERISTIC FaultManager.MAPRangeLow.Action_2_Condition "Fault manager configuration.  Select up to 4 actions for each fault." VALUE 0x80003448 RecordLayout_4 0 CompuMethod_116 0 65535 /end CHARACTERISTIC
/begin CHARACTERISTIC FaultManager.MAPRangeLow.Action_3 "Fault manager configuration.  Select up to 4 actions for each fault." VALUE 0x8000344A RecordLayout_4 0 CompuMethod_115 0 65535 /end CHARACTERISTIC
/begin CHARACTERISTIC FaultManager.MAPRangeLow.Action_3_Condition "Fault manager configuration.  Select up to 4 actions for each fault." VALUE 0x8000344C RecordLayout_4 0 CompuMethod_116 0 65535 /end CHARACTERISTIC
/begin CHARACTERISTIC FaultManager.MAPRangeLow.Action_4 "Fault manager configuration.  Select up to 4 actions for each fault." VALUE 0x8000344E RecordLayout_4 0 CompuMethod_115 0 65535 /end CHARACTERISTIC
/begin CHARACTERISTIC FaultManager.MAPRangeLow.Action_4_Condition "Fault manager configuration.  Select up to 4 actions for each fault." VALUE 0x80003450 RecordLayout_4 0 CompuMethod_116 0 65535 /end CHARACTERISTIC
/begin CHARACTERISTIC FaultManager.MAPTimeRangeHigh.Mode "Fault manager configuration.  Select up to 4 actions for each fault." VALUE 0x80003452 RecordLayout_4 0 CompuMethod_113 0 65535 /end CHARACTERISTIC
/begin CHARACTERISTIC FaultManager.MAPTimeRangeHigh.ID "Fault manager configuration.  Select up to 4 actions for each fault." VALUE 0x80003454 RecordLayout_4 0 CompuMethod_1 0 65535 /end CHARACTERISTIC
/begin CHARACTERISTIC FaultManager.MAPTimeRangeHigh.Test "Fault manager configuration.  Select up to 4 actions for each fault." VALUE 0x80003456 RecordLayout_4 0 CompuMethod_114 0 65535 /end CHARACTERISTIC
/begin CHARACTERISTIC FaultManager.MAPTimeRangeHigh.Faulty_Samples__X_ "Fault manager configuration.  Select up to 4 actions for each fault." VALUE 0x80003458 RecordLayout_4 0 CompuMethod_1 0 65535 /end CHARACTERISTIC
/begin CHARACTERISTIC FaultManager.MAPTimeRangeHigh.Total_Samples__Y_ "Fault manager configuration.  Select up to 4 actions for each fault." VALUE 0x8000345A RecordLayout_4 0 CompuMethod_1 0 65535 /end CHARACTERISTIC
/begin CHARACTERISTIC FaultManager.MAPTimeRangeHigh.Action_1 "Fault manager configuration.  Select up to 4 actions for each fault." VALUE 0x8000345C RecordLayout_4 0 CompuMethod_115 0 65535 /end CHARACTERISTIC
/begin CHARACTERISTIC FaultManager.MAPTimeRangeHigh.Action_1_Condition "Fault manager configuration.  Select up to 4 actions for each fault." VALUE 0x8000345E RecordLayout_4 0 CompuMethod_116 0 65535 /end CHARACTERISTIC
/begin CHARACTERISTIC FaultManager.MAPTimeRangeHigh.Action_2 "Fault manager configuration.  Select up to 4 actions for each fault." VALUE 0x80003460 RecordLayout_4 0 CompuMethod_115 0 65535 /end CHARACTERISTIC
/begin CHARACTERISTIC FaultManager.MAPTimeRangeHigh.Action_2_Condition "Fault manager configuration.  Select up to 4 actions for each fault." VALUE 0x80003462 RecordLayout_4 0 CompuMethod_116 0 65535 /end CHARACTERISTIC
/begin CHARACTERISTIC FaultManager.MAPTimeRangeHigh.Action_3 "Fault manager configuration.  Select up to 4 actions for each fault." VALUE 0x80003464 RecordLayout_4 0 CompuMethod_115 0 65535 /end CHARACTERISTIC
/begin CHARACTERISTIC FaultManager.MAPTimeRangeHigh.Action_3_Condition "Fault manager configuration.  Select up to 4 actions for each fault." VALUE 0x80003466 RecordLayout_4 0 CompuMethod_116 0 65535 /end CHARACTERISTIC
/begin CHARACTERISTIC FaultManager.MAPTimeRangeHigh.Action_4 "Fault manager configuration.  Select up to 4 actions for each fault." VALUE 0x80003468 RecordLayout_4 0 CompuMethod_115 0 65535 /end CHARACTERISTIC
/begin CHARACTERISTIC FaultManager.MAPTimeRangeHigh.Action_4_Condition "Fault manager configuration.  Select up to 4 actions for each fault." VALUE 0x8000346A RecordLayout_4 0 CompuMethod_116 0 65535 /end CHARACTERISTIC
/begin CHARACTERISTIC FaultManager.MAPTimeRangeLow.Mode "Fault manager configuration.  Select up to 4 actions for each fault." VALUE 0x8000346C RecordLayout_4 0 CompuMethod_113 0 65535 /end CHARACTERISTIC
/begin CHARACTERISTIC FaultManager.MAPTimeRangeLow.ID "Fault manager configuration.  Select up to 4 actions for each fault." VALUE 0x8000346E RecordLayout_4 0 CompuMethod_1 0 65535 /end CHARACTERISTIC
/begin CHARACTERISTIC FaultManager.MAPTimeRangeLow.Test "Fault manager configuration.  Select up to 4 actions for each fault." VALUE 0x80003470 RecordLayout_4 0 CompuMethod_114 0 65535 /end CHARACTERISTIC
/begin CHARACTERISTIC FaultManager.MAPTimeRangeLow.Faulty_Samples__X_ "Fault manager configuration.  Select up to 4 actions for each fault." VALUE 0x80003472 RecordLayout_4 0 CompuMethod_1 0 65535 /end CHARACTERISTIC
/begin CHARACTERISTIC FaultManager.MAPTimeRangeLow.Total_Samples__Y_ "Fault manager configuration.  Select up to 4 actions for each fault." VALUE 0x80003474 RecordLayout_4 0 CompuMethod_1 0 65535 /end CHARACTERISTIC
/begin CHARACTERISTIC FaultManager.MAPTimeRangeLow.Action_1 "Fault manager configuration.  Select up to 4 actions for each fault." VALUE 0x80003476 RecordLayout_4 0 CompuMethod_115 0 65535 /end CHARACTERISTIC
/begin CHARACTERISTIC FaultManager.MAPTimeRangeLow.Action_1_Condition "Fault manager configuration.  Select up to 4 actions for each fault." VALUE 0x80003478 RecordLayout_4 0 CompuMethod_116 0 65535 /end CHARACTERISTIC
/begin CHARACTERISTIC FaultManager.MAPTimeRangeLow.Action_2 "Fault manager configuration.  Select up to 4 actions for each fault." VALUE 0x8000347A RecordLayout_4 0 CompuMethod_115 0 65535 /end CHARACTERISTIC
/begin CHARACTERISTIC FaultManager.MAPTimeRangeLow.Action_2_Condition "Fault manager configuration.  Select up to 4 actions for each fault." VALUE 0x8000347C RecordLayout_4 0 CompuMethod_116 0 65535 /end CHARACTERISTIC
/begin CHARACTERISTIC FaultManager.MAPTimeRangeLow.Action_3 "Fault manager configuration.  Select up to 4 actions for each fault." VALUE 0x8000347E RecordLayout_4 0 CompuMethod_115 0 65535 /end CHARACTERISTIC
/begin CHARACTERISTIC FaultManager.MAPTimeRangeLow.Action_3_Condition "Fault manager configuration.  Select up to 4 actions for each fault." VALUE 0x80003480 RecordLayout_4 0 CompuMethod_116 0 65535 /end CHARACTERISTIC
/begin CHARACTERISTIC FaultManager.MAPTimeRangeLow.Action_4 "Fault manager configuration.  Select up to 4 actions for each fault." VALUE 0x80003482 RecordLayout_4 0 CompuMethod_115 0 65535 /end CHARACTERISTIC
/begin CHARACTERISTIC FaultManager.MAPTimeRangeLow.Action_4_Condition "Fault manager configuration.  Select up to 4 actions for each fault." VALUE 0x80003484 RecordLayout_4 0 CompuMethod_116 0 65535 /end CHARACTERISTIC
/begin CHARACTERISTIC FaultManager.MAP_IR_HI.Mode "Fault manager configuration.  Select up to 4 actions for each fault." VALUE 0x80003486 RecordLayout_4 0 CompuMethod_113 0 65535 /end CHARACTERISTIC
/begin CHARACTERISTIC FaultManager.MAP_IR_HI.ID "Fault manager configuration.  Select up to 4 actions for each fault." VALUE 0x80003488 RecordLayout_4 0 CompuMethod_1 0 65535 /end CHARACTERISTIC
/begin CHARACTERISTIC FaultManager.MAP_IR_HI.Test "Fault manager configuration.  Select up to 4 actions for each fault." VALUE 0x8000348A RecordLayout_4 0 CompuMethod_114 0 65535 /end CHARACTERISTIC
/begin CHARACTERISTIC FaultManager.MAP_IR_HI.Faulty_Samples__X_ "Fault manager configuration.  Select up to 4 actions for each fault." VALUE 0x8000348C RecordLayout_4 0 CompuMethod_1 0 65535 /end CHARACTERISTIC
/begin CHARACTERISTIC FaultManager.MAP_IR_HI.Total_Samples__Y_ "Fault manager configuration.  Select up to 4 actions for each fault." VALUE 0x8000348E RecordLayout_4 0 CompuMethod_1 0 65535 /end CHARACTERISTIC
/begin CHARACTERISTIC FaultManager.MAP_IR_HI.Action_1 "Fault manager configuration.  Select up to 4 actions for each fault." VALUE 0x80003490 RecordLayout_4 0 CompuMethod_115 0 65535 /end CHARACTERISTIC
/begin CHARACTERISTIC FaultManager.MAP_IR_HI.Action_1_Condition "Fault manager configuration.  Select up to 4 actions for each fault." VALUE 0x80003492 RecordLayout_4 0 CompuMethod_116 0 65535 /end CHARACTERISTIC
/begin CHARACTERISTIC FaultManager.MAP_IR_HI.Action_2 "Fault manager configuration.  Select up to 4 actions for each fault." VALUE 0x80003494 RecordLayout_4 0 CompuMethod_115 0 65535 /end CHARACTERISTIC
/begin CHARACTERISTIC FaultManager.MAP_IR_HI.Action_2_Condition "Fault manager configuration.  Select up to 4 actions for each fault." VALUE 0x80003496 RecordLayout_4 0 CompuMethod_116 0 65535 /end CHARACTERISTIC
/begin CHARACTERISTIC FaultManager.MAP_IR_HI.Action_3 "Fault manager configuration.  Select up to 4 actions for each fault." VALUE 0x80003498 RecordLayout_4 0 CompuMethod_115 0 65535 /end CHARACTERISTIC
/begin CHARACTERISTIC FaultManager.MAP_IR_HI.Action_3_Condition "Fault manager configuration.  Select up to 4 actions for each fault." VALUE 0x8000349A RecordLayout_4 0 CompuMethod_116 0 65535 /end CHARACTERISTIC
/begin CHARACTERISTIC FaultManager.MAP_IR_HI.Action_4 "Fault manager configuration.  Select up to 4 actions for each fault." VALUE 0x8000349C RecordLayout_4 0 CompuMethod_115 0 65535 /end CHARACTERISTIC
/begin CHARACTERISTIC FaultManager.MAP_IR_HI.Action_4_Condition "Fault manager configuration.  Select up to 4 actions for each fault." VALUE 0x8000349E RecordLayout_4 0 CompuMethod_116 0 65535 /end CHARACTERISTIC
/begin CHARACTERISTIC FaultManager.MAP_IR_LO.Mode "Fault manager configuration.  Select up to 4 actions for each fault." VALUE 0x800034A0 RecordLayout_4 0 CompuMethod_113 0 65535 /end CHARACTERISTIC
/begin CHARACTERISTIC FaultManager.MAP_IR_LO.ID "Fault manager configuration.  Select up to 4 actions for each fault." VALUE 0x800034A2 RecordLayout_4 0 CompuMethod_1 0 65535 /end CHARACTERISTIC
/begin CHARACTERISTIC FaultManager.MAP_IR_LO.Test "Fault manager configuration.  Select up to 4 actions for each fault." VALUE 0x800034A4 RecordLayout_4 0 CompuMethod_114 0 65535 /end CHARACTERISTIC
/begin CHARACTERISTIC FaultManager.MAP_IR_LO.Faulty_Samples__X_ "Fault manager configuration.  Select up to 4 actions for each fault." VALUE 0x800034A6 RecordLayout_4 0 CompuMethod_1 0 65535 /end CHARACTERISTIC
/begin CHARACTERISTIC FaultManager.MAP_IR_LO.Total_Samples__Y_ "Fault manager configuration.  Select up to 4 actions for each fault." VALUE 0x800034A8 RecordLayout_4 0 CompuMethod_1 0 65535 /end CHARACTERISTIC
/begin CHARACTERISTIC FaultManager.MAP_IR_LO.Action_1 "Fault manager configuration.  Select up to 4 actions for each fault." VALUE 0x800034AA RecordLayout_4 0 CompuMethod_115 0 65535 /end CHARACTERISTIC
/begin CHARACTERISTIC FaultManager.MAP_IR_LO.Action_1_Condition "Fault manager configuration.  Select up to 4 actions for each fault." VALUE 0x800034AC RecordLayout_4 0 CompuMethod_116 0 65535 /end CHARACTERISTIC
/begin CHARACTERISTIC FaultManager.MAP_IR_LO.Action_2 "Fault manager configuration.  Select up to 4 actions for each fault." VALUE 0x800034AE RecordLayout_4 0 CompuMethod_115 0 65535 /end CHARACTERISTIC
/begin CHARACTERISTIC FaultManager.MAP_IR_LO.Action_2_Condition "Fault manager configuration.  Select up to 4 actions for each fault." VALUE 0x800034B0 RecordLayout_4 0 CompuMethod_116 0 65535 /end CHARACTERISTIC
/begin CHARACTERISTIC FaultManager.MAP_IR_LO.Action_3 "Fault manager configuration.  Select up to 4 actions for each fault." VALUE 0x800034B2 RecordLayout_4 0 CompuMethod_115 0 65535 /end CHARACTERISTIC
/begin CHARACTERISTIC FaultManager.MAP_IR_LO.Action_3_Condition "Fault manager configuration.  Select up to 4 actions for each fault." VALUE 0x800034B4 RecordLayout_4 0 CompuMethod_116 0 65535 /end CHARACTERISTIC
/begin CHARACTERISTIC FaultManager.MAP_IR_LO.Action_4 "Fault manager configuration.  Select up to 4 actions for each fault." VALUE 0x800034B6 RecordLayout_4 0 CompuMethod_115 0 65535 /end CHARACTERISTIC
/begin CHARACTERISTIC FaultManager.MAP_IR_LO.Action_4_Condition "Fault manager configuration.  Select up to 4 actions for each fault." VALUE 0x800034B8 RecordLayout_4 0 CompuMethod_116 0 65535 /end CHARACTERISTIC
/begin CHARACTERISTIC FaultManager.MAP_STICKING.Mode "Fault manager configuration.  Select up to 4 actions for each fault." VALUE 0x800034BA RecordLayout_4 0 CompuMethod_113 0 65535 /end CHARACTERISTIC
/begin CHARACTERISTIC FaultManager.MAP_STICKING.ID "Fault manager configuration.  Select up to 4 actions for each fault." VALUE 0x800034BC RecordLayout_4 0 CompuMethod_1 0 65535 /end CHARACTERISTIC
/begin CHARACTERISTIC FaultManager.MAP_STICKING.Test "Fault manager configuration.  Select up to 4 actions for each fault." VALUE 0x800034BE RecordLayout_4 0 CompuMethod_114 0 65535 /end CHARACTERISTIC
/begin CHARACTERISTIC FaultManager.MAP_STICKING.Faulty_Samples__X_ "Fault manager configuration.  Select up to 4 actions for each fault." VALUE 0x800034C0 RecordLayout_4 0 CompuMethod_1 0 65535 /end CHARACTERISTIC
/begin CHARACTERISTIC FaultManager.MAP_STICKING.Total_Samples__Y_ "Fault manager configuration.  Select up to 4 actions for each fault." VALUE 0x800034C2 RecordLayout_4 0 CompuMethod_1 0 65535 /end CHARACTERISTIC
/begin CHARACTERISTIC FaultManager.MAP_STICKING.Action_1 "Fault manager configuration.  Select up to 4 actions for each fault." VALUE 0x800034C4 RecordLayout_4 0 CompuMethod_115 0 65535 /end CHARACTERISTIC
/begin CHARACTERISTIC FaultManager.MAP_STICKING.Action_1_Condition "Fault manager configuration.  Select up to 4 actions for each fault." VALUE 0x800034C6 RecordLayout_4 0 CompuMethod_116 0 65535 /end CHARACTERISTIC
/begin CHARACTERISTIC FaultManager.MAP_STICKING.Action_2 "Fault manager configuration.  Select up to 4 actions for each fault." VALUE 0x800034C8 RecordLayout_4 0 CompuMethod_115 0 65535 /end CHARACTERISTIC
/begin CHARACTERISTIC FaultManager.MAP_STICKING.Action_2_Condition "Fault manager configuration.  Select up to 4 actions for each fault." VALUE 0x800034CA RecordLayout_4 0 CompuMethod_116 0 65535 /end CHARACTERISTIC
/begin CHARACTERISTIC FaultManager.MAP_STICKING.Action_3 "Fault manager configuration.  Select up to 4 actions for each fault." VALUE 0x800034CC RecordLayout_4 0 CompuMethod_115 0 65535 /end CHARACTERISTIC
/begin CHARACTERISTIC FaultManager.MAP_STICKING.Action_3_Condition "Fault manager configuration.  Select up to 4 actions for each fault." VALUE 0x800034CE RecordLayout_4 0 CompuMethod_116 0 65535 /end CHARACTERISTIC
/begin CHARACTERISTIC FaultManager.MAP_STICKING.Action_4 "Fault manager configuration.  Select up to 4 actions for each fault." VALUE 0x800034D0 RecordLayout_4 0 CompuMethod_115 0 65535 /end CHARACTERISTIC
/begin CHARACTERISTIC FaultManager.MAP_STICKING.Action_4_Condition "Fault manager configuration.  Select up to 4 actions for each fault." VALUE 0x800034D2 RecordLayout_4 0 CompuMethod_116 0 65535 /end CHARACTERISTIC
/begin CHARACTERISTIC FaultManager.MediumOverspeed.Mode "Fault manager configuration.  Select up to 4 actions for each fault." VALUE 0x800034D4 RecordLayout_4 0 CompuMethod_113 0 65535 /end CHARACTERISTIC
/begin CHARACTERISTIC FaultManager.MediumOverspeed.ID "Fault manager configuration.  Select up to 4 actions for each fault." VALUE 0x800034D6 RecordLayout_4 0 CompuMethod_1 0 65535 /end CHARACTERISTIC
/begin CHARACTERISTIC FaultManager.MediumOverspeed.Test "Fault manager configuration.  Select up to 4 actions for each fault." VALUE 0x800034D8 RecordLayout_4 0 CompuMethod_114 0 65535 /end CHARACTERISTIC
/begin CHARACTERISTIC FaultManager.MediumOverspeed.Faulty_Samples__X_ "Fault manager configuration.  Select up to 4 actions for each fault." VALUE 0x800034DA RecordLayout_4 0 CompuMethod_1 0 65535 /end CHARACTERISTIC
/begin CHARACTERISTIC FaultManager.MediumOverspeed.Total_Samples__Y_ "Fault manager configuration.  Select up to 4 actions for each fault." VALUE 0x800034DC RecordLayout_4 0 CompuMethod_1 0 65535 /end CHARACTERISTIC
/begin CHARACTERISTIC FaultManager.MediumOverspeed.Action_1 "Fault manager configuration.  Select up to 4 actions for each fault." VALUE 0x800034DE RecordLayout_4 0 CompuMethod_115 0 65535 /end CHARACTERISTIC
/begin CHARACTERISTIC FaultManager.MediumOverspeed.Action_1_Condition "Fault manager configuration.  Select up to 4 actions for each fault." VALUE 0x800034E0 RecordLayout_4 0 CompuMethod_116 0 65535 /end CHARACTERISTIC
/begin CHARACTERISTIC FaultManager.MediumOverspeed.Action_2 "Fault manager configuration.  Select up to 4 actions for each fault." VALUE 0x800034E2 RecordLayout_4 0 CompuMethod_115 0 65535 /end CHARACTERISTIC
/begin CHARACTERISTIC FaultManager.MediumOverspeed.Action_2_Condition "Fault manager configuration.  Select up to 4 actions for each fault." VALUE 0x800034E4 RecordLayout_4 0 CompuMethod_116 0 65535 /end CHARACTERISTIC
/begin CHARACTERISTIC FaultManager.MediumOverspeed.Action_3 "Fault manager configuration.  Select up to 4 actions for each fault." VALUE 0x800034E6 RecordLayout_4 0 CompuMethod_115 0 65535 /end CHARACTERISTIC
/begin CHARACTERISTIC FaultManager.MediumOverspeed.Action_3_Condition "Fault manager configuration.  Select up to 4 actions for each fault." VALUE 0x800034E8 RecordLayout_4 0 CompuMethod_116 0 65535 /end CHARACTERISTIC
/begin CHARACTERISTIC FaultManager.MediumOverspeed.Action_4 "Fault manager configuration.  Select up to 4 actions for each fault." VALUE 0x800034EA RecordLayout_4 0 CompuMethod_115 0 65535 /end CHARACTERISTIC
/begin CHARACTERISTIC FaultManager.MediumOverspeed.Action_4_Condition "Fault manager configuration.  Select up to 4 actions for each fault." VALUE 0x800034EC RecordLayout_4 0 CompuMethod_116 0 65535 /end CHARACTERISTIC
/begin CHARACTERISTIC FaultManager.NoOil_Fault.Mode "Fault manager configuration.  Select up to 4 actions for each fault." VALUE 0x800034EE RecordLayout_4 0 CompuMethod_113 0 65535 /end CHARACTERISTIC
/begin CHARACTERISTIC FaultManager.NoOil_Fault.ID "Fault manager configuration.  Select up to 4 actions for each fault." VALUE 0x800034F0 RecordLayout_4 0 CompuMethod_1 0 65535 /end CHARACTERISTIC
/begin CHARACTERISTIC FaultManager.NoOil_Fault.Test "Fault manager configuration.  Select up to 4 actions for each fault." VALUE 0x800034F2 RecordLayout_4 0 CompuMethod_114 0 65535 /end CHARACTERISTIC
/begin CHARACTERISTIC FaultManager.NoOil_Fault.Faulty_Samples__X_ "Fault manager configuration.  Select up to 4 actions for each fault." VALUE 0x800034F4 RecordLayout_4 0 CompuMethod_1 0 65535 /end CHARACTERISTIC
/begin CHARACTERISTIC FaultManager.NoOil_Fault.Total_Samples__Y_ "Fault manager configuration.  Select up to 4 actions for each fault." VALUE 0x800034F6 RecordLayout_4 0 CompuMethod_1 0 65535 /end CHARACTERISTIC
/begin CHARACTERISTIC FaultManager.NoOil_Fault.Action_1 "Fault manager configuration.  Select up to 4 actions for each fault." VALUE 0x800034F8 RecordLayout_4 0 CompuMethod_115 0 65535 /end CHARACTERISTIC
/begin CHARACTERISTIC FaultManager.NoOil_Fault.Action_1_Condition "Fault manager configuration.  Select up to 4 actions for each fault." VALUE 0x800034FA RecordLayout_4 0 CompuMethod_116 0 65535 /end CHARACTERISTIC
/begin CHARACTERISTIC FaultManager.NoOil_Fault.Action_2 "Fault manager configuration.  Select up to 4 actions for each fault." VALUE 0x800034FC RecordLayout_4 0 CompuMethod_115 0 65535 /end CHARACTERISTIC
/begin CHARACTERISTIC FaultManager.NoOil_Fault.Action_2_Condition "Fault manager configuration.  Select up to 4 actions for each fault." VALUE 0x800034FE RecordLayout_4 0 CompuMethod_116 0 65535 /end CHARACTERISTIC
/begin CHARACTERISTIC FaultManager.NoOil_Fault.Action_3 "Fault manager configuration.  Select up to 4 actions for each fault." VALUE 0x80003500 RecordLayout_4 0 CompuMethod_115 0 65535 /end CHARACTERISTIC
/begin CHARACTERISTIC FaultManager.NoOil_Fault.Action_3_Condition "Fault manager configuration.  Select up to 4 actions for each fault." VALUE 0x80003502 RecordLayout_4 0 CompuMethod_116 0 65535 /end CHARACTERISTIC
/begin CHARACTERISTIC FaultManager.NoOil_Fault.Action_4 "Fault manager configuration.  Select up to 4 actions for each fault." VALUE 0x80003504 RecordLayout_4 0 CompuMethod_115 0 65535 /end CHARACTERISTIC
/begin CHARACTERISTIC FaultManager.NoOil_Fault.Action_4_Condition "Fault manager configuration.  Select up to 4 actions for each fault." VALUE 0x80003506 RecordLayout_4 0 CompuMethod_116 0 65535 /end CHARACTERISTIC
/begin CHARACTERISTIC FaultManager.O2FailedLean_BankA.Mode "Fault manager configuration.  Select up to 4 actions for each fault." VALUE 0x80003508 RecordLayout_4 0 CompuMethod_113 0 65535 /end CHARACTERISTIC
/begin CHARACTERISTIC FaultManager.O2FailedLean_BankA.ID "Fault manager configuration.  Select up to 4 actions for each fault." VALUE 0x8000350A RecordLayout_4 0 CompuMethod_1 0 65535 /end CHARACTERISTIC
/begin CHARACTERISTIC FaultManager.O2FailedLean_BankA.Test "Fault manager configuration.  Select up to 4 actions for each fault." VALUE 0x8000350C RecordLayout_4 0 CompuMethod_114 0 65535 /end CHARACTERISTIC
/begin CHARACTERISTIC FaultManager.O2FailedLean_BankA.Faulty_Samples__X_ "Fault manager configuration.  Select up to 4 actions for each fault." VALUE 0x8000350E RecordLayout_4 0 CompuMethod_1 0 65535 /end CHARACTERISTIC
/begin CHARACTERISTIC FaultManager.O2FailedLean_BankA.Total_Samples__Y_ "Fault manager configuration.  Select up to 4 actions for each fault." VALUE 0x80003510 RecordLayout_4 0 CompuMethod_1 0 65535 /end CHARACTERISTIC
/begin CHARACTERISTIC FaultManager.O2FailedLean_BankA.Action_1 "Fault manager configuration.  Select up to 4 actions for each fault." VALUE 0x80003512 RecordLayout_4 0 CompuMethod_115 0 65535 /end CHARACTERISTIC
/begin CHARACTERISTIC FaultManager.O2FailedLean_BankA.Action_1_Condition "Fault manager configuration.  Select up to 4 actions for each fault." VALUE 0x80003514 RecordLayout_4 0 CompuMethod_116 0 65535 /end CHARACTERISTIC
/begin CHARACTERISTIC FaultManager.O2FailedLean_BankA.Action_2 "Fault manager configuration.  Select up to 4 actions for each fault." VALUE 0x80003516 RecordLayout_4 0 CompuMethod_115 0 65535 /end CHARACTERISTIC
/begin CHARACTERISTIC FaultManager.O2FailedLean_BankA.Action_2_Condition "Fault manager configuration.  Select up to 4 actions for each fault." VALUE 0x80003518 RecordLayout_4 0 CompuMethod_116 0 65535 /end CHARACTERISTIC
/begin CHARACTERISTIC FaultManager.O2FailedLean_BankA.Action_3 "Fault manager configuration.  Select up to 4 actions for each fault." VALUE 0x8000351A RecordLayout_4 0 CompuMethod_115 0 65535 /end CHARACTERISTIC
/begin CHARACTERISTIC FaultManager.O2FailedLean_BankA.Action_3_Condition "Fault manager configuration.  Select up to 4 actions for each fault." VALUE 0x8000351C RecordLayout_4 0 CompuMethod_116 0 65535 /end CHARACTERISTIC
/begin CHARACTERISTIC FaultManager.O2FailedLean_BankA.Action_4 "Fault manager configuration.  Select up to 4 actions for each fault." VALUE 0x8000351E RecordLayout_4 0 CompuMethod_115 0 65535 /end CHARACTERISTIC
/begin CHARACTERISTIC FaultManager.O2FailedLean_BankA.Action_4_Condition "Fault manager configuration.  Select up to 4 actions for each fault." VALUE 0x80003520 RecordLayout_4 0 CompuMethod_116 0 65535 /end CHARACTERISTIC
/begin CHARACTERISTIC FaultManager.O2FailedLean_BankB.Mode "Fault manager configuration.  Select up to 4 actions for each fault." VALUE 0x80003522 RecordLayout_4 0 CompuMethod_113 0 65535 /end CHARACTERISTIC
/begin CHARACTERISTIC FaultManager.O2FailedLean_BankB.ID "Fault manager configuration.  Select up to 4 actions for each fault." VALUE 0x80003524 RecordLayout_4 0 CompuMethod_1 0 65535 /end CHARACTERISTIC
/begin CHARACTERISTIC FaultManager.O2FailedLean_BankB.Test "Fault manager configuration.  Select up to 4 actions for each fault." VALUE 0x80003526 RecordLayout_4 0 CompuMethod_114 0 65535 /end CHARACTERISTIC
/begin CHARACTERISTIC FaultManager.O2FailedLean_BankB.Faulty_Samples__X_ "Fault manager configuration.  Select up to 4 actions for each fault." VALUE 0x80003528 RecordLayout_4 0 CompuMethod_1 0 65535 /end CHARACTERISTIC
/begin CHARACTERISTIC FaultManager.O2FailedLean_BankB.Total_Samples__Y_ "Fault manager configuration.  Select up to 4 actions for each fault." VALUE 0x8000352A RecordLayout_4 0 CompuMethod_1 0 65535 /end CHARACTERISTIC
/begin CHARACTERISTIC FaultManager.O2FailedLean_BankB.Action_1 "Fault manager configuration.  Select up to 4 actions for each fault." VALUE 0x8000352C RecordLayout_4 0 CompuMethod_115 0 65535 /end CHARACTERISTIC
/begin CHARACTERISTIC FaultManager.O2FailedLean_BankB.Action_1_Condition "Fault manager configuration.  Select up to 4 actions for each fault." VALUE 0x8000352E RecordLayout_4 0 CompuMethod_116 0 65535 /end CHARACTERISTIC
/begin CHARACTERISTIC FaultManager.O2FailedLean_BankB.Action_2 "Fault manager configuration.  Select up to 4 actions for each fault." VALUE 0x80003530 RecordLayout_4 0 CompuMethod_115 0 65535 /end CHARACTERISTIC
/begin CHARACTERISTIC FaultManager.O2FailedLean_BankB.Action_2_Condition "Fault manager configuration.  Select up to 4 actions for each fault." VALUE 0x80003532 RecordLayout_4 0 CompuMethod_116 0 65535 /end CHARACTERISTIC
/begin CHARACTERISTIC FaultManager.O2FailedLean_BankB.Action_3 "Fault manager configuration.  Select up to 4 actions for each fault." VALUE 0x80003534 RecordLayout_4 0 CompuMethod_115 0 65535 /end CHARACTERISTIC
/begin CHARACTERISTIC FaultManager.O2FailedLean_BankB.Action_3_Condition "Fault manager configuration.  Select up to 4 actions for each fault." VALUE 0x80003536 RecordLayout_4 0 CompuMethod_116 0 65535 /end CHARACTERISTIC
/begin CHARACTERISTIC FaultManager.O2FailedLean_BankB.Action_4 "Fault manager configuration.  Select up to 4 actions for each fault." VALUE 0x80003538 RecordLayout_4 0 CompuMethod_115 0 65535 /end CHARACTERISTIC
/begin CHARACTERISTIC FaultManager.O2FailedLean_BankB.Action_4_Condition "Fault manager configuration.  Select up to 4 actions for each fault." VALUE 0x8000353A RecordLayout_4 0 CompuMethod_116 0 65535 /end CHARACTERISTIC
/begin CHARACTERISTIC FaultManager.O2FailedRich_BankA.Mode "Fault manager configuration.  Select up to 4 actions for each fault." VALUE 0x8000353C RecordLayout_4 0 CompuMethod_113 0 65535 /end CHARACTERISTIC
/begin CHARACTERISTIC FaultManager.O2FailedRich_BankA.ID "Fault manager configuration.  Select up to 4 actions for each fault." VALUE 0x8000353E RecordLayout_4 0 CompuMethod_1 0 65535 /end CHARACTERISTIC
/begin CHARACTERISTIC FaultManager.O2FailedRich_BankA.Test "Fault manager configuration.  Select up to 4 actions for each fault." VALUE 0x80003540 RecordLayout_4 0 CompuMethod_114 0 65535 /end CHARACTERISTIC
/begin CHARACTERISTIC FaultManager.O2FailedRich_BankA.Faulty_Samples__X_ "Fault manager configuration.  Select up to 4 actions for each fault." VALUE 0x80003542 RecordLayout_4 0 CompuMethod_1 0 65535 /end CHARACTERISTIC
/begin CHARACTERISTIC FaultManager.O2FailedRich_BankA.Total_Samples__Y_ "Fault manager configuration.  Select up to 4 actions for each fault." VALUE 0x80003544 RecordLayout_4 0 CompuMethod_1 0 65535 /end CHARACTERISTIC
/begin CHARACTERISTIC FaultManager.O2FailedRich_BankA.Action_1 "Fault manager configuration.  Select up to 4 actions for each fault." VALUE 0x80003546 RecordLayout_4 0 CompuMethod_115 0 65535 /end CHARACTERISTIC
/begin CHARACTERISTIC FaultManager.O2FailedRich_BankA.Action_1_Condition "Fault manager configuration.  Select up to 4 actions for each fault." VALUE 0x80003548 RecordLayout_4 0 CompuMethod_116 0 65535 /end CHARACTERISTIC
/begin CHARACTERISTIC FaultManager.O2FailedRich_BankA.Action_2 "Fault manager configuration.  Select up to 4 actions for each fault." VALUE 0x8000354A RecordLayout_4 0 CompuMethod_115 0 65535 /end CHARACTERISTIC
/begin CHARACTERISTIC FaultManager.O2FailedRich_BankA.Action_2_Condition "Fault manager configuration.  Select up to 4 actions for each fault." VALUE 0x8000354C RecordLayout_4 0 CompuMethod_116 0 65535 /end CHARACTERISTIC
/begin CHARACTERISTIC FaultManager.O2FailedRich_BankA.Action_3 "Fault manager configuration.  Select up to 4 actions for each fault." VALUE 0x8000354E RecordLayout_4 0 CompuMethod_115 0 65535 /end CHARACTERISTIC
/begin CHARACTERISTIC FaultManager.O2FailedRich_BankA.Action_3_Condition "Fault manager configuration.  Select up to 4 actions for each fault." VALUE 0x80003550 RecordLayout_4 0 CompuMethod_116 0 65535 /end CHARACTERISTIC
/begin CHARACTERISTIC FaultManager.O2FailedRich_BankA.Action_4 "Fault manager configuration.  Select up to 4 actions for each fault." VALUE 0x80003552 RecordLayout_4 0 CompuMethod_115 0 65535 /end CHARACTERISTIC
/begin CHARACTERISTIC FaultManager.O2FailedRich_BankA.Action_4_Condition "Fault manager configuration.  Select up to 4 actions for each fault." VALUE 0x80003554 RecordLayout_4 0 CompuMethod_116 0 65535 /end CHARACTERISTIC
/begin CHARACTERISTIC FaultManager.O2FailedRich_BankB.Mode "Fault manager configuration.  Select up to 4 actions for each fault." VALUE 0x80003556 RecordLayout_4 0 CompuMethod_113 0 65535 /end CHARACTERISTIC
/begin CHARACTERISTIC FaultManager.O2FailedRich_BankB.ID "Fault manager configuration.  Select up to 4 actions for each fault." VALUE 0x80003558 RecordLayout_4 0 CompuMethod_1 0 65535 /end CHARACTERISTIC
/begin CHARACTERISTIC FaultManager.O2FailedRich_BankB.Test "Fault manager configuration.  Select up to 4 actions for each fault." VALUE 0x8000355A RecordLayout_4 0 CompuMethod_114 0 65535 /end CHARACTERISTIC
/begin CHARACTERISTIC FaultManager.O2FailedRich_BankB.Faulty_Samples__X_ "Fault manager configuration.  Select up to 4 actions for each fault." VALUE 0x8000355C RecordLayout_4 0 CompuMethod_1 0 65535 /end CHARACTERISTIC
/begin CHARACTERISTIC FaultManager.O2FailedRich_BankB.Total_Samples__Y_ "Fault manager configuration.  Select up to 4 actions for each fault." VALUE 0x8000355E RecordLayout_4 0 CompuMethod_1 0 65535 /end CHARACTERISTIC
/begin CHARACTERISTIC FaultManager.O2FailedRich_BankB.Action_1 "Fault manager configuration.  Select up to 4 actions for each fault." VALUE 0x80003560 RecordLayout_4 0 CompuMethod_115 0 65535 /end CHARACTERISTIC
/begin CHARACTERISTIC FaultManager.O2FailedRich_BankB.Action_1_Condition "Fault manager configuration.  Select up to 4 actions for each fault." VALUE 0x80003562 RecordLayout_4 0 CompuMethod_116 0 65535 /end CHARACTERISTIC
/begin CHARACTERISTIC FaultManager.O2FailedRich_BankB.Action_2 "Fault manager configuration.  Select up to 4 actions for each fault." VALUE 0x80003564 RecordLayout_4 0 CompuMethod_115 0 65535 /end CHARACTERISTIC
/begin CHARACTERISTIC FaultManager.O2FailedRich_BankB.Action_2_Condition "Fault manager configuration.  Select up to 4 actions for each fault." VALUE 0x80003566 RecordLayout_4 0 CompuMethod_116 0 65535 /end CHARACTERISTIC
/begin CHARACTERISTIC FaultManager.O2FailedRich_BankB.Action_3 "Fault manager configuration.  Select up to 4 actions for each fault." VALUE 0x80003568 RecordLayout_4 0 CompuMethod_115 0 65535 /end CHARACTERISTIC
/begin CHARACTERISTIC FaultManager.O2FailedRich_BankB.Action_3_Condition "Fault manager configuration.  Select up to 4 actions for each fault." VALUE 0x8000356A RecordLayout_4 0 CompuMethod_116 0 65535 /end CHARACTERISTIC
/begin CHARACTERISTIC FaultManager.O2FailedRich_BankB.Action_4 "Fault manager configuration.  Select up to 4 actions for each fault." VALUE 0x8000356C RecordLayout_4 0 CompuMethod_115 0 65535 /end CHARACTERISTIC
/begin CHARACTERISTIC FaultManager.O2FailedRich_BankB.Action_4_Condition "Fault manager configuration.  Select up to 4 actions for each fault." VALUE 0x8000356E RecordLayout_4 0 CompuMethod_116 0 65535 /end CHARACTERISTIC
/begin CHARACTERISTIC FaultManager.O2NotActive_BankA.Mode "Fault manager configuration.  Select up to 4 actions for each fault." VALUE 0x80003570 RecordLayout_4 0 CompuMethod_113 0 65535 /end CHARACTERISTIC
/begin CHARACTERISTIC FaultManager.O2NotActive_BankA.ID "Fault manager configuration.  Select up to 4 actions for each fault." VALUE 0x80003572 RecordLayout_4 0 CompuMethod_1 0 65535 /end CHARACTERISTIC
/begin CHARACTERISTIC FaultManager.O2NotActive_BankA.Test "Fault manager configuration.  Select up to 4 actions for each fault." VALUE 0x80003574 RecordLayout_4 0 CompuMethod_114 0 65535 /end CHARACTERISTIC
/begin CHARACTERISTIC FaultManager.O2NotActive_BankA.Faulty_Samples__X_ "Fault manager configuration.  Select up to 4 actions for each fault." VALUE 0x80003576 RecordLayout_4 0 CompuMethod_1 0 65535 /end CHARACTERISTIC
/begin CHARACTERISTIC FaultManager.O2NotActive_BankA.Total_Samples__Y_ "Fault manager configuration.  Select up to 4 actions for each fault." VALUE 0x80003578 RecordLayout_4 0 CompuMethod_1 0 65535 /end CHARACTERISTIC
/begin CHARACTERISTIC FaultManager.O2NotActive_BankA.Action_1 "Fault manager configuration.  Select up to 4 actions for each fault." VALUE 0x8000357A RecordLayout_4 0 CompuMethod_115 0 65535 /end CHARACTERISTIC
/begin CHARACTERISTIC FaultManager.O2NotActive_BankA.Action_1_Condition "Fault manager configuration.  Select up to 4 actions for each fault." VALUE 0x8000357C RecordLayout_4 0 CompuMethod_116 0 65535 /end CHARACTERISTIC
/begin CHARACTERISTIC FaultManager.O2NotActive_BankA.Action_2 "Fault manager configuration.  Select up to 4 actions for each fault." VALUE 0x8000357E RecordLayout_4 0 CompuMethod_115 0 65535 /end CHARACTERISTIC
/begin CHARACTERISTIC FaultManager.O2NotActive_BankA.Action_2_Condition "Fault manager configuration.  Select up to 4 actions for each fault." VALUE 0x80003580 RecordLayout_4 0 CompuMethod_116 0 65535 /end CHARACTERISTIC
/begin CHARACTERISTIC FaultManager.O2NotActive_BankA.Action_3 "Fault manager configuration.  Select up to 4 actions for each fault." VALUE 0x80003582 RecordLayout_4 0 CompuMethod_115 0 65535 /end CHARACTERISTIC
/begin CHARACTERISTIC FaultManager.O2NotActive_BankA.Action_3_Condition "Fault manager configuration.  Select up to 4 actions for each fault." VALUE 0x80003584 RecordLayout_4 0 CompuMethod_116 0 65535 /end CHARACTERISTIC
/begin CHARACTERISTIC FaultManager.O2NotActive_BankA.Action_4 "Fault manager configuration.  Select up to 4 actions for each fault." VALUE 0x80003586 RecordLayout_4 0 CompuMethod_115 0 65535 /end CHARACTERISTIC
/begin CHARACTERISTIC FaultManager.O2NotActive_BankA.Action_4_Condition "Fault manager configuration.  Select up to 4 actions for each fault." VALUE 0x80003588 RecordLayout_4 0 CompuMethod_116 0 65535 /end CHARACTERISTIC
/begin CHARACTERISTIC FaultManager.O2NotActive_BankB.Mode "Fault manager configuration.  Select up to 4 actions for each fault." VALUE 0x8000358A RecordLayout_4 0 CompuMethod_113 0 65535 /end CHARACTERISTIC
/begin CHARACTERISTIC FaultManager.O2NotActive_BankB.ID "Fault manager configuration.  Select up to 4 actions for each fault." VALUE 0x8000358C RecordLayout_4 0 CompuMethod_1 0 65535 /end CHARACTERISTIC
/begin CHARACTERISTIC FaultManager.O2NotActive_BankB.Test "Fault manager configuration.  Select up to 4 actions for each fault." VALUE 0x8000358E RecordLayout_4 0 CompuMethod_114 0 65535 /end CHARACTERISTIC
/begin CHARACTERISTIC FaultManager.O2NotActive_BankB.Faulty_Samples__X_ "Fault manager configuration.  Select up to 4 actions for each fault." VALUE 0x80003590 RecordLayout_4 0 CompuMethod_1 0 65535 /end CHARACTERISTIC
/begin CHARACTERISTIC FaultManager.O2NotActive_BankB.Total_Samples__Y_ "Fault manager configuration.  Select up to 4 actions for each fault." VALUE 0x80003592 RecordLayout_4 0 CompuMethod_1 0 65535 /end CHARACTERISTIC
/begin CHARACTERISTIC FaultManager.O2NotActive_BankB.Action_1 "Fault manager configuration.  Select up to 4 actions for each fault." VALUE 0x80003594 RecordLayout_4 0 CompuMethod_115 0 65535 /end CHARACTERISTIC
/begin CHARACTERISTIC FaultManager.O2NotActive_BankB.Action_1_Condition "Fault manager configuration.  Select up to 4 actions for each fault." VALUE 0x80003596 RecordLayout_4 0 CompuMethod_116 0 65535 /end CHARACTERISTIC
/begin CHARACTERISTIC FaultManager.O2NotActive_BankB.Action_2 "Fault manager configuration.  Select up to 4 actions for each fault." VALUE 0x80003598 RecordLayout_4 0 CompuMethod_115 0 65535 /end CHARACTERISTIC
/begin CHARACTERISTIC FaultManager.O2NotActive_BankB.Action_2_Condition "Fault manager configuration.  Select up to 4 actions for each fault." VALUE 0x8000359A RecordLayout_4 0 CompuMethod_116 0 65535 /end CHARACTERISTIC
/begin CHARACTERISTIC FaultManager.O2NotActive_BankB.Action_3 "Fault manager configuration.  Select up to 4 actions for each fault." VALUE 0x8000359C RecordLayout_4 0 CompuMethod_115 0 65535 /end CHARACTERISTIC
/begin CHARACTERISTIC FaultManager.O2NotActive_BankB.Action_3_Condition "Fault manager configuration.  Select up to 4 actions for each fault." VALUE 0x8000359E RecordLayout_4 0 CompuMethod_116 0 65535 /end CHARACTERISTIC
/begin CHARACTERISTIC FaultManager.O2NotActive_BankB.Action_4 "Fault manager configuration.  Select up to 4 actions for each fault." VALUE 0x800035A0 RecordLayout_4 0 CompuMethod_115 0 65535 /end CHARACTERISTIC
/begin CHARACTERISTIC FaultManager.O2NotActive_BankB.Action_4_Condition "Fault manager configuration.  Select up to 4 actions for each fault." VALUE 0x800035A2 RecordLayout_4 0 CompuMethod_116 0 65535 /end CHARACTERISTIC
/begin CHARACTERISTIC FaultManager.OilPresRangeHigh.Mode "Fault manager configuration.  Select up to 4 actions for each fault." VALUE 0x800035A4 RecordLayout_4 0 CompuMethod_113 0 65535 /end CHARACTERISTIC
/begin CHARACTERISTIC FaultManager.OilPresRangeHigh.ID "Fault manager configuration.  Select up to 4 actions for each fault." VALUE 0x800035A6 RecordLayout_4 0 CompuMethod_1 0 65535 /end CHARACTERISTIC
/begin CHARACTERISTIC FaultManager.OilPresRangeHigh.Test "Fault manager configuration.  Select up to 4 actions for each fault." VALUE 0x800035A8 RecordLayout_4 0 CompuMethod_114 0 65535 /end CHARACTERISTIC
/begin CHARACTERISTIC FaultManager.OilPresRangeHigh.Faulty_Samples__X_ "Fault manager configuration.  Select up to 4 actions for each fault." VALUE 0x800035AA RecordLayout_4 0 CompuMethod_1 0 65535 /end CHARACTERISTIC
/begin CHARACTERISTIC FaultManager.OilPresRangeHigh.Total_Samples__Y_ "Fault manager configuration.  Select up to 4 actions for each fault." VALUE 0x800035AC RecordLayout_4 0 CompuMethod_1 0 65535 /end CHARACTERISTIC
/begin CHARACTERISTIC FaultManager.OilPresRangeHigh.Action_1 "Fault manager configuration.  Select up to 4 actions for each fault." VALUE 0x800035AE RecordLayout_4 0 CompuMethod_115 0 65535 /end CHARACTERISTIC
/begin CHARACTERISTIC FaultManager.OilPresRangeHigh.Action_1_Condition "Fault manager configuration.  Select up to 4 actions for each fault." VALUE 0x800035B0 RecordLayout_4 0 CompuMethod_116 0 65535 /end CHARACTERISTIC
/begin CHARACTERISTIC FaultManager.OilPresRangeHigh.Action_2 "Fault manager configuration.  Select up to 4 actions for each fault." VALUE 0x800035B2 RecordLayout_4 0 CompuMethod_115 0 65535 /end CHARACTERISTIC
/begin CHARACTERISTIC FaultManager.OilPresRangeHigh.Action_2_Condition "Fault manager configuration.  Select up to 4 actions for each fault." VALUE 0x800035B4 RecordLayout_4 0 CompuMethod_116 0 65535 /end CHARACTERISTIC
/begin CHARACTERISTIC FaultManager.OilPresRangeHigh.Action_3 "Fault manager configuration.  Select up to 4 actions for each fault." VALUE 0x800035B6 RecordLayout_4 0 CompuMethod_115 0 65535 /end CHARACTERISTIC
/begin CHARACTERISTIC FaultManager.OilPresRangeHigh.Action_3_Condition "Fault manager configuration.  Select up to 4 actions for each fault." VALUE 0x800035B8 RecordLayout_4 0 CompuMethod_116 0 65535 /end CHARACTERISTIC
/begin CHARACTERISTIC FaultManager.OilPresRangeHigh.Action_4 "Fault manager configuration.  Select up to 4 actions for each fault." VALUE 0x800035BA RecordLayout_4 0 CompuMethod_115 0 65535 /end CHARACTERISTIC
/begin CHARACTERISTIC FaultManager.OilPresRangeHigh.Action_4_Condition "Fault manager configuration.  Select up to 4 actions for each fault." VALUE 0x800035BC RecordLayout_4 0 CompuMethod_116 0 65535 /end CHARACTERISTIC
/begin CHARACTERISTIC FaultManager.OilPresRangeLow.Mode "Fault manager configuration.  Select up to 4 actions for each fault." VALUE 0x800035BE RecordLayout_4 0 CompuMethod_113 0 65535 /end CHARACTERISTIC
/begin CHARACTERISTIC FaultManager.OilPresRangeLow.ID "Fault manager configuration.  Select up to 4 actions for each fault." VALUE 0x800035C0 RecordLayout_4 0 CompuMethod_1 0 65535 /end CHARACTERISTIC
/begin CHARACTERISTIC FaultManager.OilPresRangeLow.Test "Fault manager configuration.  Select up to 4 actions for each fault." VALUE 0x800035C2 RecordLayout_4 0 CompuMethod_114 0 65535 /end CHARACTERISTIC
/begin CHARACTERISTIC FaultManager.OilPresRangeLow.Faulty_Samples__X_ "Fault manager configuration.  Select up to 4 actions for each fault." VALUE 0x800035C4 RecordLayout_4 0 CompuMethod_1 0 65535 /end CHARACTERISTIC
/begin CHARACTERISTIC FaultManager.OilPresRangeLow.Total_Samples__Y_ "Fault manager configuration.  Select up to 4 actions for each fault." VALUE 0x800035C6 RecordLayout_4 0 CompuMethod_1 0 65535 /end CHARACTERISTIC
/begin CHARACTERISTIC FaultManager.OilPresRangeLow.Action_1 "Fault manager configuration.  Select up to 4 actions for each fault." VALUE 0x800035C8 RecordLayout_4 0 CompuMethod_115 0 65535 /end CHARACTERISTIC
/begin CHARACTERISTIC FaultManager.OilPresRangeLow.Action_1_Condition "Fault manager configuration.  Select up to 4 actions for each fault." VALUE 0x800035CA RecordLayout_4 0 CompuMethod_116 0 65535 /end CHARACTERISTIC
/begin CHARACTERISTIC FaultManager.OilPresRangeLow.Action_2 "Fault manager configuration.  Select up to 4 actions for each fault." VALUE 0x800035CC RecordLayout_4 0 CompuMethod_115 0 65535 /end CHARACTERISTIC
/begin CHARACTERISTIC FaultManager.OilPresRangeLow.Action_2_Condition "Fault manager configuration.  Select up to 4 actions for each fault." VALUE 0x800035CE RecordLayout_4 0 CompuMethod_116 0 65535 /end CHARACTERISTIC
/begin CHARACTERISTIC FaultManager.OilPresRangeLow.Action_3 "Fault manager configuration.  Select up to 4 actions for each fault." VALUE 0x800035D0 RecordLayout_4 0 CompuMethod_115 0 65535 /end CHARACTERISTIC
/begin CHARACTERISTIC FaultManager.OilPresRangeLow.Action_3_Condition "Fault manager configuration.  Select up to 4 actions for each fault." VALUE 0x800035D2 RecordLayout_4 0 CompuMethod_116 0 65535 /end CHARACTERISTIC
/begin CHARACTERISTIC FaultManager.OilPresRangeLow.Action_4 "Fault manager configuration.  Select up to 4 actions for each fault." VALUE 0x800035D4 RecordLayout_4 0 CompuMethod_115 0 65535 /end CHARACTERISTIC
/begin CHARACTERISTIC FaultManager.OilPresRangeLow.Action_4_Condition "Fault manager configuration.  Select up to 4 actions for each fault." VALUE 0x800035D6 RecordLayout_4 0 CompuMethod_116 0 65535 /end CHARACTERISTIC
/begin CHARACTERISTIC FaultManager.ScrambleStuckHigh_Fault.Mode "Fault manager configuration.  Select up to 4 actions for each fault." VALUE 0x800035D8 RecordLayout_4 0 CompuMethod_113 0 65535 /end CHARACTERISTIC
/begin CHARACTERISTIC FaultManager.ScrambleStuckHigh_Fault.ID "Fault manager configuration.  Select up to 4 actions for each fault." VALUE 0x800035DA RecordLayout_4 0 CompuMethod_1 0 65535 /end CHARACTERISTIC
/begin CHARACTERISTIC FaultManager.ScrambleStuckHigh_Fault.Test "Fault manager configuration.  Select up to 4 actions for each fault." VALUE 0x800035DC RecordLayout_4 0 CompuMethod_114 0 65535 /end CHARACTERISTIC
/begin CHARACTERISTIC FaultManager.ScrambleStuckHigh_Fault.Faulty_Samples__X_ "Fault manager configuration.  Select up to 4 actions for each fault." VALUE 0x800035DE RecordLayout_4 0 CompuMethod_1 0 65535 /end CHARACTERISTIC
/begin CHARACTERISTIC FaultManager.ScrambleStuckHigh_Fault.Total_Samples__Y_ "Fault manager configuration.  Select up to 4 actions for each fault." VALUE 0x800035E0 RecordLayout_4 0 CompuMethod_1 0 65535 /end CHARACTERISTIC
/begin CHARACTERISTIC FaultManager.ScrambleStuckHigh_Fault.Action_1 "Fault manager configuration.  Select up to 4 actions for each fault." VALUE 0x800035E2 RecordLayout_4 0 CompuMethod_115 0 65535 /end CHARACTERISTIC
/begin CHARACTERISTIC FaultManager.ScrambleStuckHigh_Fault.Action_1_Condition "Fault manager configuration.  Select up to 4 actions for each fault." VALUE 0x800035E4 RecordLayout_4 0 CompuMethod_116 0 65535 /end CHARACTERISTIC
/begin CHARACTERISTIC FaultManager.ScrambleStuckHigh_Fault.Action_2 "Fault manager configuration.  Select up to 4 actions for each fault." VALUE 0x800035E6 RecordLayout_4 0 CompuMethod_115 0 65535 /end CHARACTERISTIC
/begin CHARACTERISTIC FaultManager.ScrambleStuckHigh_Fault.Action_2_Condition "Fault manager configuration.  Select up to 4 actions for each fault." VALUE 0x800035E8 RecordLayout_4 0 CompuMethod_116 0 65535 /end CHARACTERISTIC
/begin CHARACTERISTIC FaultManager.ScrambleStuckHigh_Fault.Action_3 "Fault manager configuration.  Select up to 4 actions for each fault." VALUE 0x800035EA RecordLayout_4 0 CompuMethod_115 0 65535 /end CHARACTERISTIC
/begin CHARACTERISTIC FaultManager.ScrambleStuckHigh_Fault.Action_3_Condition "Fault manager configuration.  Select up to 4 actions for each fault." VALUE 0x800035EC RecordLayout_4 0 CompuMethod_116 0 65535 /end CHARACTERISTIC
/begin CHARACTERISTIC FaultManager.ScrambleStuckHigh_Fault.Action_4 "Fault manager configuration.  Select up to 4 actions for each fault." VALUE 0x800035EE RecordLayout_4 0 CompuMethod_115 0 65535 /end CHARACTERISTIC
/begin CHARACTERISTIC FaultManager.ScrambleStuckHigh_Fault.Action_4_Condition "Fault manager configuration.  Select up to 4 actions for each fault." VALUE 0x800035F0 RecordLayout_4 0 CompuMethod_116 0 65535 /end CHARACTERISTIC
/begin CHARACTERISTIC FaultManager.SensVoltRangeHigh.Mode "Fault manager configuration.  Select up to 4 actions for each fault." VALUE 0x800035F2 RecordLayout_4 0 CompuMethod_113 0 65535 /end CHARACTERISTIC
/begin CHARACTERISTIC FaultManager.SensVoltRangeHigh.ID "Fault manager configuration.  Select up to 4 actions for each fault." VALUE 0x800035F4 RecordLayout_4 0 CompuMethod_1 0 65535 /end CHARACTERISTIC
/begin CHARACTERISTIC FaultManager.SensVoltRangeHigh.Test "Fault manager configuration.  Select up to 4 actions for each fault." VALUE 0x800035F6 RecordLayout_4 0 CompuMethod_114 0 65535 /end CHARACTERISTIC
/begin CHARACTERISTIC FaultManager.SensVoltRangeHigh.Faulty_Samples__X_ "Fault manager configuration.  Select up to 4 actions for each fault." VALUE 0x800035F8 RecordLayout_4 0 CompuMethod_1 0 65535 /end CHARACTERISTIC
/begin CHARACTERISTIC FaultManager.SensVoltRangeHigh.Total_Samples__Y_ "Fault manager configuration.  Select up to 4 actions for each fault." VALUE 0x800035FA RecordLayout_4 0 CompuMethod_1 0 65535 /end CHARACTERISTIC
/begin CHARACTERISTIC FaultManager.SensVoltRangeHigh.Action_1 "Fault manager configuration.  Select up to 4 actions for each fault." VALUE 0x800035FC RecordLayout_4 0 CompuMethod_115 0 65535 /end CHARACTERISTIC
/begin CHARACTERISTIC FaultManager.SensVoltRangeHigh.Action_1_Condition "Fault manager configuration.  Select up to 4 actions for each fault." VALUE 0x800035FE RecordLayout_4 0 CompuMethod_116 0 65535 /end CHARACTERISTIC
/begin CHARACTERISTIC FaultManager.SensVoltRangeHigh.Action_2 "Fault manager configuration.  Select up to 4 actions for each fault." VALUE 0x80003600 RecordLayout_4 0 CompuMethod_115 0 65535 /end CHARACTERISTIC
/begin CHARACTERISTIC FaultManager.SensVoltRangeHigh.Action_2_Condition "Fault manager configuration.  Select up to 4 actions for each fault." VALUE 0x80003602 RecordLayout_4 0 CompuMethod_116 0 65535 /end CHARACTERISTIC
/begin CHARACTERISTIC FaultManager.SensVoltRangeHigh.Action_3 "Fault manager configuration.  Select up to 4 actions for each fault." VALUE 0x80003604 RecordLayout_4 0 CompuMethod_115 0 65535 /end CHARACTERISTIC
/begin CHARACTERISTIC FaultManager.SensVoltRangeHigh.Action_3_Condition "Fault manager configuration.  Select up to 4 actions for each fault." VALUE 0x80003606 RecordLayout_4 0 CompuMethod_116 0 65535 /end CHARACTERISTIC
/begin CHARACTERISTIC FaultManager.SensVoltRangeHigh.Action_4 "Fault manager configuration.  Select up to 4 actions for each fault." VALUE 0x80003608 RecordLayout_4 0 CompuMethod_115 0 65535 /end CHARACTERISTIC
/begin CHARACTERISTIC FaultManager.SensVoltRangeHigh.Action_4_Condition "Fault manager configuration.  Select up to 4 actions for each fault." VALUE 0x8000360A RecordLayout_4 0 CompuMethod_116 0 65535 /end CHARACTERISTIC
/begin CHARACTERISTIC FaultManager.SensVoltRangeLow.Mode "Fault manager configuration.  Select up to 4 actions for each fault." VALUE 0x8000360C RecordLayout_4 0 CompuMethod_113 0 65535 /end CHARACTERISTIC
/begin CHARACTERISTIC FaultManager.SensVoltRangeLow.ID "Fault manager configuration.  Select up to 4 actions for each fault." VALUE 0x8000360E RecordLayout_4 0 CompuMethod_1 0 65535 /end CHARACTERISTIC
/begin CHARACTERISTIC FaultManager.SensVoltRangeLow.Test "Fault manager configuration.  Select up to 4 actions for each fault." VALUE 0x80003610 RecordLayout_4 0 CompuMethod_114 0 65535 /end CHARACTERISTIC
/begin CHARACTERISTIC FaultManager.SensVoltRangeLow.Faulty_Samples__X_ "Fault manager configuration.  Select up to 4 actions for each fault." VALUE 0x80003612 RecordLayout_4 0 CompuMethod_1 0 65535 /end CHARACTERISTIC
/begin CHARACTERISTIC FaultManager.SensVoltRangeLow.Total_Samples__Y_ "Fault manager configuration.  Select up to 4 actions for each fault." VALUE 0x80003614 RecordLayout_4 0 CompuMethod_1 0 65535 /end CHARACTERISTIC
/begin CHARACTERISTIC FaultManager.SensVoltRangeLow.Action_1 "Fault manager configuration.  Select up to 4 actions for each fault." VALUE 0x80003616 RecordLayout_4 0 CompuMethod_115 0 65535 /end CHARACTERISTIC
/begin CHARACTERISTIC FaultManager.SensVoltRangeLow.Action_1_Condition "Fault manager configuration.  Select up to 4 actions for each fault." VALUE 0x80003618 RecordLayout_4 0 CompuMethod_116 0 65535 /end CHARACTERISTIC
/begin CHARACTERISTIC FaultManager.SensVoltRangeLow.Action_2 "Fault manager configuration.  Select up to 4 actions for each fault." VALUE 0x8000361A RecordLayout_4 0 CompuMethod_115 0 65535 /end CHARACTERISTIC
/begin CHARACTERISTIC FaultManager.SensVoltRangeLow.Action_2_Condition "Fault manager configuration.  Select up to 4 actions for each fault." VALUE 0x8000361C RecordLayout_4 0 CompuMethod_116 0 65535 /end CHARACTERISTIC
/begin CHARACTERISTIC FaultManager.SensVoltRangeLow.Action_3 "Fault manager configuration.  Select up to 4 actions for each fault." VALUE 0x8000361E RecordLayout_4 0 CompuMethod_115 0 65535 /end CHARACTERISTIC
/begin CHARACTERISTIC FaultManager.SensVoltRangeLow.Action_3_Condition "Fault manager configuration.  Select up to 4 actions for each fault." VALUE 0x80003620 RecordLayout_4 0 CompuMethod_116 0 65535 /end CHARACTERISTIC
/begin CHARACTERISTIC FaultManager.SensVoltRangeLow.Action_4 "Fault manager configuration.  Select up to 4 actions for each fault." VALUE 0x80003622 RecordLayout_4 0 CompuMethod_115 0 65535 /end CHARACTERISTIC
/begin CHARACTERISTIC FaultManager.SensVoltRangeLow.Action_4_Condition "Fault manager configuration.  Select up to 4 actions for each fault." VALUE 0x80003624 RecordLayout_4 0 CompuMethod_116 0 65535 /end CHARACTERISTIC
/begin CHARACTERISTIC FaultManager.SoftOverBoost_Fault.Mode "Fault manager configuration.  Select up to 4 actions for each fault." VALUE 0x80003626 RecordLayout_4 0 CompuMethod_113 0 65535 /end CHARACTERISTIC
/begin CHARACTERISTIC FaultManager.SoftOverBoost_Fault.ID "Fault manager configuration.  Select up to 4 actions for each fault." VALUE 0x80003628 RecordLayout_4 0 CompuMethod_1 0 65535 /end CHARACTERISTIC
/begin CHARACTERISTIC FaultManager.SoftOverBoost_Fault.Test "Fault manager configuration.  Select up to 4 actions for each fault." VALUE 0x8000362A RecordLayout_4 0 CompuMethod_114 0 65535 /end CHARACTERISTIC
/begin CHARACTERISTIC FaultManager.SoftOverBoost_Fault.Faulty_Samples__X_ "Fault manager configuration.  Select up to 4 actions for each fault." VALUE 0x8000362C RecordLayout_4 0 CompuMethod_1 0 65535 /end CHARACTERISTIC
/begin CHARACTERISTIC FaultManager.SoftOverBoost_Fault.Total_Samples__Y_ "Fault manager configuration.  Select up to 4 actions for each fault." VALUE 0x8000362E RecordLayout_4 0 CompuMethod_1 0 65535 /end CHARACTERISTIC
/begin CHARACTERISTIC FaultManager.SoftOverBoost_Fault.Action_1 "Fault manager configuration.  Select up to 4 actions for each fault." VALUE 0x80003630 RecordLayout_4 0 CompuMethod_115 0 65535 /end CHARACTERISTIC
/begin CHARACTERISTIC FaultManager.SoftOverBoost_Fault.Action_1_Condition "Fault manager configuration.  Select up to 4 actions for each fault." VALUE 0x80003632 RecordLayout_4 0 CompuMethod_116 0 65535 /end CHARACTERISTIC
/begin CHARACTERISTIC FaultManager.SoftOverBoost_Fault.Action_2 "Fault manager configuration.  Select up to 4 actions for each fault." VALUE 0x80003634 RecordLayout_4 0 CompuMethod_115 0 65535 /end CHARACTERISTIC
/begin CHARACTERISTIC FaultManager.SoftOverBoost_Fault.Action_2_Condition "Fault manager configuration.  Select up to 4 actions for each fault." VALUE 0x80003636 RecordLayout_4 0 CompuMethod_116 0 65535 /end CHARACTERISTIC
/begin CHARACTERISTIC FaultManager.SoftOverBoost_Fault.Action_3 "Fault manager configuration.  Select up to 4 actions for each fault." VALUE 0x80003638 RecordLayout_4 0 CompuMethod_115 0 65535 /end CHARACTERISTIC
/begin CHARACTERISTIC FaultManager.SoftOverBoost_Fault.Action_3_Condition "Fault manager configuration.  Select up to 4 actions for each fault." VALUE 0x8000363A RecordLayout_4 0 CompuMethod_116 0 65535 /end CHARACTERISTIC
/begin CHARACTERISTIC FaultManager.SoftOverBoost_Fault.Action_4 "Fault manager configuration.  Select up to 4 actions for each fault." VALUE 0x8000363C RecordLayout_4 0 CompuMethod_115 0 65535 /end CHARACTERISTIC
/begin CHARACTERISTIC FaultManager.SoftOverBoost_Fault.Action_4_Condition "Fault manager configuration.  Select up to 4 actions for each fault." VALUE 0x8000363E RecordLayout_4 0 CompuMethod_116 0 65535 /end CHARACTERISTIC
/begin CHARACTERISTIC FaultManager.SoftOverspeed.Mode "Fault manager configuration.  Select up to 4 actions for each fault." VALUE 0x80003640 RecordLayout_4 0 CompuMethod_113 0 65535 /end CHARACTERISTIC
/begin CHARACTERISTIC FaultManager.SoftOverspeed.ID "Fault manager configuration.  Select up to 4 actions for each fault." VALUE 0x80003642 RecordLayout_4 0 CompuMethod_1 0 65535 /end CHARACTERISTIC
/begin CHARACTERISTIC FaultManager.SoftOverspeed.Test "Fault manager configuration.  Select up to 4 actions for each fault." VALUE 0x80003644 RecordLayout_4 0 CompuMethod_114 0 65535 /end CHARACTERISTIC
/begin CHARACTERISTIC FaultManager.SoftOverspeed.Faulty_Samples__X_ "Fault manager configuration.  Select up to 4 actions for each fault." VALUE 0x80003646 RecordLayout_4 0 CompuMethod_1 0 65535 /end CHARACTERISTIC
/begin CHARACTERISTIC FaultManager.SoftOverspeed.Total_Samples__Y_ "Fault manager configuration.  Select up to 4 actions for each fault." VALUE 0x80003648 RecordLayout_4 0 CompuMethod_1 0 65535 /end CHARACTERISTIC
/begin CHARACTERISTIC FaultManager.SoftOverspeed.Action_1 "Fault manager configuration.  Select up to 4 actions for each fault." VALUE 0x8000364A RecordLayout_4 0 CompuMethod_115 0 65535 /end CHARACTERISTIC
/begin CHARACTERISTIC FaultManager.SoftOverspeed.Action_1_Condition "Fault manager configuration.  Select up to 4 actions for each fault." VALUE 0x8000364C RecordLayout_4 0 CompuMethod_116 0 65535 /end CHARACTERISTIC
/begin CHARACTERISTIC FaultManager.SoftOverspeed.Action_2 "Fault manager configuration.  Select up to 4 actions for each fault." VALUE 0x8000364E RecordLayout_4 0 CompuMethod_115 0 65535 /end CHARACTERISTIC
/begin CHARACTERISTIC FaultManager.SoftOverspeed.Action_2_Condition "Fault manager configuration.  Select up to 4 actions for each fault." VALUE 0x80003650 RecordLayout_4 0 CompuMethod_116 0 65535 /end CHARACTERISTIC
/begin CHARACTERISTIC FaultManager.SoftOverspeed.Action_3 "Fault manager configuration.  Select up to 4 actions for each fault." VALUE 0x80003652 RecordLayout_4 0 CompuMethod_115 0 65535 /end CHARACTERISTIC
/begin CHARACTERISTIC FaultManager.SoftOverspeed.Action_3_Condition "Fault manager configuration.  Select up to 4 actions for each fault." VALUE 0x80003654 RecordLayout_4 0 CompuMethod_116 0 65535 /end CHARACTERISTIC
/begin CHARACTERISTIC FaultManager.SoftOverspeed.Action_4 "Fault manager configuration.  Select up to 4 actions for each fault." VALUE 0x80003656 RecordLayout_4 0 CompuMethod_115 0 65535 /end CHARACTERISTIC
/begin CHARACTERISTIC FaultManager.SoftOverspeed.Action_4_Condition "Fault manager configuration.  Select up to 4 actions for each fault." VALUE 0x80003658 RecordLayout_4 0 CompuMethod_116 0 65535 /end CHARACTERISTIC
/begin CHARACTERISTIC FaultManager.SysVoltRangeHigh.Mode "Fault manager configuration.  Select up to 4 actions for each fault." VALUE 0x8000365A RecordLayout_4 0 CompuMethod_113 0 65535 /end CHARACTERISTIC
/begin CHARACTERISTIC FaultManager.SysVoltRangeHigh.ID "Fault manager configuration.  Select up to 4 actions for each fault." VALUE 0x8000365C RecordLayout_4 0 CompuMethod_1 0 65535 /end CHARACTERISTIC
/begin CHARACTERISTIC FaultManager.SysVoltRangeHigh.Test "Fault manager configuration.  Select up to 4 actions for each fault." VALUE 0x8000365E RecordLayout_4 0 CompuMethod_114 0 65535 /end CHARACTERISTIC
/begin CHARACTERISTIC FaultManager.SysVoltRangeHigh.Faulty_Samples__X_ "Fault manager configuration.  Select up to 4 actions for each fault." VALUE 0x80003660 RecordLayout_4 0 CompuMethod_1 0 65535 /end CHARACTERISTIC
/begin CHARACTERISTIC FaultManager.SysVoltRangeHigh.Total_Samples__Y_ "Fault manager configuration.  Select up to 4 actions for each fault." VALUE 0x80003662 RecordLayout_4 0 CompuMethod_1 0 65535 /end CHARACTERISTIC
/begin CHARACTERISTIC FaultManager.SysVoltRangeHigh.Action_1 "Fault manager configuration.  Select up to 4 actions for each fault." VALUE 0x80003664 RecordLayout_4 0 CompuMethod_115 0 65535 /end CHARACTERISTIC
/begin CHARACTERISTIC FaultManager.SysVoltRangeHigh.Action_1_Condition "Fault manager configuration.  Select up to 4 actions for each fault." VALUE 0x80003666 RecordLayout_4 0 CompuMethod_116 0 65535 /end CHARACTERISTIC
/begin CHARACTERISTIC FaultManager.SysVoltRangeHigh.Action_2 "Fault manager configuration.  Select up to 4 actions for each fault." VALUE 0x80003668 RecordLayout_4 0 CompuMethod_115 0 65535 /end CHARACTERISTIC
/begin CHARACTERISTIC FaultManager.SysVoltRangeHigh.Action_2_Condition "Fault manager configuration.  Select up to 4 actions for each fault." VALUE 0x8000366A RecordLayout_4 0 CompuMethod_116 0 65535 /end CHARACTERISTIC
/begin CHARACTERISTIC FaultManager.SysVoltRangeHigh.Action_3 "Fault manager configuration.  Select up to 4 actions for each fault." VALUE 0x8000366C RecordLayout_4 0 CompuMethod_115 0 65535 /end CHARACTERISTIC
/begin CHARACTERISTIC FaultManager.SysVoltRangeHigh.Action_3_Condition "Fault manager configuration.  Select up to 4 actions for each fault." VALUE 0x8000366E RecordLayout_4 0 CompuMethod_116 0 65535 /end CHARACTERISTIC
/begin CHARACTERISTIC FaultManager.SysVoltRangeHigh.Action_4 "Fault manager configuration.  Select up to 4 actions for each fault." VALUE 0x80003670 RecordLayout_4 0 CompuMethod_115 0 65535 /end CHARACTERISTIC
/begin CHARACTERISTIC FaultManager.SysVoltRangeHigh.Action_4_Condition "Fault manager configuration.  Select up to 4 actions for each fault." VALUE 0x80003672 RecordLayout_4 0 CompuMethod_116 0 65535 /end CHARACTERISTIC
/begin CHARACTERISTIC FaultManager.SysVoltRangeLow.Mode "Fault manager configuration.  Select up to 4 actions for each fault." VALUE 0x80003674 RecordLayout_4 0 CompuMethod_113 0 65535 /end CHARACTERISTIC
/begin CHARACTERISTIC FaultManager.SysVoltRangeLow.ID "Fault manager configuration.  Select up to 4 actions for each fault." VALUE 0x80003676 RecordLayout_4 0 CompuMethod_1 0 65535 /end CHARACTERISTIC
/begin CHARACTERISTIC FaultManager.SysVoltRangeLow.Test "Fault manager configuration.  Select up to 4 actions for each fault." VALUE 0x80003678 RecordLayout_4 0 CompuMethod_114 0 65535 /end CHARACTERISTIC
/begin CHARACTERISTIC FaultManager.SysVoltRangeLow.Faulty_Samples__X_ "Fault manager configuration.  Select up to 4 actions for each fault." VALUE 0x8000367A RecordLayout_4 0 CompuMethod_1 0 65535 /end CHARACTERISTIC
/begin CHARACTERISTIC FaultManager.SysVoltRangeLow.Total_Samples__Y_ "Fault manager configuration.  Select up to 4 actions for each fault." VALUE 0x8000367C RecordLayout_4 0 CompuMethod_1 0 65535 /end CHARACTERISTIC
/begin CHARACTERISTIC FaultManager.SysVoltRangeLow.Action_1 "Fault manager configuration.  Select up to 4 actions for each fault." VALUE 0x8000367E RecordLayout_4 0 CompuMethod_115 0 65535 /end CHARACTERISTIC
/begin CHARACTERISTIC FaultManager.SysVoltRangeLow.Action_1_Condition "Fault manager configuration.  Select up to 4 actions for each fault." VALUE 0x80003680 RecordLayout_4 0 CompuMethod_116 0 65535 /end CHARACTERISTIC
/begin CHARACTERISTIC FaultManager.SysVoltRangeLow.Action_2 "Fault manager configuration.  Select up to 4 actions for each fault." VALUE 0x80003682 RecordLayout_4 0 CompuMethod_115 0 65535 /end CHARACTERISTIC
/begin CHARACTERISTIC FaultManager.SysVoltRangeLow.Action_2_Condition "Fault manager configuration.  Select up to 4 actions for each fault." VALUE 0x80003684 RecordLayout_4 0 CompuMethod_116 0 65535 /end CHARACTERISTIC
/begin CHARACTERISTIC FaultManager.SysVoltRangeLow.Action_3 "Fault manager configuration.  Select up to 4 actions for each fault." VALUE 0x80003686 RecordLayout_4 0 CompuMethod_115 0 65535 /end CHARACTERISTIC
/begin CHARACTERISTIC FaultManager.SysVoltRangeLow.Action_3_Condition "Fault manager configuration.  Select up to 4 actions for each fault." VALUE 0x80003688 RecordLayout_4 0 CompuMethod_116 0 65535 /end CHARACTERISTIC
/begin CHARACTERISTIC FaultManager.SysVoltRangeLow.Action_4 "Fault manager configuration.  Select up to 4 actions for each fault." VALUE 0x8000368A RecordLayout_4 0 CompuMethod_115 0 65535 /end CHARACTERISTIC
/begin CHARACTERISTIC FaultManager.SysVoltRangeLow.Action_4_Condition "Fault manager configuration.  Select up to 4 actions for each fault." VALUE 0x8000368C RecordLayout_4 0 CompuMethod_116 0 65535 /end CHARACTERISTIC
/begin CHARACTERISTIC FaultManager.TPS1AdaptHiMax.Mode "Fault manager configuration.  Select up to 4 actions for each fault." VALUE 0x8000368E RecordLayout_4 0 CompuMethod_113 0 65535 /end CHARACTERISTIC
/begin CHARACTERISTIC FaultManager.TPS1AdaptHiMax.ID "Fault manager configuration.  Select up to 4 actions for each fault." VALUE 0x80003690 RecordLayout_4 0 CompuMethod_1 0 65535 /end CHARACTERISTIC
/begin CHARACTERISTIC FaultManager.TPS1AdaptHiMax.Test "Fault manager configuration.  Select up to 4 actions for each fault." VALUE 0x80003692 RecordLayout_4 0 CompuMethod_114 0 65535 /end CHARACTERISTIC
/begin CHARACTERISTIC FaultManager.TPS1AdaptHiMax.Faulty_Samples__X_ "Fault manager configuration.  Select up to 4 actions for each fault." VALUE 0x80003694 RecordLayout_4 0 CompuMethod_1 0 65535 /end CHARACTERISTIC
/begin CHARACTERISTIC FaultManager.TPS1AdaptHiMax.Total_Samples__Y_ "Fault manager configuration.  Select up to 4 actions for each fault." VALUE 0x80003696 RecordLayout_4 0 CompuMethod_1 0 65535 /end CHARACTERISTIC
/begin CHARACTERISTIC FaultManager.TPS1AdaptHiMax.Action_1 "Fault manager configuration.  Select up to 4 actions for each fault." VALUE 0x80003698 RecordLayout_4 0 CompuMethod_115 0 65535 /end CHARACTERISTIC
/begin CHARACTERISTIC FaultManager.TPS1AdaptHiMax.Action_1_Condition "Fault manager configuration.  Select up to 4 actions for each fault." VALUE 0x8000369A RecordLayout_4 0 CompuMethod_116 0 65535 /end CHARACTERISTIC
/begin CHARACTERISTIC FaultManager.TPS1AdaptHiMax.Action_2 "Fault manager configuration.  Select up to 4 actions for each fault." VALUE 0x8000369C RecordLayout_4 0 CompuMethod_115 0 65535 /end CHARACTERISTIC
/begin CHARACTERISTIC FaultManager.TPS1AdaptHiMax.Action_2_Condition "Fault manager configuration.  Select up to 4 actions for each fault." VALUE 0x8000369E RecordLayout_4 0 CompuMethod_116 0 65535 /end CHARACTERISTIC
/begin CHARACTERISTIC FaultManager.TPS1AdaptHiMax.Action_3 "Fault manager configuration.  Select up to 4 actions for each fault." VALUE 0x800036A0 RecordLayout_4 0 CompuMethod_115 0 65535 /end CHARACTERISTIC
/begin CHARACTERISTIC FaultManager.TPS1AdaptHiMax.Action_3_Condition "Fault manager configuration.  Select up to 4 actions for each fault." VALUE 0x800036A2 RecordLayout_4 0 CompuMethod_116 0 65535 /end CHARACTERISTIC
/begin CHARACTERISTIC FaultManager.TPS1AdaptHiMax.Action_4 "Fault manager configuration.  Select up to 4 actions for each fault." VALUE 0x800036A4 RecordLayout_4 0 CompuMethod_115 0 65535 /end CHARACTERISTIC
/begin CHARACTERISTIC FaultManager.TPS1AdaptHiMax.Action_4_Condition "Fault manager configuration.  Select up to 4 actions for each fault." VALUE 0x800036A6 RecordLayout_4 0 CompuMethod_116 0 65535 /end CHARACTERISTIC
/begin CHARACTERISTIC FaultManager.TPS1AdaptHiMin.Mode "Fault manager configuration.  Select up to 4 actions for each fault." VALUE 0x800036A8 RecordLayout_4 0 CompuMethod_113 0 65535 /end CHARACTERISTIC
/begin CHARACTERISTIC FaultManager.TPS1AdaptHiMin.ID "Fault manager configuration.  Select up to 4 actions for each fault." VALUE 0x800036AA RecordLayout_4 0 CompuMethod_1 0 65535 /end CHARACTERISTIC
/begin CHARACTERISTIC FaultManager.TPS1AdaptHiMin.Test "Fault manager configuration.  Select up to 4 actions for each fault." VALUE 0x800036AC RecordLayout_4 0 CompuMethod_114 0 65535 /end CHARACTERISTIC
/begin CHARACTERISTIC FaultManager.TPS1AdaptHiMin.Faulty_Samples__X_ "Fault manager configuration.  Select up to 4 actions for each fault." VALUE 0x800036AE RecordLayout_4 0 CompuMethod_1 0 65535 /end CHARACTERISTIC
/begin CHARACTERISTIC FaultManager.TPS1AdaptHiMin.Total_Samples__Y_ "Fault manager configuration.  Select up to 4 actions for each fault." VALUE 0x800036B0 RecordLayout_4 0 CompuMethod_1 0 65535 /end CHARACTERISTIC
/begin CHARACTERISTIC FaultManager.TPS1AdaptHiMin.Action_1 "Fault manager configuration.  Select up to 4 actions for each fault." VALUE 0x800036B2 RecordLayout_4 0 CompuMethod_115 0 65535 /end CHARACTERISTIC
/begin CHARACTERISTIC FaultManager.TPS1AdaptHiMin.Action_1_Condition "Fault manager configuration.  Select up to 4 actions for each fault." VALUE 0x800036B4 RecordLayout_4 0 CompuMethod_116 0 65535 /end CHARACTERISTIC
/begin CHARACTERISTIC FaultManager.TPS1AdaptHiMin.Action_2 "Fault manager configuration.  Select up to 4 actions for each fault." VALUE 0x800036B6 RecordLayout_4 0 CompuMethod_115 0 65535 /end CHARACTERISTIC
/begin CHARACTERISTIC FaultManager.TPS1AdaptHiMin.Action_2_Condition "Fault manager configuration.  Select up to 4 actions for each fault." VALUE 0x800036B8 RecordLayout_4 0 CompuMethod_116 0 65535 /end CHARACTERISTIC
/begin CHARACTERISTIC FaultManager.TPS1AdaptHiMin.Action_3 "Fault manager configuration.  Select up to 4 actions for each fault." VALUE 0x800036BA RecordLayout_4 0 CompuMethod_115 0 65535 /end CHARACTERISTIC
/begin CHARACTERISTIC FaultManager.TPS1AdaptHiMin.Action_3_Condition "Fault manager configuration.  Select up to 4 actions for each fault." VALUE 0x800036BC RecordLayout_4 0 CompuMethod_116 0 65535 /end CHARACTERISTIC
/begin CHARACTERISTIC FaultManager.TPS1AdaptHiMin.Action_4 "Fault manager configuration.  Select up to 4 actions for each fault." VALUE 0x800036BE RecordLayout_4 0 CompuMethod_115 0 65535 /end CHARACTERISTIC
/begin CHARACTERISTIC FaultManager.TPS1AdaptHiMin.Action_4_Condition "Fault manager configuration.  Select up to 4 actions for each fault." VALUE 0x800036C0 RecordLayout_4 0 CompuMethod_116 0 65535 /end CHARACTERISTIC
/begin CHARACTERISTIC FaultManager.TPS1AdaptLoMax.Mode "Fault manager configuration.  Select up to 4 actions for each fault." VALUE 0x800036C2 RecordLayout_4 0 CompuMethod_113 0 65535 /end CHARACTERISTIC
/begin CHARACTERISTIC FaultManager.TPS1AdaptLoMax.ID "Fault manager configuration.  Select up to 4 actions for each fault." VALUE 0x800036C4 RecordLayout_4 0 CompuMethod_1 0 65535 /end CHARACTERISTIC
/begin CHARACTERISTIC FaultManager.TPS1AdaptLoMax.Test "Fault manager configuration.  Select up to 4 actions for each fault." VALUE 0x800036C6 RecordLayout_4 0 CompuMethod_114 0 65535 /end CHARACTERISTIC
/begin CHARACTERISTIC FaultManager.TPS1AdaptLoMax.Faulty_Samples__X_ "Fault manager configuration.  Select up to 4 actions for each fault." VALUE 0x800036C8 RecordLayout_4 0 CompuMethod_1 0 65535 /end CHARACTERISTIC
/begin CHARACTERISTIC FaultManager.TPS1AdaptLoMax.Total_Samples__Y_ "Fault manager configuration.  Select up to 4 actions for each fault." VALUE 0x800036CA RecordLayout_4 0 CompuMethod_1 0 65535 /end CHARACTERISTIC
/begin CHARACTERISTIC FaultManager.TPS1AdaptLoMax.Action_1 "Fault manager configuration.  Select up to 4 actions for each fault." VALUE 0x800036CC RecordLayout_4 0 CompuMethod_115 0 65535 /end CHARACTERISTIC
/begin CHARACTERISTIC FaultManager.TPS1AdaptLoMax.Action_1_Condition "Fault manager configuration.  Select up to 4 actions for each fault." VALUE 0x800036CE RecordLayout_4 0 CompuMethod_116 0 65535 /end CHARACTERISTIC
/begin CHARACTERISTIC FaultManager.TPS1AdaptLoMax.Action_2 "Fault manager configuration.  Select up to 4 actions for each fault." VALUE 0x800036D0 RecordLayout_4 0 CompuMethod_115 0 65535 /end CHARACTERISTIC
/begin CHARACTERISTIC FaultManager.TPS1AdaptLoMax.Action_2_Condition "Fault manager configuration.  Select up to 4 actions for each fault." VALUE 0x800036D2 RecordLayout_4 0 CompuMethod_116 0 65535 /end CHARACTERISTIC
/begin CHARACTERISTIC FaultManager.TPS1AdaptLoMax.Action_3 "Fault manager configuration.  Select up to 4 actions for each fault." VALUE 0x800036D4 RecordLayout_4 0 CompuMethod_115 0 65535 /end CHARACTERISTIC
/begin CHARACTERISTIC FaultManager.TPS1AdaptLoMax.Action_3_Condition "Fault manager configuration.  Select up to 4 actions for each fault." VALUE 0x800036D6 RecordLayout_4 0 CompuMethod_116 0 65535 /end CHARACTERISTIC
/begin CHARACTERISTIC FaultManager.TPS1AdaptLoMax.Action_4 "Fault manager configuration.  Select up to 4 actions for each fault." VALUE 0x800036D8 RecordLayout_4 0 CompuMethod_115 0 65535 /end CHARACTERISTIC
/begin CHARACTERISTIC FaultManager.TPS1AdaptLoMax.Action_4_Condition "Fault manager configuration.  Select up to 4 actions for each fault." VALUE 0x800036DA RecordLayout_4 0 CompuMethod_116 0 65535 /end CHARACTERISTIC
/begin CHARACTERISTIC FaultManager.TPS1AdaptLoMin.Mode "Fault manager configuration.  Select up to 4 actions for each fault." VALUE 0x800036DC RecordLayout_4 0 CompuMethod_113 0 65535 /end CHARACTERISTIC
/begin CHARACTERISTIC FaultManager.TPS1AdaptLoMin.ID "Fault manager configuration.  Select up to 4 actions for each fault." VALUE 0x800036DE RecordLayout_4 0 CompuMethod_1 0 65535 /end CHARACTERISTIC
/begin CHARACTERISTIC FaultManager.TPS1AdaptLoMin.Test "Fault manager configuration.  Select up to 4 actions for each fault." VALUE 0x800036E0 RecordLayout_4 0 CompuMethod_114 0 65535 /end CHARACTERISTIC
/begin CHARACTERISTIC FaultManager.TPS1AdaptLoMin.Faulty_Samples__X_ "Fault manager configuration.  Select up to 4 actions for each fault." VALUE 0x800036E2 RecordLayout_4 0 CompuMethod_1 0 65535 /end CHARACTERISTIC
/begin CHARACTERISTIC FaultManager.TPS1AdaptLoMin.Total_Samples__Y_ "Fault manager configuration.  Select up to 4 actions for each fault." VALUE 0x800036E4 RecordLayout_4 0 CompuMethod_1 0 65535 /end CHARACTERISTIC
/begin CHARACTERISTIC FaultManager.TPS1AdaptLoMin.Action_1 "Fault manager configuration.  Select up to 4 actions for each fault." VALUE 0x800036E6 RecordLayout_4 0 CompuMethod_115 0 65535 /end CHARACTERISTIC
/begin CHARACTERISTIC FaultManager.TPS1AdaptLoMin.Action_1_Condition "Fault manager configuration.  Select up to 4 actions for each fault." VALUE 0x800036E8 RecordLayout_4 0 CompuMethod_116 0 65535 /end CHARACTERISTIC
/begin CHARACTERISTIC FaultManager.TPS1AdaptLoMin.Action_2 "Fault manager configuration.  Select up to 4 actions for each fault." VALUE 0x800036EA RecordLayout_4 0 CompuMethod_115 0 65535 /end CHARACTERISTIC
/begin CHARACTERISTIC FaultManager.TPS1AdaptLoMin.Action_2_Condition "Fault manager configuration.  Select up to 4 actions for each fault." VALUE 0x800036EC RecordLayout_4 0 CompuMethod_116 0 65535 /end CHARACTERISTIC
/begin CHARACTERISTIC FaultManager.TPS1AdaptLoMin.Action_3 "Fault manager configuration.  Select up to 4 actions for each fault." VALUE 0x800036EE RecordLayout_4 0 CompuMethod_115 0 65535 /end CHARACTERISTIC
/begin CHARACTERISTIC FaultManager.TPS1AdaptLoMin.Action_3_Condition "Fault manager configuration.  Select up to 4 actions for each fault." VALUE 0x800036F0 RecordLayout_4 0 CompuMethod_116 0 65535 /end CHARACTERISTIC
/begin CHARACTERISTIC FaultManager.TPS1AdaptLoMin.Action_4 "Fault manager configuration.  Select up to 4 actions for each fault." VALUE 0x800036F2 RecordLayout_4 0 CompuMethod_115 0 65535 /end CHARACTERISTIC
/begin CHARACTERISTIC FaultManager.TPS1AdaptLoMin.Action_4_Condition "Fault manager configuration.  Select up to 4 actions for each fault." VALUE 0x800036F4 RecordLayout_4 0 CompuMethod_116 0 65535 /end CHARACTERISTIC
/begin CHARACTERISTIC FaultManager.TPS1RangeHigh.Mode "Fault manager configuration.  Select up to 4 actions for each fault." VALUE 0x800036F6 RecordLayout_4 0 CompuMethod_113 0 65535 /end CHARACTERISTIC
/begin CHARACTERISTIC FaultManager.TPS1RangeHigh.ID "Fault manager configuration.  Select up to 4 actions for each fault." VALUE 0x800036F8 RecordLayout_4 0 CompuMethod_1 0 65535 /end CHARACTERISTIC
/begin CHARACTERISTIC FaultManager.TPS1RangeHigh.Test "Fault manager configuration.  Select up to 4 actions for each fault." VALUE 0x800036FA RecordLayout_4 0 CompuMethod_114 0 65535 /end CHARACTERISTIC
/begin CHARACTERISTIC FaultManager.TPS1RangeHigh.Faulty_Samples__X_ "Fault manager configuration.  Select up to 4 actions for each fault." VALUE 0x800036FC RecordLayout_4 0 CompuMethod_1 0 65535 /end CHARACTERISTIC
/begin CHARACTERISTIC FaultManager.TPS1RangeHigh.Total_Samples__Y_ "Fault manager configuration.  Select up to 4 actions for each fault." VALUE 0x800036FE RecordLayout_4 0 CompuMethod_1 0 65535 /end CHARACTERISTIC
/begin CHARACTERISTIC FaultManager.TPS1RangeHigh.Action_1 "Fault manager configuration.  Select up to 4 actions for each fault." VALUE 0x80003700 RecordLayout_4 0 CompuMethod_115 0 65535 /end CHARACTERISTIC
/begin CHARACTERISTIC FaultManager.TPS1RangeHigh.Action_1_Condition "Fault manager configuration.  Select up to 4 actions for each fault." VALUE 0x80003702 RecordLayout_4 0 CompuMethod_116 0 65535 /end CHARACTERISTIC
/begin CHARACTERISTIC FaultManager.TPS1RangeHigh.Action_2 "Fault manager configuration.  Select up to 4 actions for each fault." VALUE 0x80003704 RecordLayout_4 0 CompuMethod_115 0 65535 /end CHARACTERISTIC
/begin CHARACTERISTIC FaultManager.TPS1RangeHigh.Action_2_Condition "Fault manager configuration.  Select up to 4 actions for each fault." VALUE 0x80003706 RecordLayout_4 0 CompuMethod_116 0 65535 /end CHARACTERISTIC
/begin CHARACTERISTIC FaultManager.TPS1RangeHigh.Action_3 "Fault manager configuration.  Select up to 4 actions for each fault." VALUE 0x80003708 RecordLayout_4 0 CompuMethod_115 0 65535 /end CHARACTERISTIC
/begin CHARACTERISTIC FaultManager.TPS1RangeHigh.Action_3_Condition "Fault manager configuration.  Select up to 4 actions for each fault." VALUE 0x8000370A RecordLayout_4 0 CompuMethod_116 0 65535 /end CHARACTERISTIC
/begin CHARACTERISTIC FaultManager.TPS1RangeHigh.Action_4 "Fault manager configuration.  Select up to 4 actions for each fault." VALUE 0x8000370C RecordLayout_4 0 CompuMethod_115 0 65535 /end CHARACTERISTIC
/begin CHARACTERISTIC FaultManager.TPS1RangeHigh.Action_4_Condition "Fault manager configuration.  Select up to 4 actions for each fault." VALUE 0x8000370E RecordLayout_4 0 CompuMethod_116 0 65535 /end CHARACTERISTIC
/begin CHARACTERISTIC FaultManager.TPS1RangeLow.Mode "Fault manager configuration.  Select up to 4 actions for each fault." VALUE 0x80003710 RecordLayout_4 0 CompuMethod_113 0 65535 /end CHARACTERISTIC
/begin CHARACTERISTIC FaultManager.TPS1RangeLow.ID "Fault manager configuration.  Select up to 4 actions for each fault." VALUE 0x80003712 RecordLayout_4 0 CompuMethod_1 0 65535 /end CHARACTERISTIC
/begin CHARACTERISTIC FaultManager.TPS1RangeLow.Test "Fault manager configuration.  Select up to 4 actions for each fault." VALUE 0x80003714 RecordLayout_4 0 CompuMethod_114 0 65535 /end CHARACTERISTIC
/begin CHARACTERISTIC FaultManager.TPS1RangeLow.Faulty_Samples__X_ "Fault manager configuration.  Select up to 4 actions for each fault." VALUE 0x80003716 RecordLayout_4 0 CompuMethod_1 0 65535 /end CHARACTERISTIC
/begin CHARACTERISTIC FaultManager.TPS1RangeLow.Total_Samples__Y_ "Fault manager configuration.  Select up to 4 actions for each fault." VALUE 0x80003718 RecordLayout_4 0 CompuMethod_1 0 65535 /end CHARACTERISTIC
/begin CHARACTERISTIC FaultManager.TPS1RangeLow.Action_1 "Fault manager configuration.  Select up to 4 actions for each fault." VALUE 0x8000371A RecordLayout_4 0 CompuMethod_115 0 65535 /end CHARACTERISTIC
/begin CHARACTERISTIC FaultManager.TPS1RangeLow.Action_1_Condition "Fault manager configuration.  Select up to 4 actions for each fault." VALUE 0x8000371C RecordLayout_4 0 CompuMethod_116 0 65535 /end CHARACTERISTIC
/begin CHARACTERISTIC FaultManager.TPS1RangeLow.Action_2 "Fault manager configuration.  Select up to 4 actions for each fault." VALUE 0x8000371E RecordLayout_4 0 CompuMethod_115 0 65535 /end CHARACTERISTIC
/begin CHARACTERISTIC FaultManager.TPS1RangeLow.Action_2_Condition "Fault manager configuration.  Select up to 4 actions for each fault." VALUE 0x80003720 RecordLayout_4 0 CompuMethod_116 0 65535 /end CHARACTERISTIC
/begin CHARACTERISTIC FaultManager.TPS1RangeLow.Action_3 "Fault manager configuration.  Select up to 4 actions for each fault." VALUE 0x80003722 RecordLayout_4 0 CompuMethod_115 0 65535 /end CHARACTERISTIC
/begin CHARACTERISTIC FaultManager.TPS1RangeLow.Action_3_Condition "Fault manager configuration.  Select up to 4 actions for each fault." VALUE 0x80003724 RecordLayout_4 0 CompuMethod_116 0 65535 /end CHARACTERISTIC
/begin CHARACTERISTIC FaultManager.TPS1RangeLow.Action_4 "Fault manager configuration.  Select up to 4 actions for each fault." VALUE 0x80003726 RecordLayout_4 0 CompuMethod_115 0 65535 /end CHARACTERISTIC
/begin CHARACTERISTIC FaultManager.TPS1RangeLow.Action_4_Condition "Fault manager configuration.  Select up to 4 actions for each fault." VALUE 0x80003728 RecordLayout_4 0 CompuMethod_116 0 65535 /end CHARACTERISTIC
/begin CHARACTERISTIC FaultManager.TPS2AdaptHiMax.Mode "Fault manager configuration.  Select up to 4 actions for each fault." VALUE 0x8000372A RecordLayout_4 0 CompuMethod_113 0 65535 /end CHARACTERISTIC
/begin CHARACTERISTIC FaultManager.TPS2AdaptHiMax.ID "Fault manager configuration.  Select up to 4 actions for each fault." VALUE 0x8000372C RecordLayout_4 0 CompuMethod_1 0 65535 /end CHARACTERISTIC
/begin CHARACTERISTIC FaultManager.TPS2AdaptHiMax.Test "Fault manager configuration.  Select up to 4 actions for each fault." VALUE 0x8000372E RecordLayout_4 0 CompuMethod_114 0 65535 /end CHARACTERISTIC
/begin CHARACTERISTIC FaultManager.TPS2AdaptHiMax.Faulty_Samples__X_ "Fault manager configuration.  Select up to 4 actions for each fault." VALUE 0x80003730 RecordLayout_4 0 CompuMethod_1 0 65535 /end CHARACTERISTIC
/begin CHARACTERISTIC FaultManager.TPS2AdaptHiMax.Total_Samples__Y_ "Fault manager configuration.  Select up to 4 actions for each fault." VALUE 0x80003732 RecordLayout_4 0 CompuMethod_1 0 65535 /end CHARACTERISTIC
/begin CHARACTERISTIC FaultManager.TPS2AdaptHiMax.Action_1 "Fault manager configuration.  Select up to 4 actions for each fault." VALUE 0x80003734 RecordLayout_4 0 CompuMethod_115 0 65535 /end CHARACTERISTIC
/begin CHARACTERISTIC FaultManager.TPS2AdaptHiMax.Action_1_Condition "Fault manager configuration.  Select up to 4 actions for each fault." VALUE 0x80003736 RecordLayout_4 0 CompuMethod_116 0 65535 /end CHARACTERISTIC
/begin CHARACTERISTIC FaultManager.TPS2AdaptHiMax.Action_2 "Fault manager configuration.  Select up to 4 actions for each fault." VALUE 0x80003738 RecordLayout_4 0 CompuMethod_115 0 65535 /end CHARACTERISTIC
/begin CHARACTERISTIC FaultManager.TPS2AdaptHiMax.Action_2_Condition "Fault manager configuration.  Select up to 4 actions for each fault." VALUE 0x8000373A RecordLayout_4 0 CompuMethod_116 0 65535 /end CHARACTERISTIC
/begin CHARACTERISTIC FaultManager.TPS2AdaptHiMax.Action_3 "Fault manager configuration.  Select up to 4 actions for each fault." VALUE 0x8000373C RecordLayout_4 0 CompuMethod_115 0 65535 /end CHARACTERISTIC
/begin CHARACTERISTIC FaultManager.TPS2AdaptHiMax.Action_3_Condition "Fault manager configuration.  Select up to 4 actions for each fault." VALUE 0x8000373E RecordLayout_4 0 CompuMethod_116 0 65535 /end CHARACTERISTIC
/begin CHARACTERISTIC FaultManager.TPS2AdaptHiMax.Action_4 "Fault manager configuration.  Select up to 4 actions for each fault." VALUE 0x80003740 RecordLayout_4 0 CompuMethod_115 0 65535 /end CHARACTERISTIC
/begin CHARACTERISTIC FaultManager.TPS2AdaptHiMax.Action_4_Condition "Fault manager configuration.  Select up to 4 actions for each fault." VALUE 0x80003742 RecordLayout_4 0 CompuMethod_116 0 65535 /end CHARACTERISTIC
/begin CHARACTERISTIC FaultManager.TPS2AdaptHiMin.Mode "Fault manager configuration.  Select up to 4 actions for each fault." VALUE 0x80003744 RecordLayout_4 0 CompuMethod_113 0 65535 /end CHARACTERISTIC
/begin CHARACTERISTIC FaultManager.TPS2AdaptHiMin.ID "Fault manager configuration.  Select up to 4 actions for each fault." VALUE 0x80003746 RecordLayout_4 0 CompuMethod_1 0 65535 /end CHARACTERISTIC
/begin CHARACTERISTIC FaultManager.TPS2AdaptHiMin.Test "Fault manager configuration.  Select up to 4 actions for each fault." VALUE 0x80003748 RecordLayout_4 0 CompuMethod_114 0 65535 /end CHARACTERISTIC
/begin CHARACTERISTIC FaultManager.TPS2AdaptHiMin.Faulty_Samples__X_ "Fault manager configuration.  Select up to 4 actions for each fault." VALUE 0x8000374A RecordLayout_4 0 CompuMethod_1 0 65535 /end CHARACTERISTIC
/begin CHARACTERISTIC FaultManager.TPS2AdaptHiMin.Total_Samples__Y_ "Fault manager configuration.  Select up to 4 actions for each fault." VALUE 0x8000374C RecordLayout_4 0 CompuMethod_1 0 65535 /end CHARACTERISTIC
/begin CHARACTERISTIC FaultManager.TPS2AdaptHiMin.Action_1 "Fault manager configuration.  Select up to 4 actions for each fault." VALUE 0x8000374E RecordLayout_4 0 CompuMethod_115 0 65535 /end CHARACTERISTIC
/begin CHARACTERISTIC FaultManager.TPS2AdaptHiMin.Action_1_Condition "Fault manager configuration.  Select up to 4 actions for each fault." VALUE 0x80003750 RecordLayout_4 0 CompuMethod_116 0 65535 /end CHARACTERISTIC
/begin CHARACTERISTIC FaultManager.TPS2AdaptHiMin.Action_2 "Fault manager configuration.  Select up to 4 actions for each fault." VALUE 0x80003752 RecordLayout_4 0 CompuMethod_115 0 65535 /end CHARACTERISTIC
/begin CHARACTERISTIC FaultManager.TPS2AdaptHiMin.Action_2_Condition "Fault manager configuration.  Select up to 4 actions for each fault." VALUE 0x80003754 RecordLayout_4 0 CompuMethod_116 0 65535 /end CHARACTERISTIC
/begin CHARACTERISTIC FaultManager.TPS2AdaptHiMin.Action_3 "Fault manager configuration.  Select up to 4 actions for each fault." VALUE 0x80003756 RecordLayout_4 0 CompuMethod_115 0 65535 /end CHARACTERISTIC
/begin CHARACTERISTIC FaultManager.TPS2AdaptHiMin.Action_3_Condition "Fault manager configuration.  Select up to 4 actions for each fault." VALUE 0x80003758 RecordLayout_4 0 CompuMethod_116 0 65535 /end CHARACTERISTIC
/begin CHARACTERISTIC FaultManager.TPS2AdaptHiMin.Action_4 "Fault manager configuration.  Select up to 4 actions for each fault." VALUE 0x8000375A RecordLayout_4 0 CompuMethod_115 0 65535 /end CHARACTERISTIC
/begin CHARACTERISTIC FaultManager.TPS2AdaptHiMin.Action_4_Condition "Fault manager configuration.  Select up to 4 actions for each fault." VALUE 0x8000375C RecordLayout_4 0 CompuMethod_116 0 65535 /end CHARACTERISTIC
/begin CHARACTERISTIC FaultManager.TPS2AdaptLoMax.Mode "Fault manager configuration.  Select up to 4 actions for each fault." VALUE 0x8000375E RecordLayout_4 0 CompuMethod_113 0 65535 /end CHARACTERISTIC
/begin CHARACTERISTIC FaultManager.TPS2AdaptLoMax.ID "Fault manager configuration.  Select up to 4 actions for each fault." VALUE 0x80003760 RecordLayout_4 0 CompuMethod_1 0 65535 /end CHARACTERISTIC
/begin CHARACTERISTIC FaultManager.TPS2AdaptLoMax.Test "Fault manager configuration.  Select up to 4 actions for each fault." VALUE 0x80003762 RecordLayout_4 0 CompuMethod_114 0 65535 /end CHARACTERISTIC
/begin CHARACTERISTIC FaultManager.TPS2AdaptLoMax.Faulty_Samples__X_ "Fault manager configuration.  Select up to 4 actions for each fault." VALUE 0x80003764 RecordLayout_4 0 CompuMethod_1 0 65535 /end CHARACTERISTIC
/begin CHARACTERISTIC FaultManager.TPS2AdaptLoMax.Total_Samples__Y_ "Fault manager configuration.  Select up to 4 actions for each fault." VALUE 0x80003766 RecordLayout_4 0 CompuMethod_1 0 65535 /end CHARACTERISTIC
/begin CHARACTERISTIC FaultManager.TPS2AdaptLoMax.Action_1 "Fault manager configuration.  Select up to 4 actions for each fault." VALUE 0x80003768 RecordLayout_4 0 CompuMethod_115 0 65535 /end CHARACTERISTIC
/begin CHARACTERISTIC FaultManager.TPS2AdaptLoMax.Action_1_Condition "Fault manager configuration.  Select up to 4 actions for each fault." VALUE 0x8000376A RecordLayout_4 0 CompuMethod_116 0 65535 /end CHARACTERISTIC
/begin CHARACTERISTIC FaultManager.TPS2AdaptLoMax.Action_2 "Fault manager configuration.  Select up to 4 actions for each fault." VALUE 0x8000376C RecordLayout_4 0 CompuMethod_115 0 65535 /end CHARACTERISTIC
/begin CHARACTERISTIC FaultManager.TPS2AdaptLoMax.Action_2_Condition "Fault manager configuration.  Select up to 4 actions for each fault." VALUE 0x8000376E RecordLayout_4 0 CompuMethod_116 0 65535 /end CHARACTERISTIC
/begin CHARACTERISTIC FaultManager.TPS2AdaptLoMax.Action_3 "Fault manager configuration.  Select up to 4 actions for each fault." VALUE 0x80003770 RecordLayout_4 0 CompuMethod_115 0 65535 /end CHARACTERISTIC
/begin CHARACTERISTIC FaultManager.TPS2AdaptLoMax.Action_3_Condition "Fault manager configuration.  Select up to 4 actions for each fault." VALUE 0x80003772 RecordLayout_4 0 CompuMethod_116 0 65535 /end CHARACTERISTIC
/begin CHARACTERISTIC FaultManager.TPS2AdaptLoMax.Action_4 "Fault manager configuration.  Select up to 4 actions for each fault." VALUE 0x80003774 RecordLayout_4 0 CompuMethod_115 0 65535 /end CHARACTERISTIC
/begin CHARACTERISTIC FaultManager.TPS2AdaptLoMax.Action_4_Condition "Fault manager configuration.  Select up to 4 actions for each fault." VALUE 0x80003776 RecordLayout_4 0 CompuMethod_116 0 65535 /end CHARACTERISTIC
/begin CHARACTERISTIC FaultManager.TPS2AdaptLoMin.Mode "Fault manager configuration.  Select up to 4 actions for each fault." VALUE 0x80003778 RecordLayout_4 0 CompuMethod_113 0 65535 /end CHARACTERISTIC
/begin CHARACTERISTIC FaultManager.TPS2AdaptLoMin.ID "Fault manager configuration.  Select up to 4 actions for each fault." VALUE 0x8000377A RecordLayout_4 0 CompuMethod_1 0 65535 /end CHARACTERISTIC
/begin CHARACTERISTIC FaultManager.TPS2AdaptLoMin.Test "Fault manager configuration.  Select up to 4 actions for each fault." VALUE 0x8000377C RecordLayout_4 0 CompuMethod_114 0 65535 /end CHARACTERISTIC
/begin CHARACTERISTIC FaultManager.TPS2AdaptLoMin.Faulty_Samples__X_ "Fault manager configuration.  Select up to 4 actions for each fault." VALUE 0x8000377E RecordLayout_4 0 CompuMethod_1 0 65535 /end CHARACTERISTIC
/begin CHARACTERISTIC FaultManager.TPS2AdaptLoMin.Total_Samples__Y_ "Fault manager configuration.  Select up to 4 actions for each fault." VALUE 0x80003780 RecordLayout_4 0 CompuMethod_1 0 65535 /end CHARACTERISTIC
/begin CHARACTERISTIC FaultManager.TPS2AdaptLoMin.Action_1 "Fault manager configuration.  Select up to 4 actions for each fault." VALUE 0x80003782 RecordLayout_4 0 CompuMethod_115 0 65535 /end CHARACTERISTIC
/begin CHARACTERISTIC FaultManager.TPS2AdaptLoMin.Action_1_Condition "Fault manager configuration.  Select up to 4 actions for each fault." VALUE 0x80003784 RecordLayout_4 0 CompuMethod_116 0 65535 /end CHARACTERISTIC
/begin CHARACTERISTIC FaultManager.TPS2AdaptLoMin.Action_2 "Fault manager configuration.  Select up to 4 actions for each fault." VALUE 0x80003786 RecordLayout_4 0 CompuMethod_115 0 65535 /end CHARACTERISTIC
/begin CHARACTERISTIC FaultManager.TPS2AdaptLoMin.Action_2_Condition "Fault manager configuration.  Select up to 4 actions for each fault." VALUE 0x80003788 RecordLayout_4 0 CompuMethod_116 0 65535 /end CHARACTERISTIC
/begin CHARACTERISTIC FaultManager.TPS2AdaptLoMin.Action_3 "Fault manager configuration.  Select up to 4 actions for each fault." VALUE 0x8000378A RecordLayout_4 0 CompuMethod_115 0 65535 /end CHARACTERISTIC
/begin CHARACTERISTIC FaultManager.TPS2AdaptLoMin.Action_3_Condition "Fault manager configuration.  Select up to 4 actions for each fault." VALUE 0x8000378C RecordLayout_4 0 CompuMethod_116 0 65535 /end CHARACTERISTIC
/begin CHARACTERISTIC FaultManager.TPS2AdaptLoMin.Action_4 "Fault manager configuration.  Select up to 4 actions for each fault." VALUE 0x8000378E RecordLayout_4 0 CompuMethod_115 0 65535 /end CHARACTERISTIC
/begin CHARACTERISTIC FaultManager.TPS2AdaptLoMin.Action_4_Condition "Fault manager configuration.  Select up to 4 actions for each fault." VALUE 0x80003790 RecordLayout_4 0 CompuMethod_116 0 65535 /end CHARACTERISTIC
/begin CHARACTERISTIC FaultManager.TPS2RangeHigh.Mode "Fault manager configuration.  Select up to 4 actions for each fault." VALUE 0x80003792 RecordLayout_4 0 CompuMethod_113 0 65535 /end CHARACTERISTIC
/begin CHARACTERISTIC FaultManager.TPS2RangeHigh.ID "Fault manager configuration.  Select up to 4 actions for each fault." VALUE 0x80003794 RecordLayout_4 0 CompuMethod_1 0 65535 /end CHARACTERISTIC
/begin CHARACTERISTIC FaultManager.TPS2RangeHigh.Test "Fault manager configuration.  Select up to 4 actions for each fault." VALUE 0x80003796 RecordLayout_4 0 CompuMethod_114 0 65535 /end CHARACTERISTIC
/begin CHARACTERISTIC FaultManager.TPS2RangeHigh.Faulty_Samples__X_ "Fault manager configuration.  Select up to 4 actions for each fault." VALUE 0x80003798 RecordLayout_4 0 CompuMethod_1 0 65535 /end CHARACTERISTIC
/begin CHARACTERISTIC FaultManager.TPS2RangeHigh.Total_Samples__Y_ "Fault manager configuration.  Select up to 4 actions for each fault." VALUE 0x8000379A RecordLayout_4 0 CompuMethod_1 0 65535 /end CHARACTERISTIC
/begin CHARACTERISTIC FaultManager.TPS2RangeHigh.Action_1 "Fault manager configuration.  Select up to 4 actions for each fault." VALUE 0x8000379C RecordLayout_4 0 CompuMethod_115 0 65535 /end CHARACTERISTIC
/begin CHARACTERISTIC FaultManager.TPS2RangeHigh.Action_1_Condition "Fault manager configuration.  Select up to 4 actions for each fault." VALUE 0x8000379E RecordLayout_4 0 CompuMethod_116 0 65535 /end CHARACTERISTIC
/begin CHARACTERISTIC FaultManager.TPS2RangeHigh.Action_2 "Fault manager configuration.  Select up to 4 actions for each fault." VALUE 0x800037A0 RecordLayout_4 0 CompuMethod_115 0 65535 /end CHARACTERISTIC
/begin CHARACTERISTIC FaultManager.TPS2RangeHigh.Action_2_Condition "Fault manager configuration.  Select up to 4 actions for each fault." VALUE 0x800037A2 RecordLayout_4 0 CompuMethod_116 0 65535 /end CHARACTERISTIC
/begin CHARACTERISTIC FaultManager.TPS2RangeHigh.Action_3 "Fault manager configuration.  Select up to 4 actions for each fault." VALUE 0x800037A4 RecordLayout_4 0 CompuMethod_115 0 65535 /end CHARACTERISTIC
/begin CHARACTERISTIC FaultManager.TPS2RangeHigh.Action_3_Condition "Fault manager configuration.  Select up to 4 actions for each fault." VALUE 0x800037A6 RecordLayout_4 0 CompuMethod_116 0 65535 /end CHARACTERISTIC
/begin CHARACTERISTIC FaultManager.TPS2RangeHigh.Action_4 "Fault manager configuration.  Select up to 4 actions for each fault." VALUE 0x800037A8 RecordLayout_4 0 CompuMethod_115 0 65535 /end CHARACTERISTIC
/begin CHARACTERISTIC FaultManager.TPS2RangeHigh.Action_4_Condition "Fault manager configuration.  Select up to 4 actions for each fault." VALUE 0x800037AA RecordLayout_4 0 CompuMethod_116 0 65535 /end CHARACTERISTIC
/begin CHARACTERISTIC FaultManager.TPS2RangeLow.Mode "Fault manager configuration.  Select up to 4 actions for each fault." VALUE 0x800037AC RecordLayout_4 0 CompuMethod_113 0 65535 /end CHARACTERISTIC
/begin CHARACTERISTIC FaultManager.TPS2RangeLow.ID "Fault manager configuration.  Select up to 4 actions for each fault." VALUE 0x800037AE RecordLayout_4 0 CompuMethod_1 0 65535 /end CHARACTERISTIC
/begin CHARACTERISTIC FaultManager.TPS2RangeLow.Test "Fault manager configuration.  Select up to 4 actions for each fault." VALUE 0x800037B0 RecordLayout_4 0 CompuMethod_114 0 65535 /end CHARACTERISTIC
/begin CHARACTERISTIC FaultManager.TPS2RangeLow.Faulty_Samples__X_ "Fault manager configuration.  Select up to 4 actions for each fault." VALUE 0x800037B2 RecordLayout_4 0 CompuMethod_1 0 65535 /end CHARACTERISTIC
/begin CHARACTERISTIC FaultManager.TPS2RangeLow.Total_Samples__Y_ "Fault manager configuration.  Select up to 4 actions for each fault." VALUE 0x800037B4 RecordLayout_4 0 CompuMethod_1 0 65535 /end CHARACTERISTIC
/begin CHARACTERISTIC FaultManager.TPS2RangeLow.Action_1 "Fault manager configuration.  Select up to 4 actions for each fault." VALUE 0x800037B6 RecordLayout_4 0 CompuMethod_115 0 65535 /end CHARACTERISTIC
/begin CHARACTERISTIC FaultManager.TPS2RangeLow.Action_1_Condition "Fault manager configuration.  Select up to 4 actions for each fault." VALUE 0x800037B8 RecordLayout_4 0 CompuMethod_116 0 65535 /end CHARACTERISTIC
/begin CHARACTERISTIC FaultManager.TPS2RangeLow.Action_2 "Fault manager configuration.  Select up to 4 actions for each fault." VALUE 0x800037BA RecordLayout_4 0 CompuMethod_115 0 65535 /end CHARACTERISTIC
/begin CHARACTERISTIC FaultManager.TPS2RangeLow.Action_2_Condition "Fault manager configuration.  Select up to 4 actions for each fault." VALUE 0x800037BC RecordLayout_4 0 CompuMethod_116 0 65535 /end CHARACTERISTIC
/begin CHARACTERISTIC FaultManager.TPS2RangeLow.Action_3 "Fault manager configuration.  Select up to 4 actions for each fault." VALUE 0x800037BE RecordLayout_4 0 CompuMethod_115 0 65535 /end CHARACTERISTIC
/begin CHARACTERISTIC FaultManager.TPS2RangeLow.Action_3_Condition "Fault manager configuration.  Select up to 4 actions for each fault." VALUE 0x800037C0 RecordLayout_4 0 CompuMethod_116 0 65535 /end CHARACTERISTIC
/begin CHARACTERISTIC FaultManager.TPS2RangeLow.Action_4 "Fault manager configuration.  Select up to 4 actions for each fault." VALUE 0x800037C2 RecordLayout_4 0 CompuMethod_115 0 65535 /end CHARACTERISTIC
/begin CHARACTERISTIC FaultManager.TPS2RangeLow.Action_4_Condition "Fault manager configuration.  Select up to 4 actions for each fault." VALUE 0x800037C4 RecordLayout_4 0 CompuMethod_116 0 65535 /end CHARACTERISTIC
/begin CHARACTERISTIC FaultManager.TPS_Sensors_Conflict.Mode "Fault manager configuration.  Select up to 4 actions for each fault." VALUE 0x800037C6 RecordLayout_4 0 CompuMethod_113 0 65535 /end CHARACTERISTIC
/begin CHARACTERISTIC FaultManager.TPS_Sensors_Conflict.ID "Fault manager configuration.  Select up to 4 actions for each fault." VALUE 0x800037C8 RecordLayout_4 0 CompuMethod_1 0 65535 /end CHARACTERISTIC
/begin CHARACTERISTIC FaultManager.TPS_Sensors_Conflict.Test "Fault manager configuration.  Select up to 4 actions for each fault." VALUE 0x800037CA RecordLayout_4 0 CompuMethod_114 0 65535 /end CHARACTERISTIC
/begin CHARACTERISTIC FaultManager.TPS_Sensors_Conflict.Faulty_Samples__X_ "Fault manager configuration.  Select up to 4 actions for each fault." VALUE 0x800037CC RecordLayout_4 0 CompuMethod_1 0 65535 /end CHARACTERISTIC
/begin CHARACTERISTIC FaultManager.TPS_Sensors_Conflict.Total_Samples__Y_ "Fault manager configuration.  Select up to 4 actions for each fault." VALUE 0x800037CE RecordLayout_4 0 CompuMethod_1 0 65535 /end CHARACTERISTIC
/begin CHARACTERISTIC FaultManager.TPS_Sensors_Conflict.Action_1 "Fault manager configuration.  Select up to 4 actions for each fault." VALUE 0x800037D0 RecordLayout_4 0 CompuMethod_115 0 65535 /end CHARACTERISTIC
/begin CHARACTERISTIC FaultManager.TPS_Sensors_Conflict.Action_1_Condition "Fault manager configuration.  Select up to 4 actions for each fault." VALUE 0x800037D2 RecordLayout_4 0 CompuMethod_116 0 65535 /end CHARACTERISTIC
/begin CHARACTERISTIC FaultManager.TPS_Sensors_Conflict.Action_2 "Fault manager configuration.  Select up to 4 actions for each fault." VALUE 0x800037D4 RecordLayout_4 0 CompuMethod_115 0 65535 /end CHARACTERISTIC
/begin CHARACTERISTIC FaultManager.TPS_Sensors_Conflict.Action_2_Condition "Fault manager configuration.  Select up to 4 actions for each fault." VALUE 0x800037D6 RecordLayout_4 0 CompuMethod_116 0 65535 /end CHARACTERISTIC
/begin CHARACTERISTIC FaultManager.TPS_Sensors_Conflict.Action_3 "Fault manager configuration.  Select up to 4 actions for each fault." VALUE 0x800037D8 RecordLayout_4 0 CompuMethod_115 0 65535 /end CHARACTERISTIC
/begin CHARACTERISTIC FaultManager.TPS_Sensors_Conflict.Action_3_Condition "Fault manager configuration.  Select up to 4 actions for each fault." VALUE 0x800037DA RecordLayout_4 0 CompuMethod_116 0 65535 /end CHARACTERISTIC
/begin CHARACTERISTIC FaultManager.TPS_Sensors_Conflict.Action_4 "Fault manager configuration.  Select up to 4 actions for each fault." VALUE 0x800037DC RecordLayout_4 0 CompuMethod_115 0 65535 /end CHARACTERISTIC
/begin CHARACTERISTIC FaultManager.TPS_Sensors_Conflict.Action_4_Condition "Fault manager configuration.  Select up to 4 actions for each fault." VALUE 0x800037DE RecordLayout_4 0 CompuMethod_116 0 65535 /end CHARACTERISTIC
/begin CHARACTERISTIC FaultManager.VSPDRangeHigh.Mode "Fault manager configuration.  Select up to 4 actions for each fault." VALUE 0x800037E0 RecordLayout_4 0 CompuMethod_113 0 65535 /end CHARACTERISTIC
/begin CHARACTERISTIC FaultManager.VSPDRangeHigh.ID "Fault manager configuration.  Select up to 4 actions for each fault." VALUE 0x800037E2 RecordLayout_4 0 CompuMethod_1 0 65535 /end CHARACTERISTIC
/begin CHARACTERISTIC FaultManager.VSPDRangeHigh.Test "Fault manager configuration.  Select up to 4 actions for each fault." VALUE 0x800037E4 RecordLayout_4 0 CompuMethod_114 0 65535 /end CHARACTERISTIC
/begin CHARACTERISTIC FaultManager.VSPDRangeHigh.Faulty_Samples__X_ "Fault manager configuration.  Select up to 4 actions for each fault." VALUE 0x800037E6 RecordLayout_4 0 CompuMethod_1 0 65535 /end CHARACTERISTIC
/begin CHARACTERISTIC FaultManager.VSPDRangeHigh.Total_Samples__Y_ "Fault manager configuration.  Select up to 4 actions for each fault." VALUE 0x800037E8 RecordLayout_4 0 CompuMethod_1 0 65535 /end CHARACTERISTIC
/begin CHARACTERISTIC FaultManager.VSPDRangeHigh.Action_1 "Fault manager configuration.  Select up to 4 actions for each fault." VALUE 0x800037EA RecordLayout_4 0 CompuMethod_115 0 65535 /end CHARACTERISTIC
/begin CHARACTERISTIC FaultManager.VSPDRangeHigh.Action_1_Condition "Fault manager configuration.  Select up to 4 actions for each fault." VALUE 0x800037EC RecordLayout_4 0 CompuMethod_116 0 65535 /end CHARACTERISTIC
/begin CHARACTERISTIC FaultManager.VSPDRangeHigh.Action_2 "Fault manager configuration.  Select up to 4 actions for each fault." VALUE 0x800037EE RecordLayout_4 0 CompuMethod_115 0 65535 /end CHARACTERISTIC
/begin CHARACTERISTIC FaultManager.VSPDRangeHigh.Action_2_Condition "Fault manager configuration.  Select up to 4 actions for each fault." VALUE 0x800037F0 RecordLayout_4 0 CompuMethod_116 0 65535 /end CHARACTERISTIC
/begin CHARACTERISTIC FaultManager.VSPDRangeHigh.Action_3 "Fault manager configuration.  Select up to 4 actions for each fault." VALUE 0x800037F2 RecordLayout_4 0 CompuMethod_115 0 65535 /end CHARACTERISTIC
/begin CHARACTERISTIC FaultManager.VSPDRangeHigh.Action_3_Condition "Fault manager configuration.  Select up to 4 actions for each fault." VALUE 0x800037F4 RecordLayout_4 0 CompuMethod_116 0 65535 /end CHARACTERISTIC
/begin CHARACTERISTIC FaultManager.VSPDRangeHigh.Action_4 "Fault manager configuration.  Select up to 4 actions for each fault." VALUE 0x800037F6 RecordLayout_4 0 CompuMethod_115 0 65535 /end CHARACTERISTIC
/begin CHARACTERISTIC FaultManager.VSPDRangeHigh.Action_4_Condition "Fault manager configuration.  Select up to 4 actions for each fault." VALUE 0x800037F8 RecordLayout_4 0 CompuMethod_116 0 65535 /end CHARACTERISTIC
/begin CHARACTERISTIC FaultManager.VSPDRangeLow.Mode "Fault manager configuration.  Select up to 4 actions for each fault." VALUE 0x800037FA RecordLayout_4 0 CompuMethod_113 0 65535 /end CHARACTERISTIC
/begin CHARACTERISTIC FaultManager.VSPDRangeLow.ID "Fault manager configuration.  Select up to 4 actions for each fault." VALUE 0x800037FC RecordLayout_4 0 CompuMethod_1 0 65535 /end CHARACTERISTIC
/begin CHARACTERISTIC FaultManager.VSPDRangeLow.Test "Fault manager configuration.  Select up to 4 actions for each fault." VALUE 0x800037FE RecordLayout_4 0 CompuMethod_114 0 65535 /end CHARACTERISTIC
/begin CHARACTERISTIC FaultManager.VSPDRangeLow.Faulty_Samples__X_ "Fault manager configuration.  Select up to 4 actions for each fault." VALUE 0x80003800 RecordLayout_4 0 CompuMethod_1 0 65535 /end CHARACTERISTIC
/begin CHARACTERISTIC FaultManager.VSPDRangeLow.Total_Samples__Y_ "Fault manager configuration.  Select up to 4 actions for each fault." VALUE 0x80003802 RecordLayout_4 0 CompuMethod_1 0 65535 /end CHARACTERISTIC
/begin CHARACTERISTIC FaultManager.VSPDRangeLow.Action_1 "Fault manager configuration.  Select up to 4 actions for each fault." VALUE 0x80003804 RecordLayout_4 0 CompuMethod_115 0 65535 /end CHARACTERISTIC
/begin CHARACTERISTIC FaultManager.VSPDRangeLow.Action_1_Condition "Fault manager configuration.  Select up to 4 actions for each fault." VALUE 0x80003806 RecordLayout_4 0 CompuMethod_116 0 65535 /end CHARACTERISTIC
/begin CHARACTERISTIC FaultManager.VSPDRangeLow.Action_2 "Fault manager configuration.  Select up to 4 actions for each fault." VALUE 0x80003808 RecordLayout_4 0 CompuMethod_115 0 65535 /end CHARACTERISTIC
/begin CHARACTERISTIC FaultManager.VSPDRangeLow.Action_2_Condition "Fault manager configuration.  Select up to 4 actions for each fault." VALUE 0x8000380A RecordLayout_4 0 CompuMethod_116 0 65535 /end CHARACTERISTIC
/begin CHARACTERISTIC FaultManager.VSPDRangeLow.Action_3 "Fault manager configuration.  Select up to 4 actions for each fault." VALUE 0x8000380C RecordLayout_4 0 CompuMethod_115 0 65535 /end CHARACTERISTIC
/begin CHARACTERISTIC FaultManager.VSPDRangeLow.Action_3_Condition "Fault manager configuration.  Select up to 4 actions for each fault." VALUE 0x8000380E RecordLayout_4 0 CompuMethod_116 0 65535 /end CHARACTERISTIC
/begin CHARACTERISTIC FaultManager.VSPDRangeLow.Action_4 "Fault manager configuration.  Select up to 4 actions for each fault." VALUE 0x80003810 RecordLayout_4 0 CompuMethod_115 0 65535 /end CHARACTERISTIC
/begin CHARACTERISTIC FaultManager.VSPDRangeLow.Action_4_Condition "Fault manager configuration.  Select up to 4 actions for each fault." VALUE 0x80003812 RecordLayout_4 0 CompuMethod_116 0 65535 /end CHARACTERISTIC
/begin CHARACTERISTIC FaultManager.VoltLow_Fault.Mode "Fault manager configuration.  Select up to 4 actions for each fault." VALUE 0x80003814 RecordLayout_4 0 CompuMethod_113 0 65535 /end CHARACTERISTIC
/begin CHARACTERISTIC FaultManager.VoltLow_Fault.ID "Fault manager configuration.  Select up to 4 actions for each fault." VALUE 0x80003816 RecordLayout_4 0 CompuMethod_1 0 65535 /end CHARACTERISTIC
/begin CHARACTERISTIC FaultManager.VoltLow_Fault.Test "Fault manager configuration.  Select up to 4 actions for each fault." VALUE 0x80003818 RecordLayout_4 0 CompuMethod_114 0 65535 /end CHARACTERISTIC
/begin CHARACTERISTIC FaultManager.VoltLow_Fault.Faulty_Samples__X_ "Fault manager configuration.  Select up to 4 actions for each fault." VALUE 0x8000381A RecordLayout_4 0 CompuMethod_1 0 65535 /end CHARACTERISTIC
/begin CHARACTERISTIC FaultManager.VoltLow_Fault.Total_Samples__Y_ "Fault manager configuration.  Select up to 4 actions for each fault." VALUE 0x8000381C RecordLayout_4 0 CompuMethod_1 0 65535 /end CHARACTERISTIC
/begin CHARACTERISTIC FaultManager.VoltLow_Fault.Action_1 "Fault manager configuration.  Select up to 4 actions for each fault." VALUE 0x8000381E RecordLayout_4 0 CompuMethod_115 0 65535 /end CHARACTERISTIC
/begin CHARACTERISTIC FaultManager.VoltLow_Fault.Action_1_Condition "Fault manager configuration.  Select up to 4 actions for each fault." VALUE 0x80003820 RecordLayout_4 0 CompuMethod_116 0 65535 /end CHARACTERISTIC
/begin CHARACTERISTIC FaultManager.VoltLow_Fault.Action_2 "Fault manager configuration.  Select up to 4 actions for each fault." VALUE 0x80003822 RecordLayout_4 0 CompuMethod_115 0 65535 /end CHARACTERISTIC
/begin CHARACTERISTIC FaultManager.VoltLow_Fault.Action_2_Condition "Fault manager configuration.  Select up to 4 actions for each fault." VALUE 0x80003824 RecordLayout_4 0 CompuMethod_116 0 65535 /end CHARACTERISTIC
/begin CHARACTERISTIC FaultManager.VoltLow_Fault.Action_3 "Fault manager configuration.  Select up to 4 actions for each fault." VALUE 0x80003826 RecordLayout_4 0 CompuMethod_115 0 65535 /end CHARACTERISTIC
/begin CHARACTERISTIC FaultManager.VoltLow_Fault.Action_3_Condition "Fault manager configuration.  Select up to 4 actions for each fault." VALUE 0x80003828 RecordLayout_4 0 CompuMethod_116 0 65535 /end CHARACTERISTIC
/begin CHARACTERISTIC FaultManager.VoltLow_Fault.Action_4 "Fault manager configuration.  Select up to 4 actions for each fault." VALUE 0x8000382A RecordLayout_4 0 CompuMethod_115 0 65535 /end CHARACTERISTIC
/begin CHARACTERISTIC FaultManager.VoltLow_Fault.Action_4_Condition "Fault manager configuration.  Select up to 4 actions for each fault." VALUE 0x8000382C RecordLayout_4 0 CompuMethod_116 0 65535 /end CHARACTERISTIC
/begin CHARACTERISTIC FaultManager.VoltTooHigh_Fault.Mode "Fault manager configuration.  Select up to 4 actions for each fault." VALUE 0x8000382E RecordLayout_4 0 CompuMethod_113 0 65535 /end CHARACTERISTIC
/begin CHARACTERISTIC FaultManager.VoltTooHigh_Fault.ID "Fault manager configuration.  Select up to 4 actions for each fault." VALUE 0x80003830 RecordLayout_4 0 CompuMethod_1 0 65535 /end CHARACTERISTIC
/begin CHARACTERISTIC FaultManager.VoltTooHigh_Fault.Test "Fault manager configuration.  Select up to 4 actions for each fault." VALUE 0x80003832 RecordLayout_4 0 CompuMethod_114 0 65535 /end CHARACTERISTIC
/begin CHARACTERISTIC FaultManager.VoltTooHigh_Fault.Faulty_Samples__X_ "Fault manager configuration.  Select up to 4 actions for each fault." VALUE 0x80003834 RecordLayout_4 0 CompuMethod_1 0 65535 /end CHARACTERISTIC
/begin CHARACTERISTIC FaultManager.VoltTooHigh_Fault.Total_Samples__Y_ "Fault manager configuration.  Select up to 4 actions for each fault." VALUE 0x80003836 RecordLayout_4 0 CompuMethod_1 0 65535 /end CHARACTERISTIC
/begin CHARACTERISTIC FaultManager.VoltTooHigh_Fault.Action_1 "Fault manager configuration.  Select up to 4 actions for each fault." VALUE 0x80003838 RecordLayout_4 0 CompuMethod_115 0 65535 /end CHARACTERISTIC
/begin CHARACTERISTIC FaultManager.VoltTooHigh_Fault.Action_1_Condition "Fault manager configuration.  Select up to 4 actions for each fault." VALUE 0x8000383A RecordLayout_4 0 CompuMethod_116 0 65535 /end CHARACTERISTIC
/begin CHARACTERISTIC FaultManager.VoltTooHigh_Fault.Action_2 "Fault manager configuration.  Select up to 4 actions for each fault." VALUE 0x8000383C RecordLayout_4 0 CompuMethod_115 0 65535 /end CHARACTERISTIC
/begin CHARACTERISTIC FaultManager.VoltTooHigh_Fault.Action_2_Condition "Fault manager configuration.  Select up to 4 actions for each fault." VALUE 0x8000383E RecordLayout_4 0 CompuMethod_116 0 65535 /end CHARACTERISTIC
/begin CHARACTERISTIC FaultManager.VoltTooHigh_Fault.Action_3 "Fault manager configuration.  Select up to 4 actions for each fault." VALUE 0x80003840 RecordLayout_4 0 CompuMethod_115 0 65535 /end CHARACTERISTIC
/begin CHARACTERISTIC FaultManager.VoltTooHigh_Fault.Action_3_Condition "Fault manager configuration.  Select up to 4 actions for each fault." VALUE 0x80003842 RecordLayout_4 0 CompuMethod_116 0 65535 /end CHARACTERISTIC
/begin CHARACTERISTIC FaultManager.VoltTooHigh_Fault.Action_4 "Fault manager configuration.  Select up to 4 actions for each fault." VALUE 0x80003844 RecordLayout_4 0 CompuMethod_115 0 65535 /end CHARACTERISTIC
/begin CHARACTERISTIC FaultManager.VoltTooHigh_Fault.Action_4_Condition "Fault manager configuration.  Select up to 4 actions for each fault." VALUE 0x80003846 RecordLayout_4 0 CompuMethod_116 0 65535 /end CHARACTERISTIC
/begin CHARACTERISTIC FaultManager.Wastegate_Fault.Mode "Fault manager configuration.  Select up to 4 actions for each fault." VALUE 0x80003848 RecordLayout_4 0 CompuMethod_113 0 65535 /end CHARACTERISTIC
/begin CHARACTERISTIC FaultManager.Wastegate_Fault.ID "Fault manager configuration.  Select up to 4 actions for each fault." VALUE 0x8000384A RecordLayout_4 0 CompuMethod_1 0 65535 /end CHARACTERISTIC
/begin CHARACTERISTIC FaultManager.Wastegate_Fault.Test "Fault manager configuration.  Select up to 4 actions for each fault." VALUE 0x8000384C RecordLayout_4 0 CompuMethod_114 0 65535 /end CHARACTERISTIC
/begin CHARACTERISTIC FaultManager.Wastegate_Fault.Faulty_Samples__X_ "Fault manager configuration.  Select up to 4 actions for each fault." VALUE 0x8000384E RecordLayout_4 0 CompuMethod_1 0 65535 /end CHARACTERISTIC
/begin CHARACTERISTIC FaultManager.Wastegate_Fault.Total_Samples__Y_ "Fault manager configuration.  Select up to 4 actions for each fault." VALUE 0x80003850 RecordLayout_4 0 CompuMethod_1 0 65535 /end CHARACTERISTIC
/begin CHARACTERISTIC FaultManager.Wastegate_Fault.Action_1 "Fault manager configuration.  Select up to 4 actions for each fault." VALUE 0x80003852 RecordLayout_4 0 CompuMethod_115 0 65535 /end CHARACTERISTIC
/begin CHARACTERISTIC FaultManager.Wastegate_Fault.Action_1_Condition "Fault manager configuration.  Select up to 4 actions for each fault." VALUE 0x80003854 RecordLayout_4 0 CompuMethod_116 0 65535 /end CHARACTERISTIC
/begin CHARACTERISTIC FaultManager.Wastegate_Fault.Action_2 "Fault manager configuration.  Select up to 4 actions for each fault." VALUE 0x80003856 RecordLayout_4 0 CompuMethod_115 0 65535 /end CHARACTERISTIC
/begin CHARACTERISTIC FaultManager.Wastegate_Fault.Action_2_Condition "Fault manager configuration.  Select up to 4 actions for each fault." VALUE 0x80003858 RecordLayout_4 0 CompuMethod_116 0 65535 /end CHARACTERISTIC
/begin CHARACTERISTIC FaultManager.Wastegate_Fault.Action_3 "Fault manager configuration.  Select up to 4 actions for each fault." VALUE 0x8000385A RecordLayout_4 0 CompuMethod_115 0 65535 /end CHARACTERISTIC
/begin CHARACTERISTIC FaultManager.Wastegate_Fault.Action_3_Condition "Fault manager configuration.  Select up to 4 actions for each fault." VALUE 0x8000385C RecordLayout_4 0 CompuMethod_116 0 65535 /end CHARACTERISTIC
/begin CHARACTERISTIC FaultManager.Wastegate_Fault.Action_4 "Fault manager configuration.  Select up to 4 actions for each fault." VALUE 0x8000385E RecordLayout_4 0 CompuMethod_115 0 65535 /end CHARACTERISTIC
/begin CHARACTERISTIC FaultManager.Wastegate_Fault.Action_4_Condition "Fault manager configuration.  Select up to 4 actions for each fault." VALUE 0x80003860 RecordLayout_4 0 CompuMethod_116 0 65535 /end CHARACTERISTIC
/begin CHARACTERISTIC FuelPumpPin "Digital output pin selection for DOut11001p0004" VALUE 0x80003E27 RecordLayout_6 0 CompuMethod_12 -32768 32767 /end CHARACTERISTIC
/begin CHARACTERISTIC IAC_PPin "PWM output pin selection for IAC_PPin" VALUE 0x80003EC2 RecordLayout_6 0 CompuMethod_106 -32768 32767 /end CHARACTERISTIC
/begin CHARACTERISTIC IAC_SPin "PWM output pin selection for IAC_SPin" VALUE 0x80003EDD RecordLayout_6 0 CompuMethod_106 -32768 32767 /end CHARACTERISTIC
/begin CHARACTERISTIC IATFanOff "IAT temp when the fan turns off" VALUE 0x800040DA RecordLayout_5 0 CompuMethod_63 -1E+17 1E+17 /end CHARACTERISTIC
/begin CHARACTERISTIC IATFanOn "IAT temp when the fan turns on" VALUE 0x800040DE RecordLayout_5 0 CompuMethod_63 -1E+17 1E+17 /end CHARACTERISTIC
/begin CHARACTERISTIC IATFanSpeed_StallTbl "" CURVE 0x800040E2 RecordLayout_5 0 CompuMethod_2 -1E+17 1E+17
 /begin AXIS_DESCR COM_AXIS IAT05In CompuMethod_63 5 -40 300 AXIS_PTS_REF IAT05IdxArr /end AXIS_DESCR
/end CHARACTERISTIC
/begin CHARACTERISTIC IATFanSpeedMap "" MAP 0x800040F6 RecordLayout_5 0 CompuMethod_2 -1E+17 1E+17
 /begin AXIS_DESCR COM_AXIS VSPD07In CompuMethod_184 7 -100 200 AXIS_PTS_REF VSPD07IdxArr /end AXIS_DESCR
 /begin AXIS_DESCR COM_AXIS IAT07In CompuMethod_63 7 -40 300 AXIS_PTS_REF IAT07IdxArr /end AXIS_DESCR
/end CHARACTERISTIC
/begin CHARACTERISTIC IdleExitTimeConst "Time constant for idle air and spark ramp out" VALUE 0x80004239 RecordLayout_5 0 CompuMethod_131 0 100 /end CHARACTERISTIC
/begin CHARACTERISTIC INJ_Behavior "Select the type of injector behavior.  Transient behavior will take more CPU time, but will allow make-up pulses.  Batch Mode always uses Standard Behavior." VALUE 0x80004245 RecordLayout_1 0 CompuMethod_133 0 255 /end CHARACTERISTIC
/begin CHARACTERISTIC INJ_InitialPin "First pin selection for Injector Sequence.  Goes up from here depending on the Sequence Type and number of cylinders" VALUE 0x80004246 RecordLayout_6 0 CompuMethod_134 -32768 32767 /end CHARACTERISTIC
/begin CHARACTERISTIC INJ_SequenceType "Select the type of injector sequence.  The number of pins used will depend on this selection" VALUE 0x80004248 RecordLayout_1 0 CompuMethod_135 0 255 /end CHARACTERISTIC
/begin CHARACTERISTIC WASTEGATE "PWM output pin selection for WASTEGATE" VALUE 0x8000682E RecordLayout_6 0 CompuMethod_106 -32768 32767 /end CHARACTERISTIC
/*~~~~~~~~~ 6.3.17 AXIS_PTS ~~~~~~~~~*/
/begin AXIS_PTS ACPres05IdxArr "Index of AC system high side pressure" 0x80000080 ACPres05In RecordLayout_7 0 CompuMethod_16 5 -150 10000 DEPOSIT ABSOLUTE /end AXIS_PTS
/begin AXIS_PTS ACPres07IdxArr "Index of AC system high side pressure" 0x80000094 ACPres07In RecordLayout_7 0 CompuMethod_16 7 -150 10000 DEPOSIT ABSOLUTE /end AXIS_PTS
/begin AXIS_PTS ECT05IdxArr "Idex of ECT" 0x80001BB9 ECT05In RecordLayout_7 0 CompuMethod_63 5 -40 200 DEPOSIT ABSOLUTE /end AXIS_PTS
/begin AXIS_PTS ECT07IdxArr "Index of ECT" 0x80001BCD ECT07In RecordLayout_7 0 CompuMethod_63 7 -40 200 DEPOSIT ABSOLUTE /end AXIS_PTS
/begin AXIS_PTS IAT05IdxArr "Index of IAT" 0x80004062 IAT05In RecordLayout_7 0 CompuMethod_63 5 -40 300 DEPOSIT ABSOLUTE /end AXIS_PTS
/begin AXIS_PTS IAT07IdxArr "Index of IAT" 0x80004076 IAT07In RecordLayout_7 0 CompuMethod_63 7 -40 300 DEPOSIT ABSOLUTE /end AXIS_PTS
/begin AXIS_PTS VSPD07IdxArr "Index of VSPD" 0x800065F6 VSPD07In RecordLayout_7 0 CompuMethod_184 7 -100 200 DEPOSIT ABSOLUTE /end AXIS_PTS
/*~~~~~~~~~ 6.3.106 RECORD_LAYOUTs ~~~~~~~~~*/
/begin RECORD_LAYOUT RecordLayout_1 FNC_VALUES 1 UBYTE ROW_DIR DIRECT /end RECORD_LAYOUT
/begin RECORD_LAYOUT RecordLayout_4 FNC_VALUES 1 UWORD ROW_DIR DIRECT /end RECORD_LAYOUT
/begin RECORD_LAYOUT RecordLayout_5 FNC_VALUES 1 FLOAT32_IEEE ROW_DIR DIRECT /end RECORD_LAYOUT
/begin RECORD_LAYOUT RecordLayout_6 FNC_VALUES 1 SWORD ROW_DIR DIRECT /end RECORD_LAYOUT
/begin RECORD_LAYOUT RecordLayout_7 AXIS_PTS_X 1 FLOAT32_IEEE /* IndexIncr */ INDEX_INCR /* Addressing */ DIRECT /end RECORD_LAYOUT
/*~~~~~~~~~ 6.3.31 COMPU_METHODs ~~~~~~~~~*/
/begin COMPU_METHOD CompuMethod_1 "" RAT_FUNC "%3.0" "" COEFFS 0 1 0 0 0 1 /end COMPU_METHOD
/begin COMPU_METHOD CompuMethod_2 "" RAT_FUNC "%6.2" "" COEFFS 0 1 0 0 0 1 /end COMPU_METHOD
/begin COMPU_METHOD CompuMethod_4 "" RAT_FUNC "%1.0" "bool" COEFFS 0 1 0 0 0 1 /end COMPU_METHOD
/begin COMPU_METHOD CompuMethod_5 "" TAB_VERB "%1.0" "" COMPU_TAB_REF CompuVtab_1 /end COMPU_METHOD
/begin COMPU_METHOD CompuMethod_6 "" RAT_FUNC "%5.0" "%" COEFFS 0 1 0 0 0 1 /end COMPU_METHOD
/begin COMPU_METHOD CompuMethod_7 "" RAT_FUNC "%6.2" "%" COEFFS 0 1 0 0 0 1 /end COMPU_METHOD
/begin COMPU_METHOD CompuMethod_8 "" TAB_VERB "%1.0" "" COMPU_TAB_REF CompuVtab_2 /end COMPU_METHOD
/begin COMPU_METHOD CompuMethod_9 "" RAT_FUNC "%5.0" "" COEFFS 0 1 0 0 0 1 /end COMPU_METHOD
/begin COMPU_METHOD CompuMethod_10 "" RAT_FUNC "%5.0" "kpa" COEFFS 0 1 0 0 0 1 /end COMPU_METHOD
/begin COMPU_METHOD CompuMethod_11 "" RAT_FUNC "%1.0" "" COEFFS 0 1 0 0 0 1 /end COMPU_METHOD
/begin COMPU_METHOD CompuMethod_12 "" TAB_VERB "%5.0" "" COMPU_TAB_REF CompuVtab_3 /end COMPU_METHOD
/begin COMPU_METHOD CompuMethod_13 "" RAT_FUNC "%6.2" "kPaGauge" COEFFS 0 1 0 0 0 1 /end COMPU_METHOD
/begin COMPU_METHOD CompuMethod_14 "" RAT_FUNC "%6.2" "kPa Gauge" COEFFS 0 1 0 0 0 1 /end COMPU_METHOD
/begin COMPU_METHOD CompuMethod_15 "" RAT_FUNC "%6.2" "idx.frac" COEFFS 0 1 0 0 0 0.00195313 /end COMPU_METHOD
/begin COMPU_METHOD CompuMethod_16 "" RAT_FUNC "%6.2" "kPa" COEFFS 0 1 0 0 0 1 /end COMPU_METHOD
/begin COMPU_METHOD CompuMethod_17 "" RAT_FUNC "%5.0" "ADC" COEFFS 0 1 0 0 0 1 /end COMPU_METHOD
/begin COMPU_METHOD CompuMethod_18 "" RAT_FUNC "%6.2" "kpa" COEFFS 0 1 0 0 0 1 /end COMPU_METHOD
/begin COMPU_METHOD CompuMethod_19 "" RAT_FUNC "%6.2" "sec" COEFFS 0 1 0 0 0 1 /end COMPU_METHOD
/begin COMPU_METHOD CompuMethod_20 "" RAT_FUNC "%9.4" "kPa Gauge/ADC" COEFFS 0 1 0 0 0 1 /end COMPU_METHOD
/begin COMPU_METHOD CompuMethod_21 "" RAT_FUNC "%6.2" "ADC" COEFFS 0 1 0 0 0 1 /end COMPU_METHOD
/begin COMPU_METHOD CompuMethod_24 "" RAT_FUNC "%5.0" "RPM" COEFFS 0 1 0 0 0 1 /end COMPU_METHOD
/begin COMPU_METHOD CompuMethod_26 "" RAT_FUNC "%3.0" "%" COEFFS 0 1 0 0 0 1 /end COMPU_METHOD
/begin COMPU_METHOD CompuMethod_27 "" RAT_FUNC "%6.2" "Seconds" COEFFS 0 1 0 0 0 1 /end COMPU_METHOD
/begin COMPU_METHOD CompuMethod_50 "" RAT_FUNC "%7.2" "%" COEFFS 0 1 0 0 0 1 /end COMPU_METHOD
/begin COMPU_METHOD CompuMethod_63 "" RAT_FUNC "%6.2" "degC" COEFFS 0 1 0 0 0 1 /end COMPU_METHOD
/begin COMPU_METHOD CompuMethod_96 "" TAB_VERB "%5.0" "" COMPU_TAB_REF CompuVtab_25 /end COMPU_METHOD
/begin COMPU_METHOD CompuMethod_97 "" TAB_VERB "%3.0" "" COMPU_TAB_REF CompuVtab_26 /end COMPU_METHOD
/begin COMPU_METHOD CompuMethod_106 "" TAB_VERB "%5.0" "" COMPU_TAB_REF CompuVtab_28 /end COMPU_METHOD
/begin COMPU_METHOD CompuMethod_109 "" TAB_VERB "%1.0" "" COMPU_TAB_REF CompuVtab_30 /end COMPU_METHOD
/begin COMPU_METHOD CompuMethod_113 "" TAB_VERB "%3.0" "" COMPU_TAB_REF CompuVtab_33 /end COMPU_METHOD
/begin COMPU_METHOD CompuMethod_114 "" TAB_VERB "%3.0" "" COMPU_TAB_REF CompuVtab_34 /end COMPU_METHOD
/begin COMPU_METHOD CompuMethod_115 "" TAB_VERB "%3.0" "" COMPU_TAB_REF CompuVtab_35 /end COMPU_METHOD
/begin COMPU_METHOD CompuMethod_116 "" TAB_VERB "%3.0" "" COMPU_TAB_REF CompuVtab_36 /end COMPU_METHOD
/begin COMPU_METHOD CompuMethod_131 "" RAT_FUNC "%5.3" "sec" COEFFS 0 1 0 0 0 1 /end COMPU_METHOD
/begin COMPU_METHOD CompuMethod_133 "" TAB_VERB "%3.0" "" COMPU_TAB_REF CompuVtab_44 /end COMPU_METHOD
/begin COMPU_METHOD CompuMethod_134 "" TAB_VERB "%5.0" "" COMPU_TAB_REF CompuVtab_45 /end COMPU_METHOD
/begin COMPU_METHOD CompuMethod_135 "" TAB_VERB "%3.0" "" COMPU_TAB_REF CompuVtab_46 /end COMPU_METHOD
/begin COMPU_METHOD CompuMethod_184 "" RAT_FUNC "%6.2" "MPH" COEFFS 0 1 0 0 0 1 /end COMPU_METHOD
/*~~~~~~~~~ 6.3.34 COMPU_VTABs ~~~~~~~~~*/
/begin COMPU_VTAB CompuVtab_1 "" TAB_VERB 2 0 "Pass-Through" 1 "Override" /end COMPU_VTAB
/begin COMPU_VTAB CompuVtab_2 "" TAB_VERB 2 0 "Disabled" 1 "Enabled" /end COMPU_VTAB
/begin COMPU_VTAB CompuVtab_3 "" TAB_VERB 41 -1 "(None)" 12 "FINJ1" 13 "FINJ2" 14 "FINJ3" 15 "FINJ4" 16 "FINJ5" 17 "FINJ6" 18 "FINJ7" 19 "FINJ8" 20 "FINJ9" 21 "FINJ10" 22 "FINJ11" 23 "FINJ12" 24 "TACH" 25 "LSD1" 26 "LSD2" 27 "LSD3" 28 "LSD4" 29 "LSD5" 30 "LSD6" 31 "LSD7" 32 "LSD8" 33 "LSD9" 34 "LSD10" 36 "EST 1" 37 "EST 2" 38 "EST 3" 39 "EST 4" 40 "EST 5" 41 "EST 6" 42 "EST 7" 43 "EST 8" 44 "EST 9" 45 "EST 10" 46 "EST 11" 47 "EST 12" 48 "EST 13" 49 "EST 14" 50 "EST 15" 51 "EST 16" 52 "MPRD" /end COMPU_VTAB
/begin COMPU_VTAB CompuVtab_25 "" TAB_VERB 17 -1 "(None)" 36 "EST 1" 37 "EST 2" 38 "EST 3" 39 "EST 4" 40 "EST 5" 41 "EST 6" 42 "EST 7" 43 "EST 8" 44 "EST 9" 45 "EST 10" 46 "EST 11" 47 "EST 12" 48 "EST 13" 49 "EST 14" 50 "EST 15" 51 "EST 16" /end COMPU_VTAB
/begin COMPU_VTAB CompuVtab_26 "" TAB_VERB 4 0 "Standard (Coil per cylinder)" 1 "Banked (Fire on both phases until CAM sync)" 2 "Batch (Wasted spark)" 3 "Muxed (Distributed)" /end COMPU_VTAB
/begin COMPU_VTAB CompuVtab_28 "" TAB_VERB 43 -1 "(None)" 1 "H1" 10 "H2" 12 "FINJ1" 13 "FINJ2" 14 "FINJ3" 15 "FINJ4" 16 "FINJ5" 17 "FINJ6" 18 "FINJ7" 19 "FINJ8" 20 "FINJ9" 21 "FINJ10" 22 "FINJ11" 23 "FINJ12" 24 "TACH" 25 "LSD1" 26 "LSD2" 27 "LSD3" 28 "LSD4" 29 "LSD5" 30 "LSD6" 31 "LSD7" 32 "LSD8" 33 "LSD9" 34 "LSD10" 36 "EST 1" 37 "EST 2" 38 "EST 3" 39 "EST 4" 40 "EST 5" 41 "EST 6" 42 "EST 7" 43 "EST 8" 44 "EST 9" 45 "EST 10" 46 "EST 11" 47 "EST 12" 48 "EST 13" 49 "EST 14" 50 "EST 15" 51 "EST 16" 107 "H3" /end COMPU_VTAB
/begin COMPU_VTAB CompuVtab_30 "" TAB_VERB 2 0 "PWM" 1 "OnOff" /end COMPU_VTAB
/begin COMPU_VTAB CompuVtab_33 "" TAB_VERB 6 0 "Disabled" 1 "Enabled" 2 "Sticky" 3 "Enabled - Persistent" 4 "Sticky - Persistent" 5 "Save Occurred" /end COMPU_VTAB
/begin COMPU_VTAB CompuVtab_34 "" TAB_VERB 2 0 "-" 1 "Test" /end COMPU_VTAB
/begin COMPU_VTAB CompuVtab_35 "" TAB_VERB 16 0 "CutThrottle" 1 "DFCODisable" 2 "DelayedEngineShutdown" 3 "DisableAC" 4 "DisableFanRun" 5 "DisableFanStall" 6 "DisableO2Ctrl" 7 "DisableVEAdapt" 8 "DisableWastegate" 9 "EngineProtectLED" 10 "EngineShutdown" 11 "HardRevLimit" 12 "MIL_LED" 13 "MediumRevLimit" 14 "SoftRevLimit" 15 "(None)" /end COMPU_VTAB
/begin COMPU_VTAB CompuVtab_36 "" TAB_VERB 8 0 "(None)" 1 "Suspected" 2 "Active" 3 "Suspected or Active" 4 "Occurred" 5 "Suspected or Occurred" 6 "Active or Occurred" 7 "Suspected or Active or Occurred" /end COMPU_VTAB
/begin COMPU_VTAB CompuVtab_44 "" TAB_VERB 2 0 "Standard" 1 "Transient" /end COMPU_VTAB
/begin COMPU_VTAB CompuVtab_45 "" TAB_VERB 13 -1 "(None)" 12 "FINJ1" 13 "FINJ2" 14 "FINJ3" 15 "FINJ4" 16 "FINJ5" 17 "FINJ6" 18 "FINJ7" 19 "FINJ8" 20 "FINJ9" 21 "FINJ10" 22 "FINJ11" 23 "FINJ12" /end COMPU_VTAB
/begin COMPU_VTAB CompuVtab_46 "" TAB_VERB 3 0 "Standard (Injector per cylinder)" 1 "Batch (Fire half fuel on half of the injectors every rev)" 2 " Wasted (Fire half fuel on all injectors every rev)" /end COMPU_VTAB
/begin FUNCTION BaseEngineController_LS_128 ""
 /begin DEF_CHARACTERISTIC FaultManager.Lambda2VoltHigh_Fault.Test FaultManager.Lambda2VoltHigh_Fault.Faulty_Samples__X_ FaultManager.Lambda2VoltHigh_Fault.Total_Samples__Y_ FaultManager.Lambda2VoltHigh_Fault.Action_1 FaultManager.Lambda2VoltHigh_Fault.Action_1_Condition FaultManager.Lambda2VoltHigh_Fault.Action_2 FaultManager.Lambda2VoltHigh_Fault.Action_2_Condition FaultManager.Lambda2VoltHigh_Fault.Action_3 FaultManager.Lambda2VoltHigh_Fault.Action_3_Condition FaultManager.Lambda2VoltHigh_Fault.Action_4 FaultManager.Lambda2VoltHigh_Fault.Action_4_Condition FaultManager.Lambda2VoltLow_Fault.Mode FaultManager.Lambda2VoltLow_Fault.ID FaultManager.Lambda2VoltLow_Fault.Test FaultManager.Lambda2VoltLow_Fault.Faulty_Samples__X_ FaultManager.Lambda2VoltLow_Fault.Total_Samples__Y_ FaultManager.Lambda2VoltLow_Fault.Action_1 FaultManager.Lambda2VoltLow_Fault.Action_1_Condition FaultManager.Lambda2VoltLow_Fault.Action_2 FaultManager.Lambda2VoltLow_Fault.Action_2_Condition FaultManager.Lambda2VoltLow_Fault.Action_3 FaultManager.Lambda2VoltLow_Fault.Action_3_Condition FaultManager.Lambda2VoltLow_Fault.Action_4 FaultManager.Lambda2VoltLow_Fault.Action_4_Condition FaultManager.Lambda_1_Timeout.Mode FaultManager.Lambda_1_Timeout.ID FaultManager.Lambda_1_Timeout.Test FaultManager.Lambda_1_Timeout.Faulty_Samples__X_ FaultManager.Lambda_1_Timeout.Total_Samples__Y_ FaultManager.Lambda_1_Timeout.Action_1 FaultManager.Lambda_1_Timeout.Action_1_Condition FaultManager.Lambda_1_Timeout.Action_2 FaultManager.Lambda_1_Timeout.Action_2_Condition FaultManager.Lambda_1_Timeout.Action_3 FaultManager.Lambda_1_Timeout.Action_3_Condition FaultManager.Lambda_1_Timeout.Action_4 FaultManager.Lambda_1_Timeout.Action_4_Condition FaultManager.Lambda_2_Timeout.Mode FaultManager.Lambda_2_Timeout.ID FaultManager.Lambda_2_Timeout.Test FaultManager.Lambda_2_Timeout.Faulty_Samples__X_ FaultManager.Lambda_2_Timeout.Total_Samples__Y_ FaultManager.Lambda_2_Timeout.Action_1 FaultManager.Lambda_2_Timeout.Action_1_Condition FaultManager.Lambda_2_Timeout.Action_2 FaultManager.Lambda_2_Timeout.Action_2_Condition FaultManager.Lambda_2_Timeout.Action_3 FaultManager.Lambda_2_Timeout.Action_3_Condition FaultManager.Lambda_2_Timeout.Action_4 FaultManager.Lambda_2_Timeout.Action_4_Condition FaultManager.Lambda_Bank2Bank_Fault.Mode FaultManager.Lambda_Bank2Bank_Fault.ID FaultManager.Lambda_Bank2Bank_Fault.Test FaultManager.Lambda_Bank2Bank_Fault.Faulty_Samples__X_ FaultManager.Lambda_Bank2Bank_Fault.Total_Samples__Y_ FaultManager.Lambda_Bank2Bank_Fault.Action_1 FaultManager.Lambda_Bank2Bank_Fault.Action_1_Condition FaultManager.Lambda_Bank2Bank_Fault.Action_2 FaultManager.Lambda_Bank2Bank_Fault.Action_2_Condition FaultManager.Lambda_Bank2Bank_Fault.Action_3 FaultManager.Lambda_Bank2Bank_Fault.Action_3_Condition FaultManager.Lambda_Bank2Bank_Fault.Action_4 FaultManager.Lambda_Bank2Bank_Fault.Action_4_Condition FaultManager.LeanProtect_Fault.Mode FaultManager.LeanProtect_Fault.ID FaultManager.LeanProtect_Fault.Test FaultManager.LeanProtect_Fault.Faulty_Samples__X_ FaultManager.LeanProtect_Fault.Total_Samples__Y_ FaultManager.LeanProtect_Fault.Action_1 FaultManager.LeanProtect_Fault.Action_1_Condition FaultManager.LeanProtect_Fault.Action_2 FaultManager.LeanProtect_Fault.Action_2_Condition FaultManager.LeanProtect_Fault.Action_3 FaultManager.LeanProtect_Fault.Action_3_Condition FaultManager.LeanProtect_Fault.Action_4 FaultManager.LeanProtect_Fault.Action_4_Condition FaultManager.MAFRangeHigh.Mode FaultManager.MAFRangeHigh.ID FaultManager.MAFRangeHigh.Test FaultManager.MAFRangeHigh.Faulty_Samples__X_ FaultManager.MAFRangeHigh.Total_Samples__Y_ FaultManager.MAFRangeHigh.Action_1 FaultManager.MAFRangeHigh.Action_1_Condition FaultManager.MAFRangeHigh.Action_2 FaultManager.MAFRangeHigh.Action_2_Condition FaultManager.MAFRangeHigh.Action_3 FaultManager.MAFRangeHigh.Action_3_Condition FaultManager.MAFRangeHigh.Action_4 FaultManager.MAFRangeHigh.Action_4_Condition FaultManager.MAFRangeLow.Mode FaultManager.MAFRangeLow.ID FaultManager.MAFRangeLow.Test FaultManager.MAFRangeLow.Faulty_Samples__X_ FaultManager.MAFRangeLow.Total_Samples__Y_ FaultManager.MAFRangeLow.Action_1 FaultManager.MAFRangeLow.Action_1_Condition FaultManager.MAFRangeLow.Action_2 FaultManager.MAFRangeLow.Action_2_Condition FaultManager.MAFRangeLow.Action_3 FaultManager.MAFRangeLow.Action_3_Condition FaultManager.MAFRangeLow.Action_4 FaultManager.MAFRangeLow.Action_4_Condition FaultManager.MAPRangeHigh.Mode FaultManager.MAPRangeHigh.ID FaultManager.MAPRangeHigh.Test FaultManager.MAPRangeHigh.Faulty_Samples__X_ FaultManager.MAPRangeHigh.Total_Samples__Y_ FaultManager.MAPRangeHigh.Action_1 FaultManager.MAPRangeHigh.Action_1_Condition FaultManager.MAPRangeHigh.Action_2 FaultManager.MAPRangeHigh.Action_2_Condition FaultManager.MAPRangeHigh.Action_3 FaultManager.MAPRangeHigh.Action_3_Condition FaultManager.MAPRangeHigh.Action_4 FaultManager.MAPRangeHigh.Action_4_Condition FaultManager.MAPRangeLow.Mode FaultManager.MAPRangeLow.ID FaultManager.MAPRangeLow.Test FaultManager.MAPRangeLow.Faulty_Samples__X_ FaultManager.MAPRangeLow.Total_Samples__Y_ FaultManager.MAPRangeLow.Action_1 FaultManager.MAPRangeLow.Action_1_Condition FaultManager.MAPRangeLow.Action_2 FaultManager.MAPRangeLow.Action_2_Condition FaultManager.MAPRangeLow.Action_3 FaultManager.MAPRangeLow.Action_3_Condition FaultManager.MAPRangeLow.Action_4 FaultManager.MAPRangeLow.Action_4_Condition FaultManager.MAPTimeRangeHigh.Mode FaultManager.MAPTimeRangeHigh.ID FaultManager.MAPTimeRangeHigh.Test FaultManager.MAPTimeRangeHigh.Faulty_Samples__X_ FaultManager.MAPTimeRangeHigh.Total_Samples__Y_ FaultManager.MAPTimeRangeHigh.Action_1 FaultManager.MAPTimeRangeHigh.Action_1_Condition FaultManager.MAPTimeRangeHigh.Action_2 FaultManager.MAPTimeRangeHigh.Action_2_Condition FaultManager.MAPTimeRangeHigh.Action_3 FaultManager.MAPTimeRangeHigh.Action_3_Condition FaultManager.MAPTimeRangeHigh.Action_4 FaultManager.MAPTimeRangeHigh.Action_4_Condition FaultManager.MAPTimeRangeLow.Mode FaultManager.MAPTimeRangeLow.ID FaultManager.MAPTimeRangeLow.Test FaultManager.MAPTimeRangeLow.Faulty_Samples__X_ FaultManager.MAPTimeRangeLow.Total_Samples__Y_ FaultManager.MAPTimeRangeLow.Action_1 FaultManager.MAPTimeRangeLow.Action_1_Condition FaultManager.MAPTimeRangeLow.Action_2 FaultManager.MAPTimeRangeLow.Action_2_Condition FaultManager.MAPTimeRangeLow.Action_3 FaultManager.MAPTimeRangeLow.Action_3_Condition FaultManager.MAPTimeRangeLow.Action_4 FaultManager.MAPTimeRangeLow.Action_4_Condition FaultManager.MAP_IR_HI.Mode FaultManager.MAP_IR_HI.ID FaultManager.MAP_IR_HI.Test FaultManager.MAP_IR_HI.Faulty_Samples__X_ FaultManager.MAP_IR_HI.Total_Samples__Y_ FaultManager.MAP_IR_HI.Action_1 FaultManager.MAP_IR_HI.Action_1_Condition FaultManager.MAP_IR_HI.Action_2 FaultManager.MAP_IR_HI.Action_2_Condition FaultManager.MAP_IR_HI.Action_3 FaultManager.MAP_IR_HI.Action_3_Condition FaultManager.MAP_IR_HI.Action_4 FaultManager.MAP_IR_HI.Action_4_Condition FaultManager.MAP_IR_LO.Mode FaultManager.MAP_IR_LO.ID FaultManager.MAP_IR_LO.Test FaultManager.MAP_IR_LO.Faulty_Samples__X_ FaultManager.MAP_IR_LO.Total_Samples__Y_ FaultManager.MAP_IR_LO.Action_1 FaultManager.MAP_IR_LO.Action_1_Condition FaultManager.MAP_IR_LO.Action_2 FaultManager.MAP_IR_LO.Action_2_Condition FaultManager.MAP_IR_LO.Action_3 FaultManager.MAP_IR_LO.Action_3_Condition FaultManager.MAP_IR_LO.Action_4 FaultManager.MAP_IR_LO.Action_4_Condition FaultManager.MAP_STICKING.Mode FaultManager.MAP_STICKING.ID FaultManager.MAP_STICKING.Test FaultManager.MAP_STICKING.Faulty_Samples__X_ FaultManager.MAP_STICKING.Total_Samples__Y_ FaultManager.MAP_STICKING.Action_1 FaultManager.MAP_STICKING.Action_1_Condition FaultManager.MAP_STICKING.Action_2 FaultManager.MAP_STICKING.Action_2_Condition FaultManager.MAP_STICKING.Action_3 FaultManager.MAP_STICKING.Action_3_Condition FaultManager.MAP_STICKING.Action_4 FaultManager.MAP_STICKING.Action_4_Condition FaultManager.MediumOverspeed.Mode FaultManager.MediumOverspeed.ID FaultManager.MediumOverspeed.Test FaultManager.MediumOverspeed.Faulty_Samples__X_ FaultManager.MediumOverspeed.Total_Samples__Y_ FaultManager.MediumOverspeed.Action_1 FaultManager.MediumOverspeed.Action_1_Condition FaultManager.MediumOverspeed.Action_2 FaultManager.MediumOverspeed.Action_2_Condition FaultManager.MediumOverspeed.Action_3 FaultManager.MediumOverspeed.Action_3_Condition FaultManager.MediumOverspeed.Action_4 FaultManager.MediumOverspeed.Action_4_Condition FaultManager.NoOil_Fault.Mode FaultManager.NoOil_Fault.ID FaultManager.NoOil_Fault.Test FaultManager.NoOil_Fault.Faulty_Samples__X_ FaultManager.NoOil_Fault.Total_Samples__Y_ FaultManager.NoOil_Fault.Action_1 FaultManager.NoOil_Fault.Action_1_Condition FaultManager.NoOil_Fault.Action_2 FaultManager.NoOil_Fault.Action_2_Condition FaultManager.NoOil_Fault.Action_3 FaultManager.NoOil_Fault.Action_3_Condition FaultManager.NoOil_Fault.Action_4 FaultManager.NoOil_Fault.Action_4_Condition FaultManager.O2FailedLean_BankA.Mode FaultManager.O2FailedLean_BankA.ID FaultManager.O2FailedLean_BankA.Test FaultManager.O2FailedLean_BankA.Faulty_Samples__X_ FaultManager.O2FailedLean_BankA.Total_Samples__Y_ FaultManager.O2FailedLean_BankA.Action_1 FaultManager.O2FailedLean_BankA.Action_1_Condition FaultManager.O2FailedLean_BankA.Action_2 FaultManager.O2FailedLean_BankA.Action_2_Condition FaultManager.O2FailedLean_BankA.Action_3 FaultManager.O2FailedLean_BankA.Action_3_Condition FaultManager.O2FailedLean_BankA.Action_4 FaultManager.O2FailedLean_BankA.Action_4_Condition FaultManager.O2FailedLean_BankB.Mode FaultManager.O2FailedLean_BankB.ID FaultManager.O2FailedLean_BankB.Test FaultManager.O2FailedLean_BankB.Faulty_Samples__X_ FaultManager.O2FailedLean_BankB.Total_Samples__Y_ FaultManager.O2FailedLean_BankB.Action_1 FaultManager.O2FailedLean_BankB.Action_1_Condition FaultManager.O2FailedLean_BankB.Action_2 FaultManager.O2FailedLean_BankB.Action_2_Condition FaultManager.O2FailedLean_BankB.Action_3 FaultManager.O2FailedLean_BankB.Action_3_Condition FaultManager.O2FailedLean_BankB.Action_4 FaultManager.O2FailedLean_BankB.Action_4_Condition FaultManager.O2FailedRich_BankA.Mode FaultManager.O2FailedRich_BankA.ID FaultManager.O2FailedRich_BankA.Test FaultManager.O2FailedRich_BankA.Faulty_Samples__X_ FaultManager.O2FailedRich_BankA.Total_Samples__Y_ FaultManager.O2FailedRich_BankA.Action_1 FaultManager.O2FailedRich_BankA.Action_1_Condition FaultManager.O2FailedRich_BankA.Action_2 FaultManager.O2FailedRich_BankA.Action_2_Condition FaultManager.O2FailedRich_BankA.Action_3 FaultManager.O2FailedRich_BankA.Action_3_Condition FaultManager.O2FailedRich_BankA.Action_4 FaultManager.O2FailedRich_BankA.Action_4_Condition FaultManager.O2FailedRich_BankB.Mode FaultManager.O2FailedRich_BankB.ID FaultManager.O2FailedRich_BankB.Test FaultManager.O2FailedRich_BankB.Faulty_Samples__X_ FaultManager.O2FailedRich_BankB.Total_Samples__Y_ FaultManager.O2FailedRich_BankB.Action_1 FaultManager.O2FailedRich_BankB.Action_1_Condition FaultManager.O2FailedRich_BankB.Action_2 FaultManager.O2FailedRich_BankB.Action_2_Condition FaultManager.O2FailedRich_BankB.Action_3 FaultManager.O2FailedRich_BankB.Action_3_Condition FaultManager.O2FailedRich_BankB.Action_4 FaultManager.O2FailedRich_BankB.Action_4_Condition FaultManager.O2NotActive_BankA.Mode FaultManager.O2NotActive_BankA.ID FaultManager.O2NotActive_BankA.Test FaultManager.O2NotActive_BankA.Faulty_Samples__X_ FaultManager.O2NotActive_BankA.Total_Samples__Y_ FaultManager.O2NotActive_BankA.Action_1 FaultManager.O2NotActive_BankA.Action_1_Condition FaultManager.O2NotActive_BankA.Action_2 FaultManager.O2NotActive_BankA.Action_2_Condition FaultManager.O2NotActive_BankA.Action_3 FaultManager.O2NotActive_BankA.Action_3_Condition FaultManager.O2NotActive_BankA.Action_4 FaultManager.O2NotActive_BankA.Action_4_Condition FaultManager.O2NotActive_BankB.Mode FaultManager.O2NotActive_BankB.ID FaultManager.O2NotActive_BankB.Test FaultManager.O2NotActive_BankB.Faulty_Samples__X_ FaultManager.O2NotActive_BankB.Total_Samples__Y_ FaultManager.O2NotActive_BankB.Action_1 FaultManager.O2NotActive_BankB.Action_1_Condition FaultManager.O2NotActive_BankB.Action_2 FaultManager.O2NotActive_BankB.Action_2_Condition FaultManager.O2NotActive_BankB.Action_3 FaultManager.O2NotActive_BankB.Action_3_Condition FaultManager.O2NotActive_BankB.Action_4 FaultManager.O2NotActive_BankB.Action_4_Condition FaultManager.OilPresRangeHigh.Mode FaultManager.OilPresRangeHigh.ID FaultManager.OilPresRangeHigh.Test FaultManager.OilPresRangeHigh.Faulty_Samples__X_ FaultManager.OilPresRangeHigh.Total_Samples__Y_ FaultManager.OilPresRangeHigh.Action_1 FaultManager.OilPresRangeHigh.Action_1_Condition FaultManager.OilPresRangeHigh.Action_2 FaultManager.OilPresRangeHigh.Action_2_Condition FaultManager.OilPresRangeHigh.Action_3 FaultManager.OilPresRangeHigh.Action_3_Condition FaultManager.OilPresRangeHigh.Action_4 FaultManager.OilPresRangeHigh.Action_4_Condition FaultManager.OilPresRangeLow.Mode FaultManager.OilPresRangeLow.ID FaultManager.OilPresRangeLow.Test FaultManager.OilPresRangeLow.Faulty_Samples__X_ FaultManager.OilPresRangeLow.Total_Samples__Y_ FaultManager.OilPresRangeLow.Action_1 FaultManager.OilPresRangeLow.Action_1_Condition FaultManager.OilPresRangeLow.Action_2 FaultManager.OilPresRangeLow.Action_2_Condition FaultManager.OilPresRangeLow.Action_3 FaultManager.OilPresRangeLow.Action_3_Condition FaultManager.OilPresRangeLow.Action_4 FaultManager.OilPresRangeLow.Action_4_Condition FaultManager.ScrambleStuckHigh_Fault.Mode FaultManager.ScrambleStuckHigh_Fault.ID FaultManager.ScrambleStuckHigh_Fault.Test FaultManager.ScrambleStuckHigh_Fault.Faulty_Samples__X_ FaultManager.ScrambleStuckHigh_Fault.Total_Samples__Y_ FaultManager.ScrambleStuckHigh_Fault.Action_1 FaultManager.ScrambleStuckHigh_Fault.Action_1_Condition FaultManager.ScrambleStuckHigh_Fault.Action_2 FaultManager.ScrambleStuckHigh_Fault.Action_2_Condition FaultManager.ScrambleStuckHigh_Fault.Action_3 FaultManager.ScrambleStuckHigh_Fault.Action_3_Condition FaultManager.ScrambleStuckHigh_Fault.Action_4 FaultManager.ScrambleStuckHigh_Fault.Action_4_Condition FaultManager.SensVoltRangeHigh.Mode FaultManager.SensVoltRangeHigh.ID FaultManager.SensVoltRangeHigh.Test FaultManager.SensVoltRangeHigh.Faulty_Samples__X_ FaultManager.SensVoltRangeHigh.Total_Samples__Y_ FaultManager.SensVoltRangeHigh.Action_1 FaultManager.SensVoltRangeHigh.Action_1_Condition FaultManager.SensVoltRangeHigh.Action_2 FaultManager.SensVoltRangeHigh.Action_2_Condition FaultManager.SensVoltRangeHigh.Action_3 FaultManager.SensVoltRangeHigh.Action_3_Condition FaultManager.SensVoltRangeHigh.Action_4 FaultManager.SensVoltRangeHigh.Action_4_Condition FaultManager.SensVoltRangeLow.Mode FaultManager.SensVoltRangeLow.ID FaultManager.SensVoltRangeLow.Test FaultManager.SensVoltRangeLow.Faulty_Samples__X_ FaultManager.SensVoltRangeLow.Total_Samples__Y_ FaultManager.SensVoltRangeLow.Action_1 FaultManager.SensVoltRangeLow.Action_1_Condition FaultManager.SensVoltRangeLow.Action_2 FaultManager.SensVoltRangeLow.Action_2_Condition FaultManager.SensVoltRangeLow.Action_3 FaultManager.SensVoltRangeLow.Action_3_Condition FaultManager.SensVoltRangeLow.Action_4 FaultManager.SensVoltRangeLow.Action_4_Condition FaultManager.SoftOverBoost_Fault.Mode FaultManager.SoftOverBoost_Fault.ID FaultManager.SoftOverBoost_Fault.Test FaultManager.SoftOverBoost_Fault.Faulty_Samples__X_ FaultManager.SoftOverBoost_Fault.Total_Samples__Y_ FaultManager.SoftOverBoost_Fault.Action_1 FaultManager.SoftOverBoost_Fault.Action_1_Condition FaultManager.SoftOverBoost_Fault.Action_2 FaultManager.SoftOverBoost_Fault.Action_2_Condition FaultManager.SoftOverBoost_Fault.Action_3 FaultManager.SoftOverBoost_Fault.Action_3_Condition FaultManager.SoftOverBoost_Fault.Action_4 FaultManager.SoftOverBoost_Fault.Action_4_Condition FaultManager.SoftOverspeed.Mode FaultManager.SoftOverspeed.ID FaultManager.SoftOverspeed.Test FaultManager.SoftOverspeed.Faulty_Samples__X_ FaultManager.SoftOverspeed.Total_Samples__Y_ FaultManager.SoftOverspeed.Action_1 FaultManager.SoftOverspeed.Action_1_Condition FaultManager.SoftOverspeed.Action_2 FaultManager.SoftOverspeed.Action_2_Condition FaultManager.SoftOverspeed.Action_3 FaultManager.SoftOverspeed.Action_3_Condition FaultManager.SoftOverspeed.Action_4 FaultManager.SoftOverspeed.Action_4_Condition FaultManager.SysVoltRangeHigh.Mode FaultManager.SysVoltRangeHigh.ID FaultManager.SysVoltRangeHigh.Test FaultManager.SysVoltRangeHigh.Faulty_Samples__X_ FaultManager.SysVoltRangeHigh.Total_Samples__Y_ FaultManager.SysVoltRangeHigh.Action_1 FaultManager.SysVoltRangeHigh.Action_1_Condition FaultManager.SysVoltRangeHigh.Action_2 FaultManager.SysVoltRangeHigh.Action_2_Condition FaultManager.SysVoltRangeHigh.Action_3 FaultManager.SysVoltRangeHigh.Action_3_Condition FaultManager.SysVoltRangeHigh.Action_4 FaultManager.SysVoltRangeHigh.Action_4_Condition FaultManager.SysVoltRangeLow.Mode FaultManager.SysVoltRangeLow.ID FaultManager.SysVoltRangeLow.Test FaultManager.SysVoltRangeLow.Faulty_Samples__X_ FaultManager.SysVoltRangeLow.Total_Samples__Y_ FaultManager.SysVoltRangeLow.Action_1 FaultManager.SysVoltRangeLow.Action_1_Condition FaultManager.SysVoltRangeLow.Action_2 FaultManager.SysVoltRangeLow.Action_2_Condition FaultManager.SysVoltRangeLow.Action_3 FaultManager.SysVoltRangeLow.Action_3_Condition FaultManager.SysVoltRangeLow.Action_4 FaultManager.SysVoltRangeLow.Action_4_Condition FaultManager.TPS1AdaptHiMax.Mode FaultManager.TPS1AdaptHiMax.ID FaultManager.TPS1AdaptHiMax.Test FaultManager.TPS1AdaptHiMax.Faulty_Samples__X_ FaultManager.TPS1AdaptHiMax.Total_Samples__Y_ FaultManager.TPS1AdaptHiMax.Action_1 FaultManager.TPS1AdaptHiMax.Action_1_Condition FaultManager.TPS1AdaptHiMax.Action_2 FaultManager.TPS1AdaptHiMax.Action_2_Condition FaultManager.TPS1AdaptHiMax.Action_3 FaultManager.TPS1AdaptHiMax.Action_3_Condition FaultManager.TPS1AdaptHiMax.Action_4 FaultManager.TPS1AdaptHiMax.Action_4_Condition FaultManager.TPS1AdaptHiMin.Mode FaultManager.TPS1AdaptHiMin.ID FaultManager.TPS1AdaptHiMin.Test FaultManager.TPS1AdaptHiMin.Faulty_Samples__X_ FaultManager.TPS1AdaptHiMin.Total_Samples__Y_ FaultManager.TPS1AdaptHiMin.Action_1 FaultManager.TPS1AdaptHiMin.Action_1_Condition FaultManager.TPS1AdaptHiMin.Action_2 FaultManager.TPS1AdaptHiMin.Action_2_Condition FaultManager.TPS1AdaptHiMin.Action_3 FaultManager.TPS1AdaptHiMin.Action_3_Condition FaultManager.TPS1AdaptHiMin.Action_4 FaultManager.TPS1AdaptHiMin.Action_4_Condition FaultManager.TPS1AdaptLoMax.Mode FaultManager.TPS1AdaptLoMax.ID FaultManager.TPS1AdaptLoMax.Test FaultManager.TPS1AdaptLoMax.Faulty_Samples__X_ FaultManager.TPS1AdaptLoMax.Total_Samples__Y_ FaultManager.TPS1AdaptLoMax.Action_1 FaultManager.TPS1AdaptLoMax.Action_1_Condition FaultManager.TPS1AdaptLoMax.Action_2 FaultManager.TPS1AdaptLoMax.Action_2_Condition FaultManager.TPS1AdaptLoMax.Action_3 FaultManager.TPS1AdaptLoMax.Action_3_Condition FaultManager.TPS1AdaptLoMax.Action_4 FaultManager.TPS1AdaptLoMax.Action_4_Condition FaultManager.TPS1AdaptLoMin.Mode FaultManager.TPS1AdaptLoMin.ID FaultManager.TPS1AdaptLoMin.Test FaultManager.TPS1AdaptLoMin.Faulty_Samples__X_ FaultManager.TPS1AdaptLoMin.Total_Samples__Y_ FaultManager.TPS1AdaptLoMin.Action_1 FaultManager.TPS1AdaptLoMin.Action_1_Condition FaultManager.TPS1AdaptLoMin.Action_2 FaultManager.TPS1AdaptLoMin.Action_2_Condition FaultManager.TPS1AdaptLoMin.Action_3 FaultManager.TPS1AdaptLoMin.Action_3_Condition FaultManager.TPS1AdaptLoMin.Action_4 FaultManager.TPS1AdaptLoMin.Action_4_Condition FaultManager.TPS1RangeHigh.Mode FaultManager.TPS1RangeHigh.ID FaultManager.TPS1RangeHigh.Test FaultManager.TPS1RangeHigh.Faulty_Samples__X_ FaultManager.TPS1RangeHigh.Total_Samples__Y_ FaultManager.TPS1RangeHigh.Action_1 FaultManager.TPS1RangeHigh.Action_1_Condition FaultManager.TPS1RangeHigh.Action_2 FaultManager.TPS1RangeHigh.Action_2_Condition FaultManager.TPS1RangeHigh.Action_3 FaultManager.TPS1RangeHigh.Action_3_Condition FaultManager.TPS1RangeHigh.Action_4 FaultManager.TPS1RangeHigh.Action_4_Condition FaultManager.TPS1RangeLow.Mode FaultManager.TPS1RangeLow.ID FaultManager.TPS1RangeLow.Test FaultManager.TPS1RangeLow.Faulty_Samples__X_ FaultManager.TPS1RangeLow.Total_Samples__Y_ FaultManager.TPS1RangeLow.Action_1 FaultManager.TPS1RangeLow.Action_1_Condition FaultManager.TPS1RangeLow.Action_2 FaultManager.TPS1RangeLow.Action_2_Condition FaultManager.TPS1RangeLow.Action_3 FaultManager.TPS1RangeLow.Action_3_Condition FaultManager.TPS1RangeLow.Action_4 FaultManager.TPS1RangeLow.Action_4_Condition FaultManager.TPS2AdaptHiMax.Mode FaultManager.TPS2AdaptHiMax.ID FaultManager.TPS2AdaptHiMax.Test FaultManager.TPS2AdaptHiMax.Faulty_Samples__X_ FaultManager.TPS2AdaptHiMax.Total_Samples__Y_ FaultManager.TPS2AdaptHiMax.Action_1 FaultManager.TPS2AdaptHiMax.Action_1_Condition FaultManager.TPS2AdaptHiMax.Action_2 FaultManager.TPS2AdaptHiMax.Action_2_Condition FaultManager.TPS2AdaptHiMax.Action_3 FaultManager.TPS2AdaptHiMax.Action_3_Condition FaultManager.TPS2AdaptHiMax.Action_4 FaultManager.TPS2AdaptHiMax.Action_4_Condition FaultManager.TPS2AdaptHiMin.Mode FaultManager.TPS2AdaptHiMin.ID FaultManager.TPS2AdaptHiMin.Test FaultManager.TPS2AdaptHiMin.Faulty_Samples__X_ FaultManager.TPS2AdaptHiMin.Total_Samples__Y_ FaultManager.TPS2AdaptHiMin.Action_1 FaultManager.TPS2AdaptHiMin.Action_1_Condition FaultManager.TPS2AdaptHiMin.Action_2 FaultManager.TPS2AdaptHiMin.Action_2_Condition FaultManager.TPS2AdaptHiMin.Action_3 FaultManager.TPS2AdaptHiMin.Action_3_Condition FaultManager.TPS2AdaptHiMin.Action_4 FaultManager.TPS2AdaptHiMin.Action_4_Condition FaultManager.TPS2AdaptLoMax.Mode FaultManager.TPS2AdaptLoMax.ID FaultManager.TPS2AdaptLoMax.Test FaultManager.TPS2AdaptLoMax.Faulty_Samples__X_ FaultManager.TPS2AdaptLoMax.Total_Samples__Y_ FaultManager.TPS2AdaptLoMax.Action_1 FaultManager.TPS2AdaptLoMax.Action_1_Condition FaultManager.TPS2AdaptLoMax.Action_2 FaultManager.TPS2AdaptLoMax.Action_2_Condition FaultManager.TPS2AdaptLoMax.Action_3 FaultManager.TPS2AdaptLoMax.Action_3_Condition FaultManager.TPS2AdaptLoMax.Action_4 FaultManager.TPS2AdaptLoMax.Action_4_Condition FaultManager.TPS2AdaptLoMin.Mode FaultManager.TPS2AdaptLoMin.ID FaultManager.TPS2AdaptLoMin.Test FaultManager.TPS2AdaptLoMin.Faulty_Samples__X_ FaultManager.TPS2AdaptLoMin.Total_Samples__Y_ FaultManager.TPS2AdaptLoMin.Action_1 FaultManager.TPS2AdaptLoMin.Action_1_Condition FaultManager.TPS2AdaptLoMin.Action_2 FaultManager.TPS2AdaptLoMin.Action_2_Condition FaultManager.TPS2AdaptLoMin.Action_3 FaultManager.TPS2AdaptLoMin.Action_3_Condition FaultManager.TPS2AdaptLoMin.Action_4 FaultManager.TPS2AdaptLoMin.Action_4_Condition FaultManager.TPS2RangeHigh.Mode FaultManager.TPS2RangeHigh.ID FaultManager.TPS2RangeHigh.Test FaultManager.TPS2RangeHigh.Faulty_Samples__X_ FaultManager.TPS2RangeHigh.Total_Samples__Y_ FaultManager.TPS2RangeHigh.Action_1 FaultManager.TPS2RangeHigh.Action_1_Condition FaultManager.TPS2RangeHigh.Action_2 FaultManager.TPS2RangeHigh.Action_2_Condition FaultManager.TPS2RangeHigh.Action_3 FaultManager.TPS2RangeHigh.Action_3_Condition FaultManager.TPS2RangeHigh.Action_4 FaultManager.TPS2RangeHigh.Action_4_Condition FaultManager.TPS2RangeLow.Mode FaultManager.TPS2RangeLow.ID FaultManager.TPS2RangeLow.Test FaultManager.TPS2RangeLow.Faulty_Samples__X_ FaultManager.TPS2RangeLow.Total_Samples__Y_ FaultManager.TPS2RangeLow.Action_1 FaultManager.TPS2RangeLow.Action_1_Condition FaultManager.TPS2RangeLow.Action_2 FaultManager.TPS2RangeLow.Action_2_Condition FaultManager.TPS2RangeLow.Action_3 FaultManager.TPS2RangeLow.Action_3_Condition FaultManager.TPS2RangeLow.Action_4 FaultManager.TPS2RangeLow.Action_4_Condition FaultManager.TPS_Sensors_Conflict.Mode FaultManager.TPS_Sensors_Conflict.ID FaultManager.TPS_Sensors_Conflict.Test FaultManager.TPS_Sensors_Conflict.Faulty_Samples__X_ FaultManager.TPS_Sensors_Conflict.Total_Samples__Y_ FaultManager.TPS_Sensors_Conflict.Action_1 FaultManager.TPS_Sensors_Conflict.Action_1_Condition FaultManager.TPS_Sensors_Conflict.Action_2 FaultManager.TPS_Sensors_Conflict.Action_2_Condition FaultManager.TPS_Sensors_Conflict.Action_3 FaultManager.TPS_Sensors_Conflict.Action_3_Condition FaultManager.TPS_Sensors_Conflict.Action_4 FaultManager.TPS_Sensors_Conflict.Action_4_Condition FaultManager.VSPDRangeHigh.Mode FaultManager.VSPDRangeHigh.ID FaultManager.VSPDRangeHigh.Test FaultManager.VSPDRangeHigh.Faulty_Samples__X_ FaultManager.VSPDRangeHigh.Total_Samples__Y_ FaultManager.VSPDRangeHigh.Action_1 FaultManager.VSPDRangeHigh.Action_1_Condition FaultManager.VSPDRangeHigh.Action_2 FaultManager.VSPDRangeHigh.Action_2_Condition FaultManager.VSPDRangeHigh.Action_3 FaultManager.VSPDRangeHigh.Action_3_Condition FaultManager.VSPDRangeHigh.Action_4 FaultManager.VSPDRangeHigh.Action_4_Condition FaultManager.VSPDRangeLow.Mode FaultManager.VSPDRangeLow.ID FaultManager.VSPDRangeLow.Test FaultManager.VSPDRangeLow.Faulty_Samples__X_ FaultManager.VSPDRangeLow.Total_Samples__Y_ FaultManager.VSPDRangeLow.Action_1 FaultManager.VSPDRangeLow.Action_1_Condition FaultManager.VSPDRangeLow.Action_2 FaultManager.VSPDRangeLow.Action_2_Condition FaultManager.VSPDRangeLow.Action_3 FaultManager.VSPDRangeLow.Action_3_Condition FaultManager.VSPDRangeLow.Action_4 FaultManager.VSPDRangeLow.Action_4_Condition FaultManager.VoltLow_Fault.Mode FaultManager.VoltLow_Fault.ID FaultManager.VoltLow_Fault.Test FaultManager.VoltLow_Fault.Faulty_Samples__X_ FaultManager.VoltLow_Fault.Total_Samples__Y_ FaultManager.VoltLow_Fault.Action_1 FaultManager.VoltLow_Fault.Action_1_Condition FaultManager.VoltLow_Fault.Action_2 FaultManager.VoltLow_Fault.Action_2_Condition FaultManager.VoltLow_Fault.Action_3 FaultManager.VoltLow_Fault.Action_3_Condition FaultManager.VoltLow_Fault.Action_4 FaultManager.VoltLow_Fault.Action_4_Condition FaultManager.VoltTooHigh_Fault.Mode FaultManager.VoltTooHigh_Fault.ID FaultManager.VoltTooHigh_Fault.Test FaultManager.VoltTooHigh_Fault.Faulty_Samples__X_ FaultManager.VoltTooHigh_Fault.Total_Samples__Y_ FaultManager.VoltTooHigh_Fault.Action_1 FaultManager.VoltTooHigh_Fault.Action_1_Condition FaultManager.VoltTooHigh_Fault.Action_2 FaultManager.VoltTooHigh_Fault.Action_2_Condition FaultManager.VoltTooHigh_Fault.Action_3 FaultManager.VoltTooHigh_Fault.Action_3_Condition FaultManager.VoltTooHigh_Fault.Action_4 FaultManager.VoltTooHigh_Fault.Action_4_Condition FaultManager.Wastegate_Fault.Mode FaultManager.Wastegate_Fault.ID FaultManager.Wastegate_Fault.Test FaultManager.Wastegate_Fault.Faulty_Samples__X_ FaultManager.Wastegate_Fault.Total_Samples__Y_ FaultManager.Wastegate_Fault.Action_1 FaultManager.Wastegate_Fault.Action_1_Condition FaultManager.Wastegate_Fault.Action_2 FaultManager.Wastegate_Fault.Action_2_Condition FaultManager.Wastegate_Fault.Action_3 FaultManager.Wastegate_Fault.Action_3_Condition FaultManager.Wastegate_Fault.Action_4 FaultManager.Wastegate_Fault.Action_4_Condition /end DEF_CHARACTERISTIC
/end FUNCTION
/begin FUNCTION AC_Override "" /begin DEF_CHARACTERISTIC AC_new AC_ovr /end DEF_CHARACTERISTIC /end FUNCTION
/begin FUNCTION AC_Config "" /begin DEF_CHARACTERISTIC AC_Polarity /end DEF_CHARACTERISTIC /end FUNCTION
/begin FUNCTION AC_Control_1 ""
 /begin DEF_CHARACTERISTIC AC_TPSOff AC_TPSOn ACHighPresOff ACHighPresOn ACLowPresOff ACLowPresOn ACSpdFastOff ACSpdFastOn ACSpdSlowOff ACSpdSlowOn ACTempOff ACTempOn ACTimeFromStartDelay /end DEF_CHARACTERISTIC
 /begin OUT_MEASUREMENT ACLowChrg ACOutput ACOverPressure ACRpmHighEnbl ACRpmLowEnbl ACTempEnbl ACTpsEnble /end OUT_MEASUREMENT
/end FUNCTION
/begin FUNCTION Run ""
 /begin SUB_FUNCTION AC_Control_1 MinGovernor FAN_Control_1 Fuel_System_Manager AirFlow_Manager O2_Control Base_Equiv_Ratio Spark_Manager Boost_Control DFCO MaxGovernor /end SUB_FUNCTION
/end FUNCTION
/begin FUNCTION Controller "" /begin SUB_FUNCTION Run Stall Crank /end SUB_FUNCTION /end FUNCTION
/begin FUNCTION Control ""
 /begin SUB_FUNCTION Controller Diagnostics VirtualSensors ActuatorCharacterization /end SUB_FUNCTION
/end FUNCTION
/begin FUNCTION AiflowOffset "" /begin DEF_CHARACTERISTIC ACAirFlowOfst_Enab ACAirFlowOfstTbl BaseAirflowOfstTbl /end DEF_CHARACTERISTIC /begin OUT_MEASUREMENT ACAirFlowOfst BaseAirflowOfst BaseAirOffset /end OUT_MEASUREMENT /begin SUB_FUNCTION Ramp_Air_Into_Idle_State /end SUB_FUNCTION /end FUNCTION
/begin FUNCTION MinGovernor "" /begin DEF_CHARACTERISTIC IdleExitTimeConst /end DEF_CHARACTERISTIC
 /begin OUT_MEASUREMENT AirMinGovOutput IdleHandOffMult MinGovReset SpkMinGovOutput /end OUT_MEASUREMENT
 /begin SUB_FUNCTION AiflowOffset Universal_PID__Tunable___Scheduled_ Air_PID_Config Base_Airflow_Table_Adapt Idle_State_Determination Ramp_RPM Base_RPM_Set_Pt MotoringDetection Universal_PD__Tunable___Scheduled_ /end SUB_FUNCTION
/end FUNCTION
/begin FUNCTION AC_Fault "" /begin DEF_CHARACTERISTIC ACHighPressureDisable ACLowPressureDisable /end DEF_CHARACTERISTIC /end FUNCTION
/begin FUNCTION Diagnostics ""
 /begin SUB_FUNCTION AC_Fault AirFlow Overspeed_Protection Boost_Fault MISFIRE Digital_Sensors Fuel_Economy Wrong_Fuel_Pressure_Fault_Logic O2_Smart_Sensor Lean_Protect Low_Voltage MAP_Fault_Logic Low_Oil_Pressure_Fault_Logic Engine_Overheat_Fault_Logic /end SUB_FUNCTION
/end FUNCTION
/begin FUNCTION Outputs_Config ""
 /begin DEF_CHARACTERISTIC ACPin EST_InitialPin EST_OpenThreshold EST_SequenceType ETCPin FAN1Pin_PWM FAN2Pin_PWM FuelPumpPin IAC_PPin IAC_SPin INJ_Behavior INJ_InitialPin INJ_SequenceType WASTEGATE /end DEF_CHARACTERISTIC
/end FUNCTION
/begin FUNCTION I_O_Pins "" /begin SUB_FUNCTION Outputs_Config Inputs_Config Frequency_In_Config /end SUB_FUNCTION /end FUNCTION
/begin FUNCTION ACPres "" /begin OUT_MEASUREMENT ACPres ACPresADC ACPresRaw /end OUT_MEASUREMENT /begin SUB_FUNCTION ACPres_Override ACPres_Config /end SUB_FUNCTION /end FUNCTION
/begin FUNCTION LinearSensors ""
 /begin SUB_FUNCTION ACPres FuelOxygenationSensor FuelPres FuelSens _MAP MAPTime OilPres SensVolt SysVolt /end SUB_FUNCTION
/end FUNCTION
/begin FUNCTION Inputs ""
 /begin SUB_FUNCTION LinearSensors Digital PotentiometerSensors CAN EngineSpeed NonLinearSensors /end SUB_FUNCTION
/end FUNCTION
/begin FUNCTION ACPres_Override "" /begin DEF_CHARACTERISTIC ACPres_new ACPres_ovr /end DEF_CHARACTERISTIC /end FUNCTION
/begin FUNCTION ACPres_Index "" /begin OUT_MEASUREMENT ACPres05Idx ACPres05In ACPres07Idx ACPres07In /end OUT_MEASUREMENT /end FUNCTION
/begin FUNCTION Raw_Indexes ""
 /begin SUB_FUNCTION ACPres_Index CAT_Index ECT_Index IAT_Indexes MAP_Indexes OXY_Index RPM_Indexes SysVolt_Index TPS_Indexes VSPD_Index /end SUB_FUNCTION
/end FUNCTION
/begin FUNCTION VirtualSensors ""
 /begin SUB_FUNCTION Raw_Indexes Virtual_Indexes RawProcessed AirCalcs FuelLevel LoadBasedCalcs /end SUB_FUNCTION
/end FUNCTION
/begin FUNCTION ACPres_Config ""
 /begin DEF_CHARACTERISTIC ACPresDfltValue ACPresFilterConst ACPresGain ACPresInputHiFltPos ACPresInputLoFltPos ACPresOfst /end DEF_CHARACTERISTIC
/end FUNCTION
/begin FUNCTION FAN_Control ""
 /begin DEF_CHARACTERISTIC ACPresFanOff ACPresFanOn ACPresFanSpeed_StallTbl ACSwFanSpeed_Stall ECTFanOff ECTFanOn ECTFanSpeed_StallTbl FAN_Mode Fan1ACPres Fan1ACSw Fan1ECT Fan1IAT Fan2ACPres Fan2ACSw Fan2ECT Fan2IAT IATFanOff IATFanOn IATFanSpeed_StallTbl /end DEF_CHARACTERISTIC
 /begin OUT_MEASUREMENT ACPresFanSpeed_Stall ECTFanSpeed_Stall IATFanSpeed_Stall /end OUT_MEASUREMENT
/end FUNCTION
/begin FUNCTION Stall "" /begin SUB_FUNCTION FAN_Control Fuel_Pump_at_Startup Stall_Throttle /end SUB_FUNCTION /end FUNCTION
/begin FUNCTION FAN_Control_1 ""
 /begin DEF_CHARACTERISTIC ACPresFanSpeedMap ACSwFanSpeed ECTFanSpeedMap IATFanSpeedMap /end DEF_CHARACTERISTIC
 /begin OUT_MEASUREMENT ACPresFanSpeed ECTFanSpeed Fan1Cmd Fan2Cmd IATFanSpeed /end OUT_MEASUREMENT
/end FUNCTION
/end MODULE
/end PROJECT
