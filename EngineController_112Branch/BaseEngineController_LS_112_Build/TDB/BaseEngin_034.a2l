/******************************************************************************
* ASAP2 descrition file /
* Generated by Woodward ASAP2 Generator /
* This file was auto-generated on: Tuesday, November 22, 2022 1:58 PM /
******************************************************************************/
ASAP2_VERSION 1 51
/begin PROJECT Project ""
/begin MODULE BaseEngin_034 ""
/begin IF_DATA VISION DEVICE_SETTING "CCP=2.1_ASAP1b" DEVICE_SETTING "DefaultCRCType=5" /end IF_DATA
/begin IF_DATA ASAP1B_CCP
 /begin SOURCE "List 1" 0 0 DISPLAY_IDENTIFIER "DAQ1"
  /begin QP_BLOB 0 LENGTH 8 CAN_ID_FIXED 0x98EF3102 RASTER 0 REDUCTION_ALLOWED FIRST_PID 0 /end QP_BLOB
 /end SOURCE
 /begin SOURCE "List 2" 0 0 DISPLAY_IDENTIFIER "DAQ2"
  /begin QP_BLOB 1 LENGTH 8 CAN_ID_FIXED 0x98EF3102 RASTER 1 REDUCTION_ALLOWED FIRST_PID 8 /end QP_BLOB
 /end SOURCE
 /begin SOURCE "List 3" 0 0 DISPLAY_IDENTIFIER "DAQ3"
  /begin QP_BLOB 2 LENGTH 8 CAN_ID_FIXED 0x98EF3102 RASTER 2 REDUCTION_ALLOWED FIRST_PID 16 /end QP_BLOB
 /end SOURCE
 /begin SOURCE "List 4" 0 0 DISPLAY_IDENTIFIER "DAQ4"
  /begin QP_BLOB 3 LENGTH 8 CAN_ID_FIXED 0x98EF3102 RASTER 3 REDUCTION_ALLOWED FIRST_PID 24 /end QP_BLOB
 /end SOURCE
 /begin SOURCE "List 5" 0 0 DISPLAY_IDENTIFIER "DAQ5"
  /begin QP_BLOB 4 LENGTH 8 CAN_ID_FIXED 0x98EF3102 RASTER 4 REDUCTION_ALLOWED FIRST_PID 32 /end QP_BLOB
 /end SOURCE
 /begin SOURCE "List 6" 0 0 DISPLAY_IDENTIFIER "DAQ6"
  /begin QP_BLOB 5 LENGTH 8 CAN_ID_FIXED 0x98EF3102 RASTER 5 REDUCTION_ALLOWED FIRST_PID 40 /end QP_BLOB
 /end SOURCE
 /begin SOURCE "List 7" 0 0 DISPLAY_IDENTIFIER "DAQ7"
  /begin QP_BLOB 6 LENGTH 8 CAN_ID_FIXED 0x98EF3102 RASTER 6 REDUCTION_ALLOWED FIRST_PID 48 /end QP_BLOB
 /end SOURCE
 /begin SOURCE "List 8" 0 0 DISPLAY_IDENTIFIER "DAQ8"
  /begin QP_BLOB 7 LENGTH 8 CAN_ID_FIXED 0x98EF3102 RASTER 7 REDUCTION_ALLOWED FIRST_PID 56 /end QP_BLOB
 /end SOURCE
 /begin SOURCE "List 9" 0 0 DISPLAY_IDENTIFIER "DAQ9"
  /begin QP_BLOB 8 LENGTH 8 CAN_ID_FIXED 0x98EF3102 RASTER 7 REDUCTION_ALLOWED FIRST_PID 64 /end QP_BLOB
 /end SOURCE
 /begin SOURCE "List 10" 0 0 DISPLAY_IDENTIFIER "DAQ10"
  /begin QP_BLOB 9 LENGTH 8 CAN_ID_FIXED 0x98EF3102 RASTER 7 REDUCTION_ALLOWED FIRST_PID 72 /end QP_BLOB
 /end SOURCE
 /begin RASTER "FGND_RTI_PERIODIC" "FGND_RTI_PERIODIC" 0 3 5 /end RASTER
 /begin RASTER "FGND_5XRTI_PERIODIC" "FGND_5XRTI_PERIODIC" 1 3 25 /end RASTER
 /begin RASTER "FGND_MID_TDC_EVENT" "FGND_MID_TDC_EVENT" 2 103 1 /end RASTER
 /begin RASTER "FGND_20XRTI_PERIODIC" "FGND_20XRTI_PERIODIC" 3 3 100 /end RASTER
 /begin RASTER "BGND_BASE_PERIODIC" "BGND_BASE_PERIODIC" 4 3 50 /end RASTER
 /begin RASTER "BGND_BASEx2_PERIODIC" "BGND_BASEx2_PERIODIC" 5 3 100 /end RASTER
 /begin RASTER "BGND_BASEx10_PERIODIC" "BGND_BASEx10_PERIODIC" 6 3 500 /end RASTER
 /begin RASTER "ONE_SECOND_EVENT" "ONE_SECOND_EVENT" 7 3 1000 /end RASTER
 /* /begin SEED_KEY */ /* DLL for CAL */ /* Uncomment and supply a value "SecurityCAL.dll" */ /* DLL for DAQ */ /* Uncomment and supply a value "SecurityDAQ.dll" */ /* DLL for PGM */ /* Uncomment and supply a value "SecurityPGM.dll" */ /* /end SEED_KEY */
 /begin TP_BLOB /* CCP version */ 0x201 /* Blob version */ 0x204 /* CAN msg ID - send */ 0x98EF0231 /* CAN msg ID - recv */ 0x98EF3102 /* Station address */ 0x31 /* byte order */ 1 BAUDRATE 500000 SAMPLE_RATE 1 SAMPLE_POINT 75 BTL_CYCLES 8 SJW 2 SYNC_EDGE SINGLE DAQ_MODE BURST CONSISTENCY ODT ADDRESS_EXTENSION DAQ
  /begin CHECKSUM_PARAM /* algorithm */ 0x8009 /* limit */ 0x1000 CHECKSUM_CALCULATION ACTIVE_PAGE /end CHECKSUM_PARAM
  /begin DEFINED_PAGES /* Memory page num */ 1 /* Page Name */ "working page" /* address ext. */ 0x00 /* base address */ 0x80000000 /* page length */ 0x00006780 RAM /* memory page in RAM */ RAM_INIT_BY_ECU /* memory page is initialised by ECU start-up */ /end DEFINED_PAGES
  OPTIONAL_CMD 0x5 /* TEST */ OPTIONAL_CMD 0x8 /* START_STOP_ALL */ OPTIONAL_CMD 0xC /* SET_S_STATUS */ OPTIONAL_CMD 0xD /* GET_S_STATUS */ OPTIONAL_CMD 0xE /* BUILD_CHECKSUM */ OPTIONAL_CMD 0xF /* SHORT_UP */ OPTIONAL_CMD 0x12 /* GET_SEED */ OPTIONAL_CMD 0x13 /* UNLOCK */ OPTIONAL_CMD 0x23 /* DNLOAD_6 */ /end TP_BLOB
/end IF_DATA
/*~~~~~~~~~ 6.3.91 MOD_PAR ~~~~~~~~~*/
/begin MOD_PAR /* MOD_PAR Comment*/ "" ECU_CALIBRATION_OFFSET 0x00000000
 /begin MEMORY_SEGMENT CAL "" DATA FLASH INTERN 0x80000000 /* Size */ 0x00006780 /* Offset */ -1 -1 -1 -1 -1 /end MEMORY_SEGMENT
 /begin MEMORY_SEGMENT MeasRAM "" VARIABLES RAM INTERN 0x40000000 /* Size */ 0x00000B80 /* Offset */ -1 -1 -1 -1 -1 /end MEMORY_SEGMENT
/end MOD_PAR
/begin MOD_COMMON /* MOD_COMMON Comment */ "" BYTE_ORDER MSB_FIRST ALIGNMENT_BYTE 1 ALIGNMENT_FLOAT32_IEEE 1 ALIGNMENT_FLOAT64_IEEE 1 ALIGNMENT_LONG 1 ALIGNMENT_WORD 1 /end MOD_COMMON
/*~~~~~~~~~ 6.3.86 MEASUREMENTs ~~~~~~~~~*/
/begin MEASUREMENT project_id "This is the Platform ID used by the tools." UBYTE CompuMethod_1 1 0 0 255 ECU_ADDRESS 0x40000B7F /end MEASUREMENT
/begin MEASUREMENT table_0_rev "This is Table0 Revision Number" UBYTE CompuMethod_1 1 0 0 255 ECU_ADDRESS 0x40000001 /end MEASUREMENT
/begin MEASUREMENT table_1_rev "This is Table1 Revision Number" UBYTE CompuMethod_1 1 0 0 255 ECU_ADDRESS 0x40000002 /end MEASUREMENT
/begin MEASUREMENT table_2_rev "This is Table2 Revision Number" UBYTE CompuMethod_1 1 0 0 255 ECU_ADDRESS 0x40000003 /end MEASUREMENT
/begin MEASUREMENT Protocol_KeySuite_Rev "MotoTron KeySuite Protocol Version (Key/ERI)" UBYTE CompuMethod_1 1 0 0 255 ECU_ADDRESS 0x40000005 /end MEASUREMENT
/begin MEASUREMENT EriRev "This is the revision for the ERI protocol." UBYTE CompuMethod_1 1 0 0 255 ECU_ADDRESS 0x40000006 /end MEASUREMENT
/begin MEASUREMENT table_3_rev "This is Table3 Revision Number" UBYTE CompuMethod_1 1 0 0 255 ECU_ADDRESS 0x40000007 /end MEASUREMENT
/begin MEASUREMENT table_4_rev "This is Table4 Revision Number" UBYTE CompuMethod_1 1 0 0 255 ECU_ADDRESS 0x40000008 /end MEASUREMENT
/begin MEASUREMENT table_5_rev "This is Table5 Revision Number" UBYTE CompuMethod_1 1 0 0 255 ECU_ADDRESS 0x40000009 /end MEASUREMENT
/begin MEASUREMENT table_6_rev "This is Table6 Revision Number" UBYTE CompuMethod_1 1 0 0 255 ECU_ADDRESS 0x4000000A /end MEASUREMENT
/begin MEASUREMENT table_7_rev "This is Table7 Revision Number" UBYTE CompuMethod_1 1 0 0 255 ECU_ADDRESS 0x4000000B /end MEASUREMENT
/begin MEASUREMENT ProductID "Customer's ID used by the tools." ULONG CompuMethod_3 1 0 0 4294970000 ECU_ADDRESS 0x40000075 /end MEASUREMENT
/begin MEASUREMENT MotProgRev "MotoTron Programming Interface Version" UBYTE CompuMethod_1 1 0 0 255 ECU_ADDRESS 0x40000079 /end MEASUREMENT
/begin MEASUREMENT BootVerMaj "" UBYTE CompuMethod_1 1 0 0 255 ECU_ADDRESS 0x4000007A /end MEASUREMENT
/begin MEASUREMENT BootVerMin "" UBYTE CompuMethod_1 1 0 0 255 ECU_ADDRESS 0x4000007B /end MEASUREMENT
/begin MEASUREMENT EcuHwMaj "" UBYTE CompuMethod_4 1 0 0 255 ECU_ADDRESS 0x4000007C /end MEASUREMENT
/begin MEASUREMENT EcuHwMin "" UBYTE CompuMethod_1 1 0 0 255 ECU_ADDRESS 0x4000007D /end MEASUREMENT
/begin MEASUREMENT ApplicationCompatibilityArr "Software Format ID" UWORD CompuMethod_5 1 0 0 65535 ECU_ADDRESS 0x4000007E MATRIX_DIM 1 50 1 /end MEASUREMENT
/begin MEASUREMENT AC "Display output in engineering units" UBYTE CompuMethod_6 1 0 0 1 ECU_ADDRESS 0x40000144 /end MEASUREMENT
/begin MEASUREMENT Capability "" UBYTE CompuMethod_58 1 0 0 255 ECU_ADDRESS 0x400002B6 /end MEASUREMENT
/begin MEASUREMENT FaultMarquees.FaultMarquees.Current_Suspected "Displays a rolling marquee for suspected, active and occurred faults." UBYTE CompuMethod_103 1 0 0 255 ECU_ADDRESS 0x400004EA /end MEASUREMENT
/begin MEASUREMENT FaultMarquees.FaultMarquees.Current_Active "Displays a rolling marquee for suspected, active and occurred faults." UBYTE CompuMethod_103 1 0 0 255 ECU_ADDRESS 0x400004EB /end MEASUREMENT
/begin MEASUREMENT FaultMarquees.FaultMarquees.Current_Occurred "Displays a rolling marquee for suspected, active and occurred faults." UBYTE CompuMethod_103 1 0 0 255 ECU_ADDRESS 0x400004EC /end MEASUREMENT
/begin MEASUREMENT MotoHawkModelSecondsInUse "Total runtime of this MotoHawk software model" ULONG CompuMethod_131 1 0 0 4294970000 ECU_ADDRESS 0x4000089B /end MEASUREMENT
/*~~~~~~~~~ 6.3.27 CHARACTERISTICs ~~~~~~~~~*/
/begin CHARACTERISTIC SwIdTxt "Software Format ID" ASCII 0x4000000C RecordLayout_1 0 CompuMethod_2 0 255 NUMBER 13 MATRIX_DIM 13 1 1 READ_ONLY /end CHARACTERISTIC
/begin CHARACTERISTIC CalIdTxt "Calibration ID" ASCII 0x80000000 RecordLayout_1 0 CompuMethod_2 0 255 NUMBER 35 MATRIX_DIM 35 1 1 /end CHARACTERISTIC
/begin CHARACTERISTIC SwRevisionTxt "Software Revision ID" ASCII 0x40000019 RecordLayout_1 0 CompuMethod_2 0 255 NUMBER 50 MATRIX_DIM 50 1 1 READ_ONLY /end CHARACTERISTIC
/begin CHARACTERISTIC FriendlyName "The device's friendly name." ASCII 0x40000054 RecordLayout_1 0 CompuMethod_2 0 255 NUMBER 33 MATRIX_DIM 33 1 1 READ_ONLY /end CHARACTERISTIC
/begin CHARACTERISTIC SerialNumber "Module Serial Number" ASCII 0x400000E2 RecordLayout_1 0 CompuMethod_2 0 255 NUMBER 49 MATRIX_DIM 49 1 1 READ_ONLY /end CHARACTERISTIC
/begin CHARACTERISTIC ModelNumber "Module Model Number" ASCII 0x40000113 RecordLayout_1 0 CompuMethod_2 0 255 NUMBER 49 MATRIX_DIM 49 1 1 READ_ONLY /end CHARACTERISTIC
/begin CHARACTERISTIC CompilerVersion "Compiler toolchain version used for the MotoHawk build" ASCII 0x400002F0 RecordLayout_1 0 CompuMethod_2 0 255 NUMBER 80 MATRIX_DIM 80 1 1 READ_ONLY /end CHARACTERISTIC
/begin CHARACTERISTIC FaultCommand "Select a command to control the fault manager." VALUE 0x80002786 RecordLayout_2 0 CompuMethod_104 0 255 /end CHARACTERISTIC
/begin CHARACTERISTIC FaultManager.ACChargeHigh_Fault.Mode "Fault manager configuration.  Select up to 4 actions for each fault." VALUE 0x80002787 RecordLayout_3 0 CompuMethod_105 0 65535 /end CHARACTERISTIC
/begin CHARACTERISTIC FaultManager.ACChargeHigh_Fault.ID "Fault manager configuration.  Select up to 4 actions for each fault." VALUE 0x80002789 RecordLayout_3 0 CompuMethod_1 0 65535 /end CHARACTERISTIC
/begin CHARACTERISTIC FaultManager.ACChargeHigh_Fault.Test "Fault manager configuration.  Select up to 4 actions for each fault." VALUE 0x8000278B RecordLayout_3 0 CompuMethod_106 0 65535 /end CHARACTERISTIC
/begin CHARACTERISTIC FaultManager.ACChargeHigh_Fault.Faulty_Samples__X_ "Fault manager configuration.  Select up to 4 actions for each fault." VALUE 0x8000278D RecordLayout_3 0 CompuMethod_1 0 65535 /end CHARACTERISTIC
/begin CHARACTERISTIC FaultManager.ACChargeHigh_Fault.Total_Samples__Y_ "Fault manager configuration.  Select up to 4 actions for each fault." VALUE 0x8000278F RecordLayout_3 0 CompuMethod_1 0 65535 /end CHARACTERISTIC
/begin CHARACTERISTIC FaultManager.ACChargeHigh_Fault.Action_1 "Fault manager configuration.  Select up to 4 actions for each fault." VALUE 0x80002791 RecordLayout_3 0 CompuMethod_107 0 65535 /end CHARACTERISTIC
/begin CHARACTERISTIC FaultManager.ACChargeHigh_Fault.Action_1_Condition "Fault manager configuration.  Select up to 4 actions for each fault." VALUE 0x80002793 RecordLayout_3 0 CompuMethod_108 0 65535 /end CHARACTERISTIC
/begin CHARACTERISTIC FaultManager.ACChargeHigh_Fault.Action_2 "Fault manager configuration.  Select up to 4 actions for each fault." VALUE 0x80002795 RecordLayout_3 0 CompuMethod_107 0 65535 /end CHARACTERISTIC
/begin CHARACTERISTIC FaultManager.ACChargeHigh_Fault.Action_2_Condition "Fault manager configuration.  Select up to 4 actions for each fault." VALUE 0x80002797 RecordLayout_3 0 CompuMethod_108 0 65535 /end CHARACTERISTIC
/begin CHARACTERISTIC FaultManager.ACChargeHigh_Fault.Action_3 "Fault manager configuration.  Select up to 4 actions for each fault." VALUE 0x80002799 RecordLayout_3 0 CompuMethod_107 0 65535 /end CHARACTERISTIC
/begin CHARACTERISTIC FaultManager.ACChargeHigh_Fault.Action_3_Condition "Fault manager configuration.  Select up to 4 actions for each fault." VALUE 0x8000279B RecordLayout_3 0 CompuMethod_108 0 65535 /end CHARACTERISTIC
/begin CHARACTERISTIC FaultManager.ACChargeHigh_Fault.Action_4 "Fault manager configuration.  Select up to 4 actions for each fault." VALUE 0x8000279D RecordLayout_3 0 CompuMethod_107 0 65535 /end CHARACTERISTIC
/begin CHARACTERISTIC FaultManager.ACChargeHigh_Fault.Action_4_Condition "Fault manager configuration.  Select up to 4 actions for each fault." VALUE 0x8000279F RecordLayout_3 0 CompuMethod_108 0 65535 /end CHARACTERISTIC
/begin CHARACTERISTIC FaultManager.ACChargeLow_Fault.Mode "Fault manager configuration.  Select up to 4 actions for each fault." VALUE 0x800027A1 RecordLayout_3 0 CompuMethod_105 0 65535 /end CHARACTERISTIC
/begin CHARACTERISTIC FaultManager.ACChargeLow_Fault.ID "Fault manager configuration.  Select up to 4 actions for each fault." VALUE 0x800027A3 RecordLayout_3 0 CompuMethod_1 0 65535 /end CHARACTERISTIC
/begin CHARACTERISTIC FaultManager.ACChargeLow_Fault.Test "Fault manager configuration.  Select up to 4 actions for each fault." VALUE 0x800027A5 RecordLayout_3 0 CompuMethod_106 0 65535 /end CHARACTERISTIC
/begin CHARACTERISTIC FaultManager.ACChargeLow_Fault.Faulty_Samples__X_ "Fault manager configuration.  Select up to 4 actions for each fault." VALUE 0x800027A7 RecordLayout_3 0 CompuMethod_1 0 65535 /end CHARACTERISTIC
/begin CHARACTERISTIC FaultManager.ACChargeLow_Fault.Total_Samples__Y_ "Fault manager configuration.  Select up to 4 actions for each fault." VALUE 0x800027A9 RecordLayout_3 0 CompuMethod_1 0 65535 /end CHARACTERISTIC
/begin CHARACTERISTIC FaultManager.ACChargeLow_Fault.Action_1 "Fault manager configuration.  Select up to 4 actions for each fault." VALUE 0x800027AB RecordLayout_3 0 CompuMethod_107 0 65535 /end CHARACTERISTIC
/begin CHARACTERISTIC FaultManager.ACChargeLow_Fault.Action_1_Condition "Fault manager configuration.  Select up to 4 actions for each fault." VALUE 0x800027AD RecordLayout_3 0 CompuMethod_108 0 65535 /end CHARACTERISTIC
/begin CHARACTERISTIC FaultManager.ACChargeLow_Fault.Action_2 "Fault manager configuration.  Select up to 4 actions for each fault." VALUE 0x800027AF RecordLayout_3 0 CompuMethod_107 0 65535 /end CHARACTERISTIC
/begin CHARACTERISTIC FaultManager.ACChargeLow_Fault.Action_2_Condition "Fault manager configuration.  Select up to 4 actions for each fault." VALUE 0x800027B1 RecordLayout_3 0 CompuMethod_108 0 65535 /end CHARACTERISTIC
/begin CHARACTERISTIC FaultManager.ACChargeLow_Fault.Action_3 "Fault manager configuration.  Select up to 4 actions for each fault." VALUE 0x800027B3 RecordLayout_3 0 CompuMethod_107 0 65535 /end CHARACTERISTIC
/begin CHARACTERISTIC FaultManager.ACChargeLow_Fault.Action_3_Condition "Fault manager configuration.  Select up to 4 actions for each fault." VALUE 0x800027B5 RecordLayout_3 0 CompuMethod_108 0 65535 /end CHARACTERISTIC
/begin CHARACTERISTIC FaultManager.ACChargeLow_Fault.Action_4 "Fault manager configuration.  Select up to 4 actions for each fault." VALUE 0x800027B7 RecordLayout_3 0 CompuMethod_107 0 65535 /end CHARACTERISTIC
/begin CHARACTERISTIC FaultManager.ACChargeLow_Fault.Action_4_Condition "Fault manager configuration.  Select up to 4 actions for each fault." VALUE 0x800027B9 RecordLayout_3 0 CompuMethod_108 0 65535 /end CHARACTERISTIC
/begin CHARACTERISTIC FaultManager.ACPresRangeHigh.Mode "Fault manager configuration.  Select up to 4 actions for each fault." VALUE 0x800027BB RecordLayout_3 0 CompuMethod_105 0 65535 /end CHARACTERISTIC
/begin CHARACTERISTIC FaultManager.ACPresRangeHigh.ID "Fault manager configuration.  Select up to 4 actions for each fault." VALUE 0x800027BD RecordLayout_3 0 CompuMethod_1 0 65535 /end CHARACTERISTIC
/begin CHARACTERISTIC FaultManager.ACPresRangeHigh.Test "Fault manager configuration.  Select up to 4 actions for each fault." VALUE 0x800027BF RecordLayout_3 0 CompuMethod_106 0 65535 /end CHARACTERISTIC
/begin CHARACTERISTIC FaultManager.ACPresRangeHigh.Faulty_Samples__X_ "Fault manager configuration.  Select up to 4 actions for each fault." VALUE 0x800027C1 RecordLayout_3 0 CompuMethod_1 0 65535 /end CHARACTERISTIC
/begin CHARACTERISTIC FaultManager.ACPresRangeHigh.Total_Samples__Y_ "Fault manager configuration.  Select up to 4 actions for each fault." VALUE 0x800027C3 RecordLayout_3 0 CompuMethod_1 0 65535 /end CHARACTERISTIC
/begin CHARACTERISTIC FaultManager.ACPresRangeHigh.Action_1 "Fault manager configuration.  Select up to 4 actions for each fault." VALUE 0x800027C5 RecordLayout_3 0 CompuMethod_107 0 65535 /end CHARACTERISTIC
/begin CHARACTERISTIC FaultManager.ACPresRangeHigh.Action_1_Condition "Fault manager configuration.  Select up to 4 actions for each fault." VALUE 0x800027C7 RecordLayout_3 0 CompuMethod_108 0 65535 /end CHARACTERISTIC
/begin CHARACTERISTIC FaultManager.ACPresRangeHigh.Action_2 "Fault manager configuration.  Select up to 4 actions for each fault." VALUE 0x800027C9 RecordLayout_3 0 CompuMethod_107 0 65535 /end CHARACTERISTIC
/begin CHARACTERISTIC FaultManager.ACPresRangeHigh.Action_2_Condition "Fault manager configuration.  Select up to 4 actions for each fault." VALUE 0x800027CB RecordLayout_3 0 CompuMethod_108 0 65535 /end CHARACTERISTIC
/begin CHARACTERISTIC FaultManager.ACPresRangeHigh.Action_3 "Fault manager configuration.  Select up to 4 actions for each fault." VALUE 0x800027CD RecordLayout_3 0 CompuMethod_107 0 65535 /end CHARACTERISTIC
/begin CHARACTERISTIC FaultManager.ACPresRangeHigh.Action_3_Condition "Fault manager configuration.  Select up to 4 actions for each fault." VALUE 0x800027CF RecordLayout_3 0 CompuMethod_108 0 65535 /end CHARACTERISTIC
/begin CHARACTERISTIC FaultManager.ACPresRangeHigh.Action_4 "Fault manager configuration.  Select up to 4 actions for each fault." VALUE 0x800027D1 RecordLayout_3 0 CompuMethod_107 0 65535 /end CHARACTERISTIC
/begin CHARACTERISTIC FaultManager.ACPresRangeHigh.Action_4_Condition "Fault manager configuration.  Select up to 4 actions for each fault." VALUE 0x800027D3 RecordLayout_3 0 CompuMethod_108 0 65535 /end CHARACTERISTIC
/begin CHARACTERISTIC FaultManager.ACPresRangeLow.Mode "Fault manager configuration.  Select up to 4 actions for each fault." VALUE 0x800027D5 RecordLayout_3 0 CompuMethod_105 0 65535 /end CHARACTERISTIC
/begin CHARACTERISTIC FaultManager.ACPresRangeLow.ID "Fault manager configuration.  Select up to 4 actions for each fault." VALUE 0x800027D7 RecordLayout_3 0 CompuMethod_1 0 65535 /end CHARACTERISTIC
/begin CHARACTERISTIC FaultManager.ACPresRangeLow.Test "Fault manager configuration.  Select up to 4 actions for each fault." VALUE 0x800027D9 RecordLayout_3 0 CompuMethod_106 0 65535 /end CHARACTERISTIC
/begin CHARACTERISTIC FaultManager.ACPresRangeLow.Faulty_Samples__X_ "Fault manager configuration.  Select up to 4 actions for each fault." VALUE 0x800027DB RecordLayout_3 0 CompuMethod_1 0 65535 /end CHARACTERISTIC
/begin CHARACTERISTIC FaultManager.ACPresRangeLow.Total_Samples__Y_ "Fault manager configuration.  Select up to 4 actions for each fault." VALUE 0x800027DD RecordLayout_3 0 CompuMethod_1 0 65535 /end CHARACTERISTIC
/begin CHARACTERISTIC FaultManager.ACPresRangeLow.Action_1 "Fault manager configuration.  Select up to 4 actions for each fault." VALUE 0x800027DF RecordLayout_3 0 CompuMethod_107 0 65535 /end CHARACTERISTIC
/begin CHARACTERISTIC FaultManager.ACPresRangeLow.Action_1_Condition "Fault manager configuration.  Select up to 4 actions for each fault." VALUE 0x800027E1 RecordLayout_3 0 CompuMethod_108 0 65535 /end CHARACTERISTIC
/begin CHARACTERISTIC FaultManager.ACPresRangeLow.Action_2 "Fault manager configuration.  Select up to 4 actions for each fault." VALUE 0x800027E3 RecordLayout_3 0 CompuMethod_107 0 65535 /end CHARACTERISTIC
/begin CHARACTERISTIC FaultManager.ACPresRangeLow.Action_2_Condition "Fault manager configuration.  Select up to 4 actions for each fault." VALUE 0x800027E5 RecordLayout_3 0 CompuMethod_108 0 65535 /end CHARACTERISTIC
/begin CHARACTERISTIC FaultManager.ACPresRangeLow.Action_3 "Fault manager configuration.  Select up to 4 actions for each fault." VALUE 0x800027E7 RecordLayout_3 0 CompuMethod_107 0 65535 /end CHARACTERISTIC
/begin CHARACTERISTIC FaultManager.ACPresRangeLow.Action_3_Condition "Fault manager configuration.  Select up to 4 actions for each fault." VALUE 0x800027E9 RecordLayout_3 0 CompuMethod_108 0 65535 /end CHARACTERISTIC
/begin CHARACTERISTIC FaultManager.ACPresRangeLow.Action_4 "Fault manager configuration.  Select up to 4 actions for each fault." VALUE 0x800027EB RecordLayout_3 0 CompuMethod_107 0 65535 /end CHARACTERISTIC
/begin CHARACTERISTIC FaultManager.ACPresRangeLow.Action_4_Condition "Fault manager configuration.  Select up to 4 actions for each fault." VALUE 0x800027ED RecordLayout_3 0 CompuMethod_108 0 65535 /end CHARACTERISTIC
/begin CHARACTERISTIC FaultManager.APP1RangeHigh.Mode "Fault manager configuration.  Select up to 4 actions for each fault." VALUE 0x800027EF RecordLayout_3 0 CompuMethod_105 0 65535 /end CHARACTERISTIC
/begin CHARACTERISTIC FaultManager.APP1RangeHigh.ID "Fault manager configuration.  Select up to 4 actions for each fault." VALUE 0x800027F1 RecordLayout_3 0 CompuMethod_1 0 65535 /end CHARACTERISTIC
/begin CHARACTERISTIC FaultManager.APP1RangeHigh.Test "Fault manager configuration.  Select up to 4 actions for each fault." VALUE 0x800027F3 RecordLayout_3 0 CompuMethod_106 0 65535 /end CHARACTERISTIC
/begin CHARACTERISTIC FaultManager.APP1RangeHigh.Faulty_Samples__X_ "Fault manager configuration.  Select up to 4 actions for each fault." VALUE 0x800027F5 RecordLayout_3 0 CompuMethod_1 0 65535 /end CHARACTERISTIC
/begin CHARACTERISTIC FaultManager.APP1RangeHigh.Total_Samples__Y_ "Fault manager configuration.  Select up to 4 actions for each fault." VALUE 0x800027F7 RecordLayout_3 0 CompuMethod_1 0 65535 /end CHARACTERISTIC
/begin CHARACTERISTIC FaultManager.APP1RangeHigh.Action_1 "Fault manager configuration.  Select up to 4 actions for each fault." VALUE 0x800027F9 RecordLayout_3 0 CompuMethod_107 0 65535 /end CHARACTERISTIC
/begin CHARACTERISTIC FaultManager.APP1RangeHigh.Action_1_Condition "Fault manager configuration.  Select up to 4 actions for each fault." VALUE 0x800027FB RecordLayout_3 0 CompuMethod_108 0 65535 /end CHARACTERISTIC
/begin CHARACTERISTIC FaultManager.APP1RangeHigh.Action_2 "Fault manager configuration.  Select up to 4 actions for each fault." VALUE 0x800027FD RecordLayout_3 0 CompuMethod_107 0 65535 /end CHARACTERISTIC
/begin CHARACTERISTIC FaultManager.APP1RangeHigh.Action_2_Condition "Fault manager configuration.  Select up to 4 actions for each fault." VALUE 0x800027FF RecordLayout_3 0 CompuMethod_108 0 65535 /end CHARACTERISTIC
/begin CHARACTERISTIC FaultManager.APP1RangeHigh.Action_3 "Fault manager configuration.  Select up to 4 actions for each fault." VALUE 0x80002801 RecordLayout_3 0 CompuMethod_107 0 65535 /end CHARACTERISTIC
/begin CHARACTERISTIC FaultManager.APP1RangeHigh.Action_3_Condition "Fault manager configuration.  Select up to 4 actions for each fault." VALUE 0x80002803 RecordLayout_3 0 CompuMethod_108 0 65535 /end CHARACTERISTIC
/begin CHARACTERISTIC FaultManager.APP1RangeHigh.Action_4 "Fault manager configuration.  Select up to 4 actions for each fault." VALUE 0x80002805 RecordLayout_3 0 CompuMethod_107 0 65535 /end CHARACTERISTIC
/begin CHARACTERISTIC FaultManager.APP1RangeHigh.Action_4_Condition "Fault manager configuration.  Select up to 4 actions for each fault." VALUE 0x80002807 RecordLayout_3 0 CompuMethod_108 0 65535 /end CHARACTERISTIC
/begin CHARACTERISTIC FaultManager.APP1RangeLow.Mode "Fault manager configuration.  Select up to 4 actions for each fault." VALUE 0x80002809 RecordLayout_3 0 CompuMethod_105 0 65535 /end CHARACTERISTIC
/begin CHARACTERISTIC FaultManager.APP1RangeLow.ID "Fault manager configuration.  Select up to 4 actions for each fault." VALUE 0x8000280B RecordLayout_3 0 CompuMethod_1 0 65535 /end CHARACTERISTIC
/begin CHARACTERISTIC FaultManager.APP1RangeLow.Test "Fault manager configuration.  Select up to 4 actions for each fault." VALUE 0x8000280D RecordLayout_3 0 CompuMethod_106 0 65535 /end CHARACTERISTIC
/begin CHARACTERISTIC FaultManager.APP1RangeLow.Faulty_Samples__X_ "Fault manager configuration.  Select up to 4 actions for each fault." VALUE 0x8000280F RecordLayout_3 0 CompuMethod_1 0 65535 /end CHARACTERISTIC
/begin CHARACTERISTIC FaultManager.APP1RangeLow.Total_Samples__Y_ "Fault manager configuration.  Select up to 4 actions for each fault." VALUE 0x80002811 RecordLayout_3 0 CompuMethod_1 0 65535 /end CHARACTERISTIC
/begin CHARACTERISTIC FaultManager.APP1RangeLow.Action_1 "Fault manager configuration.  Select up to 4 actions for each fault." VALUE 0x80002813 RecordLayout_3 0 CompuMethod_107 0 65535 /end CHARACTERISTIC
/begin CHARACTERISTIC FaultManager.APP1RangeLow.Action_1_Condition "Fault manager configuration.  Select up to 4 actions for each fault." VALUE 0x80002815 RecordLayout_3 0 CompuMethod_108 0 65535 /end CHARACTERISTIC
/begin CHARACTERISTIC FaultManager.APP1RangeLow.Action_2 "Fault manager configuration.  Select up to 4 actions for each fault." VALUE 0x80002817 RecordLayout_3 0 CompuMethod_107 0 65535 /end CHARACTERISTIC
/begin CHARACTERISTIC FaultManager.APP1RangeLow.Action_2_Condition "Fault manager configuration.  Select up to 4 actions for each fault." VALUE 0x80002819 RecordLayout_3 0 CompuMethod_108 0 65535 /end CHARACTERISTIC
/begin CHARACTERISTIC FaultManager.APP1RangeLow.Action_3 "Fault manager configuration.  Select up to 4 actions for each fault." VALUE 0x8000281B RecordLayout_3 0 CompuMethod_107 0 65535 /end CHARACTERISTIC
/begin CHARACTERISTIC FaultManager.APP1RangeLow.Action_3_Condition "Fault manager configuration.  Select up to 4 actions for each fault." VALUE 0x8000281D RecordLayout_3 0 CompuMethod_108 0 65535 /end CHARACTERISTIC
/begin CHARACTERISTIC FaultManager.APP1RangeLow.Action_4 "Fault manager configuration.  Select up to 4 actions for each fault." VALUE 0x8000281F RecordLayout_3 0 CompuMethod_107 0 65535 /end CHARACTERISTIC
/begin CHARACTERISTIC FaultManager.APP1RangeLow.Action_4_Condition "Fault manager configuration.  Select up to 4 actions for each fault." VALUE 0x80002821 RecordLayout_3 0 CompuMethod_108 0 65535 /end CHARACTERISTIC
/begin CHARACTERISTIC FaultManager.APP1_AdaptAdaptHiMax.Mode "Fault manager configuration.  Select up to 4 actions for each fault." VALUE 0x80002823 RecordLayout_3 0 CompuMethod_105 0 65535 /end CHARACTERISTIC
/begin CHARACTERISTIC FaultManager.APP1_AdaptAdaptHiMax.ID "Fault manager configuration.  Select up to 4 actions for each fault." VALUE 0x80002825 RecordLayout_3 0 CompuMethod_1 0 65535 /end CHARACTERISTIC
/begin CHARACTERISTIC FaultManager.APP1_AdaptAdaptHiMax.Test "Fault manager configuration.  Select up to 4 actions for each fault." VALUE 0x80002827 RecordLayout_3 0 CompuMethod_106 0 65535 /end CHARACTERISTIC
/begin CHARACTERISTIC FaultManager.APP1_AdaptAdaptHiMax.Faulty_Samples__X_ "Fault manager configuration.  Select up to 4 actions for each fault." VALUE 0x80002829 RecordLayout_3 0 CompuMethod_1 0 65535 /end CHARACTERISTIC
/begin CHARACTERISTIC FaultManager.APP1_AdaptAdaptHiMax.Total_Samples__Y_ "Fault manager configuration.  Select up to 4 actions for each fault." VALUE 0x8000282B RecordLayout_3 0 CompuMethod_1 0 65535 /end CHARACTERISTIC
/begin CHARACTERISTIC FaultManager.APP1_AdaptAdaptHiMax.Action_1 "Fault manager configuration.  Select up to 4 actions for each fault." VALUE 0x8000282D RecordLayout_3 0 CompuMethod_107 0 65535 /end CHARACTERISTIC
/begin CHARACTERISTIC FaultManager.APP1_AdaptAdaptHiMax.Action_1_Condition "Fault manager configuration.  Select up to 4 actions for each fault." VALUE 0x8000282F RecordLayout_3 0 CompuMethod_108 0 65535 /end CHARACTERISTIC
/begin CHARACTERISTIC FaultManager.APP1_AdaptAdaptHiMax.Action_2 "Fault manager configuration.  Select up to 4 actions for each fault." VALUE 0x80002831 RecordLayout_3 0 CompuMethod_107 0 65535 /end CHARACTERISTIC
/begin CHARACTERISTIC FaultManager.APP1_AdaptAdaptHiMax.Action_2_Condition "Fault manager configuration.  Select up to 4 actions for each fault." VALUE 0x80002833 RecordLayout_3 0 CompuMethod_108 0 65535 /end CHARACTERISTIC
/begin CHARACTERISTIC FaultManager.APP1_AdaptAdaptHiMax.Action_3 "Fault manager configuration.  Select up to 4 actions for each fault." VALUE 0x80002835 RecordLayout_3 0 CompuMethod_107 0 65535 /end CHARACTERISTIC
/begin CHARACTERISTIC FaultManager.APP1_AdaptAdaptHiMax.Action_3_Condition "Fault manager configuration.  Select up to 4 actions for each fault." VALUE 0x80002837 RecordLayout_3 0 CompuMethod_108 0 65535 /end CHARACTERISTIC
/begin CHARACTERISTIC FaultManager.APP1_AdaptAdaptHiMax.Action_4 "Fault manager configuration.  Select up to 4 actions for each fault." VALUE 0x80002839 RecordLayout_3 0 CompuMethod_107 0 65535 /end CHARACTERISTIC
/begin CHARACTERISTIC FaultManager.APP1_AdaptAdaptHiMax.Action_4_Condition "Fault manager configuration.  Select up to 4 actions for each fault." VALUE 0x8000283B RecordLayout_3 0 CompuMethod_108 0 65535 /end CHARACTERISTIC
/begin CHARACTERISTIC FaultManager.APP1_AdaptAdaptHiMin.Mode "Fault manager configuration.  Select up to 4 actions for each fault." VALUE 0x8000283D RecordLayout_3 0 CompuMethod_105 0 65535 /end CHARACTERISTIC
/begin CHARACTERISTIC FaultManager.APP1_AdaptAdaptHiMin.ID "Fault manager configuration.  Select up to 4 actions for each fault." VALUE 0x8000283F RecordLayout_3 0 CompuMethod_1 0 65535 /end CHARACTERISTIC
/begin CHARACTERISTIC FaultManager.APP1_AdaptAdaptHiMin.Test "Fault manager configuration.  Select up to 4 actions for each fault." VALUE 0x80002841 RecordLayout_3 0 CompuMethod_106 0 65535 /end CHARACTERISTIC
/begin CHARACTERISTIC FaultManager.APP1_AdaptAdaptHiMin.Faulty_Samples__X_ "Fault manager configuration.  Select up to 4 actions for each fault." VALUE 0x80002843 RecordLayout_3 0 CompuMethod_1 0 65535 /end CHARACTERISTIC
/begin CHARACTERISTIC FaultManager.APP1_AdaptAdaptHiMin.Total_Samples__Y_ "Fault manager configuration.  Select up to 4 actions for each fault." VALUE 0x80002845 RecordLayout_3 0 CompuMethod_1 0 65535 /end CHARACTERISTIC
/begin CHARACTERISTIC FaultManager.APP1_AdaptAdaptHiMin.Action_1 "Fault manager configuration.  Select up to 4 actions for each fault." VALUE 0x80002847 RecordLayout_3 0 CompuMethod_107 0 65535 /end CHARACTERISTIC
/begin CHARACTERISTIC FaultManager.APP1_AdaptAdaptHiMin.Action_1_Condition "Fault manager configuration.  Select up to 4 actions for each fault." VALUE 0x80002849 RecordLayout_3 0 CompuMethod_108 0 65535 /end CHARACTERISTIC
/begin CHARACTERISTIC FaultManager.APP1_AdaptAdaptHiMin.Action_2 "Fault manager configuration.  Select up to 4 actions for each fault." VALUE 0x8000284B RecordLayout_3 0 CompuMethod_107 0 65535 /end CHARACTERISTIC
/begin CHARACTERISTIC FaultManager.APP1_AdaptAdaptHiMin.Action_2_Condition "Fault manager configuration.  Select up to 4 actions for each fault." VALUE 0x8000284D RecordLayout_3 0 CompuMethod_108 0 65535 /end CHARACTERISTIC
/begin CHARACTERISTIC FaultManager.APP1_AdaptAdaptHiMin.Action_3 "Fault manager configuration.  Select up to 4 actions for each fault." VALUE 0x8000284F RecordLayout_3 0 CompuMethod_107 0 65535 /end CHARACTERISTIC
/begin CHARACTERISTIC FaultManager.APP1_AdaptAdaptHiMin.Action_3_Condition "Fault manager configuration.  Select up to 4 actions for each fault." VALUE 0x80002851 RecordLayout_3 0 CompuMethod_108 0 65535 /end CHARACTERISTIC
/begin CHARACTERISTIC FaultManager.APP1_AdaptAdaptHiMin.Action_4 "Fault manager configuration.  Select up to 4 actions for each fault." VALUE 0x80002853 RecordLayout_3 0 CompuMethod_107 0 65535 /end CHARACTERISTIC
/begin CHARACTERISTIC FaultManager.APP1_AdaptAdaptHiMin.Action_4_Condition "Fault manager configuration.  Select up to 4 actions for each fault." VALUE 0x80002855 RecordLayout_3 0 CompuMethod_108 0 65535 /end CHARACTERISTIC
/begin CHARACTERISTIC FaultManager.APP1_AdaptAdaptLoMax.Mode "Fault manager configuration.  Select up to 4 actions for each fault." VALUE 0x80002857 RecordLayout_3 0 CompuMethod_105 0 65535 /end CHARACTERISTIC
/begin CHARACTERISTIC FaultManager.APP1_AdaptAdaptLoMax.ID "Fault manager configuration.  Select up to 4 actions for each fault." VALUE 0x80002859 RecordLayout_3 0 CompuMethod_1 0 65535 /end CHARACTERISTIC
/begin CHARACTERISTIC FaultManager.APP1_AdaptAdaptLoMax.Test "Fault manager configuration.  Select up to 4 actions for each fault." VALUE 0x8000285B RecordLayout_3 0 CompuMethod_106 0 65535 /end CHARACTERISTIC
/begin CHARACTERISTIC FaultManager.APP1_AdaptAdaptLoMax.Faulty_Samples__X_ "Fault manager configuration.  Select up to 4 actions for each fault." VALUE 0x8000285D RecordLayout_3 0 CompuMethod_1 0 65535 /end CHARACTERISTIC
/begin CHARACTERISTIC FaultManager.APP1_AdaptAdaptLoMax.Total_Samples__Y_ "Fault manager configuration.  Select up to 4 actions for each fault." VALUE 0x8000285F RecordLayout_3 0 CompuMethod_1 0 65535 /end CHARACTERISTIC
/begin CHARACTERISTIC FaultManager.APP1_AdaptAdaptLoMax.Action_1 "Fault manager configuration.  Select up to 4 actions for each fault." VALUE 0x80002861 RecordLayout_3 0 CompuMethod_107 0 65535 /end CHARACTERISTIC
/begin CHARACTERISTIC FaultManager.APP1_AdaptAdaptLoMax.Action_1_Condition "Fault manager configuration.  Select up to 4 actions for each fault." VALUE 0x80002863 RecordLayout_3 0 CompuMethod_108 0 65535 /end CHARACTERISTIC
/begin CHARACTERISTIC FaultManager.APP1_AdaptAdaptLoMax.Action_2 "Fault manager configuration.  Select up to 4 actions for each fault." VALUE 0x80002865 RecordLayout_3 0 CompuMethod_107 0 65535 /end CHARACTERISTIC
/begin CHARACTERISTIC FaultManager.APP1_AdaptAdaptLoMax.Action_2_Condition "Fault manager configuration.  Select up to 4 actions for each fault." VALUE 0x80002867 RecordLayout_3 0 CompuMethod_108 0 65535 /end CHARACTERISTIC
/begin CHARACTERISTIC FaultManager.APP1_AdaptAdaptLoMax.Action_3 "Fault manager configuration.  Select up to 4 actions for each fault." VALUE 0x80002869 RecordLayout_3 0 CompuMethod_107 0 65535 /end CHARACTERISTIC
/begin CHARACTERISTIC FaultManager.APP1_AdaptAdaptLoMax.Action_3_Condition "Fault manager configuration.  Select up to 4 actions for each fault." VALUE 0x8000286B RecordLayout_3 0 CompuMethod_108 0 65535 /end CHARACTERISTIC
/begin CHARACTERISTIC FaultManager.APP1_AdaptAdaptLoMax.Action_4 "Fault manager configuration.  Select up to 4 actions for each fault." VALUE 0x8000286D RecordLayout_3 0 CompuMethod_107 0 65535 /end CHARACTERISTIC
/begin CHARACTERISTIC FaultManager.APP1_AdaptAdaptLoMax.Action_4_Condition "Fault manager configuration.  Select up to 4 actions for each fault." VALUE 0x8000286F RecordLayout_3 0 CompuMethod_108 0 65535 /end CHARACTERISTIC
/begin CHARACTERISTIC FaultManager.APP1_AdaptAdaptLoMin.Mode "Fault manager configuration.  Select up to 4 actions for each fault." VALUE 0x80002871 RecordLayout_3 0 CompuMethod_105 0 65535 /end CHARACTERISTIC
/begin CHARACTERISTIC FaultManager.APP1_AdaptAdaptLoMin.ID "Fault manager configuration.  Select up to 4 actions for each fault." VALUE 0x80002873 RecordLayout_3 0 CompuMethod_1 0 65535 /end CHARACTERISTIC
/begin CHARACTERISTIC FaultManager.APP1_AdaptAdaptLoMin.Test "Fault manager configuration.  Select up to 4 actions for each fault." VALUE 0x80002875 RecordLayout_3 0 CompuMethod_106 0 65535 /end CHARACTERISTIC
/begin CHARACTERISTIC FaultManager.APP1_AdaptAdaptLoMin.Faulty_Samples__X_ "Fault manager configuration.  Select up to 4 actions for each fault." VALUE 0x80002877 RecordLayout_3 0 CompuMethod_1 0 65535 /end CHARACTERISTIC
/begin CHARACTERISTIC FaultManager.APP1_AdaptAdaptLoMin.Total_Samples__Y_ "Fault manager configuration.  Select up to 4 actions for each fault." VALUE 0x80002879 RecordLayout_3 0 CompuMethod_1 0 65535 /end CHARACTERISTIC
/begin CHARACTERISTIC FaultManager.APP1_AdaptAdaptLoMin.Action_1 "Fault manager configuration.  Select up to 4 actions for each fault." VALUE 0x8000287B RecordLayout_3 0 CompuMethod_107 0 65535 /end CHARACTERISTIC
/begin CHARACTERISTIC FaultManager.APP1_AdaptAdaptLoMin.Action_1_Condition "Fault manager configuration.  Select up to 4 actions for each fault." VALUE 0x8000287D RecordLayout_3 0 CompuMethod_108 0 65535 /end CHARACTERISTIC
/begin CHARACTERISTIC FaultManager.APP1_AdaptAdaptLoMin.Action_2 "Fault manager configuration.  Select up to 4 actions for each fault." VALUE 0x8000287F RecordLayout_3 0 CompuMethod_107 0 65535 /end CHARACTERISTIC
/begin CHARACTERISTIC FaultManager.APP1_AdaptAdaptLoMin.Action_2_Condition "Fault manager configuration.  Select up to 4 actions for each fault." VALUE 0x80002881 RecordLayout_3 0 CompuMethod_108 0 65535 /end CHARACTERISTIC
/begin CHARACTERISTIC FaultManager.APP1_AdaptAdaptLoMin.Action_3 "Fault manager configuration.  Select up to 4 actions for each fault." VALUE 0x80002883 RecordLayout_3 0 CompuMethod_107 0 65535 /end CHARACTERISTIC
/begin CHARACTERISTIC FaultManager.APP1_AdaptAdaptLoMin.Action_3_Condition "Fault manager configuration.  Select up to 4 actions for each fault." VALUE 0x80002885 RecordLayout_3 0 CompuMethod_108 0 65535 /end CHARACTERISTIC
/begin CHARACTERISTIC FaultManager.APP1_AdaptAdaptLoMin.Action_4 "Fault manager configuration.  Select up to 4 actions for each fault." VALUE 0x80002887 RecordLayout_3 0 CompuMethod_107 0 65535 /end CHARACTERISTIC
/begin CHARACTERISTIC FaultManager.APP1_AdaptAdaptLoMin.Action_4_Condition "Fault manager configuration.  Select up to 4 actions for each fault." VALUE 0x80002889 RecordLayout_3 0 CompuMethod_108 0 65535 /end CHARACTERISTIC
/begin CHARACTERISTIC FaultManager.APP1_AdaptRangeHigh.Mode "Fault manager configuration.  Select up to 4 actions for each fault." VALUE 0x8000288B RecordLayout_3 0 CompuMethod_105 0 65535 /end CHARACTERISTIC
/begin CHARACTERISTIC FaultManager.APP1_AdaptRangeHigh.ID "Fault manager configuration.  Select up to 4 actions for each fault." VALUE 0x8000288D RecordLayout_3 0 CompuMethod_1 0 65535 /end CHARACTERISTIC
/begin CHARACTERISTIC FaultManager.APP1_AdaptRangeHigh.Test "Fault manager configuration.  Select up to 4 actions for each fault." VALUE 0x8000288F RecordLayout_3 0 CompuMethod_106 0 65535 /end CHARACTERISTIC
/begin CHARACTERISTIC FaultManager.APP1_AdaptRangeHigh.Faulty_Samples__X_ "Fault manager configuration.  Select up to 4 actions for each fault." VALUE 0x80002891 RecordLayout_3 0 CompuMethod_1 0 65535 /end CHARACTERISTIC
/begin CHARACTERISTIC FaultManager.APP1_AdaptRangeHigh.Total_Samples__Y_ "Fault manager configuration.  Select up to 4 actions for each fault." VALUE 0x80002893 RecordLayout_3 0 CompuMethod_1 0 65535 /end CHARACTERISTIC
/begin CHARACTERISTIC FaultManager.APP1_AdaptRangeHigh.Action_1 "Fault manager configuration.  Select up to 4 actions for each fault." VALUE 0x80002895 RecordLayout_3 0 CompuMethod_107 0 65535 /end CHARACTERISTIC
/begin CHARACTERISTIC FaultManager.APP1_AdaptRangeHigh.Action_1_Condition "Fault manager configuration.  Select up to 4 actions for each fault." VALUE 0x80002897 RecordLayout_3 0 CompuMethod_108 0 65535 /end CHARACTERISTIC
/begin CHARACTERISTIC FaultManager.APP1_AdaptRangeHigh.Action_2 "Fault manager configuration.  Select up to 4 actions for each fault." VALUE 0x80002899 RecordLayout_3 0 CompuMethod_107 0 65535 /end CHARACTERISTIC
/begin CHARACTERISTIC FaultManager.APP1_AdaptRangeHigh.Action_2_Condition "Fault manager configuration.  Select up to 4 actions for each fault." VALUE 0x8000289B RecordLayout_3 0 CompuMethod_108 0 65535 /end CHARACTERISTIC
/begin CHARACTERISTIC FaultManager.APP1_AdaptRangeHigh.Action_3 "Fault manager configuration.  Select up to 4 actions for each fault." VALUE 0x8000289D RecordLayout_3 0 CompuMethod_107 0 65535 /end CHARACTERISTIC
/begin CHARACTERISTIC FaultManager.APP1_AdaptRangeHigh.Action_3_Condition "Fault manager configuration.  Select up to 4 actions for each fault." VALUE 0x8000289F RecordLayout_3 0 CompuMethod_108 0 65535 /end CHARACTERISTIC
/begin CHARACTERISTIC FaultManager.APP1_AdaptRangeHigh.Action_4 "Fault manager configuration.  Select up to 4 actions for each fault." VALUE 0x800028A1 RecordLayout_3 0 CompuMethod_107 0 65535 /end CHARACTERISTIC
/begin CHARACTERISTIC FaultManager.APP1_AdaptRangeHigh.Action_4_Condition "Fault manager configuration.  Select up to 4 actions for each fault." VALUE 0x800028A3 RecordLayout_3 0 CompuMethod_108 0 65535 /end CHARACTERISTIC
/begin CHARACTERISTIC FaultManager.APP1_AdaptRangeLow.Mode "Fault manager configuration.  Select up to 4 actions for each fault." VALUE 0x800028A5 RecordLayout_3 0 CompuMethod_105 0 65535 /end CHARACTERISTIC
/begin CHARACTERISTIC FaultManager.APP1_AdaptRangeLow.ID "Fault manager configuration.  Select up to 4 actions for each fault." VALUE 0x800028A7 RecordLayout_3 0 CompuMethod_1 0 65535 /end CHARACTERISTIC
/begin CHARACTERISTIC FaultManager.APP1_AdaptRangeLow.Test "Fault manager configuration.  Select up to 4 actions for each fault." VALUE 0x800028A9 RecordLayout_3 0 CompuMethod_106 0 65535 /end CHARACTERISTIC
/begin CHARACTERISTIC FaultManager.APP1_AdaptRangeLow.Faulty_Samples__X_ "Fault manager configuration.  Select up to 4 actions for each fault." VALUE 0x800028AB RecordLayout_3 0 CompuMethod_1 0 65535 /end CHARACTERISTIC
/begin CHARACTERISTIC FaultManager.APP1_AdaptRangeLow.Total_Samples__Y_ "Fault manager configuration.  Select up to 4 actions for each fault." VALUE 0x800028AD RecordLayout_3 0 CompuMethod_1 0 65535 /end CHARACTERISTIC
/begin CHARACTERISTIC FaultManager.APP1_AdaptRangeLow.Action_1 "Fault manager configuration.  Select up to 4 actions for each fault." VALUE 0x800028AF RecordLayout_3 0 CompuMethod_107 0 65535 /end CHARACTERISTIC
/begin CHARACTERISTIC FaultManager.APP1_AdaptRangeLow.Action_1_Condition "Fault manager configuration.  Select up to 4 actions for each fault." VALUE 0x800028B1 RecordLayout_3 0 CompuMethod_108 0 65535 /end CHARACTERISTIC
/begin CHARACTERISTIC FaultManager.APP1_AdaptRangeLow.Action_2 "Fault manager configuration.  Select up to 4 actions for each fault." VALUE 0x800028B3 RecordLayout_3 0 CompuMethod_107 0 65535 /end CHARACTERISTIC
/begin CHARACTERISTIC FaultManager.APP1_AdaptRangeLow.Action_2_Condition "Fault manager configuration.  Select up to 4 actions for each fault." VALUE 0x800028B5 RecordLayout_3 0 CompuMethod_108 0 65535 /end CHARACTERISTIC
/begin CHARACTERISTIC FaultManager.APP1_AdaptRangeLow.Action_3 "Fault manager configuration.  Select up to 4 actions for each fault." VALUE 0x800028B7 RecordLayout_3 0 CompuMethod_107 0 65535 /end CHARACTERISTIC
/begin CHARACTERISTIC FaultManager.APP1_AdaptRangeLow.Action_3_Condition "Fault manager configuration.  Select up to 4 actions for each fault." VALUE 0x800028B9 RecordLayout_3 0 CompuMethod_108 0 65535 /end CHARACTERISTIC
/begin CHARACTERISTIC FaultManager.APP1_AdaptRangeLow.Action_4 "Fault manager configuration.  Select up to 4 actions for each fault." VALUE 0x800028BB RecordLayout_3 0 CompuMethod_107 0 65535 /end CHARACTERISTIC
/begin CHARACTERISTIC FaultManager.APP1_AdaptRangeLow.Action_4_Condition "Fault manager configuration.  Select up to 4 actions for each fault." VALUE 0x800028BD RecordLayout_3 0 CompuMethod_108 0 65535 /end CHARACTERISTIC
/begin CHARACTERISTIC FaultManager.APP2RangeHigh.Mode "Fault manager configuration.  Select up to 4 actions for each fault." VALUE 0x800028BF RecordLayout_3 0 CompuMethod_105 0 65535 /end CHARACTERISTIC
/begin CHARACTERISTIC FaultManager.APP2RangeHigh.ID "Fault manager configuration.  Select up to 4 actions for each fault." VALUE 0x800028C1 RecordLayout_3 0 CompuMethod_1 0 65535 /end CHARACTERISTIC
/begin CHARACTERISTIC FaultManager.APP2RangeHigh.Test "Fault manager configuration.  Select up to 4 actions for each fault." VALUE 0x800028C3 RecordLayout_3 0 CompuMethod_106 0 65535 /end CHARACTERISTIC
/begin CHARACTERISTIC FaultManager.APP2RangeHigh.Faulty_Samples__X_ "Fault manager configuration.  Select up to 4 actions for each fault." VALUE 0x800028C5 RecordLayout_3 0 CompuMethod_1 0 65535 /end CHARACTERISTIC
/begin CHARACTERISTIC FaultManager.APP2RangeHigh.Total_Samples__Y_ "Fault manager configuration.  Select up to 4 actions for each fault." VALUE 0x800028C7 RecordLayout_3 0 CompuMethod_1 0 65535 /end CHARACTERISTIC
/begin CHARACTERISTIC FaultManager.APP2RangeHigh.Action_1 "Fault manager configuration.  Select up to 4 actions for each fault." VALUE 0x800028C9 RecordLayout_3 0 CompuMethod_107 0 65535 /end CHARACTERISTIC
/begin CHARACTERISTIC FaultManager.APP2RangeHigh.Action_1_Condition "Fault manager configuration.  Select up to 4 actions for each fault." VALUE 0x800028CB RecordLayout_3 0 CompuMethod_108 0 65535 /end CHARACTERISTIC
/begin CHARACTERISTIC FaultManager.APP2RangeHigh.Action_2 "Fault manager configuration.  Select up to 4 actions for each fault." VALUE 0x800028CD RecordLayout_3 0 CompuMethod_107 0 65535 /end CHARACTERISTIC
/begin CHARACTERISTIC FaultManager.APP2RangeHigh.Action_2_Condition "Fault manager configuration.  Select up to 4 actions for each fault." VALUE 0x800028CF RecordLayout_3 0 CompuMethod_108 0 65535 /end CHARACTERISTIC
/begin CHARACTERISTIC FaultManager.APP2RangeHigh.Action_3 "Fault manager configuration.  Select up to 4 actions for each fault." VALUE 0x800028D1 RecordLayout_3 0 CompuMethod_107 0 65535 /end CHARACTERISTIC
/begin CHARACTERISTIC FaultManager.APP2RangeHigh.Action_3_Condition "Fault manager configuration.  Select up to 4 actions for each fault." VALUE 0x800028D3 RecordLayout_3 0 CompuMethod_108 0 65535 /end CHARACTERISTIC
/begin CHARACTERISTIC FaultManager.APP2RangeHigh.Action_4 "Fault manager configuration.  Select up to 4 actions for each fault." VALUE 0x800028D5 RecordLayout_3 0 CompuMethod_107 0 65535 /end CHARACTERISTIC
/begin CHARACTERISTIC FaultManager.APP2RangeHigh.Action_4_Condition "Fault manager configuration.  Select up to 4 actions for each fault." VALUE 0x800028D7 RecordLayout_3 0 CompuMethod_108 0 65535 /end CHARACTERISTIC
/begin CHARACTERISTIC FaultManager.APP2RangeLow.Mode "Fault manager configuration.  Select up to 4 actions for each fault." VALUE 0x800028D9 RecordLayout_3 0 CompuMethod_105 0 65535 /end CHARACTERISTIC
/begin CHARACTERISTIC FaultManager.APP2RangeLow.ID "Fault manager configuration.  Select up to 4 actions for each fault." VALUE 0x800028DB RecordLayout_3 0 CompuMethod_1 0 65535 /end CHARACTERISTIC
/begin CHARACTERISTIC FaultManager.APP2RangeLow.Test "Fault manager configuration.  Select up to 4 actions for each fault." VALUE 0x800028DD RecordLayout_3 0 CompuMethod_106 0 65535 /end CHARACTERISTIC
/begin CHARACTERISTIC FaultManager.APP2RangeLow.Faulty_Samples__X_ "Fault manager configuration.  Select up to 4 actions for each fault." VALUE 0x800028DF RecordLayout_3 0 CompuMethod_1 0 65535 /end CHARACTERISTIC
/begin CHARACTERISTIC FaultManager.APP2RangeLow.Total_Samples__Y_ "Fault manager configuration.  Select up to 4 actions for each fault." VALUE 0x800028E1 RecordLayout_3 0 CompuMethod_1 0 65535 /end CHARACTERISTIC
/begin CHARACTERISTIC FaultManager.APP2RangeLow.Action_1 "Fault manager configuration.  Select up to 4 actions for each fault." VALUE 0x800028E3 RecordLayout_3 0 CompuMethod_107 0 65535 /end CHARACTERISTIC
/begin CHARACTERISTIC FaultManager.APP2RangeLow.Action_1_Condition "Fault manager configuration.  Select up to 4 actions for each fault." VALUE 0x800028E5 RecordLayout_3 0 CompuMethod_108 0 65535 /end CHARACTERISTIC
/begin CHARACTERISTIC FaultManager.APP2RangeLow.Action_2 "Fault manager configuration.  Select up to 4 actions for each fault." VALUE 0x800028E7 RecordLayout_3 0 CompuMethod_107 0 65535 /end CHARACTERISTIC
/begin CHARACTERISTIC FaultManager.APP2RangeLow.Action_2_Condition "Fault manager configuration.  Select up to 4 actions for each fault." VALUE 0x800028E9 RecordLayout_3 0 CompuMethod_108 0 65535 /end CHARACTERISTIC
/begin CHARACTERISTIC FaultManager.APP2RangeLow.Action_3 "Fault manager configuration.  Select up to 4 actions for each fault." VALUE 0x800028EB RecordLayout_3 0 CompuMethod_107 0 65535 /end CHARACTERISTIC
/begin CHARACTERISTIC FaultManager.APP2RangeLow.Action_3_Condition "Fault manager configuration.  Select up to 4 actions for each fault." VALUE 0x800028ED RecordLayout_3 0 CompuMethod_108 0 65535 /end CHARACTERISTIC
/begin CHARACTERISTIC FaultManager.APP2RangeLow.Action_4 "Fault manager configuration.  Select up to 4 actions for each fault." VALUE 0x800028EF RecordLayout_3 0 CompuMethod_107 0 65535 /end CHARACTERISTIC
/begin CHARACTERISTIC FaultManager.APP2RangeLow.Action_4_Condition "Fault manager configuration.  Select up to 4 actions for each fault." VALUE 0x800028F1 RecordLayout_3 0 CompuMethod_108 0 65535 /end CHARACTERISTIC
/begin CHARACTERISTIC FaultManager.APP2_AdaptAdaptHiMax.Mode "Fault manager configuration.  Select up to 4 actions for each fault." VALUE 0x800028F3 RecordLayout_3 0 CompuMethod_105 0 65535 /end CHARACTERISTIC
/begin CHARACTERISTIC FaultManager.APP2_AdaptAdaptHiMax.ID "Fault manager configuration.  Select up to 4 actions for each fault." VALUE 0x800028F5 RecordLayout_3 0 CompuMethod_1 0 65535 /end CHARACTERISTIC
/begin CHARACTERISTIC FaultManager.APP2_AdaptAdaptHiMax.Test "Fault manager configuration.  Select up to 4 actions for each fault." VALUE 0x800028F7 RecordLayout_3 0 CompuMethod_106 0 65535 /end CHARACTERISTIC
/begin CHARACTERISTIC FaultManager.APP2_AdaptAdaptHiMax.Faulty_Samples__X_ "Fault manager configuration.  Select up to 4 actions for each fault." VALUE 0x800028F9 RecordLayout_3 0 CompuMethod_1 0 65535 /end CHARACTERISTIC
/begin CHARACTERISTIC FaultManager.APP2_AdaptAdaptHiMax.Total_Samples__Y_ "Fault manager configuration.  Select up to 4 actions for each fault." VALUE 0x800028FB RecordLayout_3 0 CompuMethod_1 0 65535 /end CHARACTERISTIC
/begin CHARACTERISTIC FaultManager.APP2_AdaptAdaptHiMax.Action_1 "Fault manager configuration.  Select up to 4 actions for each fault." VALUE 0x800028FD RecordLayout_3 0 CompuMethod_107 0 65535 /end CHARACTERISTIC
/begin CHARACTERISTIC FaultManager.APP2_AdaptAdaptHiMax.Action_1_Condition "Fault manager configuration.  Select up to 4 actions for each fault." VALUE 0x800028FF RecordLayout_3 0 CompuMethod_108 0 65535 /end CHARACTERISTIC
/begin CHARACTERISTIC FaultManager.APP2_AdaptAdaptHiMax.Action_2 "Fault manager configuration.  Select up to 4 actions for each fault." VALUE 0x80002901 RecordLayout_3 0 CompuMethod_107 0 65535 /end CHARACTERISTIC
/begin CHARACTERISTIC FaultManager.APP2_AdaptAdaptHiMax.Action_2_Condition "Fault manager configuration.  Select up to 4 actions for each fault." VALUE 0x80002903 RecordLayout_3 0 CompuMethod_108 0 65535 /end CHARACTERISTIC
/begin CHARACTERISTIC FaultManager.APP2_AdaptAdaptHiMax.Action_3 "Fault manager configuration.  Select up to 4 actions for each fault." VALUE 0x80002905 RecordLayout_3 0 CompuMethod_107 0 65535 /end CHARACTERISTIC
/begin CHARACTERISTIC FaultManager.APP2_AdaptAdaptHiMax.Action_3_Condition "Fault manager configuration.  Select up to 4 actions for each fault." VALUE 0x80002907 RecordLayout_3 0 CompuMethod_108 0 65535 /end CHARACTERISTIC
/begin CHARACTERISTIC FaultManager.APP2_AdaptAdaptHiMax.Action_4 "Fault manager configuration.  Select up to 4 actions for each fault." VALUE 0x80002909 RecordLayout_3 0 CompuMethod_107 0 65535 /end CHARACTERISTIC
/begin CHARACTERISTIC FaultManager.APP2_AdaptAdaptHiMax.Action_4_Condition "Fault manager configuration.  Select up to 4 actions for each fault." VALUE 0x8000290B RecordLayout_3 0 CompuMethod_108 0 65535 /end CHARACTERISTIC
/begin CHARACTERISTIC FaultManager.APP2_AdaptAdaptHiMin.Mode "Fault manager configuration.  Select up to 4 actions for each fault." VALUE 0x8000290D RecordLayout_3 0 CompuMethod_105 0 65535 /end CHARACTERISTIC
/begin CHARACTERISTIC FaultManager.APP2_AdaptAdaptHiMin.ID "Fault manager configuration.  Select up to 4 actions for each fault." VALUE 0x8000290F RecordLayout_3 0 CompuMethod_1 0 65535 /end CHARACTERISTIC
/begin CHARACTERISTIC FaultManager.APP2_AdaptAdaptHiMin.Test "Fault manager configuration.  Select up to 4 actions for each fault." VALUE 0x80002911 RecordLayout_3 0 CompuMethod_106 0 65535 /end CHARACTERISTIC
/begin CHARACTERISTIC FaultManager.APP2_AdaptAdaptHiMin.Faulty_Samples__X_ "Fault manager configuration.  Select up to 4 actions for each fault." VALUE 0x80002913 RecordLayout_3 0 CompuMethod_1 0 65535 /end CHARACTERISTIC
/begin CHARACTERISTIC FaultManager.APP2_AdaptAdaptHiMin.Total_Samples__Y_ "Fault manager configuration.  Select up to 4 actions for each fault." VALUE 0x80002915 RecordLayout_3 0 CompuMethod_1 0 65535 /end CHARACTERISTIC
/begin CHARACTERISTIC FaultManager.APP2_AdaptAdaptHiMin.Action_1 "Fault manager configuration.  Select up to 4 actions for each fault." VALUE 0x80002917 RecordLayout_3 0 CompuMethod_107 0 65535 /end CHARACTERISTIC
/begin CHARACTERISTIC FaultManager.APP2_AdaptAdaptHiMin.Action_1_Condition "Fault manager configuration.  Select up to 4 actions for each fault." VALUE 0x80002919 RecordLayout_3 0 CompuMethod_108 0 65535 /end CHARACTERISTIC
/begin CHARACTERISTIC FaultManager.APP2_AdaptAdaptHiMin.Action_2 "Fault manager configuration.  Select up to 4 actions for each fault." VALUE 0x8000291B RecordLayout_3 0 CompuMethod_107 0 65535 /end CHARACTERISTIC
/begin CHARACTERISTIC FaultManager.APP2_AdaptAdaptHiMin.Action_2_Condition "Fault manager configuration.  Select up to 4 actions for each fault." VALUE 0x8000291D RecordLayout_3 0 CompuMethod_108 0 65535 /end CHARACTERISTIC
/begin CHARACTERISTIC FaultManager.APP2_AdaptAdaptHiMin.Action_3 "Fault manager configuration.  Select up to 4 actions for each fault." VALUE 0x8000291F RecordLayout_3 0 CompuMethod_107 0 65535 /end CHARACTERISTIC
/begin CHARACTERISTIC FaultManager.APP2_AdaptAdaptHiMin.Action_3_Condition "Fault manager configuration.  Select up to 4 actions for each fault." VALUE 0x80002921 RecordLayout_3 0 CompuMethod_108 0 65535 /end CHARACTERISTIC
/begin CHARACTERISTIC FaultManager.APP2_AdaptAdaptHiMin.Action_4 "Fault manager configuration.  Select up to 4 actions for each fault." VALUE 0x80002923 RecordLayout_3 0 CompuMethod_107 0 65535 /end CHARACTERISTIC
/begin CHARACTERISTIC FaultManager.APP2_AdaptAdaptHiMin.Action_4_Condition "Fault manager configuration.  Select up to 4 actions for each fault." VALUE 0x80002925 RecordLayout_3 0 CompuMethod_108 0 65535 /end CHARACTERISTIC
/begin CHARACTERISTIC FaultManager.APP2_AdaptAdaptLoMax.Mode "Fault manager configuration.  Select up to 4 actions for each fault." VALUE 0x80002927 RecordLayout_3 0 CompuMethod_105 0 65535 /end CHARACTERISTIC
/begin CHARACTERISTIC FaultManager.APP2_AdaptAdaptLoMax.ID "Fault manager configuration.  Select up to 4 actions for each fault." VALUE 0x80002929 RecordLayout_3 0 CompuMethod_1 0 65535 /end CHARACTERISTIC
/begin CHARACTERISTIC FaultManager.APP2_AdaptAdaptLoMax.Test "Fault manager configuration.  Select up to 4 actions for each fault." VALUE 0x8000292B RecordLayout_3 0 CompuMethod_106 0 65535 /end CHARACTERISTIC
/begin CHARACTERISTIC FaultManager.APP2_AdaptAdaptLoMax.Faulty_Samples__X_ "Fault manager configuration.  Select up to 4 actions for each fault." VALUE 0x8000292D RecordLayout_3 0 CompuMethod_1 0 65535 /end CHARACTERISTIC
/begin CHARACTERISTIC FaultManager.APP2_AdaptAdaptLoMax.Total_Samples__Y_ "Fault manager configuration.  Select up to 4 actions for each fault." VALUE 0x8000292F RecordLayout_3 0 CompuMethod_1 0 65535 /end CHARACTERISTIC
/begin CHARACTERISTIC FaultManager.APP2_AdaptAdaptLoMax.Action_1 "Fault manager configuration.  Select up to 4 actions for each fault." VALUE 0x80002931 RecordLayout_3 0 CompuMethod_107 0 65535 /end CHARACTERISTIC
/begin CHARACTERISTIC FaultManager.APP2_AdaptAdaptLoMax.Action_1_Condition "Fault manager configuration.  Select up to 4 actions for each fault." VALUE 0x80002933 RecordLayout_3 0 CompuMethod_108 0 65535 /end CHARACTERISTIC
/begin CHARACTERISTIC FaultManager.APP2_AdaptAdaptLoMax.Action_2 "Fault manager configuration.  Select up to 4 actions for each fault." VALUE 0x80002935 RecordLayout_3 0 CompuMethod_107 0 65535 /end CHARACTERISTIC
/begin CHARACTERISTIC FaultManager.APP2_AdaptAdaptLoMax.Action_2_Condition "Fault manager configuration.  Select up to 4 actions for each fault." VALUE 0x80002937 RecordLayout_3 0 CompuMethod_108 0 65535 /end CHARACTERISTIC
/begin CHARACTERISTIC FaultManager.APP2_AdaptAdaptLoMax.Action_3 "Fault manager configuration.  Select up to 4 actions for each fault." VALUE 0x80002939 RecordLayout_3 0 CompuMethod_107 0 65535 /end CHARACTERISTIC
/begin CHARACTERISTIC FaultManager.APP2_AdaptAdaptLoMax.Action_3_Condition "Fault manager configuration.  Select up to 4 actions for each fault." VALUE 0x8000293B RecordLayout_3 0 CompuMethod_108 0 65535 /end CHARACTERISTIC
/begin CHARACTERISTIC FaultManager.APP2_AdaptAdaptLoMax.Action_4 "Fault manager configuration.  Select up to 4 actions for each fault." VALUE 0x8000293D RecordLayout_3 0 CompuMethod_107 0 65535 /end CHARACTERISTIC
/begin CHARACTERISTIC FaultManager.APP2_AdaptAdaptLoMax.Action_4_Condition "Fault manager configuration.  Select up to 4 actions for each fault." VALUE 0x8000293F RecordLayout_3 0 CompuMethod_108 0 65535 /end CHARACTERISTIC
/begin CHARACTERISTIC FaultManager.APP2_AdaptAdaptLoMin.Mode "Fault manager configuration.  Select up to 4 actions for each fault." VALUE 0x80002941 RecordLayout_3 0 CompuMethod_105 0 65535 /end CHARACTERISTIC
/begin CHARACTERISTIC FaultManager.APP2_AdaptAdaptLoMin.ID "Fault manager configuration.  Select up to 4 actions for each fault." VALUE 0x80002943 RecordLayout_3 0 CompuMethod_1 0 65535 /end CHARACTERISTIC
/begin CHARACTERISTIC FaultManager.APP2_AdaptAdaptLoMin.Test "Fault manager configuration.  Select up to 4 actions for each fault." VALUE 0x80002945 RecordLayout_3 0 CompuMethod_106 0 65535 /end CHARACTERISTIC
/begin CHARACTERISTIC FaultManager.APP2_AdaptAdaptLoMin.Faulty_Samples__X_ "Fault manager configuration.  Select up to 4 actions for each fault." VALUE 0x80002947 RecordLayout_3 0 CompuMethod_1 0 65535 /end CHARACTERISTIC
/begin CHARACTERISTIC FaultManager.APP2_AdaptAdaptLoMin.Total_Samples__Y_ "Fault manager configuration.  Select up to 4 actions for each fault." VALUE 0x80002949 RecordLayout_3 0 CompuMethod_1 0 65535 /end CHARACTERISTIC
/begin CHARACTERISTIC FaultManager.APP2_AdaptAdaptLoMin.Action_1 "Fault manager configuration.  Select up to 4 actions for each fault." VALUE 0x8000294B RecordLayout_3 0 CompuMethod_107 0 65535 /end CHARACTERISTIC
/begin CHARACTERISTIC FaultManager.APP2_AdaptAdaptLoMin.Action_1_Condition "Fault manager configuration.  Select up to 4 actions for each fault." VALUE 0x8000294D RecordLayout_3 0 CompuMethod_108 0 65535 /end CHARACTERISTIC
/begin CHARACTERISTIC FaultManager.APP2_AdaptAdaptLoMin.Action_2 "Fault manager configuration.  Select up to 4 actions for each fault." VALUE 0x8000294F RecordLayout_3 0 CompuMethod_107 0 65535 /end CHARACTERISTIC
/begin CHARACTERISTIC FaultManager.APP2_AdaptAdaptLoMin.Action_2_Condition "Fault manager configuration.  Select up to 4 actions for each fault." VALUE 0x80002951 RecordLayout_3 0 CompuMethod_108 0 65535 /end CHARACTERISTIC
/begin CHARACTERISTIC FaultManager.APP2_AdaptAdaptLoMin.Action_3 "Fault manager configuration.  Select up to 4 actions for each fault." VALUE 0x80002953 RecordLayout_3 0 CompuMethod_107 0 65535 /end CHARACTERISTIC
/begin CHARACTERISTIC FaultManager.APP2_AdaptAdaptLoMin.Action_3_Condition "Fault manager configuration.  Select up to 4 actions for each fault." VALUE 0x80002955 RecordLayout_3 0 CompuMethod_108 0 65535 /end CHARACTERISTIC
/begin CHARACTERISTIC FaultManager.APP2_AdaptAdaptLoMin.Action_4 "Fault manager configuration.  Select up to 4 actions for each fault." VALUE 0x80002957 RecordLayout_3 0 CompuMethod_107 0 65535 /end CHARACTERISTIC
/begin CHARACTERISTIC FaultManager.APP2_AdaptAdaptLoMin.Action_4_Condition "Fault manager configuration.  Select up to 4 actions for each fault." VALUE 0x80002959 RecordLayout_3 0 CompuMethod_108 0 65535 /end CHARACTERISTIC
/begin CHARACTERISTIC FaultManager.APP2_AdaptRangeHigh.Mode "Fault manager configuration.  Select up to 4 actions for each fault." VALUE 0x8000295B RecordLayout_3 0 CompuMethod_105 0 65535 /end CHARACTERISTIC
/begin CHARACTERISTIC FaultManager.APP2_AdaptRangeHigh.ID "Fault manager configuration.  Select up to 4 actions for each fault." VALUE 0x8000295D RecordLayout_3 0 CompuMethod_1 0 65535 /end CHARACTERISTIC
/begin CHARACTERISTIC FaultManager.APP2_AdaptRangeHigh.Test "Fault manager configuration.  Select up to 4 actions for each fault." VALUE 0x8000295F RecordLayout_3 0 CompuMethod_106 0 65535 /end CHARACTERISTIC
/begin CHARACTERISTIC FaultManager.APP2_AdaptRangeHigh.Faulty_Samples__X_ "Fault manager configuration.  Select up to 4 actions for each fault." VALUE 0x80002961 RecordLayout_3 0 CompuMethod_1 0 65535 /end CHARACTERISTIC
/begin CHARACTERISTIC FaultManager.APP2_AdaptRangeHigh.Total_Samples__Y_ "Fault manager configuration.  Select up to 4 actions for each fault." VALUE 0x80002963 RecordLayout_3 0 CompuMethod_1 0 65535 /end CHARACTERISTIC
/begin CHARACTERISTIC FaultManager.APP2_AdaptRangeHigh.Action_1 "Fault manager configuration.  Select up to 4 actions for each fault." VALUE 0x80002965 RecordLayout_3 0 CompuMethod_107 0 65535 /end CHARACTERISTIC
/begin CHARACTERISTIC FaultManager.APP2_AdaptRangeHigh.Action_1_Condition "Fault manager configuration.  Select up to 4 actions for each fault." VALUE 0x80002967 RecordLayout_3 0 CompuMethod_108 0 65535 /end CHARACTERISTIC
/begin CHARACTERISTIC FaultManager.APP2_AdaptRangeHigh.Action_2 "Fault manager configuration.  Select up to 4 actions for each fault." VALUE 0x80002969 RecordLayout_3 0 CompuMethod_107 0 65535 /end CHARACTERISTIC
/begin CHARACTERISTIC FaultManager.APP2_AdaptRangeHigh.Action_2_Condition "Fault manager configuration.  Select up to 4 actions for each fault." VALUE 0x8000296B RecordLayout_3 0 CompuMethod_108 0 65535 /end CHARACTERISTIC
/begin CHARACTERISTIC FaultManager.APP2_AdaptRangeHigh.Action_3 "Fault manager configuration.  Select up to 4 actions for each fault." VALUE 0x8000296D RecordLayout_3 0 CompuMethod_107 0 65535 /end CHARACTERISTIC
/begin CHARACTERISTIC FaultManager.APP2_AdaptRangeHigh.Action_3_Condition "Fault manager configuration.  Select up to 4 actions for each fault." VALUE 0x8000296F RecordLayout_3 0 CompuMethod_108 0 65535 /end CHARACTERISTIC
/begin CHARACTERISTIC FaultManager.APP2_AdaptRangeHigh.Action_4 "Fault manager configuration.  Select up to 4 actions for each fault." VALUE 0x80002971 RecordLayout_3 0 CompuMethod_107 0 65535 /end CHARACTERISTIC
/begin CHARACTERISTIC FaultManager.APP2_AdaptRangeHigh.Action_4_Condition "Fault manager configuration.  Select up to 4 actions for each fault." VALUE 0x80002973 RecordLayout_3 0 CompuMethod_108 0 65535 /end CHARACTERISTIC
/begin CHARACTERISTIC FaultManager.APP2_AdaptRangeLow.Mode "Fault manager configuration.  Select up to 4 actions for each fault." VALUE 0x80002975 RecordLayout_3 0 CompuMethod_105 0 65535 /end CHARACTERISTIC
/begin CHARACTERISTIC FaultManager.APP2_AdaptRangeLow.ID "Fault manager configuration.  Select up to 4 actions for each fault." VALUE 0x80002977 RecordLayout_3 0 CompuMethod_1 0 65535 /end CHARACTERISTIC
/begin CHARACTERISTIC FaultManager.APP2_AdaptRangeLow.Test "Fault manager configuration.  Select up to 4 actions for each fault." VALUE 0x80002979 RecordLayout_3 0 CompuMethod_106 0 65535 /end CHARACTERISTIC
/begin CHARACTERISTIC FaultManager.APP2_AdaptRangeLow.Faulty_Samples__X_ "Fault manager configuration.  Select up to 4 actions for each fault." VALUE 0x8000297B RecordLayout_3 0 CompuMethod_1 0 65535 /end CHARACTERISTIC
/begin CHARACTERISTIC FaultManager.APP2_AdaptRangeLow.Total_Samples__Y_ "Fault manager configuration.  Select up to 4 actions for each fault." VALUE 0x8000297D RecordLayout_3 0 CompuMethod_1 0 65535 /end CHARACTERISTIC
/begin CHARACTERISTIC FaultManager.APP2_AdaptRangeLow.Action_1 "Fault manager configuration.  Select up to 4 actions for each fault." VALUE 0x8000297F RecordLayout_3 0 CompuMethod_107 0 65535 /end CHARACTERISTIC
/begin CHARACTERISTIC FaultManager.APP2_AdaptRangeLow.Action_1_Condition "Fault manager configuration.  Select up to 4 actions for each fault." VALUE 0x80002981 RecordLayout_3 0 CompuMethod_108 0 65535 /end CHARACTERISTIC
/begin CHARACTERISTIC FaultManager.APP2_AdaptRangeLow.Action_2 "Fault manager configuration.  Select up to 4 actions for each fault." VALUE 0x80002983 RecordLayout_3 0 CompuMethod_107 0 65535 /end CHARACTERISTIC
/begin CHARACTERISTIC FaultManager.APP2_AdaptRangeLow.Action_2_Condition "Fault manager configuration.  Select up to 4 actions for each fault." VALUE 0x80002985 RecordLayout_3 0 CompuMethod_108 0 65535 /end CHARACTERISTIC
/begin CHARACTERISTIC FaultManager.APP2_AdaptRangeLow.Action_3 "Fault manager configuration.  Select up to 4 actions for each fault." VALUE 0x80002987 RecordLayout_3 0 CompuMethod_107 0 65535 /end CHARACTERISTIC
/begin CHARACTERISTIC FaultManager.APP2_AdaptRangeLow.Action_3_Condition "Fault manager configuration.  Select up to 4 actions for each fault." VALUE 0x80002989 RecordLayout_3 0 CompuMethod_108 0 65535 /end CHARACTERISTIC
/begin CHARACTERISTIC FaultManager.APP2_AdaptRangeLow.Action_4 "Fault manager configuration.  Select up to 4 actions for each fault." VALUE 0x8000298B RecordLayout_3 0 CompuMethod_107 0 65535 /end CHARACTERISTIC
/begin CHARACTERISTIC FaultManager.APP2_AdaptRangeLow.Action_4_Condition "Fault manager configuration.  Select up to 4 actions for each fault." VALUE 0x8000298D RecordLayout_3 0 CompuMethod_108 0 65535 /end CHARACTERISTIC
/begin CHARACTERISTIC FaultManager.APP_Sensors_Conflict.Mode "Fault manager configuration.  Select up to 4 actions for each fault." VALUE 0x8000298F RecordLayout_3 0 CompuMethod_105 0 65535 /end CHARACTERISTIC
/begin CHARACTERISTIC FaultManager.APP_Sensors_Conflict.ID "Fault manager configuration.  Select up to 4 actions for each fault." VALUE 0x80002991 RecordLayout_3 0 CompuMethod_1 0 65535 /end CHARACTERISTIC
/begin CHARACTERISTIC FaultManager.APP_Sensors_Conflict.Test "Fault manager configuration.  Select up to 4 actions for each fault." VALUE 0x80002993 RecordLayout_3 0 CompuMethod_106 0 65535 /end CHARACTERISTIC
/begin CHARACTERISTIC FaultManager.APP_Sensors_Conflict.Faulty_Samples__X_ "Fault manager configuration.  Select up to 4 actions for each fault." VALUE 0x80002995 RecordLayout_3 0 CompuMethod_1 0 65535 /end CHARACTERISTIC
/begin CHARACTERISTIC FaultManager.APP_Sensors_Conflict.Total_Samples__Y_ "Fault manager configuration.  Select up to 4 actions for each fault." VALUE 0x80002997 RecordLayout_3 0 CompuMethod_1 0 65535 /end CHARACTERISTIC
/begin CHARACTERISTIC FaultManager.APP_Sensors_Conflict.Action_1 "Fault manager configuration.  Select up to 4 actions for each fault." VALUE 0x80002999 RecordLayout_3 0 CompuMethod_107 0 65535 /end CHARACTERISTIC
/begin CHARACTERISTIC FaultManager.APP_Sensors_Conflict.Action_1_Condition "Fault manager configuration.  Select up to 4 actions for each fault." VALUE 0x8000299B RecordLayout_3 0 CompuMethod_108 0 65535 /end CHARACTERISTIC
/begin CHARACTERISTIC FaultManager.APP_Sensors_Conflict.Action_2 "Fault manager configuration.  Select up to 4 actions for each fault." VALUE 0x8000299D RecordLayout_3 0 CompuMethod_107 0 65535 /end CHARACTERISTIC
/begin CHARACTERISTIC FaultManager.APP_Sensors_Conflict.Action_2_Condition "Fault manager configuration.  Select up to 4 actions for each fault." VALUE 0x8000299F RecordLayout_3 0 CompuMethod_108 0 65535 /end CHARACTERISTIC
/begin CHARACTERISTIC FaultManager.APP_Sensors_Conflict.Action_3 "Fault manager configuration.  Select up to 4 actions for each fault." VALUE 0x800029A1 RecordLayout_3 0 CompuMethod_107 0 65535 /end CHARACTERISTIC
/begin CHARACTERISTIC FaultManager.APP_Sensors_Conflict.Action_3_Condition "Fault manager configuration.  Select up to 4 actions for each fault." VALUE 0x800029A3 RecordLayout_3 0 CompuMethod_108 0 65535 /end CHARACTERISTIC
/begin CHARACTERISTIC FaultManager.APP_Sensors_Conflict.Action_4 "Fault manager configuration.  Select up to 4 actions for each fault." VALUE 0x800029A5 RecordLayout_3 0 CompuMethod_107 0 65535 /end CHARACTERISTIC
/begin CHARACTERISTIC FaultManager.APP_Sensors_Conflict.Action_4_Condition "Fault manager configuration.  Select up to 4 actions for each fault." VALUE 0x800029A7 RecordLayout_3 0 CompuMethod_108 0 65535 /end CHARACTERISTIC
/begin CHARACTERISTIC FaultManager.AirflowMismatch_Fault.Mode "Fault manager configuration.  Select up to 4 actions for each fault." VALUE 0x800029A9 RecordLayout_3 0 CompuMethod_105 0 65535 /end CHARACTERISTIC
/begin CHARACTERISTIC FaultManager.AirflowMismatch_Fault.ID "Fault manager configuration.  Select up to 4 actions for each fault." VALUE 0x800029AB RecordLayout_3 0 CompuMethod_1 0 65535 /end CHARACTERISTIC
/begin CHARACTERISTIC FaultManager.AirflowMismatch_Fault.Test "Fault manager configuration.  Select up to 4 actions for each fault." VALUE 0x800029AD RecordLayout_3 0 CompuMethod_106 0 65535 /end CHARACTERISTIC
/begin CHARACTERISTIC FaultManager.AirflowMismatch_Fault.Faulty_Samples__X_ "Fault manager configuration.  Select up to 4 actions for each fault." VALUE 0x800029AF RecordLayout_3 0 CompuMethod_1 0 65535 /end CHARACTERISTIC
/begin CHARACTERISTIC FaultManager.AirflowMismatch_Fault.Total_Samples__Y_ "Fault manager configuration.  Select up to 4 actions for each fault." VALUE 0x800029B1 RecordLayout_3 0 CompuMethod_1 0 65535 /end CHARACTERISTIC
/begin CHARACTERISTIC FaultManager.AirflowMismatch_Fault.Action_1 "Fault manager configuration.  Select up to 4 actions for each fault." VALUE 0x800029B3 RecordLayout_3 0 CompuMethod_107 0 65535 /end CHARACTERISTIC
/begin CHARACTERISTIC FaultManager.AirflowMismatch_Fault.Action_1_Condition "Fault manager configuration.  Select up to 4 actions for each fault." VALUE 0x800029B5 RecordLayout_3 0 CompuMethod_108 0 65535 /end CHARACTERISTIC
/begin CHARACTERISTIC FaultManager.AirflowMismatch_Fault.Action_2 "Fault manager configuration.  Select up to 4 actions for each fault." VALUE 0x800029B7 RecordLayout_3 0 CompuMethod_107 0 65535 /end CHARACTERISTIC
/begin CHARACTERISTIC FaultManager.AirflowMismatch_Fault.Action_2_Condition "Fault manager configuration.  Select up to 4 actions for each fault." VALUE 0x800029B9 RecordLayout_3 0 CompuMethod_108 0 65535 /end CHARACTERISTIC
/begin CHARACTERISTIC FaultManager.AirflowMismatch_Fault.Action_3 "Fault manager configuration.  Select up to 4 actions for each fault." VALUE 0x800029BB RecordLayout_3 0 CompuMethod_107 0 65535 /end CHARACTERISTIC
/begin CHARACTERISTIC FaultManager.AirflowMismatch_Fault.Action_3_Condition "Fault manager configuration.  Select up to 4 actions for each fault." VALUE 0x800029BD RecordLayout_3 0 CompuMethod_108 0 65535 /end CHARACTERISTIC
/begin CHARACTERISTIC FaultManager.AirflowMismatch_Fault.Action_4 "Fault manager configuration.  Select up to 4 actions for each fault." VALUE 0x800029BF RecordLayout_3 0 CompuMethod_107 0 65535 /end CHARACTERISTIC
/begin CHARACTERISTIC FaultManager.AirflowMismatch_Fault.Action_4_Condition "Fault manager configuration.  Select up to 4 actions for each fault." VALUE 0x800029C1 RecordLayout_3 0 CompuMethod_108 0 65535 /end CHARACTERISTIC
/begin CHARACTERISTIC FaultManager.AltInop_Fault.Mode "Fault manager configuration.  Select up to 4 actions for each fault." VALUE 0x800029C3 RecordLayout_3 0 CompuMethod_105 0 65535 /end CHARACTERISTIC
/begin CHARACTERISTIC FaultManager.AltInop_Fault.ID "Fault manager configuration.  Select up to 4 actions for each fault." VALUE 0x800029C5 RecordLayout_3 0 CompuMethod_1 0 65535 /end CHARACTERISTIC
/begin CHARACTERISTIC FaultManager.AltInop_Fault.Test "Fault manager configuration.  Select up to 4 actions for each fault." VALUE 0x800029C7 RecordLayout_3 0 CompuMethod_106 0 65535 /end CHARACTERISTIC
/begin CHARACTERISTIC FaultManager.AltInop_Fault.Faulty_Samples__X_ "Fault manager configuration.  Select up to 4 actions for each fault." VALUE 0x800029C9 RecordLayout_3 0 CompuMethod_1 0 65535 /end CHARACTERISTIC
/begin CHARACTERISTIC FaultManager.AltInop_Fault.Total_Samples__Y_ "Fault manager configuration.  Select up to 4 actions for each fault." VALUE 0x800029CB RecordLayout_3 0 CompuMethod_1 0 65535 /end CHARACTERISTIC
/begin CHARACTERISTIC FaultManager.AltInop_Fault.Action_1 "Fault manager configuration.  Select up to 4 actions for each fault." VALUE 0x800029CD RecordLayout_3 0 CompuMethod_107 0 65535 /end CHARACTERISTIC
/begin CHARACTERISTIC FaultManager.AltInop_Fault.Action_1_Condition "Fault manager configuration.  Select up to 4 actions for each fault." VALUE 0x800029CF RecordLayout_3 0 CompuMethod_108 0 65535 /end CHARACTERISTIC
/begin CHARACTERISTIC FaultManager.AltInop_Fault.Action_2 "Fault manager configuration.  Select up to 4 actions for each fault." VALUE 0x800029D1 RecordLayout_3 0 CompuMethod_107 0 65535 /end CHARACTERISTIC
/begin CHARACTERISTIC FaultManager.AltInop_Fault.Action_2_Condition "Fault manager configuration.  Select up to 4 actions for each fault." VALUE 0x800029D3 RecordLayout_3 0 CompuMethod_108 0 65535 /end CHARACTERISTIC
/begin CHARACTERISTIC FaultManager.AltInop_Fault.Action_3 "Fault manager configuration.  Select up to 4 actions for each fault." VALUE 0x800029D5 RecordLayout_3 0 CompuMethod_107 0 65535 /end CHARACTERISTIC
/begin CHARACTERISTIC FaultManager.AltInop_Fault.Action_3_Condition "Fault manager configuration.  Select up to 4 actions for each fault." VALUE 0x800029D7 RecordLayout_3 0 CompuMethod_108 0 65535 /end CHARACTERISTIC
/begin CHARACTERISTIC FaultManager.AltInop_Fault.Action_4 "Fault manager configuration.  Select up to 4 actions for each fault." VALUE 0x800029D9 RecordLayout_3 0 CompuMethod_107 0 65535 /end CHARACTERISTIC
/begin CHARACTERISTIC FaultManager.AltInop_Fault.Action_4_Condition "Fault manager configuration.  Select up to 4 actions for each fault." VALUE 0x800029DB RecordLayout_3 0 CompuMethod_108 0 65535 /end CHARACTERISTIC
/begin CHARACTERISTIC FaultManager.Bank1_EquivRatioRangeHigh.Mode "Fault manager configuration.  Select up to 4 actions for each fault." VALUE 0x800029DD RecordLayout_3 0 CompuMethod_105 0 65535 /end CHARACTERISTIC
/begin CHARACTERISTIC FaultManager.Bank1_EquivRatioRangeHigh.ID "Fault manager configuration.  Select up to 4 actions for each fault." VALUE 0x800029DF RecordLayout_3 0 CompuMethod_1 0 65535 /end CHARACTERISTIC
/begin CHARACTERISTIC FaultManager.Bank1_EquivRatioRangeHigh.Test "Fault manager configuration.  Select up to 4 actions for each fault." VALUE 0x800029E1 RecordLayout_3 0 CompuMethod_106 0 65535 /end CHARACTERISTIC
/begin CHARACTERISTIC FaultManager.Bank1_EquivRatioRangeHigh.Faulty_Samples__X_ "Fault manager configuration.  Select up to 4 actions for each fault." VALUE 0x800029E3 RecordLayout_3 0 CompuMethod_1 0 65535 /end CHARACTERISTIC
/begin CHARACTERISTIC FaultManager.Bank1_EquivRatioRangeHigh.Total_Samples__Y_ "Fault manager configuration.  Select up to 4 actions for each fault." VALUE 0x800029E5 RecordLayout_3 0 CompuMethod_1 0 65535 /end CHARACTERISTIC
/begin CHARACTERISTIC FaultManager.Bank1_EquivRatioRangeHigh.Action_1 "Fault manager configuration.  Select up to 4 actions for each fault." VALUE 0x800029E7 RecordLayout_3 0 CompuMethod_107 0 65535 /end CHARACTERISTIC
/begin CHARACTERISTIC FaultManager.Bank1_EquivRatioRangeHigh.Action_1_Condition "Fault manager configuration.  Select up to 4 actions for each fault." VALUE 0x800029E9 RecordLayout_3 0 CompuMethod_108 0 65535 /end CHARACTERISTIC
/begin CHARACTERISTIC FaultManager.Bank1_EquivRatioRangeHigh.Action_2 "Fault manager configuration.  Select up to 4 actions for each fault." VALUE 0x800029EB RecordLayout_3 0 CompuMethod_107 0 65535 /end CHARACTERISTIC
/begin CHARACTERISTIC FaultManager.Bank1_EquivRatioRangeHigh.Action_2_Condition "Fault manager configuration.  Select up to 4 actions for each fault." VALUE 0x800029ED RecordLayout_3 0 CompuMethod_108 0 65535 /end CHARACTERISTIC
/begin CHARACTERISTIC FaultManager.Bank1_EquivRatioRangeHigh.Action_3 "Fault manager configuration.  Select up to 4 actions for each fault." VALUE 0x800029EF RecordLayout_3 0 CompuMethod_107 0 65535 /end CHARACTERISTIC
/begin CHARACTERISTIC FaultManager.Bank1_EquivRatioRangeHigh.Action_3_Condition "Fault manager configuration.  Select up to 4 actions for each fault." VALUE 0x800029F1 RecordLayout_3 0 CompuMethod_108 0 65535 /end CHARACTERISTIC
/begin CHARACTERISTIC FaultManager.Bank1_EquivRatioRangeHigh.Action_4 "Fault manager configuration.  Select up to 4 actions for each fault." VALUE 0x800029F3 RecordLayout_3 0 CompuMethod_107 0 65535 /end CHARACTERISTIC
/begin CHARACTERISTIC FaultManager.Bank1_EquivRatioRangeHigh.Action_4_Condition "Fault manager configuration.  Select up to 4 actions for each fault." VALUE 0x800029F5 RecordLayout_3 0 CompuMethod_108 0 65535 /end CHARACTERISTIC
/begin CHARACTERISTIC FaultManager.Bank1_EquivRatioRangeLow.Mode "Fault manager configuration.  Select up to 4 actions for each fault." VALUE 0x800029F7 RecordLayout_3 0 CompuMethod_105 0 65535 /end CHARACTERISTIC
/begin CHARACTERISTIC FaultManager.Bank1_EquivRatioRangeLow.ID "Fault manager configuration.  Select up to 4 actions for each fault." VALUE 0x800029F9 RecordLayout_3 0 CompuMethod_1 0 65535 /end CHARACTERISTIC
/begin CHARACTERISTIC FaultManager.Bank1_EquivRatioRangeLow.Test "Fault manager configuration.  Select up to 4 actions for each fault." VALUE 0x800029FB RecordLayout_3 0 CompuMethod_106 0 65535 /end CHARACTERISTIC
/begin CHARACTERISTIC FaultManager.Bank1_EquivRatioRangeLow.Faulty_Samples__X_ "Fault manager configuration.  Select up to 4 actions for each fault." VALUE 0x800029FD RecordLayout_3 0 CompuMethod_1 0 65535 /end CHARACTERISTIC
/begin CHARACTERISTIC FaultManager.Bank1_EquivRatioRangeLow.Total_Samples__Y_ "Fault manager configuration.  Select up to 4 actions for each fault." VALUE 0x800029FF RecordLayout_3 0 CompuMethod_1 0 65535 /end CHARACTERISTIC
/begin CHARACTERISTIC FaultManager.Bank1_EquivRatioRangeLow.Action_1 "Fault manager configuration.  Select up to 4 actions for each fault." VALUE 0x80002A01 RecordLayout_3 0 CompuMethod_107 0 65535 /end CHARACTERISTIC
/begin CHARACTERISTIC FaultManager.Bank1_EquivRatioRangeLow.Action_1_Condition "Fault manager configuration.  Select up to 4 actions for each fault." VALUE 0x80002A03 RecordLayout_3 0 CompuMethod_108 0 65535 /end CHARACTERISTIC
/begin CHARACTERISTIC FaultManager.Bank1_EquivRatioRangeLow.Action_2 "Fault manager configuration.  Select up to 4 actions for each fault." VALUE 0x80002A05 RecordLayout_3 0 CompuMethod_107 0 65535 /end CHARACTERISTIC
/begin CHARACTERISTIC FaultManager.Bank1_EquivRatioRangeLow.Action_2_Condition "Fault manager configuration.  Select up to 4 actions for each fault." VALUE 0x80002A07 RecordLayout_3 0 CompuMethod_108 0 65535 /end CHARACTERISTIC
/begin CHARACTERISTIC FaultManager.Bank1_EquivRatioRangeLow.Action_3 "Fault manager configuration.  Select up to 4 actions for each fault." VALUE 0x80002A09 RecordLayout_3 0 CompuMethod_107 0 65535 /end CHARACTERISTIC
/begin CHARACTERISTIC FaultManager.Bank1_EquivRatioRangeLow.Action_3_Condition "Fault manager configuration.  Select up to 4 actions for each fault." VALUE 0x80002A0B RecordLayout_3 0 CompuMethod_108 0 65535 /end CHARACTERISTIC
/begin CHARACTERISTIC FaultManager.Bank1_EquivRatioRangeLow.Action_4 "Fault manager configuration.  Select up to 4 actions for each fault." VALUE 0x80002A0D RecordLayout_3 0 CompuMethod_107 0 65535 /end CHARACTERISTIC
/begin CHARACTERISTIC FaultManager.Bank1_EquivRatioRangeLow.Action_4_Condition "Fault manager configuration.  Select up to 4 actions for each fault." VALUE 0x80002A0F RecordLayout_3 0 CompuMethod_108 0 65535 /end CHARACTERISTIC
/begin CHARACTERISTIC FaultManager.Bank2_EquivRatioRangeHigh.Mode "Fault manager configuration.  Select up to 4 actions for each fault." VALUE 0x80002A11 RecordLayout_3 0 CompuMethod_105 0 65535 /end CHARACTERISTIC
/begin CHARACTERISTIC FaultManager.Bank2_EquivRatioRangeHigh.ID "Fault manager configuration.  Select up to 4 actions for each fault." VALUE 0x80002A13 RecordLayout_3 0 CompuMethod_1 0 65535 /end CHARACTERISTIC
/begin CHARACTERISTIC FaultManager.Bank2_EquivRatioRangeHigh.Test "Fault manager configuration.  Select up to 4 actions for each fault." VALUE 0x80002A15 RecordLayout_3 0 CompuMethod_106 0 65535 /end CHARACTERISTIC
/begin CHARACTERISTIC FaultManager.Bank2_EquivRatioRangeHigh.Faulty_Samples__X_ "Fault manager configuration.  Select up to 4 actions for each fault." VALUE 0x80002A17 RecordLayout_3 0 CompuMethod_1 0 65535 /end CHARACTERISTIC
/begin CHARACTERISTIC FaultManager.Bank2_EquivRatioRangeHigh.Total_Samples__Y_ "Fault manager configuration.  Select up to 4 actions for each fault." VALUE 0x80002A19 RecordLayout_3 0 CompuMethod_1 0 65535 /end CHARACTERISTIC
/begin CHARACTERISTIC FaultManager.Bank2_EquivRatioRangeHigh.Action_1 "Fault manager configuration.  Select up to 4 actions for each fault." VALUE 0x80002A1B RecordLayout_3 0 CompuMethod_107 0 65535 /end CHARACTERISTIC
/begin CHARACTERISTIC FaultManager.Bank2_EquivRatioRangeHigh.Action_1_Condition "Fault manager configuration.  Select up to 4 actions for each fault." VALUE 0x80002A1D RecordLayout_3 0 CompuMethod_108 0 65535 /end CHARACTERISTIC
/begin CHARACTERISTIC FaultManager.Bank2_EquivRatioRangeHigh.Action_2 "Fault manager configuration.  Select up to 4 actions for each fault." VALUE 0x80002A1F RecordLayout_3 0 CompuMethod_107 0 65535 /end CHARACTERISTIC
/begin CHARACTERISTIC FaultManager.Bank2_EquivRatioRangeHigh.Action_2_Condition "Fault manager configuration.  Select up to 4 actions for each fault." VALUE 0x80002A21 RecordLayout_3 0 CompuMethod_108 0 65535 /end CHARACTERISTIC
/begin CHARACTERISTIC FaultManager.Bank2_EquivRatioRangeHigh.Action_3 "Fault manager configuration.  Select up to 4 actions for each fault." VALUE 0x80002A23 RecordLayout_3 0 CompuMethod_107 0 65535 /end CHARACTERISTIC
/begin CHARACTERISTIC FaultManager.Bank2_EquivRatioRangeHigh.Action_3_Condition "Fault manager configuration.  Select up to 4 actions for each fault." VALUE 0x80002A25 RecordLayout_3 0 CompuMethod_108 0 65535 /end CHARACTERISTIC
/begin CHARACTERISTIC FaultManager.Bank2_EquivRatioRangeHigh.Action_4 "Fault manager configuration.  Select up to 4 actions for each fault." VALUE 0x80002A27 RecordLayout_3 0 CompuMethod_107 0 65535 /end CHARACTERISTIC
/begin CHARACTERISTIC FaultManager.Bank2_EquivRatioRangeHigh.Action_4_Condition "Fault manager configuration.  Select up to 4 actions for each fault." VALUE 0x80002A29 RecordLayout_3 0 CompuMethod_108 0 65535 /end CHARACTERISTIC
/begin CHARACTERISTIC FaultManager.Bank2_EquivRatioRangeLow.Mode "Fault manager configuration.  Select up to 4 actions for each fault." VALUE 0x80002A2B RecordLayout_3 0 CompuMethod_105 0 65535 /end CHARACTERISTIC
/begin CHARACTERISTIC FaultManager.Bank2_EquivRatioRangeLow.ID "Fault manager configuration.  Select up to 4 actions for each fault." VALUE 0x80002A2D RecordLayout_3 0 CompuMethod_1 0 65535 /end CHARACTERISTIC
/begin CHARACTERISTIC FaultManager.Bank2_EquivRatioRangeLow.Test "Fault manager configuration.  Select up to 4 actions for each fault." VALUE 0x80002A2F RecordLayout_3 0 CompuMethod_106 0 65535 /end CHARACTERISTIC
/begin CHARACTERISTIC FaultManager.Bank2_EquivRatioRangeLow.Faulty_Samples__X_ "Fault manager configuration.  Select up to 4 actions for each fault." VALUE 0x80002A31 RecordLayout_3 0 CompuMethod_1 0 65535 /end CHARACTERISTIC
/begin CHARACTERISTIC FaultManager.Bank2_EquivRatioRangeLow.Total_Samples__Y_ "Fault manager configuration.  Select up to 4 actions for each fault." VALUE 0x80002A33 RecordLayout_3 0 CompuMethod_1 0 65535 /end CHARACTERISTIC
/begin CHARACTERISTIC FaultManager.Bank2_EquivRatioRangeLow.Action_1 "Fault manager configuration.  Select up to 4 actions for each fault." VALUE 0x80002A35 RecordLayout_3 0 CompuMethod_107 0 65535 /end CHARACTERISTIC
/begin CHARACTERISTIC FaultManager.Bank2_EquivRatioRangeLow.Action_1_Condition "Fault manager configuration.  Select up to 4 actions for each fault." VALUE 0x80002A37 RecordLayout_3 0 CompuMethod_108 0 65535 /end CHARACTERISTIC
/begin CHARACTERISTIC FaultManager.Bank2_EquivRatioRangeLow.Action_2 "Fault manager configuration.  Select up to 4 actions for each fault." VALUE 0x80002A39 RecordLayout_3 0 CompuMethod_107 0 65535 /end CHARACTERISTIC
/begin CHARACTERISTIC FaultManager.Bank2_EquivRatioRangeLow.Action_2_Condition "Fault manager configuration.  Select up to 4 actions for each fault." VALUE 0x80002A3B RecordLayout_3 0 CompuMethod_108 0 65535 /end CHARACTERISTIC
/begin CHARACTERISTIC FaultManager.Bank2_EquivRatioRangeLow.Action_3 "Fault manager configuration.  Select up to 4 actions for each fault." VALUE 0x80002A3D RecordLayout_3 0 CompuMethod_107 0 65535 /end CHARACTERISTIC
/begin CHARACTERISTIC FaultManager.Bank2_EquivRatioRangeLow.Action_3_Condition "Fault manager configuration.  Select up to 4 actions for each fault." VALUE 0x80002A3F RecordLayout_3 0 CompuMethod_108 0 65535 /end CHARACTERISTIC
/begin CHARACTERISTIC FaultManager.Bank2_EquivRatioRangeLow.Action_4 "Fault manager configuration.  Select up to 4 actions for each fault." VALUE 0x80002A41 RecordLayout_3 0 CompuMethod_107 0 65535 /end CHARACTERISTIC
/begin CHARACTERISTIC FaultManager.Bank2_EquivRatioRangeLow.Action_4_Condition "Fault manager configuration.  Select up to 4 actions for each fault." VALUE 0x80002A43 RecordLayout_3 0 CompuMethod_108 0 65535 /end CHARACTERISTIC
/begin CHARACTERISTIC FaultManager.CATRangeHigh.Mode "Fault manager configuration.  Select up to 4 actions for each fault." VALUE 0x80002A45 RecordLayout_3 0 CompuMethod_105 0 65535 /end CHARACTERISTIC
/begin CHARACTERISTIC FaultManager.CATRangeHigh.ID "Fault manager configuration.  Select up to 4 actions for each fault." VALUE 0x80002A47 RecordLayout_3 0 CompuMethod_1 0 65535 /end CHARACTERISTIC
/begin CHARACTERISTIC FaultManager.CATRangeHigh.Test "Fault manager configuration.  Select up to 4 actions for each fault." VALUE 0x80002A49 RecordLayout_3 0 CompuMethod_106 0 65535 /end CHARACTERISTIC
/begin CHARACTERISTIC FaultManager.CATRangeHigh.Faulty_Samples__X_ "Fault manager configuration.  Select up to 4 actions for each fault." VALUE 0x80002A4B RecordLayout_3 0 CompuMethod_1 0 65535 /end CHARACTERISTIC
/begin CHARACTERISTIC FaultManager.CATRangeHigh.Total_Samples__Y_ "Fault manager configuration.  Select up to 4 actions for each fault." VALUE 0x80002A4D RecordLayout_3 0 CompuMethod_1 0 65535 /end CHARACTERISTIC
/begin CHARACTERISTIC FaultManager.CATRangeHigh.Action_1 "Fault manager configuration.  Select up to 4 actions for each fault." VALUE 0x80002A4F RecordLayout_3 0 CompuMethod_107 0 65535 /end CHARACTERISTIC
/begin CHARACTERISTIC FaultManager.CATRangeHigh.Action_1_Condition "Fault manager configuration.  Select up to 4 actions for each fault." VALUE 0x80002A51 RecordLayout_3 0 CompuMethod_108 0 65535 /end CHARACTERISTIC
/begin CHARACTERISTIC FaultManager.CATRangeHigh.Action_2 "Fault manager configuration.  Select up to 4 actions for each fault." VALUE 0x80002A53 RecordLayout_3 0 CompuMethod_107 0 65535 /end CHARACTERISTIC
/begin CHARACTERISTIC FaultManager.CATRangeHigh.Action_2_Condition "Fault manager configuration.  Select up to 4 actions for each fault." VALUE 0x80002A55 RecordLayout_3 0 CompuMethod_108 0 65535 /end CHARACTERISTIC
/begin CHARACTERISTIC FaultManager.CATRangeHigh.Action_3 "Fault manager configuration.  Select up to 4 actions for each fault." VALUE 0x80002A57 RecordLayout_3 0 CompuMethod_107 0 65535 /end CHARACTERISTIC
/begin CHARACTERISTIC FaultManager.CATRangeHigh.Action_3_Condition "Fault manager configuration.  Select up to 4 actions for each fault." VALUE 0x80002A59 RecordLayout_3 0 CompuMethod_108 0 65535 /end CHARACTERISTIC
/begin CHARACTERISTIC FaultManager.CATRangeHigh.Action_4 "Fault manager configuration.  Select up to 4 actions for each fault." VALUE 0x80002A5B RecordLayout_3 0 CompuMethod_107 0 65535 /end CHARACTERISTIC
/begin CHARACTERISTIC FaultManager.CATRangeHigh.Action_4_Condition "Fault manager configuration.  Select up to 4 actions for each fault." VALUE 0x80002A5D RecordLayout_3 0 CompuMethod_108 0 65535 /end CHARACTERISTIC
/begin CHARACTERISTIC FaultManager.CATRangeLow.Mode "Fault manager configuration.  Select up to 4 actions for each fault." VALUE 0x80002A5F RecordLayout_3 0 CompuMethod_105 0 65535 /end CHARACTERISTIC
/begin CHARACTERISTIC FaultManager.CATRangeLow.ID "Fault manager configuration.  Select up to 4 actions for each fault." VALUE 0x80002A61 RecordLayout_3 0 CompuMethod_1 0 65535 /end CHARACTERISTIC
/begin CHARACTERISTIC FaultManager.CATRangeLow.Test "Fault manager configuration.  Select up to 4 actions for each fault." VALUE 0x80002A63 RecordLayout_3 0 CompuMethod_106 0 65535 /end CHARACTERISTIC
/begin CHARACTERISTIC FaultManager.CATRangeLow.Faulty_Samples__X_ "Fault manager configuration.  Select up to 4 actions for each fault." VALUE 0x80002A65 RecordLayout_3 0 CompuMethod_1 0 65535 /end CHARACTERISTIC
/begin CHARACTERISTIC FaultManager.CATRangeLow.Total_Samples__Y_ "Fault manager configuration.  Select up to 4 actions for each fault." VALUE 0x80002A67 RecordLayout_3 0 CompuMethod_1 0 65535 /end CHARACTERISTIC
/begin CHARACTERISTIC FaultManager.CATRangeLow.Action_1 "Fault manager configuration.  Select up to 4 actions for each fault." VALUE 0x80002A69 RecordLayout_3 0 CompuMethod_107 0 65535 /end CHARACTERISTIC
/begin CHARACTERISTIC FaultManager.CATRangeLow.Action_1_Condition "Fault manager configuration.  Select up to 4 actions for each fault." VALUE 0x80002A6B RecordLayout_3 0 CompuMethod_108 0 65535 /end CHARACTERISTIC
/begin CHARACTERISTIC FaultManager.CATRangeLow.Action_2 "Fault manager configuration.  Select up to 4 actions for each fault." VALUE 0x80002A6D RecordLayout_3 0 CompuMethod_107 0 65535 /end CHARACTERISTIC
/begin CHARACTERISTIC FaultManager.CATRangeLow.Action_2_Condition "Fault manager configuration.  Select up to 4 actions for each fault." VALUE 0x80002A6F RecordLayout_3 0 CompuMethod_108 0 65535 /end CHARACTERISTIC
/begin CHARACTERISTIC FaultManager.CATRangeLow.Action_3 "Fault manager configuration.  Select up to 4 actions for each fault." VALUE 0x80002A71 RecordLayout_3 0 CompuMethod_107 0 65535 /end CHARACTERISTIC
/begin CHARACTERISTIC FaultManager.CATRangeLow.Action_3_Condition "Fault manager configuration.  Select up to 4 actions for each fault." VALUE 0x80002A73 RecordLayout_3 0 CompuMethod_108 0 65535 /end CHARACTERISTIC
/begin CHARACTERISTIC FaultManager.CATRangeLow.Action_4 "Fault manager configuration.  Select up to 4 actions for each fault." VALUE 0x80002A75 RecordLayout_3 0 CompuMethod_107 0 65535 /end CHARACTERISTIC
/begin CHARACTERISTIC FaultManager.CATRangeLow.Action_4_Condition "Fault manager configuration.  Select up to 4 actions for each fault." VALUE 0x80002A77 RecordLayout_3 0 CompuMethod_108 0 65535 /end CHARACTERISTIC
/begin CHARACTERISTIC FaultManager.CamEdgesFault.Mode "Fault manager configuration.  Select up to 4 actions for each fault." VALUE 0x80002A79 RecordLayout_3 0 CompuMethod_105 0 65535 /end CHARACTERISTIC
/begin CHARACTERISTIC FaultManager.CamEdgesFault.ID "Fault manager configuration.  Select up to 4 actions for each fault." VALUE 0x80002A7B RecordLayout_3 0 CompuMethod_1 0 65535 /end CHARACTERISTIC
/begin CHARACTERISTIC FaultManager.CamEdgesFault.Test "Fault manager configuration.  Select up to 4 actions for each fault." VALUE 0x80002A7D RecordLayout_3 0 CompuMethod_106 0 65535 /end CHARACTERISTIC
/begin CHARACTERISTIC FaultManager.CamEdgesFault.Faulty_Samples__X_ "Fault manager configuration.  Select up to 4 actions for each fault." VALUE 0x80002A7F RecordLayout_3 0 CompuMethod_1 0 65535 /end CHARACTERISTIC
/begin CHARACTERISTIC FaultManager.CamEdgesFault.Total_Samples__Y_ "Fault manager configuration.  Select up to 4 actions for each fault." VALUE 0x80002A81 RecordLayout_3 0 CompuMethod_1 0 65535 /end CHARACTERISTIC
/begin CHARACTERISTIC FaultManager.CamEdgesFault.Action_1 "Fault manager configuration.  Select up to 4 actions for each fault." VALUE 0x80002A83 RecordLayout_3 0 CompuMethod_107 0 65535 /end CHARACTERISTIC
/begin CHARACTERISTIC FaultManager.CamEdgesFault.Action_1_Condition "Fault manager configuration.  Select up to 4 actions for each fault." VALUE 0x80002A85 RecordLayout_3 0 CompuMethod_108 0 65535 /end CHARACTERISTIC
/begin CHARACTERISTIC FaultManager.CamEdgesFault.Action_2 "Fault manager configuration.  Select up to 4 actions for each fault." VALUE 0x80002A87 RecordLayout_3 0 CompuMethod_107 0 65535 /end CHARACTERISTIC
/begin CHARACTERISTIC FaultManager.CamEdgesFault.Action_2_Condition "Fault manager configuration.  Select up to 4 actions for each fault." VALUE 0x80002A89 RecordLayout_3 0 CompuMethod_108 0 65535 /end CHARACTERISTIC
/begin CHARACTERISTIC FaultManager.CamEdgesFault.Action_3 "Fault manager configuration.  Select up to 4 actions for each fault." VALUE 0x80002A8B RecordLayout_3 0 CompuMethod_107 0 65535 /end CHARACTERISTIC
/begin CHARACTERISTIC FaultManager.CamEdgesFault.Action_3_Condition "Fault manager configuration.  Select up to 4 actions for each fault." VALUE 0x80002A8D RecordLayout_3 0 CompuMethod_108 0 65535 /end CHARACTERISTIC
/begin CHARACTERISTIC FaultManager.CamEdgesFault.Action_4 "Fault manager configuration.  Select up to 4 actions for each fault." VALUE 0x80002A8F RecordLayout_3 0 CompuMethod_107 0 65535 /end CHARACTERISTIC
/begin CHARACTERISTIC FaultManager.CamEdgesFault.Action_4_Condition "Fault manager configuration.  Select up to 4 actions for each fault." VALUE 0x80002A91 RecordLayout_3 0 CompuMethod_108 0 65535 /end CHARACTERISTIC
/begin CHARACTERISTIC FaultManager.CamSyncFault.Mode "Fault manager configuration.  Select up to 4 actions for each fault." VALUE 0x80002A93 RecordLayout_3 0 CompuMethod_105 0 65535 /end CHARACTERISTIC
/begin CHARACTERISTIC FaultManager.CamSyncFault.ID "Fault manager configuration.  Select up to 4 actions for each fault." VALUE 0x80002A95 RecordLayout_3 0 CompuMethod_1 0 65535 /end CHARACTERISTIC
/begin CHARACTERISTIC FaultManager.CamSyncFault.Test "Fault manager configuration.  Select up to 4 actions for each fault." VALUE 0x80002A97 RecordLayout_3 0 CompuMethod_106 0 65535 /end CHARACTERISTIC
/begin CHARACTERISTIC FaultManager.CamSyncFault.Faulty_Samples__X_ "Fault manager configuration.  Select up to 4 actions for each fault." VALUE 0x80002A99 RecordLayout_3 0 CompuMethod_1 0 65535 /end CHARACTERISTIC
/begin CHARACTERISTIC FaultManager.CamSyncFault.Total_Samples__Y_ "Fault manager configuration.  Select up to 4 actions for each fault." VALUE 0x80002A9B RecordLayout_3 0 CompuMethod_1 0 65535 /end CHARACTERISTIC
/begin CHARACTERISTIC FaultManager.CamSyncFault.Action_1 "Fault manager configuration.  Select up to 4 actions for each fault." VALUE 0x80002A9D RecordLayout_3 0 CompuMethod_107 0 65535 /end CHARACTERISTIC
/begin CHARACTERISTIC FaultManager.CamSyncFault.Action_1_Condition "Fault manager configuration.  Select up to 4 actions for each fault." VALUE 0x80002A9F RecordLayout_3 0 CompuMethod_108 0 65535 /end CHARACTERISTIC
/begin CHARACTERISTIC FaultManager.CamSyncFault.Action_2 "Fault manager configuration.  Select up to 4 actions for each fault." VALUE 0x80002AA1 RecordLayout_3 0 CompuMethod_107 0 65535 /end CHARACTERISTIC
/begin CHARACTERISTIC FaultManager.CamSyncFault.Action_2_Condition "Fault manager configuration.  Select up to 4 actions for each fault." VALUE 0x80002AA3 RecordLayout_3 0 CompuMethod_108 0 65535 /end CHARACTERISTIC
/begin CHARACTERISTIC FaultManager.CamSyncFault.Action_3 "Fault manager configuration.  Select up to 4 actions for each fault." VALUE 0x80002AA5 RecordLayout_3 0 CompuMethod_107 0 65535 /end CHARACTERISTIC
/begin CHARACTERISTIC FaultManager.CamSyncFault.Action_3_Condition "Fault manager configuration.  Select up to 4 actions for each fault." VALUE 0x80002AA7 RecordLayout_3 0 CompuMethod_108 0 65535 /end CHARACTERISTIC
/begin CHARACTERISTIC FaultManager.CamSyncFault.Action_4 "Fault manager configuration.  Select up to 4 actions for each fault." VALUE 0x80002AA9 RecordLayout_3 0 CompuMethod_107 0 65535 /end CHARACTERISTIC
/begin CHARACTERISTIC FaultManager.CamSyncFault.Action_4_Condition "Fault manager configuration.  Select up to 4 actions for each fault." VALUE 0x80002AAB RecordLayout_3 0 CompuMethod_108 0 65535 /end CHARACTERISTIC
/begin CHARACTERISTIC FaultManager.ClutchStuckHigh_Fault.Mode "Fault manager configuration.  Select up to 4 actions for each fault." VALUE 0x80002AAD RecordLayout_3 0 CompuMethod_105 0 65535 /end CHARACTERISTIC
/begin CHARACTERISTIC FaultManager.ClutchStuckHigh_Fault.ID "Fault manager configuration.  Select up to 4 actions for each fault." VALUE 0x80002AAF RecordLayout_3 0 CompuMethod_1 0 65535 /end CHARACTERISTIC
/begin CHARACTERISTIC FaultManager.ClutchStuckHigh_Fault.Test "Fault manager configuration.  Select up to 4 actions for each fault." VALUE 0x80002AB1 RecordLayout_3 0 CompuMethod_106 0 65535 /end CHARACTERISTIC
/begin CHARACTERISTIC FaultManager.ClutchStuckHigh_Fault.Faulty_Samples__X_ "Fault manager configuration.  Select up to 4 actions for each fault." VALUE 0x80002AB3 RecordLayout_3 0 CompuMethod_1 0 65535 /end CHARACTERISTIC
/begin CHARACTERISTIC FaultManager.ClutchStuckHigh_Fault.Total_Samples__Y_ "Fault manager configuration.  Select up to 4 actions for each fault." VALUE 0x80002AB5 RecordLayout_3 0 CompuMethod_1 0 65535 /end CHARACTERISTIC
/begin CHARACTERISTIC FaultManager.ClutchStuckHigh_Fault.Action_1 "Fault manager configuration.  Select up to 4 actions for each fault." VALUE 0x80002AB7 RecordLayout_3 0 CompuMethod_107 0 65535 /end CHARACTERISTIC
/begin CHARACTERISTIC FaultManager.ClutchStuckHigh_Fault.Action_1_Condition "Fault manager configuration.  Select up to 4 actions for each fault." VALUE 0x80002AB9 RecordLayout_3 0 CompuMethod_108 0 65535 /end CHARACTERISTIC
/begin CHARACTERISTIC FaultManager.ClutchStuckHigh_Fault.Action_2 "Fault manager configuration.  Select up to 4 actions for each fault." VALUE 0x80002ABB RecordLayout_3 0 CompuMethod_107 0 65535 /end CHARACTERISTIC
/begin CHARACTERISTIC FaultManager.ClutchStuckHigh_Fault.Action_2_Condition "Fault manager configuration.  Select up to 4 actions for each fault." VALUE 0x80002ABD RecordLayout_3 0 CompuMethod_108 0 65535 /end CHARACTERISTIC
/begin CHARACTERISTIC FaultManager.ClutchStuckHigh_Fault.Action_3 "Fault manager configuration.  Select up to 4 actions for each fault." VALUE 0x80002ABF RecordLayout_3 0 CompuMethod_107 0 65535 /end CHARACTERISTIC
/begin CHARACTERISTIC FaultManager.ClutchStuckHigh_Fault.Action_3_Condition "Fault manager configuration.  Select up to 4 actions for each fault." VALUE 0x80002AC1 RecordLayout_3 0 CompuMethod_108 0 65535 /end CHARACTERISTIC
/begin CHARACTERISTIC FaultManager.ClutchStuckHigh_Fault.Action_4 "Fault manager configuration.  Select up to 4 actions for each fault." VALUE 0x80002AC3 RecordLayout_3 0 CompuMethod_107 0 65535 /end CHARACTERISTIC
/begin CHARACTERISTIC FaultManager.ClutchStuckHigh_Fault.Action_4_Condition "Fault manager configuration.  Select up to 4 actions for each fault." VALUE 0x80002AC5 RecordLayout_3 0 CompuMethod_108 0 65535 /end CHARACTERISTIC
/begin CHARACTERISTIC FaultManager.CrankEdgesFault.Mode "Fault manager configuration.  Select up to 4 actions for each fault." VALUE 0x80002AC7 RecordLayout_3 0 CompuMethod_105 0 65535 /end CHARACTERISTIC
/begin CHARACTERISTIC FaultManager.CrankEdgesFault.ID "Fault manager configuration.  Select up to 4 actions for each fault." VALUE 0x80002AC9 RecordLayout_3 0 CompuMethod_1 0 65535 /end CHARACTERISTIC
/begin CHARACTERISTIC FaultManager.CrankEdgesFault.Test "Fault manager configuration.  Select up to 4 actions for each fault." VALUE 0x80002ACB RecordLayout_3 0 CompuMethod_106 0 65535 /end CHARACTERISTIC
/begin CHARACTERISTIC FaultManager.CrankEdgesFault.Faulty_Samples__X_ "Fault manager configuration.  Select up to 4 actions for each fault." VALUE 0x80002ACD RecordLayout_3 0 CompuMethod_1 0 65535 /end CHARACTERISTIC
/begin CHARACTERISTIC FaultManager.CrankEdgesFault.Total_Samples__Y_ "Fault manager configuration.  Select up to 4 actions for each fault." VALUE 0x80002ACF RecordLayout_3 0 CompuMethod_1 0 65535 /end CHARACTERISTIC
/begin CHARACTERISTIC FaultManager.CrankEdgesFault.Action_1 "Fault manager configuration.  Select up to 4 actions for each fault." VALUE 0x80002AD1 RecordLayout_3 0 CompuMethod_107 0 65535 /end CHARACTERISTIC
/begin CHARACTERISTIC FaultManager.CrankEdgesFault.Action_1_Condition "Fault manager configuration.  Select up to 4 actions for each fault." VALUE 0x80002AD3 RecordLayout_3 0 CompuMethod_108 0 65535 /end CHARACTERISTIC
/begin CHARACTERISTIC FaultManager.CrankEdgesFault.Action_2 "Fault manager configuration.  Select up to 4 actions for each fault." VALUE 0x80002AD5 RecordLayout_3 0 CompuMethod_107 0 65535 /end CHARACTERISTIC
/begin CHARACTERISTIC FaultManager.CrankEdgesFault.Action_2_Condition "Fault manager configuration.  Select up to 4 actions for each fault." VALUE 0x80002AD7 RecordLayout_3 0 CompuMethod_108 0 65535 /end CHARACTERISTIC
/begin CHARACTERISTIC FaultManager.CrankEdgesFault.Action_3 "Fault manager configuration.  Select up to 4 actions for each fault." VALUE 0x80002AD9 RecordLayout_3 0 CompuMethod_107 0 65535 /end CHARACTERISTIC
/begin CHARACTERISTIC FaultManager.CrankEdgesFault.Action_3_Condition "Fault manager configuration.  Select up to 4 actions for each fault." VALUE 0x80002ADB RecordLayout_3 0 CompuMethod_108 0 65535 /end CHARACTERISTIC
/begin CHARACTERISTIC FaultManager.CrankEdgesFault.Action_4 "Fault manager configuration.  Select up to 4 actions for each fault." VALUE 0x80002ADD RecordLayout_3 0 CompuMethod_107 0 65535 /end CHARACTERISTIC
/begin CHARACTERISTIC FaultManager.CrankEdgesFault.Action_4_Condition "Fault manager configuration.  Select up to 4 actions for each fault." VALUE 0x80002ADF RecordLayout_3 0 CompuMethod_108 0 65535 /end CHARACTERISTIC
/begin CHARACTERISTIC FaultManager.CrankSyncFault.Mode "Fault manager configuration.  Select up to 4 actions for each fault." VALUE 0x80002AE1 RecordLayout_3 0 CompuMethod_105 0 65535 /end CHARACTERISTIC
/begin CHARACTERISTIC FaultManager.CrankSyncFault.ID "Fault manager configuration.  Select up to 4 actions for each fault." VALUE 0x80002AE3 RecordLayout_3 0 CompuMethod_1 0 65535 /end CHARACTERISTIC
/begin CHARACTERISTIC FaultManager.CrankSyncFault.Test "Fault manager configuration.  Select up to 4 actions for each fault." VALUE 0x80002AE5 RecordLayout_3 0 CompuMethod_106 0 65535 /end CHARACTERISTIC
/begin CHARACTERISTIC FaultManager.CrankSyncFault.Faulty_Samples__X_ "Fault manager configuration.  Select up to 4 actions for each fault." VALUE 0x80002AE7 RecordLayout_3 0 CompuMethod_1 0 65535 /end CHARACTERISTIC
/begin CHARACTERISTIC FaultManager.CrankSyncFault.Total_Samples__Y_ "Fault manager configuration.  Select up to 4 actions for each fault." VALUE 0x80002AE9 RecordLayout_3 0 CompuMethod_1 0 65535 /end CHARACTERISTIC
/begin CHARACTERISTIC FaultManager.CrankSyncFault.Action_1 "Fault manager configuration.  Select up to 4 actions for each fault." VALUE 0x80002AEB RecordLayout_3 0 CompuMethod_107 0 65535 /end CHARACTERISTIC
/begin CHARACTERISTIC FaultManager.CrankSyncFault.Action_1_Condition "Fault manager configuration.  Select up to 4 actions for each fault." VALUE 0x80002AED RecordLayout_3 0 CompuMethod_108 0 65535 /end CHARACTERISTIC
/begin CHARACTERISTIC FaultManager.CrankSyncFault.Action_2 "Fault manager configuration.  Select up to 4 actions for each fault." VALUE 0x80002AEF RecordLayout_3 0 CompuMethod_107 0 65535 /end CHARACTERISTIC
/begin CHARACTERISTIC FaultManager.CrankSyncFault.Action_2_Condition "Fault manager configuration.  Select up to 4 actions for each fault." VALUE 0x80002AF1 RecordLayout_3 0 CompuMethod_108 0 65535 /end CHARACTERISTIC
/begin CHARACTERISTIC FaultManager.CrankSyncFault.Action_3 "Fault manager configuration.  Select up to 4 actions for each fault." VALUE 0x80002AF3 RecordLayout_3 0 CompuMethod_107 0 65535 /end CHARACTERISTIC
/begin CHARACTERISTIC FaultManager.CrankSyncFault.Action_3_Condition "Fault manager configuration.  Select up to 4 actions for each fault." VALUE 0x80002AF5 RecordLayout_3 0 CompuMethod_108 0 65535 /end CHARACTERISTIC
/begin CHARACTERISTIC FaultManager.CrankSyncFault.Action_4 "Fault manager configuration.  Select up to 4 actions for each fault." VALUE 0x80002AF7 RecordLayout_3 0 CompuMethod_107 0 65535 /end CHARACTERISTIC
/begin CHARACTERISTIC FaultManager.CrankSyncFault.Action_4_Condition "Fault manager configuration.  Select up to 4 actions for each fault." VALUE 0x80002AF9 RecordLayout_3 0 CompuMethod_108 0 65535 /end CHARACTERISTIC
/begin CHARACTERISTIC FaultManager.Cylinder1_HardMisfire.Mode "Fault manager configuration.  Select up to 4 actions for each fault." VALUE 0x80002AFB RecordLayout_3 0 CompuMethod_105 0 65535 /end CHARACTERISTIC
/begin CHARACTERISTIC FaultManager.Cylinder1_HardMisfire.ID "Fault manager configuration.  Select up to 4 actions for each fault." VALUE 0x80002AFD RecordLayout_3 0 CompuMethod_1 0 65535 /end CHARACTERISTIC
/begin CHARACTERISTIC FaultManager.Cylinder1_HardMisfire.Test "Fault manager configuration.  Select up to 4 actions for each fault." VALUE 0x80002AFF RecordLayout_3 0 CompuMethod_106 0 65535 /end CHARACTERISTIC
/begin CHARACTERISTIC FaultManager.Cylinder1_HardMisfire.Faulty_Samples__X_ "Fault manager configuration.  Select up to 4 actions for each fault." VALUE 0x80002B01 RecordLayout_3 0 CompuMethod_1 0 65535 /end CHARACTERISTIC
/begin CHARACTERISTIC FaultManager.Cylinder1_HardMisfire.Total_Samples__Y_ "Fault manager configuration.  Select up to 4 actions for each fault." VALUE 0x80002B03 RecordLayout_3 0 CompuMethod_1 0 65535 /end CHARACTERISTIC
/begin CHARACTERISTIC FaultManager.Cylinder1_HardMisfire.Action_1 "Fault manager configuration.  Select up to 4 actions for each fault." VALUE 0x80002B05 RecordLayout_3 0 CompuMethod_107 0 65535 /end CHARACTERISTIC
/begin CHARACTERISTIC FaultManager.Cylinder1_HardMisfire.Action_1_Condition "Fault manager configuration.  Select up to 4 actions for each fault." VALUE 0x80002B07 RecordLayout_3 0 CompuMethod_108 0 65535 /end CHARACTERISTIC
/begin CHARACTERISTIC FaultManager.Cylinder1_HardMisfire.Action_2 "Fault manager configuration.  Select up to 4 actions for each fault." VALUE 0x80002B09 RecordLayout_3 0 CompuMethod_107 0 65535 /end CHARACTERISTIC
/begin CHARACTERISTIC FaultManager.Cylinder1_HardMisfire.Action_2_Condition "Fault manager configuration.  Select up to 4 actions for each fault." VALUE 0x80002B0B RecordLayout_3 0 CompuMethod_108 0 65535 /end CHARACTERISTIC
/begin CHARACTERISTIC FaultManager.Cylinder1_HardMisfire.Action_3 "Fault manager configuration.  Select up to 4 actions for each fault." VALUE 0x80002B0D RecordLayout_3 0 CompuMethod_107 0 65535 /end CHARACTERISTIC
/begin CHARACTERISTIC FaultManager.Cylinder1_HardMisfire.Action_3_Condition "Fault manager configuration.  Select up to 4 actions for each fault." VALUE 0x80002B0F RecordLayout_3 0 CompuMethod_108 0 65535 /end CHARACTERISTIC
/begin CHARACTERISTIC FaultManager.Cylinder1_HardMisfire.Action_4 "Fault manager configuration.  Select up to 4 actions for each fault." VALUE 0x80002B11 RecordLayout_3 0 CompuMethod_107 0 65535 /end CHARACTERISTIC
/begin CHARACTERISTIC FaultManager.Cylinder1_HardMisfire.Action_4_Condition "Fault manager configuration.  Select up to 4 actions for each fault." VALUE 0x80002B13 RecordLayout_3 0 CompuMethod_108 0 65535 /end CHARACTERISTIC
/begin CHARACTERISTIC FaultManager.Cylinder2_HardMisfire.Mode "Fault manager configuration.  Select up to 4 actions for each fault." VALUE 0x80002B15 RecordLayout_3 0 CompuMethod_105 0 65535 /end CHARACTERISTIC
/begin CHARACTERISTIC FaultManager.Cylinder2_HardMisfire.ID "Fault manager configuration.  Select up to 4 actions for each fault." VALUE 0x80002B17 RecordLayout_3 0 CompuMethod_1 0 65535 /end CHARACTERISTIC
/begin CHARACTERISTIC FaultManager.Cylinder2_HardMisfire.Test "Fault manager configuration.  Select up to 4 actions for each fault." VALUE 0x80002B19 RecordLayout_3 0 CompuMethod_106 0 65535 /end CHARACTERISTIC
/begin CHARACTERISTIC FaultManager.Cylinder2_HardMisfire.Faulty_Samples__X_ "Fault manager configuration.  Select up to 4 actions for each fault." VALUE 0x80002B1B RecordLayout_3 0 CompuMethod_1 0 65535 /end CHARACTERISTIC
/begin CHARACTERISTIC FaultManager.Cylinder2_HardMisfire.Total_Samples__Y_ "Fault manager configuration.  Select up to 4 actions for each fault." VALUE 0x80002B1D RecordLayout_3 0 CompuMethod_1 0 65535 /end CHARACTERISTIC
/begin CHARACTERISTIC FaultManager.Cylinder2_HardMisfire.Action_1 "Fault manager configuration.  Select up to 4 actions for each fault." VALUE 0x80002B1F RecordLayout_3 0 CompuMethod_107 0 65535 /end CHARACTERISTIC
/begin CHARACTERISTIC FaultManager.Cylinder2_HardMisfire.Action_1_Condition "Fault manager configuration.  Select up to 4 actions for each fault." VALUE 0x80002B21 RecordLayout_3 0 CompuMethod_108 0 65535 /end CHARACTERISTIC
/begin CHARACTERISTIC FaultManager.Cylinder2_HardMisfire.Action_2 "Fault manager configuration.  Select up to 4 actions for each fault." VALUE 0x80002B23 RecordLayout_3 0 CompuMethod_107 0 65535 /end CHARACTERISTIC
/begin CHARACTERISTIC FaultManager.Cylinder2_HardMisfire.Action_2_Condition "Fault manager configuration.  Select up to 4 actions for each fault." VALUE 0x80002B25 RecordLayout_3 0 CompuMethod_108 0 65535 /end CHARACTERISTIC
/begin CHARACTERISTIC FaultManager.Cylinder2_HardMisfire.Action_3 "Fault manager configuration.  Select up to 4 actions for each fault." VALUE 0x80002B27 RecordLayout_3 0 CompuMethod_107 0 65535 /end CHARACTERISTIC
/begin CHARACTERISTIC FaultManager.Cylinder2_HardMisfire.Action_3_Condition "Fault manager configuration.  Select up to 4 actions for each fault." VALUE 0x80002B29 RecordLayout_3 0 CompuMethod_108 0 65535 /end CHARACTERISTIC
/begin CHARACTERISTIC FaultManager.Cylinder2_HardMisfire.Action_4 "Fault manager configuration.  Select up to 4 actions for each fault." VALUE 0x80002B2B RecordLayout_3 0 CompuMethod_107 0 65535 /end CHARACTERISTIC
/begin CHARACTERISTIC FaultManager.Cylinder2_HardMisfire.Action_4_Condition "Fault manager configuration.  Select up to 4 actions for each fault." VALUE 0x80002B2D RecordLayout_3 0 CompuMethod_108 0 65535 /end CHARACTERISTIC
/begin CHARACTERISTIC FaultManager.Cylinder3_HardMisfire.Mode "Fault manager configuration.  Select up to 4 actions for each fault." VALUE 0x80002B2F RecordLayout_3 0 CompuMethod_105 0 65535 /end CHARACTERISTIC
/begin CHARACTERISTIC FaultManager.Cylinder3_HardMisfire.ID "Fault manager configuration.  Select up to 4 actions for each fault." VALUE 0x80002B31 RecordLayout_3 0 CompuMethod_1 0 65535 /end CHARACTERISTIC
/begin CHARACTERISTIC FaultManager.Cylinder3_HardMisfire.Test "Fault manager configuration.  Select up to 4 actions for each fault." VALUE 0x80002B33 RecordLayout_3 0 CompuMethod_106 0 65535 /end CHARACTERISTIC
/begin CHARACTERISTIC FaultManager.Cylinder3_HardMisfire.Faulty_Samples__X_ "Fault manager configuration.  Select up to 4 actions for each fault." VALUE 0x80002B35 RecordLayout_3 0 CompuMethod_1 0 65535 /end CHARACTERISTIC
/begin CHARACTERISTIC FaultManager.Cylinder3_HardMisfire.Total_Samples__Y_ "Fault manager configuration.  Select up to 4 actions for each fault." VALUE 0x80002B37 RecordLayout_3 0 CompuMethod_1 0 65535 /end CHARACTERISTIC
/begin CHARACTERISTIC FaultManager.Cylinder3_HardMisfire.Action_1 "Fault manager configuration.  Select up to 4 actions for each fault." VALUE 0x80002B39 RecordLayout_3 0 CompuMethod_107 0 65535 /end CHARACTERISTIC
/begin CHARACTERISTIC FaultManager.Cylinder3_HardMisfire.Action_1_Condition "Fault manager configuration.  Select up to 4 actions for each fault." VALUE 0x80002B3B RecordLayout_3 0 CompuMethod_108 0 65535 /end CHARACTERISTIC
/begin CHARACTERISTIC FaultManager.Cylinder3_HardMisfire.Action_2 "Fault manager configuration.  Select up to 4 actions for each fault." VALUE 0x80002B3D RecordLayout_3 0 CompuMethod_107 0 65535 /end CHARACTERISTIC
/begin CHARACTERISTIC FaultManager.Cylinder3_HardMisfire.Action_2_Condition "Fault manager configuration.  Select up to 4 actions for each fault." VALUE 0x80002B3F RecordLayout_3 0 CompuMethod_108 0 65535 /end CHARACTERISTIC
/begin CHARACTERISTIC FaultManager.Cylinder3_HardMisfire.Action_3 "Fault manager configuration.  Select up to 4 actions for each fault." VALUE 0x80002B41 RecordLayout_3 0 CompuMethod_107 0 65535 /end CHARACTERISTIC
/begin CHARACTERISTIC FaultManager.Cylinder3_HardMisfire.Action_3_Condition "Fault manager configuration.  Select up to 4 actions for each fault." VALUE 0x80002B43 RecordLayout_3 0 CompuMethod_108 0 65535 /end CHARACTERISTIC
/begin CHARACTERISTIC FaultManager.Cylinder3_HardMisfire.Action_4 "Fault manager configuration.  Select up to 4 actions for each fault." VALUE 0x80002B45 RecordLayout_3 0 CompuMethod_107 0 65535 /end CHARACTERISTIC
/begin CHARACTERISTIC FaultManager.Cylinder3_HardMisfire.Action_4_Condition "Fault manager configuration.  Select up to 4 actions for each fault." VALUE 0x80002B47 RecordLayout_3 0 CompuMethod_108 0 65535 /end CHARACTERISTIC
/begin CHARACTERISTIC FaultManager.Cylinder4_HardMisfire.Mode "Fault manager configuration.  Select up to 4 actions for each fault." VALUE 0x80002B49 RecordLayout_3 0 CompuMethod_105 0 65535 /end CHARACTERISTIC
/begin CHARACTERISTIC FaultManager.Cylinder4_HardMisfire.ID "Fault manager configuration.  Select up to 4 actions for each fault." VALUE 0x80002B4B RecordLayout_3 0 CompuMethod_1 0 65535 /end CHARACTERISTIC
/begin CHARACTERISTIC FaultManager.Cylinder4_HardMisfire.Test "Fault manager configuration.  Select up to 4 actions for each fault." VALUE 0x80002B4D RecordLayout_3 0 CompuMethod_106 0 65535 /end CHARACTERISTIC
/begin CHARACTERISTIC FaultManager.Cylinder4_HardMisfire.Faulty_Samples__X_ "Fault manager configuration.  Select up to 4 actions for each fault." VALUE 0x80002B4F RecordLayout_3 0 CompuMethod_1 0 65535 /end CHARACTERISTIC
/begin CHARACTERISTIC FaultManager.Cylinder4_HardMisfire.Total_Samples__Y_ "Fault manager configuration.  Select up to 4 actions for each fault." VALUE 0x80002B51 RecordLayout_3 0 CompuMethod_1 0 65535 /end CHARACTERISTIC
/begin CHARACTERISTIC FaultManager.Cylinder4_HardMisfire.Action_1 "Fault manager configuration.  Select up to 4 actions for each fault." VALUE 0x80002B53 RecordLayout_3 0 CompuMethod_107 0 65535 /end CHARACTERISTIC
/begin CHARACTERISTIC FaultManager.Cylinder4_HardMisfire.Action_1_Condition "Fault manager configuration.  Select up to 4 actions for each fault." VALUE 0x80002B55 RecordLayout_3 0 CompuMethod_108 0 65535 /end CHARACTERISTIC
/begin CHARACTERISTIC FaultManager.Cylinder4_HardMisfire.Action_2 "Fault manager configuration.  Select up to 4 actions for each fault." VALUE 0x80002B57 RecordLayout_3 0 CompuMethod_107 0 65535 /end CHARACTERISTIC
/begin CHARACTERISTIC FaultManager.Cylinder4_HardMisfire.Action_2_Condition "Fault manager configuration.  Select up to 4 actions for each fault." VALUE 0x80002B59 RecordLayout_3 0 CompuMethod_108 0 65535 /end CHARACTERISTIC
/begin CHARACTERISTIC FaultManager.Cylinder4_HardMisfire.Action_3 "Fault manager configuration.  Select up to 4 actions for each fault." VALUE 0x80002B5B RecordLayout_3 0 CompuMethod_107 0 65535 /end CHARACTERISTIC
/begin CHARACTERISTIC FaultManager.Cylinder4_HardMisfire.Action_3_Condition "Fault manager configuration.  Select up to 4 actions for each fault." VALUE 0x80002B5D RecordLayout_3 0 CompuMethod_108 0 65535 /end CHARACTERISTIC
/begin CHARACTERISTIC FaultManager.Cylinder4_HardMisfire.Action_4 "Fault manager configuration.  Select up to 4 actions for each fault." VALUE 0x80002B5F RecordLayout_3 0 CompuMethod_107 0 65535 /end CHARACTERISTIC
/begin CHARACTERISTIC FaultManager.Cylinder4_HardMisfire.Action_4_Condition "Fault manager configuration.  Select up to 4 actions for each fault." VALUE 0x80002B61 RecordLayout_3 0 CompuMethod_108 0 65535 /end CHARACTERISTIC
/begin CHARACTERISTIC FaultManager.Cylinder5_HardMisfire.Mode "Fault manager configuration.  Select up to 4 actions for each fault." VALUE 0x80002B63 RecordLayout_3 0 CompuMethod_105 0 65535 /end CHARACTERISTIC
/begin CHARACTERISTIC FaultManager.Cylinder5_HardMisfire.ID "Fault manager configuration.  Select up to 4 actions for each fault." VALUE 0x80002B65 RecordLayout_3 0 CompuMethod_1 0 65535 /end CHARACTERISTIC
/begin CHARACTERISTIC FaultManager.Cylinder5_HardMisfire.Test "Fault manager configuration.  Select up to 4 actions for each fault." VALUE 0x80002B67 RecordLayout_3 0 CompuMethod_106 0 65535 /end CHARACTERISTIC
/begin CHARACTERISTIC FaultManager.Cylinder5_HardMisfire.Faulty_Samples__X_ "Fault manager configuration.  Select up to 4 actions for each fault." VALUE 0x80002B69 RecordLayout_3 0 CompuMethod_1 0 65535 /end CHARACTERISTIC
/begin CHARACTERISTIC FaultManager.Cylinder5_HardMisfire.Total_Samples__Y_ "Fault manager configuration.  Select up to 4 actions for each fault." VALUE 0x80002B6B RecordLayout_3 0 CompuMethod_1 0 65535 /end CHARACTERISTIC
/begin CHARACTERISTIC FaultManager.Cylinder5_HardMisfire.Action_1 "Fault manager configuration.  Select up to 4 actions for each fault." VALUE 0x80002B6D RecordLayout_3 0 CompuMethod_107 0 65535 /end CHARACTERISTIC
/begin CHARACTERISTIC FaultManager.Cylinder5_HardMisfire.Action_1_Condition "Fault manager configuration.  Select up to 4 actions for each fault." VALUE 0x80002B6F RecordLayout_3 0 CompuMethod_108 0 65535 /end CHARACTERISTIC
/begin CHARACTERISTIC FaultManager.Cylinder5_HardMisfire.Action_2 "Fault manager configuration.  Select up to 4 actions for each fault." VALUE 0x80002B71 RecordLayout_3 0 CompuMethod_107 0 65535 /end CHARACTERISTIC
/begin CHARACTERISTIC FaultManager.Cylinder5_HardMisfire.Action_2_Condition "Fault manager configuration.  Select up to 4 actions for each fault." VALUE 0x80002B73 RecordLayout_3 0 CompuMethod_108 0 65535 /end CHARACTERISTIC
/begin CHARACTERISTIC FaultManager.Cylinder5_HardMisfire.Action_3 "Fault manager configuration.  Select up to 4 actions for each fault." VALUE 0x80002B75 RecordLayout_3 0 CompuMethod_107 0 65535 /end CHARACTERISTIC
/begin CHARACTERISTIC FaultManager.Cylinder5_HardMisfire.Action_3_Condition "Fault manager configuration.  Select up to 4 actions for each fault." VALUE 0x80002B77 RecordLayout_3 0 CompuMethod_108 0 65535 /end CHARACTERISTIC
/begin CHARACTERISTIC FaultManager.Cylinder5_HardMisfire.Action_4 "Fault manager configuration.  Select up to 4 actions for each fault." VALUE 0x80002B79 RecordLayout_3 0 CompuMethod_107 0 65535 /end CHARACTERISTIC
/begin CHARACTERISTIC FaultManager.Cylinder5_HardMisfire.Action_4_Condition "Fault manager configuration.  Select up to 4 actions for each fault." VALUE 0x80002B7B RecordLayout_3 0 CompuMethod_108 0 65535 /end CHARACTERISTIC
/begin CHARACTERISTIC FaultManager.Cylinder6_HardMisfire.Mode "Fault manager configuration.  Select up to 4 actions for each fault." VALUE 0x80002B7D RecordLayout_3 0 CompuMethod_105 0 65535 /end CHARACTERISTIC
/begin CHARACTERISTIC FaultManager.Cylinder6_HardMisfire.ID "Fault manager configuration.  Select up to 4 actions for each fault." VALUE 0x80002B7F RecordLayout_3 0 CompuMethod_1 0 65535 /end CHARACTERISTIC
/begin CHARACTERISTIC FaultManager.Cylinder6_HardMisfire.Test "Fault manager configuration.  Select up to 4 actions for each fault." VALUE 0x80002B81 RecordLayout_3 0 CompuMethod_106 0 65535 /end CHARACTERISTIC
/begin CHARACTERISTIC FaultManager.Cylinder6_HardMisfire.Faulty_Samples__X_ "Fault manager configuration.  Select up to 4 actions for each fault." VALUE 0x80002B83 RecordLayout_3 0 CompuMethod_1 0 65535 /end CHARACTERISTIC
/begin CHARACTERISTIC FaultManager.Cylinder6_HardMisfire.Total_Samples__Y_ "Fault manager configuration.  Select up to 4 actions for each fault." VALUE 0x80002B85 RecordLayout_3 0 CompuMethod_1 0 65535 /end CHARACTERISTIC
/begin CHARACTERISTIC FaultManager.Cylinder6_HardMisfire.Action_1 "Fault manager configuration.  Select up to 4 actions for each fault." VALUE 0x80002B87 RecordLayout_3 0 CompuMethod_107 0 65535 /end CHARACTERISTIC
/begin CHARACTERISTIC FaultManager.Cylinder6_HardMisfire.Action_1_Condition "Fault manager configuration.  Select up to 4 actions for each fault." VALUE 0x80002B89 RecordLayout_3 0 CompuMethod_108 0 65535 /end CHARACTERISTIC
/begin CHARACTERISTIC FaultManager.Cylinder6_HardMisfire.Action_2 "Fault manager configuration.  Select up to 4 actions for each fault." VALUE 0x80002B8B RecordLayout_3 0 CompuMethod_107 0 65535 /end CHARACTERISTIC
/begin CHARACTERISTIC FaultManager.Cylinder6_HardMisfire.Action_2_Condition "Fault manager configuration.  Select up to 4 actions for each fault." VALUE 0x80002B8D RecordLayout_3 0 CompuMethod_108 0 65535 /end CHARACTERISTIC
/begin CHARACTERISTIC FaultManager.Cylinder6_HardMisfire.Action_3 "Fault manager configuration.  Select up to 4 actions for each fault." VALUE 0x80002B8F RecordLayout_3 0 CompuMethod_107 0 65535 /end CHARACTERISTIC
/begin CHARACTERISTIC FaultManager.Cylinder6_HardMisfire.Action_3_Condition "Fault manager configuration.  Select up to 4 actions for each fault." VALUE 0x80002B91 RecordLayout_3 0 CompuMethod_108 0 65535 /end CHARACTERISTIC
/begin CHARACTERISTIC FaultManager.Cylinder6_HardMisfire.Action_4 "Fault manager configuration.  Select up to 4 actions for each fault." VALUE 0x80002B93 RecordLayout_3 0 CompuMethod_107 0 65535 /end CHARACTERISTIC
/begin CHARACTERISTIC FaultManager.Cylinder6_HardMisfire.Action_4_Condition "Fault manager configuration.  Select up to 4 actions for each fault." VALUE 0x80002B95 RecordLayout_3 0 CompuMethod_108 0 65535 /end CHARACTERISTIC
/begin CHARACTERISTIC FaultManager.Cylinder7_HardMisfire.Mode "Fault manager configuration.  Select up to 4 actions for each fault." VALUE 0x80002B97 RecordLayout_3 0 CompuMethod_105 0 65535 /end CHARACTERISTIC
/begin CHARACTERISTIC FaultManager.Cylinder7_HardMisfire.ID "Fault manager configuration.  Select up to 4 actions for each fault." VALUE 0x80002B99 RecordLayout_3 0 CompuMethod_1 0 65535 /end CHARACTERISTIC
/begin CHARACTERISTIC FaultManager.Cylinder7_HardMisfire.Test "Fault manager configuration.  Select up to 4 actions for each fault." VALUE 0x80002B9B RecordLayout_3 0 CompuMethod_106 0 65535 /end CHARACTERISTIC
/begin CHARACTERISTIC FaultManager.Cylinder7_HardMisfire.Faulty_Samples__X_ "Fault manager configuration.  Select up to 4 actions for each fault." VALUE 0x80002B9D RecordLayout_3 0 CompuMethod_1 0 65535 /end CHARACTERISTIC
/begin CHARACTERISTIC FaultManager.Cylinder7_HardMisfire.Total_Samples__Y_ "Fault manager configuration.  Select up to 4 actions for each fault." VALUE 0x80002B9F RecordLayout_3 0 CompuMethod_1 0 65535 /end CHARACTERISTIC
/begin CHARACTERISTIC FaultManager.Cylinder7_HardMisfire.Action_1 "Fault manager configuration.  Select up to 4 actions for each fault." VALUE 0x80002BA1 RecordLayout_3 0 CompuMethod_107 0 65535 /end CHARACTERISTIC
/begin CHARACTERISTIC FaultManager.Cylinder7_HardMisfire.Action_1_Condition "Fault manager configuration.  Select up to 4 actions for each fault." VALUE 0x80002BA3 RecordLayout_3 0 CompuMethod_108 0 65535 /end CHARACTERISTIC
/begin CHARACTERISTIC FaultManager.Cylinder7_HardMisfire.Action_2 "Fault manager configuration.  Select up to 4 actions for each fault." VALUE 0x80002BA5 RecordLayout_3 0 CompuMethod_107 0 65535 /end CHARACTERISTIC
/begin CHARACTERISTIC FaultManager.Cylinder7_HardMisfire.Action_2_Condition "Fault manager configuration.  Select up to 4 actions for each fault." VALUE 0x80002BA7 RecordLayout_3 0 CompuMethod_108 0 65535 /end CHARACTERISTIC
/begin CHARACTERISTIC FaultManager.Cylinder7_HardMisfire.Action_3 "Fault manager configuration.  Select up to 4 actions for each fault." VALUE 0x80002BA9 RecordLayout_3 0 CompuMethod_107 0 65535 /end CHARACTERISTIC
/begin CHARACTERISTIC FaultManager.Cylinder7_HardMisfire.Action_3_Condition "Fault manager configuration.  Select up to 4 actions for each fault." VALUE 0x80002BAB RecordLayout_3 0 CompuMethod_108 0 65535 /end CHARACTERISTIC
/begin CHARACTERISTIC FaultManager.Cylinder7_HardMisfire.Action_4 "Fault manager configuration.  Select up to 4 actions for each fault." VALUE 0x80002BAD RecordLayout_3 0 CompuMethod_107 0 65535 /end CHARACTERISTIC
/begin CHARACTERISTIC FaultManager.Cylinder7_HardMisfire.Action_4_Condition "Fault manager configuration.  Select up to 4 actions for each fault." VALUE 0x80002BAF RecordLayout_3 0 CompuMethod_108 0 65535 /end CHARACTERISTIC
/begin CHARACTERISTIC FaultManager.Cylinder8_HardMisfire.Mode "Fault manager configuration.  Select up to 4 actions for each fault." VALUE 0x80002BB1 RecordLayout_3 0 CompuMethod_105 0 65535 /end CHARACTERISTIC
/begin CHARACTERISTIC FaultManager.Cylinder8_HardMisfire.ID "Fault manager configuration.  Select up to 4 actions for each fault." VALUE 0x80002BB3 RecordLayout_3 0 CompuMethod_1 0 65535 /end CHARACTERISTIC
/begin CHARACTERISTIC FaultManager.Cylinder8_HardMisfire.Test "Fault manager configuration.  Select up to 4 actions for each fault." VALUE 0x80002BB5 RecordLayout_3 0 CompuMethod_106 0 65535 /end CHARACTERISTIC
/begin CHARACTERISTIC FaultManager.Cylinder8_HardMisfire.Faulty_Samples__X_ "Fault manager configuration.  Select up to 4 actions for each fault." VALUE 0x80002BB7 RecordLayout_3 0 CompuMethod_1 0 65535 /end CHARACTERISTIC
/begin CHARACTERISTIC FaultManager.Cylinder8_HardMisfire.Total_Samples__Y_ "Fault manager configuration.  Select up to 4 actions for each fault." VALUE 0x80002BB9 RecordLayout_3 0 CompuMethod_1 0 65535 /end CHARACTERISTIC
/begin CHARACTERISTIC FaultManager.Cylinder8_HardMisfire.Action_1 "Fault manager configuration.  Select up to 4 actions for each fault." VALUE 0x80002BBB RecordLayout_3 0 CompuMethod_107 0 65535 /end CHARACTERISTIC
/begin CHARACTERISTIC FaultManager.Cylinder8_HardMisfire.Action_1_Condition "Fault manager configuration.  Select up to 4 actions for each fault." VALUE 0x80002BBD RecordLayout_3 0 CompuMethod_108 0 65535 /end CHARACTERISTIC
/begin CHARACTERISTIC FaultManager.Cylinder8_HardMisfire.Action_2 "Fault manager configuration.  Select up to 4 actions for each fault." VALUE 0x80002BBF RecordLayout_3 0 CompuMethod_107 0 65535 /end CHARACTERISTIC
/begin CHARACTERISTIC FaultManager.Cylinder8_HardMisfire.Action_2_Condition "Fault manager configuration.  Select up to 4 actions for each fault." VALUE 0x80002BC1 RecordLayout_3 0 CompuMethod_108 0 65535 /end CHARACTERISTIC
/begin CHARACTERISTIC FaultManager.Cylinder8_HardMisfire.Action_3 "Fault manager configuration.  Select up to 4 actions for each fault." VALUE 0x80002BC3 RecordLayout_3 0 CompuMethod_107 0 65535 /end CHARACTERISTIC
/begin CHARACTERISTIC FaultManager.Cylinder8_HardMisfire.Action_3_Condition "Fault manager configuration.  Select up to 4 actions for each fault." VALUE 0x80002BC5 RecordLayout_3 0 CompuMethod_108 0 65535 /end CHARACTERISTIC
/begin CHARACTERISTIC FaultManager.Cylinder8_HardMisfire.Action_4 "Fault manager configuration.  Select up to 4 actions for each fault." VALUE 0x80002BC7 RecordLayout_3 0 CompuMethod_107 0 65535 /end CHARACTERISTIC
/begin CHARACTERISTIC FaultManager.Cylinder8_HardMisfire.Action_4_Condition "Fault manager configuration.  Select up to 4 actions for each fault." VALUE 0x80002BC9 RecordLayout_3 0 CompuMethod_108 0 65535 /end CHARACTERISTIC
/begin CHARACTERISTIC FaultManager.ECTOverTempFault.Mode "Fault manager configuration.  Select up to 4 actions for each fault." VALUE 0x80002BCB RecordLayout_3 0 CompuMethod_105 0 65535 /end CHARACTERISTIC
/begin CHARACTERISTIC FaultManager.ECTOverTempFault.ID "Fault manager configuration.  Select up to 4 actions for each fault." VALUE 0x80002BCD RecordLayout_3 0 CompuMethod_1 0 65535 /end CHARACTERISTIC
/begin CHARACTERISTIC FaultManager.ECTOverTempFault.Test "Fault manager configuration.  Select up to 4 actions for each fault." VALUE 0x80002BCF RecordLayout_3 0 CompuMethod_106 0 65535 /end CHARACTERISTIC
/begin CHARACTERISTIC FaultManager.ECTOverTempFault.Faulty_Samples__X_ "Fault manager configuration.  Select up to 4 actions for each fault." VALUE 0x80002BD1 RecordLayout_3 0 CompuMethod_1 0 65535 /end CHARACTERISTIC
/begin CHARACTERISTIC FaultManager.ECTOverTempFault.Total_Samples__Y_ "Fault manager configuration.  Select up to 4 actions for each fault." VALUE 0x80002BD3 RecordLayout_3 0 CompuMethod_1 0 65535 /end CHARACTERISTIC
/begin CHARACTERISTIC FaultManager.ECTOverTempFault.Action_1 "Fault manager configuration.  Select up to 4 actions for each fault." VALUE 0x80002BD5 RecordLayout_3 0 CompuMethod_107 0 65535 /end CHARACTERISTIC
/begin CHARACTERISTIC FaultManager.ECTOverTempFault.Action_1_Condition "Fault manager configuration.  Select up to 4 actions for each fault." VALUE 0x80002BD7 RecordLayout_3 0 CompuMethod_108 0 65535 /end CHARACTERISTIC
/begin CHARACTERISTIC FaultManager.ECTOverTempFault.Action_2 "Fault manager configuration.  Select up to 4 actions for each fault." VALUE 0x80002BD9 RecordLayout_3 0 CompuMethod_107 0 65535 /end CHARACTERISTIC
/begin CHARACTERISTIC FaultManager.ECTOverTempFault.Action_2_Condition "Fault manager configuration.  Select up to 4 actions for each fault." VALUE 0x80002BDB RecordLayout_3 0 CompuMethod_108 0 65535 /end CHARACTERISTIC
/begin CHARACTERISTIC FaultManager.ECTOverTempFault.Action_3 "Fault manager configuration.  Select up to 4 actions for each fault." VALUE 0x80002BDD RecordLayout_3 0 CompuMethod_107 0 65535 /end CHARACTERISTIC
/begin CHARACTERISTIC FaultManager.ECTOverTempFault.Action_3_Condition "Fault manager configuration.  Select up to 4 actions for each fault." VALUE 0x80002BDF RecordLayout_3 0 CompuMethod_108 0 65535 /end CHARACTERISTIC
/begin CHARACTERISTIC FaultManager.ECTOverTempFault.Action_4 "Fault manager configuration.  Select up to 4 actions for each fault." VALUE 0x80002BE1 RecordLayout_3 0 CompuMethod_107 0 65535 /end CHARACTERISTIC
/begin CHARACTERISTIC FaultManager.ECTOverTempFault.Action_4_Condition "Fault manager configuration.  Select up to 4 actions for each fault." VALUE 0x80002BE3 RecordLayout_3 0 CompuMethod_108 0 65535 /end CHARACTERISTIC
/begin CHARACTERISTIC FaultManager.ECTRangeHigh.Mode "Fault manager configuration.  Select up to 4 actions for each fault." VALUE 0x80002BE5 RecordLayout_3 0 CompuMethod_105 0 65535 /end CHARACTERISTIC
/begin CHARACTERISTIC FaultManager.ECTRangeHigh.ID "Fault manager configuration.  Select up to 4 actions for each fault." VALUE 0x80002BE7 RecordLayout_3 0 CompuMethod_1 0 65535 /end CHARACTERISTIC
/begin CHARACTERISTIC FaultManager.ECTRangeHigh.Test "Fault manager configuration.  Select up to 4 actions for each fault." VALUE 0x80002BE9 RecordLayout_3 0 CompuMethod_106 0 65535 /end CHARACTERISTIC
/begin CHARACTERISTIC FaultManager.ECTRangeHigh.Faulty_Samples__X_ "Fault manager configuration.  Select up to 4 actions for each fault." VALUE 0x80002BEB RecordLayout_3 0 CompuMethod_1 0 65535 /end CHARACTERISTIC
/begin CHARACTERISTIC FaultManager.ECTRangeHigh.Total_Samples__Y_ "Fault manager configuration.  Select up to 4 actions for each fault." VALUE 0x80002BED RecordLayout_3 0 CompuMethod_1 0 65535 /end CHARACTERISTIC
/begin CHARACTERISTIC FaultManager.ECTRangeHigh.Action_1 "Fault manager configuration.  Select up to 4 actions for each fault." VALUE 0x80002BEF RecordLayout_3 0 CompuMethod_107 0 65535 /end CHARACTERISTIC
/begin CHARACTERISTIC FaultManager.ECTRangeHigh.Action_1_Condition "Fault manager configuration.  Select up to 4 actions for each fault." VALUE 0x80002BF1 RecordLayout_3 0 CompuMethod_108 0 65535 /end CHARACTERISTIC
/begin CHARACTERISTIC FaultManager.ECTRangeHigh.Action_2 "Fault manager configuration.  Select up to 4 actions for each fault." VALUE 0x80002BF3 RecordLayout_3 0 CompuMethod_107 0 65535 /end CHARACTERISTIC
/begin CHARACTERISTIC FaultManager.ECTRangeHigh.Action_2_Condition "Fault manager configuration.  Select up to 4 actions for each fault." VALUE 0x80002BF5 RecordLayout_3 0 CompuMethod_108 0 65535 /end CHARACTERISTIC
/begin CHARACTERISTIC FaultManager.ECTRangeHigh.Action_3 "Fault manager configuration.  Select up to 4 actions for each fault." VALUE 0x80002BF7 RecordLayout_3 0 CompuMethod_107 0 65535 /end CHARACTERISTIC
/begin CHARACTERISTIC FaultManager.ECTRangeHigh.Action_3_Condition "Fault manager configuration.  Select up to 4 actions for each fault." VALUE 0x80002BF9 RecordLayout_3 0 CompuMethod_108 0 65535 /end CHARACTERISTIC
/begin CHARACTERISTIC FaultManager.ECTRangeHigh.Action_4 "Fault manager configuration.  Select up to 4 actions for each fault." VALUE 0x80002BFB RecordLayout_3 0 CompuMethod_107 0 65535 /end CHARACTERISTIC
/begin CHARACTERISTIC FaultManager.ECTRangeHigh.Action_4_Condition "Fault manager configuration.  Select up to 4 actions for each fault." VALUE 0x80002BFD RecordLayout_3 0 CompuMethod_108 0 65535 /end CHARACTERISTIC
/begin CHARACTERISTIC FaultManager.ECTRangeLow.Mode "Fault manager configuration.  Select up to 4 actions for each fault." VALUE 0x80002BFF RecordLayout_3 0 CompuMethod_105 0 65535 /end CHARACTERISTIC
/begin CHARACTERISTIC FaultManager.ECTRangeLow.ID "Fault manager configuration.  Select up to 4 actions for each fault." VALUE 0x80002C01 RecordLayout_3 0 CompuMethod_1 0 65535 /end CHARACTERISTIC
/begin CHARACTERISTIC FaultManager.ECTRangeLow.Test "Fault manager configuration.  Select up to 4 actions for each fault." VALUE 0x80002C03 RecordLayout_3 0 CompuMethod_106 0 65535 /end CHARACTERISTIC
/begin CHARACTERISTIC FaultManager.ECTRangeLow.Faulty_Samples__X_ "Fault manager configuration.  Select up to 4 actions for each fault." VALUE 0x80002C05 RecordLayout_3 0 CompuMethod_1 0 65535 /end CHARACTERISTIC
/begin CHARACTERISTIC FaultManager.ECTRangeLow.Total_Samples__Y_ "Fault manager configuration.  Select up to 4 actions for each fault." VALUE 0x80002C07 RecordLayout_3 0 CompuMethod_1 0 65535 /end CHARACTERISTIC
/begin CHARACTERISTIC FaultManager.ECTRangeLow.Action_1 "Fault manager configuration.  Select up to 4 actions for each fault." VALUE 0x80002C09 RecordLayout_3 0 CompuMethod_107 0 65535 /end CHARACTERISTIC
/begin CHARACTERISTIC FaultManager.ECTRangeLow.Action_1_Condition "Fault manager configuration.  Select up to 4 actions for each fault." VALUE 0x80002C0B RecordLayout_3 0 CompuMethod_108 0 65535 /end CHARACTERISTIC
/begin CHARACTERISTIC FaultManager.ECTRangeLow.Action_2 "Fault manager configuration.  Select up to 4 actions for each fault." VALUE 0x80002C0D RecordLayout_3 0 CompuMethod_107 0 65535 /end CHARACTERISTIC
/begin CHARACTERISTIC FaultManager.ECTRangeLow.Action_2_Condition "Fault manager configuration.  Select up to 4 actions for each fault." VALUE 0x80002C0F RecordLayout_3 0 CompuMethod_108 0 65535 /end CHARACTERISTIC
/begin CHARACTERISTIC FaultManager.ECTRangeLow.Action_3 "Fault manager configuration.  Select up to 4 actions for each fault." VALUE 0x80002C11 RecordLayout_3 0 CompuMethod_107 0 65535 /end CHARACTERISTIC
/begin CHARACTERISTIC FaultManager.ECTRangeLow.Action_3_Condition "Fault manager configuration.  Select up to 4 actions for each fault." VALUE 0x80002C13 RecordLayout_3 0 CompuMethod_108 0 65535 /end CHARACTERISTIC
/begin CHARACTERISTIC FaultManager.ECTRangeLow.Action_4 "Fault manager configuration.  Select up to 4 actions for each fault." VALUE 0x80002C15 RecordLayout_3 0 CompuMethod_107 0 65535 /end CHARACTERISTIC
/begin CHARACTERISTIC FaultManager.ECTRangeLow.Action_4_Condition "Fault manager configuration.  Select up to 4 actions for each fault." VALUE 0x80002C17 RecordLayout_3 0 CompuMethod_108 0 65535 /end CHARACTERISTIC
/begin CHARACTERISTIC FaultManager.ECTSevereOverTempFault.Mode "Fault manager configuration.  Select up to 4 actions for each fault." VALUE 0x80002C19 RecordLayout_3 0 CompuMethod_105 0 65535 /end CHARACTERISTIC
/begin CHARACTERISTIC FaultManager.ECTSevereOverTempFault.ID "Fault manager configuration.  Select up to 4 actions for each fault." VALUE 0x80002C1B RecordLayout_3 0 CompuMethod_1 0 65535 /end CHARACTERISTIC
/begin CHARACTERISTIC FaultManager.ECTSevereOverTempFault.Test "Fault manager configuration.  Select up to 4 actions for each fault." VALUE 0x80002C1D RecordLayout_3 0 CompuMethod_106 0 65535 /end CHARACTERISTIC
/begin CHARACTERISTIC FaultManager.ECTSevereOverTempFault.Faulty_Samples__X_ "Fault manager configuration.  Select up to 4 actions for each fault." VALUE 0x80002C1F RecordLayout_3 0 CompuMethod_1 0 65535 /end CHARACTERISTIC
/begin CHARACTERISTIC FaultManager.ECTSevereOverTempFault.Total_Samples__Y_ "Fault manager configuration.  Select up to 4 actions for each fault." VALUE 0x80002C21 RecordLayout_3 0 CompuMethod_1 0 65535 /end CHARACTERISTIC
/begin CHARACTERISTIC FaultManager.ECTSevereOverTempFault.Action_1 "Fault manager configuration.  Select up to 4 actions for each fault." VALUE 0x80002C23 RecordLayout_3 0 CompuMethod_107 0 65535 /end CHARACTERISTIC
/begin CHARACTERISTIC FaultManager.ECTSevereOverTempFault.Action_1_Condition "Fault manager configuration.  Select up to 4 actions for each fault." VALUE 0x80002C25 RecordLayout_3 0 CompuMethod_108 0 65535 /end CHARACTERISTIC
/begin CHARACTERISTIC FaultManager.ECTSevereOverTempFault.Action_2 "Fault manager configuration.  Select up to 4 actions for each fault." VALUE 0x80002C27 RecordLayout_3 0 CompuMethod_107 0 65535 /end CHARACTERISTIC
/begin CHARACTERISTIC FaultManager.ECTSevereOverTempFault.Action_2_Condition "Fault manager configuration.  Select up to 4 actions for each fault." VALUE 0x80002C29 RecordLayout_3 0 CompuMethod_108 0 65535 /end CHARACTERISTIC
/begin CHARACTERISTIC FaultManager.ECTSevereOverTempFault.Action_3 "Fault manager configuration.  Select up to 4 actions for each fault." VALUE 0x80002C2B RecordLayout_3 0 CompuMethod_107 0 65535 /end CHARACTERISTIC
/begin CHARACTERISTIC FaultManager.ECTSevereOverTempFault.Action_3_Condition "Fault manager configuration.  Select up to 4 actions for each fault." VALUE 0x80002C2D RecordLayout_3 0 CompuMethod_108 0 65535 /end CHARACTERISTIC
/begin CHARACTERISTIC FaultManager.ECTSevereOverTempFault.Action_4 "Fault manager configuration.  Select up to 4 actions for each fault." VALUE 0x80002C2F RecordLayout_3 0 CompuMethod_107 0 65535 /end CHARACTERISTIC
/begin CHARACTERISTIC FaultManager.ECTSevereOverTempFault.Action_4_Condition "Fault manager configuration.  Select up to 4 actions for each fault." VALUE 0x80002C31 RecordLayout_3 0 CompuMethod_108 0 65535 /end CHARACTERISTIC
/begin CHARACTERISTIC FaultManager.EST1_Open.Mode "Fault manager configuration.  Select up to 4 actions for each fault." VALUE 0x80002C33 RecordLayout_3 0 CompuMethod_105 0 65535 /end CHARACTERISTIC
/begin CHARACTERISTIC FaultManager.EST1_Open.ID "Fault manager configuration.  Select up to 4 actions for each fault." VALUE 0x80002C35 RecordLayout_3 0 CompuMethod_1 0 65535 /end CHARACTERISTIC
/begin CHARACTERISTIC FaultManager.EST1_Open.Test "Fault manager configuration.  Select up to 4 actions for each fault." VALUE 0x80002C37 RecordLayout_3 0 CompuMethod_106 0 65535 /end CHARACTERISTIC
/begin CHARACTERISTIC FaultManager.EST1_Open.Faulty_Samples__X_ "Fault manager configuration.  Select up to 4 actions for each fault." VALUE 0x80002C39 RecordLayout_3 0 CompuMethod_1 0 65535 /end CHARACTERISTIC
/begin CHARACTERISTIC FaultManager.EST1_Open.Total_Samples__Y_ "Fault manager configuration.  Select up to 4 actions for each fault." VALUE 0x80002C3B RecordLayout_3 0 CompuMethod_1 0 65535 /end CHARACTERISTIC
/begin CHARACTERISTIC FaultManager.EST1_Open.Action_1 "Fault manager configuration.  Select up to 4 actions for each fault." VALUE 0x80002C3D RecordLayout_3 0 CompuMethod_107 0 65535 /end CHARACTERISTIC
/begin CHARACTERISTIC FaultManager.EST1_Open.Action_1_Condition "Fault manager configuration.  Select up to 4 actions for each fault." VALUE 0x80002C3F RecordLayout_3 0 CompuMethod_108 0 65535 /end CHARACTERISTIC
/begin CHARACTERISTIC FaultManager.EST1_Open.Action_2 "Fault manager configuration.  Select up to 4 actions for each fault." VALUE 0x80002C41 RecordLayout_3 0 CompuMethod_107 0 65535 /end CHARACTERISTIC
/begin CHARACTERISTIC FaultManager.EST1_Open.Action_2_Condition "Fault manager configuration.  Select up to 4 actions for each fault." VALUE 0x80002C43 RecordLayout_3 0 CompuMethod_108 0 65535 /end CHARACTERISTIC
/begin CHARACTERISTIC FaultManager.EST1_Open.Action_3 "Fault manager configuration.  Select up to 4 actions for each fault." VALUE 0x80002C45 RecordLayout_3 0 CompuMethod_107 0 65535 /end CHARACTERISTIC
/begin CHARACTERISTIC FaultManager.EST1_Open.Action_3_Condition "Fault manager configuration.  Select up to 4 actions for each fault." VALUE 0x80002C47 RecordLayout_3 0 CompuMethod_108 0 65535 /end CHARACTERISTIC
/begin CHARACTERISTIC FaultManager.EST1_Open.Action_4 "Fault manager configuration.  Select up to 4 actions for each fault." VALUE 0x80002C49 RecordLayout_3 0 CompuMethod_107 0 65535 /end CHARACTERISTIC
/begin CHARACTERISTIC FaultManager.EST1_Open.Action_4_Condition "Fault manager configuration.  Select up to 4 actions for each fault." VALUE 0x80002C4B RecordLayout_3 0 CompuMethod_108 0 65535 /end CHARACTERISTIC
/begin CHARACTERISTIC FaultManager.EST1_Short.Mode "Fault manager configuration.  Select up to 4 actions for each fault." VALUE 0x80002C4D RecordLayout_3 0 CompuMethod_105 0 65535 /end CHARACTERISTIC
/begin CHARACTERISTIC FaultManager.EST1_Short.ID "Fault manager configuration.  Select up to 4 actions for each fault." VALUE 0x80002C4F RecordLayout_3 0 CompuMethod_1 0 65535 /end CHARACTERISTIC
/begin CHARACTERISTIC FaultManager.EST1_Short.Test "Fault manager configuration.  Select up to 4 actions for each fault." VALUE 0x80002C51 RecordLayout_3 0 CompuMethod_106 0 65535 /end CHARACTERISTIC
/begin CHARACTERISTIC FaultManager.EST1_Short.Faulty_Samples__X_ "Fault manager configuration.  Select up to 4 actions for each fault." VALUE 0x80002C53 RecordLayout_3 0 CompuMethod_1 0 65535 /end CHARACTERISTIC
/begin CHARACTERISTIC FaultManager.EST1_Short.Total_Samples__Y_ "Fault manager configuration.  Select up to 4 actions for each fault." VALUE 0x80002C55 RecordLayout_3 0 CompuMethod_1 0 65535 /end CHARACTERISTIC
/begin CHARACTERISTIC FaultManager.EST1_Short.Action_1 "Fault manager configuration.  Select up to 4 actions for each fault." VALUE 0x80002C57 RecordLayout_3 0 CompuMethod_107 0 65535 /end CHARACTERISTIC
/begin CHARACTERISTIC FaultManager.EST1_Short.Action_1_Condition "Fault manager configuration.  Select up to 4 actions for each fault." VALUE 0x80002C59 RecordLayout_3 0 CompuMethod_108 0 65535 /end CHARACTERISTIC
/begin CHARACTERISTIC FaultManager.EST1_Short.Action_2 "Fault manager configuration.  Select up to 4 actions for each fault." VALUE 0x80002C5B RecordLayout_3 0 CompuMethod_107 0 65535 /end CHARACTERISTIC
/begin CHARACTERISTIC FaultManager.EST1_Short.Action_2_Condition "Fault manager configuration.  Select up to 4 actions for each fault." VALUE 0x80002C5D RecordLayout_3 0 CompuMethod_108 0 65535 /end CHARACTERISTIC
/begin CHARACTERISTIC FaultManager.EST1_Short.Action_3 "Fault manager configuration.  Select up to 4 actions for each fault." VALUE 0x80002C5F RecordLayout_3 0 CompuMethod_107 0 65535 /end CHARACTERISTIC
/begin CHARACTERISTIC FaultManager.EST1_Short.Action_3_Condition "Fault manager configuration.  Select up to 4 actions for each fault." VALUE 0x80002C61 RecordLayout_3 0 CompuMethod_108 0 65535 /end CHARACTERISTIC
/begin CHARACTERISTIC FaultManager.EST1_Short.Action_4 "Fault manager configuration.  Select up to 4 actions for each fault." VALUE 0x80002C63 RecordLayout_3 0 CompuMethod_107 0 65535 /end CHARACTERISTIC
/begin CHARACTERISTIC FaultManager.EST1_Short.Action_4_Condition "Fault manager configuration.  Select up to 4 actions for each fault." VALUE 0x80002C65 RecordLayout_3 0 CompuMethod_108 0 65535 /end CHARACTERISTIC
/begin CHARACTERISTIC FaultManager.EST2_Open.Mode "Fault manager configuration.  Select up to 4 actions for each fault." VALUE 0x80002C67 RecordLayout_3 0 CompuMethod_105 0 65535 /end CHARACTERISTIC
/begin CHARACTERISTIC FaultManager.EST2_Open.ID "Fault manager configuration.  Select up to 4 actions for each fault." VALUE 0x80002C69 RecordLayout_3 0 CompuMethod_1 0 65535 /end CHARACTERISTIC
/begin CHARACTERISTIC FaultManager.EST2_Open.Test "Fault manager configuration.  Select up to 4 actions for each fault." VALUE 0x80002C6B RecordLayout_3 0 CompuMethod_106 0 65535 /end CHARACTERISTIC
/begin CHARACTERISTIC FaultManager.EST2_Open.Faulty_Samples__X_ "Fault manager configuration.  Select up to 4 actions for each fault." VALUE 0x80002C6D RecordLayout_3 0 CompuMethod_1 0 65535 /end CHARACTERISTIC
/begin CHARACTERISTIC FaultManager.EST2_Open.Total_Samples__Y_ "Fault manager configuration.  Select up to 4 actions for each fault." VALUE 0x80002C6F RecordLayout_3 0 CompuMethod_1 0 65535 /end CHARACTERISTIC
/begin CHARACTERISTIC FaultManager.EST2_Open.Action_1 "Fault manager configuration.  Select up to 4 actions for each fault." VALUE 0x80002C71 RecordLayout_3 0 CompuMethod_107 0 65535 /end CHARACTERISTIC
/begin CHARACTERISTIC FaultManager.EST2_Open.Action_1_Condition "Fault manager configuration.  Select up to 4 actions for each fault." VALUE 0x80002C73 RecordLayout_3 0 CompuMethod_108 0 65535 /end CHARACTERISTIC
/begin CHARACTERISTIC FaultManager.EST2_Open.Action_2 "Fault manager configuration.  Select up to 4 actions for each fault." VALUE 0x80002C75 RecordLayout_3 0 CompuMethod_107 0 65535 /end CHARACTERISTIC
/begin CHARACTERISTIC FaultManager.EST2_Open.Action_2_Condition "Fault manager configuration.  Select up to 4 actions for each fault." VALUE 0x80002C77 RecordLayout_3 0 CompuMethod_108 0 65535 /end CHARACTERISTIC
/begin CHARACTERISTIC FaultManager.EST2_Open.Action_3 "Fault manager configuration.  Select up to 4 actions for each fault." VALUE 0x80002C79 RecordLayout_3 0 CompuMethod_107 0 65535 /end CHARACTERISTIC
/begin CHARACTERISTIC FaultManager.EST2_Open.Action_3_Condition "Fault manager configuration.  Select up to 4 actions for each fault." VALUE 0x80002C7B RecordLayout_3 0 CompuMethod_108 0 65535 /end CHARACTERISTIC
/begin CHARACTERISTIC FaultManager.EST2_Open.Action_4 "Fault manager configuration.  Select up to 4 actions for each fault." VALUE 0x80002C7D RecordLayout_3 0 CompuMethod_107 0 65535 /end CHARACTERISTIC
/begin CHARACTERISTIC FaultManager.EST2_Open.Action_4_Condition "Fault manager configuration.  Select up to 4 actions for each fault." VALUE 0x80002C7F RecordLayout_3 0 CompuMethod_108 0 65535 /end CHARACTERISTIC
/begin CHARACTERISTIC FaultManager.EST2_Short.Mode "Fault manager configuration.  Select up to 4 actions for each fault." VALUE 0x80002C81 RecordLayout_3 0 CompuMethod_105 0 65535 /end CHARACTERISTIC
/begin CHARACTERISTIC FaultManager.EST2_Short.ID "Fault manager configuration.  Select up to 4 actions for each fault." VALUE 0x80002C83 RecordLayout_3 0 CompuMethod_1 0 65535 /end CHARACTERISTIC
/begin CHARACTERISTIC FaultManager.EST2_Short.Test "Fault manager configuration.  Select up to 4 actions for each fault." VALUE 0x80002C85 RecordLayout_3 0 CompuMethod_106 0 65535 /end CHARACTERISTIC
/begin CHARACTERISTIC FaultManager.EST2_Short.Faulty_Samples__X_ "Fault manager configuration.  Select up to 4 actions for each fault." VALUE 0x80002C87 RecordLayout_3 0 CompuMethod_1 0 65535 /end CHARACTERISTIC
/begin CHARACTERISTIC FaultManager.EST2_Short.Total_Samples__Y_ "Fault manager configuration.  Select up to 4 actions for each fault." VALUE 0x80002C89 RecordLayout_3 0 CompuMethod_1 0 65535 /end CHARACTERISTIC
/begin CHARACTERISTIC FaultManager.EST2_Short.Action_1 "Fault manager configuration.  Select up to 4 actions for each fault." VALUE 0x80002C8B RecordLayout_3 0 CompuMethod_107 0 65535 /end CHARACTERISTIC
/begin CHARACTERISTIC FaultManager.EST2_Short.Action_1_Condition "Fault manager configuration.  Select up to 4 actions for each fault." VALUE 0x80002C8D RecordLayout_3 0 CompuMethod_108 0 65535 /end CHARACTERISTIC
/begin CHARACTERISTIC FaultManager.EST2_Short.Action_2 "Fault manager configuration.  Select up to 4 actions for each fault." VALUE 0x80002C8F RecordLayout_3 0 CompuMethod_107 0 65535 /end CHARACTERISTIC
/begin CHARACTERISTIC FaultManager.EST2_Short.Action_2_Condition "Fault manager configuration.  Select up to 4 actions for each fault." VALUE 0x80002C91 RecordLayout_3 0 CompuMethod_108 0 65535 /end CHARACTERISTIC
/begin CHARACTERISTIC FaultManager.EST2_Short.Action_3 "Fault manager configuration.  Select up to 4 actions for each fault." VALUE 0x80002C93 RecordLayout_3 0 CompuMethod_107 0 65535 /end CHARACTERISTIC
/begin CHARACTERISTIC FaultManager.EST2_Short.Action_3_Condition "Fault manager configuration.  Select up to 4 actions for each fault." VALUE 0x80002C95 RecordLayout_3 0 CompuMethod_108 0 65535 /end CHARACTERISTIC
/begin CHARACTERISTIC FaultManager.EST2_Short.Action_4 "Fault manager configuration.  Select up to 4 actions for each fault." VALUE 0x80002C97 RecordLayout_3 0 CompuMethod_107 0 65535 /end CHARACTERISTIC
/begin CHARACTERISTIC FaultManager.EST2_Short.Action_4_Condition "Fault manager configuration.  Select up to 4 actions for each fault." VALUE 0x80002C99 RecordLayout_3 0 CompuMethod_108 0 65535 /end CHARACTERISTIC
/begin CHARACTERISTIC MatlabVersionTxt "MATLAB version used to build the application." ASCII 0x400006F7 RecordLayout_1 0 CompuMethod_2 0 255 NUMBER 80 MATRIX_DIM 80 1 1 READ_ONLY /end CHARACTERISTIC
/begin CHARACTERISTIC MotoCoderVersionTxt "MotoCoder version used to build the application." ASCII 0x400007A4 RecordLayout_1 0 CompuMethod_2 0 255 NUMBER 7 MATRIX_DIM 7 1 1 READ_ONLY /end CHARACTERISTIC
/begin CHARACTERISTIC MotoHawkBuildGUID "GUID identifying the MotoHawk build session" ASCII 0x400007AB RecordLayout_1 0 CompuMethod_2 0 255 NUMBER 80 MATRIX_DIM 80 1 1 READ_ONLY /end CHARACTERISTIC
/begin CHARACTERISTIC MotoHawkModelGUID "GUID identifying the MotoHawk model" ASCII 0x400007FB RecordLayout_1 0 CompuMethod_2 0 255 NUMBER 80 MATRIX_DIM 80 1 1 READ_ONLY /end CHARACTERISTIC
/begin CHARACTERISTIC MotoHawkModelName "Simulink model name used for the MotoHawk build" ASCII 0x4000084B RecordLayout_1 0 CompuMethod_2 0 255 NUMBER 80 MATRIX_DIM 80 1 1 READ_ONLY /end CHARACTERISTIC
/begin CHARACTERISTIC MotoHawkTokenGUID "GUID identifying the token inserted during the build.  May be empty if no token was available" ASCII 0x4000089F RecordLayout_1 0 CompuMethod_2 0 255 NUMBER 80 MATRIX_DIM 80 1 1 READ_ONLY /end CHARACTERISTIC
/begin CHARACTERISTIC MotoHawkVersionTxt "MotoHawk version used to build the application." ASCII 0x400008EF RecordLayout_1 0 CompuMethod_2 0 255 NUMBER 50 MATRIX_DIM 50 1 1 READ_ONLY /end CHARACTERISTIC
/begin CHARACTERISTIC PartNumber "Module Part Number" ASCII 0x400009B0 RecordLayout_1 0 CompuMethod_2 0 255 NUMBER 40 MATRIX_DIM 40 1 1 READ_ONLY /end CHARACTERISTIC
/*~~~~~~~~~ 6.3.106 RECORD_LAYOUTs ~~~~~~~~~*/
/begin RECORD_LAYOUT RecordLayout_1 FNC_VALUES 1 UBYTE ROW_DIR DIRECT /end RECORD_LAYOUT
/begin RECORD_LAYOUT RecordLayout_2 FNC_VALUES 1 UBYTE ROW_DIR DIRECT /end RECORD_LAYOUT
/begin RECORD_LAYOUT RecordLayout_3 FNC_VALUES 1 UWORD ROW_DIR DIRECT /end RECORD_LAYOUT
/*~~~~~~~~~ 6.3.31 COMPU_METHODs ~~~~~~~~~*/
/begin COMPU_METHOD CompuMethod_1 "" RAT_FUNC "%3.0" "" COEFFS 0 1 0 0 0 1 /end COMPU_METHOD
/begin COMPU_METHOD CompuMethod_2 "" RAT_FUNC "%6.2" "" COEFFS 0 1 0 0 0 1 /end COMPU_METHOD
/begin COMPU_METHOD CompuMethod_3 "" RAT_FUNC "%10.0" "ID" COEFFS 0 1 0 0 0 1 /end COMPU_METHOD
/begin COMPU_METHOD CompuMethod_4 "" TAB_VERB "%3.0" "" COMPU_TAB_REF CompuVtab_1 /end COMPU_METHOD
/begin COMPU_METHOD CompuMethod_5 "" RAT_FUNC "%5.0" "" COEFFS 0 1 0 0 0 1 /end COMPU_METHOD
/begin COMPU_METHOD CompuMethod_6 "" RAT_FUNC "%1.0" "bool" COEFFS 0 1 0 0 0 1 /end COMPU_METHOD
/begin COMPU_METHOD CompuMethod_58 "" TAB_VERB "%4.0" "" COMPU_TAB_REF CompuVtab_14 /end COMPU_METHOD
/begin COMPU_METHOD CompuMethod_103 "" TAB_VERB "%3.0" "" COMPU_TAB_REF CompuVtab_23 /end COMPU_METHOD
/begin COMPU_METHOD CompuMethod_104 "" TAB_VERB "%3.0" "" COMPU_TAB_REF CompuVtab_24 /end COMPU_METHOD
/begin COMPU_METHOD CompuMethod_105 "" TAB_VERB "%3.0" "" COMPU_TAB_REF CompuVtab_25 /end COMPU_METHOD
/begin COMPU_METHOD CompuMethod_106 "" TAB_VERB "%3.0" "" COMPU_TAB_REF CompuVtab_26 /end COMPU_METHOD
/begin COMPU_METHOD CompuMethod_107 "" TAB_VERB "%3.0" "" COMPU_TAB_REF CompuVtab_27 /end COMPU_METHOD
/begin COMPU_METHOD CompuMethod_108 "" TAB_VERB "%3.0" "" COMPU_TAB_REF CompuVtab_28 /end COMPU_METHOD
/begin COMPU_METHOD CompuMethod_131 "" RAT_FUNC "%8.0" "seconds" COEFFS 0 1 0 0 0 1 /end COMPU_METHOD
/*~~~~~~~~~ 6.3.34 COMPU_VTABs ~~~~~~~~~*/
/begin COMPU_VTAB CompuVtab_1 "" TAB_VERB 41 8 "PCM" 9 "ECM" 10 "PCM80" 11 "VCM" 13 "PCM128" 14 "ISDL 555" 15 "ISDL" 15 "DLM565-24" 17 "SECM" 18 "uCHI" 19 "ECM48" 20 "AIM" 21 "FIRE48" 22 "TVM48" 23 "Axiom Eval" 24 "Indy 05" 25 "MPC5554 112 Pin module" 26 "PCM0901" 27 "Lowrance LMF-200" 28 "Peiker" 29 "M3A" 30 "Kohler Doolittle" 31 "PIM" 32 "Win32 Host" 33 "Bedrock" 34 "SECM" 35 "uCHI" 36 "Tenneco AT" 37 "Woodward DPF" 38 "M460" 39 "DE-ECU" 40 "Axiom MPC5566EVB" 41 "Large Engine Platform Core" 42 "Large Engine Platform Knock Processor" 43 "ECM OH with MPC5566" 44 "ECM OH with MPC5554" 45 "Axiom MPC5553EVB" 46 "ECM OH Quizzer micro" 47 "GCM-5566-068-047" 48 "ECM-5644-112-048" 49 "ECM-5642-112-049" /end COMPU_VTAB
/begin COMPU_VTAB CompuVtab_14 "" TAB_VERB 7 0 "Calibratable Development Module" 1 "Non-Calibratable Production Module" 2 "Software Dev Module (with RAM overlay only)" 3 "Software Dev Module (with Trace Pod & RAM)" 4 "Calibratable Development Module with Censorship disabled" 5 "Non-Calibratable Production Module with Censorship disabled" 6 "Module with a daughter board whose purpose is to aid in calibration" /end COMPU_VTAB
/begin COMPU_VTAB CompuVtab_23 "" TAB_VERB 163 0 "ACChargeHigh_Fault" 1 "ACChargeLow_Fault" 2 "ACPresRangeHigh" 3 "ACPresRangeLow" 4 "APP1RangeHigh" 5 "APP1RangeLow" 6 "APP1_AdaptAdaptHiMax" 7 "APP1_AdaptAdaptHiMin" 8 "APP1_AdaptAdaptLoMax" 9 "APP1_AdaptAdaptLoMin" 10 "APP1_AdaptRangeHigh" 11 "APP1_AdaptRangeLow" 12 "APP2RangeHigh" 13 "APP2RangeLow" 14 "APP2_AdaptAdaptHiMax" 15 "APP2_AdaptAdaptHiMin" 16 "APP2_AdaptAdaptLoMax" 17 "APP2_AdaptAdaptLoMin" 18 "APP2_AdaptRangeHigh" 19 "APP2_AdaptRangeLow" 20 "APP_Sensors_Conflict" 21 "AirflowMismatch_Fault" 22 "AltInop_Fault" 23 "Bank1_EquivRatioRangeHigh" 24 "Bank1_EquivRatioRangeLow" 25 "Bank2_EquivRatioRangeHigh" 26 "Bank2_EquivRatioRangeLow" 27 "CATRangeHigh" 28 "CATRangeLow" 29 "CamEdgesFault" 30 "CamSyncFault" 31 "ClutchStuckHigh_Fault" 32 "CrankEdgesFault" 33 "CrankSyncFault" 34 "Cylinder1_HardMisfire" 35 "Cylinder2_HardMisfire" 36 "Cylinder3_HardMisfire" 37 "Cylinder4_HardMisfire" 38 "Cylinder5_HardMisfire" 39 "Cylinder6_HardMisfire" 40 "Cylinder7_HardMisfire" 41 "Cylinder8_HardMisfire" 42 "ECTOverTempFault" 43 "ECTRangeHigh" 44 "ECTRangeLow" 45 "ECTSevereOverTempFault" 46 "EST1_Open" 47 "EST1_Short" 48 "EST2_Open" 49 "EST2_Short" 50 "EST3_Open" 51 "EST3_Short" 52 "EST4_Open" 53 "EST4_Short" 54 "EST5_Open" 55 "EST5_Short" 56 "EST6_Open" 57 "EST6_Short" 58 "EST7_Open" 59 "EST7_Short" 60 "EST8_Open" 61 "EST8_Short" 62 "ETCSpringTest" 63 "ETC_Open_Fault" 64 "ETC_Sticking" 65 "EVAPRangeHigh" 66 "EVAPRangeLow" 67 "FuelAdaptRangeHi_BankA" 68 "FuelAdaptRangeHi_BankB" 69 "FuelAdaptRangeLow_BankA" 70 "FuelAdaptRangeLow_BankB" 71 "FuelPresHigh_Fault" 72 "FuelPresLow_Fault" 73 "FuelPresRangeHigh" 74 "FuelPresRangeLow" 75 "FuelSensRangeHigh" 76 "FuelSensRangeLow" 77 "Fuel_LvlRangeHigh" 78 "Fuel_LvlRangeLow" 79 "GPS_DateTime_Timeout" 80 "GPS_LatLong_Timeout" 81 "GPS_SpeedDir_Timeout" 82 "HardOverBoost_Fault" 83 "HardOverspeed" 84 "IATRangeHigh" 85 "IATRangeLow" 86 "Inj1Open" 87 "Inj2Open" 88 "Inj3Open" 89 "Inj4Open" 90 "Inj5Open" 91 "Inj6Open" 92 "Inj7Open" 93 "Inj8Open" 94 "Lambda1Error_Fault" 95 "Lambda1Fault_Fault" 96 "Lambda1HtrOpen_Fault" 97 "Lambda1HtrShort_Fault" 98 "Lambda1Overcool_Fault" 99 "Lambda1Overheat_Fault" 100 "Lambda1StuckInReset_Fault" 101 "Lambda1StuckInWarmup_Fault" 102 "Lambda1VoltHigh_Fault" 103 "Lambda1VoltLow_Fault" 104 "Lambda2Error_Fault" 105 "Lambda2Fault_Fault" 106 "Lambda2HtrOpen_Fault" 107 "Lambda2HtrShort_Fault" 108 "Lambda2Overcool_Fault" 109 "Lambda2Overheat_Fault" 110 "Lambda2StuckInReset_Fault" 111 "Lambda2StuckInWarmup_Fault" 112 "Lambda2VoltHigh_Fault" 113 "Lambda2VoltLow_Fault" 114 "Lambda_1_Timeout" 115 "Lambda_2_Timeout" 116 "Lambda_Bank2Bank_Fault" 117 "LeanProtect_Fault" 118 "MAFRangeHigh" 119 "MAFRangeLow" 120 "MAPRangeHigh" 121 "MAPRangeLow" 122 "MAPTimeRangeHigh" 123 "MAPTimeRangeLow" 124 "MAP_IR_HI" 125 "MAP_IR_LO" 126 "MAP_STICKING" 127 "MediumOverspeed" 128 "NoOil_Fault" 129 "O2FailedLean_BankA" 130 "O2FailedLean_BankB" 131 "O2FailedRich_BankA" 132 "O2FailedRich_BankB" 133 "O2NotActive_BankA" 134 "O2NotActive_BankB" 135 "OilPresRangeHigh" 136 "OilPresRangeLow" 137 "ScrambleStuckHigh_Fault" 138 "SensVoltRangeHigh" 139 "SensVoltRangeLow" 140 "SoftOverBoost_Fault" 141 "SoftOverspeed" 142 "SysVoltRangeHigh" 143 "SysVoltRangeLow" 144 "TPS1AdaptHiMax" 145 "TPS1AdaptHiMin" 146 "TPS1AdaptLoMax" 147 "TPS1AdaptLoMin" 148 "TPS1RangeHigh" 149 "TPS1RangeLow" 150 "TPS2AdaptHiMax" 151 "TPS2AdaptHiMin" 152 "TPS2AdaptLoMax" 153 "TPS2AdaptLoMin" 154 "TPS2RangeHigh" 155 "TPS2RangeLow" 156 "TPS_Sensors_Conflict" 157 "VSPDRangeHigh" 158 "VSPDRangeLow" 159 "VoltLow_Fault" 160 "VoltTooHigh_Fault" 161 "Wastegate_Fault" 162 "(None)" /end COMPU_VTAB
/begin COMPU_VTAB CompuVtab_24 "" TAB_VERB 2 0 "-" 1 "Clear All Faults" /end COMPU_VTAB
/begin COMPU_VTAB CompuVtab_25 "" TAB_VERB 6 0 "Disabled" 1 "Enabled" 2 "Sticky" 3 "Enabled - Persistent" 4 "Sticky - Persistent" 5 "Save Occurred" /end COMPU_VTAB
/begin COMPU_VTAB CompuVtab_26 "" TAB_VERB 2 0 "-" 1 "Test" /end COMPU_VTAB
/begin COMPU_VTAB CompuVtab_27 "" TAB_VERB 16 0 "CutThrottle" 1 "DFCODisable" 2 "DelayedEngineShutdown" 3 "DisableAC" 4 "DisableFanRun" 5 "DisableFanStall" 6 "DisableO2Ctrl" 7 "DisableVEAdapt" 8 "DisableWastegate" 9 "EngineProtectLED" 10 "EngineShutdown" 11 "HardRevLimit" 12 "MIL_LED" 13 "MediumRevLimit" 14 "SoftRevLimit" 15 "(None)" /end COMPU_VTAB
/begin COMPU_VTAB CompuVtab_28 "" TAB_VERB 8 0 "(None)" 1 "Suspected" 2 "Active" 3 "Suspected or Active" 4 "Occurred" 5 "Suspected or Occurred" 6 "Active or Occurred" 7 "Suspected or Active or Occurred" /end COMPU_VTAB
/*~~~~~~~~~ 6.3.65 FUNCTIONs ~~~~~~~~~*/
/begin FUNCTION Version ""
 /begin DEF_CHARACTERISTIC SwIdTxt CalIdTxt SwRevisionTxt FriendlyName CompilerVersion MatlabVersionTxt MotoCoderVersionTxt MotoHawkBuildGUID MotoHawkModelGUID MotoHawkModelName MotoHawkTokenGUID MotoHawkVersionTxt /end DEF_CHARACTERISTIC
 /begin OUT_MEASUREMENT project_id ProductID MotoHawkModelSecondsInUse /end OUT_MEASUREMENT
/end FUNCTION
/begin FUNCTION System ""
 /begin SUB_FUNCTION Version Tool_Interface Module Debug Performance Memory CCP System_Config Main_Power_Relay NonVolatile_Storage Status /end SUB_FUNCTION
/end FUNCTION
/begin FUNCTION Tool_Interface ""
 /begin OUT_MEASUREMENT table_0_rev table_1_rev table_2_rev Protocol_KeySuite_Rev EriRev table_3_rev table_4_rev table_5_rev table_6_rev table_7_rev MotProgRev /end OUT_MEASUREMENT
/end FUNCTION
/begin FUNCTION Module "" /begin DEF_CHARACTERISTIC SerialNumber ModelNumber PartNumber /end DEF_CHARACTERISTIC
 /begin OUT_MEASUREMENT BootVerMaj BootVerMin EcuHwMaj EcuHwMin ApplicationCompatibilityArr Capability /end OUT_MEASUREMENT
/end FUNCTION
/begin FUNCTION AC "" /begin OUT_MEASUREMENT AC /end OUT_MEASUREMENT /begin SUB_FUNCTION AC_Override AC_Config /end SUB_FUNCTION /end FUNCTION
/begin FUNCTION AC_Control "" /begin SUB_FUNCTION AC /end SUB_FUNCTION /end FUNCTION
/begin FUNCTION Outputs ""
 /begin SUB_FUNCTION AC_Control AEM_Infinity_Dash Coil_Control Injector_Control HBridge ETC_CutPower FAN_Control_2 FuelPump IAC_Control WASTEGATE_Control /end SUB_FUNCTION
/end FUNCTION
/begin FUNCTION Foreground "" /begin SUB_FUNCTION Outputs Control Inputs /end SUB_FUNCTION /end FUNCTION
/begin FUNCTION BaseEngineController_LS_112 ""
 /begin DEF_CHARACTERISTIC FaultCommand FaultManager.ACChargeHigh_Fault.Mode FaultManager.ACChargeHigh_Fault.ID FaultManager.ACChargeHigh_Fault.Test FaultManager.ACChargeHigh_Fault.Faulty_Samples__X_ FaultManager.ACChargeHigh_Fault.Total_Samples__Y_ FaultManager.ACChargeHigh_Fault.Action_1 FaultManager.ACChargeHigh_Fault.Action_1_Condition FaultManager.ACChargeHigh_Fault.Action_2 FaultManager.ACChargeHigh_Fault.Action_2_Condition FaultManager.ACChargeHigh_Fault.Action_3 FaultManager.ACChargeHigh_Fault.Action_3_Condition FaultManager.ACChargeHigh_Fault.Action_4 FaultManager.ACChargeHigh_Fault.Action_4_Condition FaultManager.ACChargeLow_Fault.Mode FaultManager.ACChargeLow_Fault.ID FaultManager.ACChargeLow_Fault.Test FaultManager.ACChargeLow_Fault.Faulty_Samples__X_ FaultManager.ACChargeLow_Fault.Total_Samples__Y_ FaultManager.ACChargeLow_Fault.Action_1 FaultManager.ACChargeLow_Fault.Action_1_Condition FaultManager.ACChargeLow_Fault.Action_2 FaultManager.ACChargeLow_Fault.Action_2_Condition FaultManager.ACChargeLow_Fault.Action_3 FaultManager.ACChargeLow_Fault.Action_3_Condition FaultManager.ACChargeLow_Fault.Action_4 FaultManager.ACChargeLow_Fault.Action_4_Condition FaultManager.ACPresRangeHigh.Mode FaultManager.ACPresRangeHigh.ID FaultManager.ACPresRangeHigh.Test FaultManager.ACPresRangeHigh.Faulty_Samples__X_ FaultManager.ACPresRangeHigh.Total_Samples__Y_ FaultManager.ACPresRangeHigh.Action_1 FaultManager.ACPresRangeHigh.Action_1_Condition FaultManager.ACPresRangeHigh.Action_2 FaultManager.ACPresRangeHigh.Action_2_Condition FaultManager.ACPresRangeHigh.Action_3 FaultManager.ACPresRangeHigh.Action_3_Condition FaultManager.ACPresRangeHigh.Action_4 FaultManager.ACPresRangeHigh.Action_4_Condition FaultManager.ACPresRangeLow.Mode FaultManager.ACPresRangeLow.ID FaultManager.ACPresRangeLow.Test FaultManager.ACPresRangeLow.Faulty_Samples__X_ FaultManager.ACPresRangeLow.Total_Samples__Y_ FaultManager.ACPresRangeLow.Action_1 FaultManager.ACPresRangeLow.Action_1_Condition FaultManager.ACPresRangeLow.Action_2 FaultManager.ACPresRangeLow.Action_2_Condition FaultManager.ACPresRangeLow.Action_3 FaultManager.ACPresRangeLow.Action_3_Condition FaultManager.ACPresRangeLow.Action_4 FaultManager.ACPresRangeLow.Action_4_Condition FaultManager.APP1RangeHigh.Mode FaultManager.APP1RangeHigh.ID FaultManager.APP1RangeHigh.Test FaultManager.APP1RangeHigh.Faulty_Samples__X_ FaultManager.APP1RangeHigh.Total_Samples__Y_ FaultManager.APP1RangeHigh.Action_1 FaultManager.APP1RangeHigh.Action_1_Condition FaultManager.APP1RangeHigh.Action_2 FaultManager.APP1RangeHigh.Action_2_Condition FaultManager.APP1RangeHigh.Action_3 FaultManager.APP1RangeHigh.Action_3_Condition FaultManager.APP1RangeHigh.Action_4 FaultManager.APP1RangeHigh.Action_4_Condition FaultManager.APP1RangeLow.Mode FaultManager.APP1RangeLow.ID FaultManager.APP1RangeLow.Test FaultManager.APP1RangeLow.Faulty_Samples__X_ FaultManager.APP1RangeLow.Total_Samples__Y_ FaultManager.APP1RangeLow.Action_1 FaultManager.APP1RangeLow.Action_1_Condition FaultManager.APP1RangeLow.Action_2 FaultManager.APP1RangeLow.Action_2_Condition FaultManager.APP1RangeLow.Action_3 FaultManager.APP1RangeLow.Action_3_Condition FaultManager.APP1RangeLow.Action_4 FaultManager.APP1RangeLow.Action_4_Condition FaultManager.APP1_AdaptAdaptHiMax.Mode FaultManager.APP1_AdaptAdaptHiMax.ID FaultManager.APP1_AdaptAdaptHiMax.Test FaultManager.APP1_AdaptAdaptHiMax.Faulty_Samples__X_ FaultManager.APP1_AdaptAdaptHiMax.Total_Samples__Y_ FaultManager.APP1_AdaptAdaptHiMax.Action_1 FaultManager.APP1_AdaptAdaptHiMax.Action_1_Condition FaultManager.APP1_AdaptAdaptHiMax.Action_2 FaultManager.APP1_AdaptAdaptHiMax.Action_2_Condition FaultManager.APP1_AdaptAdaptHiMax.Action_3 FaultManager.APP1_AdaptAdaptHiMax.Action_3_Condition FaultManager.APP1_AdaptAdaptHiMax.Action_4 FaultManager.APP1_AdaptAdaptHiMax.Action_4_Condition FaultManager.APP1_AdaptAdaptHiMin.Mode FaultManager.APP1_AdaptAdaptHiMin.ID FaultManager.APP1_AdaptAdaptHiMin.Test FaultManager.APP1_AdaptAdaptHiMin.Faulty_Samples__X_ FaultManager.APP1_AdaptAdaptHiMin.Total_Samples__Y_ FaultManager.APP1_AdaptAdaptHiMin.Action_1 FaultManager.APP1_AdaptAdaptHiMin.Action_1_Condition FaultManager.APP1_AdaptAdaptHiMin.Action_2 FaultManager.APP1_AdaptAdaptHiMin.Action_2_Condition FaultManager.APP1_AdaptAdaptHiMin.Action_3 FaultManager.APP1_AdaptAdaptHiMin.Action_3_Condition FaultManager.APP1_AdaptAdaptHiMin.Action_4 FaultManager.APP1_AdaptAdaptHiMin.Action_4_Condition FaultManager.APP1_AdaptAdaptLoMax.Mode FaultManager.APP1_AdaptAdaptLoMax.ID FaultManager.APP1_AdaptAdaptLoMax.Test FaultManager.APP1_AdaptAdaptLoMax.Faulty_Samples__X_ FaultManager.APP1_AdaptAdaptLoMax.Total_Samples__Y_ FaultManager.APP1_AdaptAdaptLoMax.Action_1 FaultManager.APP1_AdaptAdaptLoMax.Action_1_Condition FaultManager.APP1_AdaptAdaptLoMax.Action_2 FaultManager.APP1_AdaptAdaptLoMax.Action_2_Condition FaultManager.APP1_AdaptAdaptLoMax.Action_3 FaultManager.APP1_AdaptAdaptLoMax.Action_3_Condition FaultManager.APP1_AdaptAdaptLoMax.Action_4 FaultManager.APP1_AdaptAdaptLoMax.Action_4_Condition FaultManager.APP1_AdaptAdaptLoMin.Mode FaultManager.APP1_AdaptAdaptLoMin.ID FaultManager.APP1_AdaptAdaptLoMin.Test FaultManager.APP1_AdaptAdaptLoMin.Faulty_Samples__X_ FaultManager.APP1_AdaptAdaptLoMin.Total_Samples__Y_ FaultManager.APP1_AdaptAdaptLoMin.Action_1 FaultManager.APP1_AdaptAdaptLoMin.Action_1_Condition FaultManager.APP1_AdaptAdaptLoMin.Action_2 FaultManager.APP1_AdaptAdaptLoMin.Action_2_Condition FaultManager.APP1_AdaptAdaptLoMin.Action_3 FaultManager.APP1_AdaptAdaptLoMin.Action_3_Condition FaultManager.APP1_AdaptAdaptLoMin.Action_4 FaultManager.APP1_AdaptAdaptLoMin.Action_4_Condition FaultManager.APP1_AdaptRangeHigh.Mode FaultManager.APP1_AdaptRangeHigh.ID FaultManager.APP1_AdaptRangeHigh.Test FaultManager.APP1_AdaptRangeHigh.Faulty_Samples__X_ FaultManager.APP1_AdaptRangeHigh.Total_Samples__Y_ FaultManager.APP1_AdaptRangeHigh.Action_1 FaultManager.APP1_AdaptRangeHigh.Action_1_Condition FaultManager.APP1_AdaptRangeHigh.Action_2 FaultManager.APP1_AdaptRangeHigh.Action_2_Condition FaultManager.APP1_AdaptRangeHigh.Action_3 FaultManager.APP1_AdaptRangeHigh.Action_3_Condition FaultManager.APP1_AdaptRangeHigh.Action_4 FaultManager.APP1_AdaptRangeHigh.Action_4_Condition FaultManager.APP1_AdaptRangeLow.Mode FaultManager.APP1_AdaptRangeLow.ID FaultManager.APP1_AdaptRangeLow.Test FaultManager.APP1_AdaptRangeLow.Faulty_Samples__X_ FaultManager.APP1_AdaptRangeLow.Total_Samples__Y_ FaultManager.APP1_AdaptRangeLow.Action_1 FaultManager.APP1_AdaptRangeLow.Action_1_Condition FaultManager.APP1_AdaptRangeLow.Action_2 FaultManager.APP1_AdaptRangeLow.Action_2_Condition FaultManager.APP1_AdaptRangeLow.Action_3 FaultManager.APP1_AdaptRangeLow.Action_3_Condition FaultManager.APP1_AdaptRangeLow.Action_4 FaultManager.APP1_AdaptRangeLow.Action_4_Condition FaultManager.APP2RangeHigh.Mode FaultManager.APP2RangeHigh.ID FaultManager.APP2RangeHigh.Test FaultManager.APP2RangeHigh.Faulty_Samples__X_ FaultManager.APP2RangeHigh.Total_Samples__Y_ FaultManager.APP2RangeHigh.Action_1 FaultManager.APP2RangeHigh.Action_1_Condition FaultManager.APP2RangeHigh.Action_2 FaultManager.APP2RangeHigh.Action_2_Condition FaultManager.APP2RangeHigh.Action_3 FaultManager.APP2RangeHigh.Action_3_Condition FaultManager.APP2RangeHigh.Action_4 FaultManager.APP2RangeHigh.Action_4_Condition FaultManager.APP2RangeLow.Mode FaultManager.APP2RangeLow.ID FaultManager.APP2RangeLow.Test FaultManager.APP2RangeLow.Faulty_Samples__X_ FaultManager.APP2RangeLow.Total_Samples__Y_ FaultManager.APP2RangeLow.Action_1 FaultManager.APP2RangeLow.Action_1_Condition FaultManager.APP2RangeLow.Action_2 FaultManager.APP2RangeLow.Action_2_Condition FaultManager.APP2RangeLow.Action_3 FaultManager.APP2RangeLow.Action_3_Condition FaultManager.APP2RangeLow.Action_4 FaultManager.APP2RangeLow.Action_4_Condition FaultManager.APP2_AdaptAdaptHiMax.Mode FaultManager.APP2_AdaptAdaptHiMax.ID FaultManager.APP2_AdaptAdaptHiMax.Test FaultManager.APP2_AdaptAdaptHiMax.Faulty_Samples__X_ FaultManager.APP2_AdaptAdaptHiMax.Total_Samples__Y_ FaultManager.APP2_AdaptAdaptHiMax.Action_1 FaultManager.APP2_AdaptAdaptHiMax.Action_1_Condition FaultManager.APP2_AdaptAdaptHiMax.Action_2 FaultManager.APP2_AdaptAdaptHiMax.Action_2_Condition FaultManager.APP2_AdaptAdaptHiMax.Action_3 FaultManager.APP2_AdaptAdaptHiMax.Action_3_Condition FaultManager.APP2_AdaptAdaptHiMax.Action_4 FaultManager.APP2_AdaptAdaptHiMax.Action_4_Condition FaultManager.APP2_AdaptAdaptHiMin.Mode FaultManager.APP2_AdaptAdaptHiMin.ID FaultManager.APP2_AdaptAdaptHiMin.Test FaultManager.APP2_AdaptAdaptHiMin.Faulty_Samples__X_ FaultManager.APP2_AdaptAdaptHiMin.Total_Samples__Y_ FaultManager.APP2_AdaptAdaptHiMin.Action_1 FaultManager.APP2_AdaptAdaptHiMin.Action_1_Condition FaultManager.APP2_AdaptAdaptHiMin.Action_2 FaultManager.APP2_AdaptAdaptHiMin.Action_2_Condition FaultManager.APP2_AdaptAdaptHiMin.Action_3 FaultManager.APP2_AdaptAdaptHiMin.Action_3_Condition FaultManager.APP2_AdaptAdaptHiMin.Action_4 FaultManager.APP2_AdaptAdaptHiMin.Action_4_Condition FaultManager.APP2_AdaptAdaptLoMax.Mode FaultManager.APP2_AdaptAdaptLoMax.ID FaultManager.APP2_AdaptAdaptLoMax.Test FaultManager.APP2_AdaptAdaptLoMax.Faulty_Samples__X_ FaultManager.APP2_AdaptAdaptLoMax.Total_Samples__Y_ FaultManager.APP2_AdaptAdaptLoMax.Action_1 FaultManager.APP2_AdaptAdaptLoMax.Action_1_Condition FaultManager.APP2_AdaptAdaptLoMax.Action_2 FaultManager.APP2_AdaptAdaptLoMax.Action_2_Condition FaultManager.APP2_AdaptAdaptLoMax.Action_3 FaultManager.APP2_AdaptAdaptLoMax.Action_3_Condition FaultManager.APP2_AdaptAdaptLoMax.Action_4 FaultManager.APP2_AdaptAdaptLoMax.Action_4_Condition FaultManager.APP2_AdaptAdaptLoMin.Mode FaultManager.APP2_AdaptAdaptLoMin.ID FaultManager.APP2_AdaptAdaptLoMin.Test FaultManager.APP2_AdaptAdaptLoMin.Faulty_Samples__X_ FaultManager.APP2_AdaptAdaptLoMin.Total_Samples__Y_ FaultManager.APP2_AdaptAdaptLoMin.Action_1 FaultManager.APP2_AdaptAdaptLoMin.Action_1_Condition FaultManager.APP2_AdaptAdaptLoMin.Action_2 FaultManager.APP2_AdaptAdaptLoMin.Action_2_Condition FaultManager.APP2_AdaptAdaptLoMin.Action_3 FaultManager.APP2_AdaptAdaptLoMin.Action_3_Condition FaultManager.APP2_AdaptAdaptLoMin.Action_4 FaultManager.APP2_AdaptAdaptLoMin.Action_4_Condition FaultManager.APP2_AdaptRangeHigh.Mode FaultManager.APP2_AdaptRangeHigh.ID FaultManager.APP2_AdaptRangeHigh.Test FaultManager.APP2_AdaptRangeHigh.Faulty_Samples__X_ FaultManager.APP2_AdaptRangeHigh.Total_Samples__Y_ FaultManager.APP2_AdaptRangeHigh.Action_1 FaultManager.APP2_AdaptRangeHigh.Action_1_Condition FaultManager.APP2_AdaptRangeHigh.Action_2 FaultManager.APP2_AdaptRangeHigh.Action_2_Condition FaultManager.APP2_AdaptRangeHigh.Action_3 FaultManager.APP2_AdaptRangeHigh.Action_3_Condition FaultManager.APP2_AdaptRangeHigh.Action_4 FaultManager.APP2_AdaptRangeHigh.Action_4_Condition FaultManager.APP2_AdaptRangeLow.Mode FaultManager.APP2_AdaptRangeLow.ID FaultManager.APP2_AdaptRangeLow.Test FaultManager.APP2_AdaptRangeLow.Faulty_Samples__X_ FaultManager.APP2_AdaptRangeLow.Total_Samples__Y_ FaultManager.APP2_AdaptRangeLow.Action_1 FaultManager.APP2_AdaptRangeLow.Action_1_Condition FaultManager.APP2_AdaptRangeLow.Action_2 FaultManager.APP2_AdaptRangeLow.Action_2_Condition FaultManager.APP2_AdaptRangeLow.Action_3 FaultManager.APP2_AdaptRangeLow.Action_3_Condition FaultManager.APP2_AdaptRangeLow.Action_4 FaultManager.APP2_AdaptRangeLow.Action_4_Condition FaultManager.APP_Sensors_Conflict.Mode FaultManager.APP_Sensors_Conflict.ID FaultManager.APP_Sensors_Conflict.Test FaultManager.APP_Sensors_Conflict.Faulty_Samples__X_ FaultManager.APP_Sensors_Conflict.Total_Samples__Y_ FaultManager.APP_Sensors_Conflict.Action_1 FaultManager.APP_Sensors_Conflict.Action_1_Condition FaultManager.APP_Sensors_Conflict.Action_2 FaultManager.APP_Sensors_Conflict.Action_2_Condition FaultManager.APP_Sensors_Conflict.Action_3 FaultManager.APP_Sensors_Conflict.Action_3_Condition FaultManager.APP_Sensors_Conflict.Action_4 FaultManager.APP_Sensors_Conflict.Action_4_Condition FaultManager.AirflowMismatch_Fault.Mode FaultManager.AirflowMismatch_Fault.ID FaultManager.AirflowMismatch_Fault.Test FaultManager.AirflowMismatch_Fault.Faulty_Samples__X_ FaultManager.AirflowMismatch_Fault.Total_Samples__Y_ FaultManager.AirflowMismatch_Fault.Action_1 FaultManager.AirflowMismatch_Fault.Action_1_Condition FaultManager.AirflowMismatch_Fault.Action_2 FaultManager.AirflowMismatch_Fault.Action_2_Condition FaultManager.AirflowMismatch_Fault.Action_3 FaultManager.AirflowMismatch_Fault.Action_3_Condition FaultManager.AirflowMismatch_Fault.Action_4 FaultManager.AirflowMismatch_Fault.Action_4_Condition FaultManager.AltInop_Fault.Mode FaultManager.AltInop_Fault.ID FaultManager.AltInop_Fault.Test FaultManager.AltInop_Fault.Faulty_Samples__X_ FaultManager.AltInop_Fault.Total_Samples__Y_ FaultManager.AltInop_Fault.Action_1 FaultManager.AltInop_Fault.Action_1_Condition FaultManager.AltInop_Fault.Action_2 FaultManager.AltInop_Fault.Action_2_Condition FaultManager.AltInop_Fault.Action_3 FaultManager.AltInop_Fault.Action_3_Condition FaultManager.AltInop_Fault.Action_4 FaultManager.AltInop_Fault.Action_4_Condition FaultManager.Bank1_EquivRatioRangeHigh.Mode FaultManager.Bank1_EquivRatioRangeHigh.ID FaultManager.Bank1_EquivRatioRangeHigh.Test FaultManager.Bank1_EquivRatioRangeHigh.Faulty_Samples__X_ FaultManager.Bank1_EquivRatioRangeHigh.Total_Samples__Y_ FaultManager.Bank1_EquivRatioRangeHigh.Action_1 FaultManager.Bank1_EquivRatioRangeHigh.Action_1_Condition FaultManager.Bank1_EquivRatioRangeHigh.Action_2 FaultManager.Bank1_EquivRatioRangeHigh.Action_2_Condition FaultManager.Bank1_EquivRatioRangeHigh.Action_3 FaultManager.Bank1_EquivRatioRangeHigh.Action_3_Condition FaultManager.Bank1_EquivRatioRangeHigh.Action_4 FaultManager.Bank1_EquivRatioRangeHigh.Action_4_Condition FaultManager.Bank1_EquivRatioRangeLow.Mode FaultManager.Bank1_EquivRatioRangeLow.ID FaultManager.Bank1_EquivRatioRangeLow.Test FaultManager.Bank1_EquivRatioRangeLow.Faulty_Samples__X_ FaultManager.Bank1_EquivRatioRangeLow.Total_Samples__Y_ FaultManager.Bank1_EquivRatioRangeLow.Action_1 FaultManager.Bank1_EquivRatioRangeLow.Action_1_Condition FaultManager.Bank1_EquivRatioRangeLow.Action_2 FaultManager.Bank1_EquivRatioRangeLow.Action_2_Condition FaultManager.Bank1_EquivRatioRangeLow.Action_3 FaultManager.Bank1_EquivRatioRangeLow.Action_3_Condition FaultManager.Bank1_EquivRatioRangeLow.Action_4 FaultManager.Bank1_EquivRatioRangeLow.Action_4_Condition FaultManager.Bank2_EquivRatioRangeHigh.Mode FaultManager.Bank2_EquivRatioRangeHigh.ID FaultManager.Bank2_EquivRatioRangeHigh.Test FaultManager.Bank2_EquivRatioRangeHigh.Faulty_Samples__X_ FaultManager.Bank2_EquivRatioRangeHigh.Total_Samples__Y_ FaultManager.Bank2_EquivRatioRangeHigh.Action_1 FaultManager.Bank2_EquivRatioRangeHigh.Action_1_Condition FaultManager.Bank2_EquivRatioRangeHigh.Action_2 FaultManager.Bank2_EquivRatioRangeHigh.Action_2_Condition FaultManager.Bank2_EquivRatioRangeHigh.Action_3 FaultManager.Bank2_EquivRatioRangeHigh.Action_3_Condition FaultManager.Bank2_EquivRatioRangeHigh.Action_4 FaultManager.Bank2_EquivRatioRangeHigh.Action_4_Condition FaultManager.Bank2_EquivRatioRangeLow.Mode FaultManager.Bank2_EquivRatioRangeLow.ID FaultManager.Bank2_EquivRatioRangeLow.Test FaultManager.Bank2_EquivRatioRangeLow.Faulty_Samples__X_ FaultManager.Bank2_EquivRatioRangeLow.Total_Samples__Y_ FaultManager.Bank2_EquivRatioRangeLow.Action_1 FaultManager.Bank2_EquivRatioRangeLow.Action_1_Condition FaultManager.Bank2_EquivRatioRangeLow.Action_2 FaultManager.Bank2_EquivRatioRangeLow.Action_2_Condition FaultManager.Bank2_EquivRatioRangeLow.Action_3 FaultManager.Bank2_EquivRatioRangeLow.Action_3_Condition FaultManager.Bank2_EquivRatioRangeLow.Action_4 FaultManager.Bank2_EquivRatioRangeLow.Action_4_Condition FaultManager.CATRangeHigh.Mode FaultManager.CATRangeHigh.ID FaultManager.CATRangeHigh.Test FaultManager.CATRangeHigh.Faulty_Samples__X_ FaultManager.CATRangeHigh.Total_Samples__Y_ FaultManager.CATRangeHigh.Action_1 FaultManager.CATRangeHigh.Action_1_Condition FaultManager.CATRangeHigh.Action_2 FaultManager.CATRangeHigh.Action_2_Condition FaultManager.CATRangeHigh.Action_3 FaultManager.CATRangeHigh.Action_3_Condition FaultManager.CATRangeHigh.Action_4 FaultManager.CATRangeHigh.Action_4_Condition FaultManager.CATRangeLow.Mode FaultManager.CATRangeLow.ID FaultManager.CATRangeLow.Test FaultManager.CATRangeLow.Faulty_Samples__X_ FaultManager.CATRangeLow.Total_Samples__Y_ FaultManager.CATRangeLow.Action_1 FaultManager.CATRangeLow.Action_1_Condition FaultManager.CATRangeLow.Action_2 FaultManager.CATRangeLow.Action_2_Condition FaultManager.CATRangeLow.Action_3 FaultManager.CATRangeLow.Action_3_Condition FaultManager.CATRangeLow.Action_4 FaultManager.CATRangeLow.Action_4_Condition FaultManager.CamEdgesFault.Mode FaultManager.CamEdgesFault.ID FaultManager.CamEdgesFault.Test FaultManager.CamEdgesFault.Faulty_Samples__X_ FaultManager.CamEdgesFault.Total_Samples__Y_ FaultManager.CamEdgesFault.Action_1 FaultManager.CamEdgesFault.Action_1_Condition FaultManager.CamEdgesFault.Action_2 FaultManager.CamEdgesFault.Action_2_Condition FaultManager.CamEdgesFault.Action_3 FaultManager.CamEdgesFault.Action_3_Condition FaultManager.CamEdgesFault.Action_4 FaultManager.CamEdgesFault.Action_4_Condition FaultManager.CamSyncFault.Mode FaultManager.CamSyncFault.ID FaultManager.CamSyncFault.Test FaultManager.CamSyncFault.Faulty_Samples__X_ FaultManager.CamSyncFault.Total_Samples__Y_ FaultManager.CamSyncFault.Action_1 FaultManager.CamSyncFault.Action_1_Condition FaultManager.CamSyncFault.Action_2 FaultManager.CamSyncFault.Action_2_Condition FaultManager.CamSyncFault.Action_3 FaultManager.CamSyncFault.Action_3_Condition FaultManager.CamSyncFault.Action_4 FaultManager.CamSyncFault.Action_4_Condition FaultManager.ClutchStuckHigh_Fault.Mode FaultManager.ClutchStuckHigh_Fault.ID FaultManager.ClutchStuckHigh_Fault.Test FaultManager.ClutchStuckHigh_Fault.Faulty_Samples__X_ FaultManager.ClutchStuckHigh_Fault.Total_Samples__Y_ FaultManager.ClutchStuckHigh_Fault.Action_1 FaultManager.ClutchStuckHigh_Fault.Action_1_Condition FaultManager.ClutchStuckHigh_Fault.Action_2 FaultManager.ClutchStuckHigh_Fault.Action_2_Condition FaultManager.ClutchStuckHigh_Fault.Action_3 FaultManager.ClutchStuckHigh_Fault.Action_3_Condition FaultManager.ClutchStuckHigh_Fault.Action_4 FaultManager.ClutchStuckHigh_Fault.Action_4_Condition FaultManager.CrankEdgesFault.Mode FaultManager.CrankEdgesFault.ID FaultManager.CrankEdgesFault.Test FaultManager.CrankEdgesFault.Faulty_Samples__X_ FaultManager.CrankEdgesFault.Total_Samples__Y_ FaultManager.CrankEdgesFault.Action_1 FaultManager.CrankEdgesFault.Action_1_Condition FaultManager.CrankEdgesFault.Action_2 FaultManager.CrankEdgesFault.Action_2_Condition FaultManager.CrankEdgesFault.Action_3 FaultManager.CrankEdgesFault.Action_3_Condition FaultManager.CrankEdgesFault.Action_4 FaultManager.CrankEdgesFault.Action_4_Condition FaultManager.CrankSyncFault.Mode FaultManager.CrankSyncFault.ID FaultManager.CrankSyncFault.Test FaultManager.CrankSyncFault.Faulty_Samples__X_ FaultManager.CrankSyncFault.Total_Samples__Y_ FaultManager.CrankSyncFault.Action_1 FaultManager.CrankSyncFault.Action_1_Condition FaultManager.CrankSyncFault.Action_2 FaultManager.CrankSyncFault.Action_2_Condition FaultManager.CrankSyncFault.Action_3 FaultManager.CrankSyncFault.Action_3_Condition FaultManager.CrankSyncFault.Action_4 FaultManager.CrankSyncFault.Action_4_Condition FaultManager.Cylinder1_HardMisfire.Mode FaultManager.Cylinder1_HardMisfire.ID FaultManager.Cylinder1_HardMisfire.Test FaultManager.Cylinder1_HardMisfire.Faulty_Samples__X_ FaultManager.Cylinder1_HardMisfire.Total_Samples__Y_ FaultManager.Cylinder1_HardMisfire.Action_1 FaultManager.Cylinder1_HardMisfire.Action_1_Condition FaultManager.Cylinder1_HardMisfire.Action_2 FaultManager.Cylinder1_HardMisfire.Action_2_Condition FaultManager.Cylinder1_HardMisfire.Action_3 FaultManager.Cylinder1_HardMisfire.Action_3_Condition FaultManager.Cylinder1_HardMisfire.Action_4 FaultManager.Cylinder1_HardMisfire.Action_4_Condition FaultManager.Cylinder2_HardMisfire.Mode FaultManager.Cylinder2_HardMisfire.ID FaultManager.Cylinder2_HardMisfire.Test FaultManager.Cylinder2_HardMisfire.Faulty_Samples__X_ FaultManager.Cylinder2_HardMisfire.Total_Samples__Y_ FaultManager.Cylinder2_HardMisfire.Action_1 FaultManager.Cylinder2_HardMisfire.Action_1_Condition FaultManager.Cylinder2_HardMisfire.Action_2 FaultManager.Cylinder2_HardMisfire.Action_2_Condition FaultManager.Cylinder2_HardMisfire.Action_3 FaultManager.Cylinder2_HardMisfire.Action_3_Condition FaultManager.Cylinder2_HardMisfire.Action_4 FaultManager.Cylinder2_HardMisfire.Action_4_Condition FaultManager.Cylinder3_HardMisfire.Mode FaultManager.Cylinder3_HardMisfire.ID FaultManager.Cylinder3_HardMisfire.Test FaultManager.Cylinder3_HardMisfire.Faulty_Samples__X_ FaultManager.Cylinder3_HardMisfire.Total_Samples__Y_ FaultManager.Cylinder3_HardMisfire.Action_1 FaultManager.Cylinder3_HardMisfire.Action_1_Condition FaultManager.Cylinder3_HardMisfire.Action_2 FaultManager.Cylinder3_HardMisfire.Action_2_Condition FaultManager.Cylinder3_HardMisfire.Action_3 FaultManager.Cylinder3_HardMisfire.Action_3_Condition FaultManager.Cylinder3_HardMisfire.Action_4 FaultManager.Cylinder3_HardMisfire.Action_4_Condition FaultManager.Cylinder4_HardMisfire.Mode FaultManager.Cylinder4_HardMisfire.ID FaultManager.Cylinder4_HardMisfire.Test FaultManager.Cylinder4_HardMisfire.Faulty_Samples__X_ FaultManager.Cylinder4_HardMisfire.Total_Samples__Y_ FaultManager.Cylinder4_HardMisfire.Action_1 FaultManager.Cylinder4_HardMisfire.Action_1_Condition FaultManager.Cylinder4_HardMisfire.Action_2 FaultManager.Cylinder4_HardMisfire.Action_2_Condition FaultManager.Cylinder4_HardMisfire.Action_3 FaultManager.Cylinder4_HardMisfire.Action_3_Condition FaultManager.Cylinder4_HardMisfire.Action_4 FaultManager.Cylinder4_HardMisfire.Action_4_Condition FaultManager.Cylinder5_HardMisfire.Mode FaultManager.Cylinder5_HardMisfire.ID FaultManager.Cylinder5_HardMisfire.Test FaultManager.Cylinder5_HardMisfire.Faulty_Samples__X_ FaultManager.Cylinder5_HardMisfire.Total_Samples__Y_ FaultManager.Cylinder5_HardMisfire.Action_1 FaultManager.Cylinder5_HardMisfire.Action_1_Condition FaultManager.Cylinder5_HardMisfire.Action_2 FaultManager.Cylinder5_HardMisfire.Action_2_Condition FaultManager.Cylinder5_HardMisfire.Action_3 FaultManager.Cylinder5_HardMisfire.Action_3_Condition FaultManager.Cylinder5_HardMisfire.Action_4 FaultManager.Cylinder5_HardMisfire.Action_4_Condition FaultManager.Cylinder6_HardMisfire.Mode FaultManager.Cylinder6_HardMisfire.ID FaultManager.Cylinder6_HardMisfire.Test FaultManager.Cylinder6_HardMisfire.Faulty_Samples__X_ FaultManager.Cylinder6_HardMisfire.Total_Samples__Y_ FaultManager.Cylinder6_HardMisfire.Action_1 FaultManager.Cylinder6_HardMisfire.Action_1_Condition FaultManager.Cylinder6_HardMisfire.Action_2 FaultManager.Cylinder6_HardMisfire.Action_2_Condition FaultManager.Cylinder6_HardMisfire.Action_3 FaultManager.Cylinder6_HardMisfire.Action_3_Condition FaultManager.Cylinder6_HardMisfire.Action_4 FaultManager.Cylinder6_HardMisfire.Action_4_Condition FaultManager.Cylinder7_HardMisfire.Mode FaultManager.Cylinder7_HardMisfire.ID FaultManager.Cylinder7_HardMisfire.Test FaultManager.Cylinder7_HardMisfire.Faulty_Samples__X_ FaultManager.Cylinder7_HardMisfire.Total_Samples__Y_ FaultManager.Cylinder7_HardMisfire.Action_1 FaultManager.Cylinder7_HardMisfire.Action_1_Condition FaultManager.Cylinder7_HardMisfire.Action_2 FaultManager.Cylinder7_HardMisfire.Action_2_Condition FaultManager.Cylinder7_HardMisfire.Action_3 FaultManager.Cylinder7_HardMisfire.Action_3_Condition FaultManager.Cylinder7_HardMisfire.Action_4 FaultManager.Cylinder7_HardMisfire.Action_4_Condition FaultManager.Cylinder8_HardMisfire.Mode FaultManager.Cylinder8_HardMisfire.ID FaultManager.Cylinder8_HardMisfire.Test FaultManager.Cylinder8_HardMisfire.Faulty_Samples__X_ FaultManager.Cylinder8_HardMisfire.Total_Samples__Y_ FaultManager.Cylinder8_HardMisfire.Action_1 FaultManager.Cylinder8_HardMisfire.Action_1_Condition FaultManager.Cylinder8_HardMisfire.Action_2 FaultManager.Cylinder8_HardMisfire.Action_2_Condition FaultManager.Cylinder8_HardMisfire.Action_3 FaultManager.Cylinder8_HardMisfire.Action_3_Condition FaultManager.Cylinder8_HardMisfire.Action_4 FaultManager.Cylinder8_HardMisfire.Action_4_Condition FaultManager.ECTOverTempFault.Mode FaultManager.ECTOverTempFault.ID FaultManager.ECTOverTempFault.Test FaultManager.ECTOverTempFault.Faulty_Samples__X_ FaultManager.ECTOverTempFault.Total_Samples__Y_ FaultManager.ECTOverTempFault.Action_1 FaultManager.ECTOverTempFault.Action_1_Condition FaultManager.ECTOverTempFault.Action_2 FaultManager.ECTOverTempFault.Action_2_Condition FaultManager.ECTOverTempFault.Action_3 FaultManager.ECTOverTempFault.Action_3_Condition FaultManager.ECTOverTempFault.Action_4 FaultManager.ECTOverTempFault.Action_4_Condition FaultManager.ECTRangeHigh.Mode FaultManager.ECTRangeHigh.ID FaultManager.ECTRangeHigh.Test FaultManager.ECTRangeHigh.Faulty_Samples__X_ FaultManager.ECTRangeHigh.Total_Samples__Y_ FaultManager.ECTRangeHigh.Action_1 FaultManager.ECTRangeHigh.Action_1_Condition FaultManager.ECTRangeHigh.Action_2 FaultManager.ECTRangeHigh.Action_2_Condition FaultManager.ECTRangeHigh.Action_3 FaultManager.ECTRangeHigh.Action_3_Condition FaultManager.ECTRangeHigh.Action_4 FaultManager.ECTRangeHigh.Action_4_Condition FaultManager.ECTRangeLow.Mode FaultManager.ECTRangeLow.ID FaultManager.ECTRangeLow.Test FaultManager.ECTRangeLow.Faulty_Samples__X_ FaultManager.ECTRangeLow.Total_Samples__Y_ FaultManager.ECTRangeLow.Action_1 FaultManager.ECTRangeLow.Action_1_Condition FaultManager.ECTRangeLow.Action_2 FaultManager.ECTRangeLow.Action_2_Condition FaultManager.ECTRangeLow.Action_3 FaultManager.ECTRangeLow.Action_3_Condition FaultManager.ECTRangeLow.Action_4 FaultManager.ECTRangeLow.Action_4_Condition FaultManager.ECTSevereOverTempFault.Mode FaultManager.ECTSevereOverTempFault.ID FaultManager.ECTSevereOverTempFault.Test FaultManager.ECTSevereOverTempFault.Faulty_Samples__X_ FaultManager.ECTSevereOverTempFault.Total_Samples__Y_ FaultManager.ECTSevereOverTempFault.Action_1 FaultManager.ECTSevereOverTempFault.Action_1_Condition FaultManager.ECTSevereOverTempFault.Action_2 FaultManager.ECTSevereOverTempFault.Action_2_Condition FaultManager.ECTSevereOverTempFault.Action_3 FaultManager.ECTSevereOverTempFault.Action_3_Condition FaultManager.ECTSevereOverTempFault.Action_4 FaultManager.ECTSevereOverTempFault.Action_4_Condition FaultManager.EST1_Open.Mode FaultManager.EST1_Open.ID FaultManager.EST1_Open.Test FaultManager.EST1_Open.Faulty_Samples__X_ FaultManager.EST1_Open.Total_Samples__Y_ FaultManager.EST1_Open.Action_1 FaultManager.EST1_Open.Action_1_Condition FaultManager.EST1_Open.Action_2 FaultManager.EST1_Open.Action_2_Condition FaultManager.EST1_Open.Action_3 FaultManager.EST1_Open.Action_3_Condition FaultManager.EST1_Open.Action_4 FaultManager.EST1_Open.Action_4_Condition FaultManager.EST1_Short.Mode FaultManager.EST1_Short.ID FaultManager.EST1_Short.Test FaultManager.EST1_Short.Faulty_Samples__X_ FaultManager.EST1_Short.Total_Samples__Y_ FaultManager.EST1_Short.Action_1 FaultManager.EST1_Short.Action_1_Condition FaultManager.EST1_Short.Action_2 FaultManager.EST1_Short.Action_2_Condition FaultManager.EST1_Short.Action_3 FaultManager.EST1_Short.Action_3_Condition FaultManager.EST1_Short.Action_4 FaultManager.EST1_Short.Action_4_Condition FaultManager.EST2_Open.Mode FaultManager.EST2_Open.ID FaultManager.EST2_Open.Test FaultManager.EST2_Open.Faulty_Samples__X_ FaultManager.EST2_Open.Total_Samples__Y_ FaultManager.EST2_Open.Action_1 FaultManager.EST2_Open.Action_1_Condition FaultManager.EST2_Open.Action_2 FaultManager.EST2_Open.Action_2_Condition FaultManager.EST2_Open.Action_3 FaultManager.EST2_Open.Action_3_Condition FaultManager.EST2_Open.Action_4 FaultManager.EST2_Open.Action_4_Condition FaultManager.EST2_Short.Mode FaultManager.EST2_Short.ID FaultManager.EST2_Short.Test FaultManager.EST2_Short.Faulty_Samples__X_ FaultManager.EST2_Short.Total_Samples__Y_ FaultManager.EST2_Short.Action_1 FaultManager.EST2_Short.Action_1_Condition FaultManager.EST2_Short.Action_2 FaultManager.EST2_Short.Action_2_Condition FaultManager.EST2_Short.Action_3 FaultManager.EST2_Short.Action_3_Condition FaultManager.EST2_Short.Action_4 FaultManager.EST2_Short.Action_4_Condition /end DEF_CHARACTERISTIC
 /begin OUT_MEASUREMENT FaultMarquees.FaultMarquees.Current_Suspected FaultMarquees.FaultMarquees.Current_Active FaultMarquees.FaultMarquees.Current_Occurred /end OUT_MEASUREMENT
 /begin SUB_FUNCTION Foreground Action_Reasons /end SUB_FUNCTION
/end FUNCTION
/end MODULE
/end PROJECT
