VERSION ""

NS_ :

BS_:

BU_: DASH ECU

BO_ 2650804224 RTC_RPM: 8 Vector__XXX
 SG_ RPM : 39|32@0- (1,0) [-3.4E+038|3.4E+038] "RPM" Vector__XXX
 SG_ ETC : 7|32@0+ (1,0) [0|0] "ms" Vector__XXX

BA_DEF_  "BusType" STRING ;
BA_DEF_DEF_  "BusType" "CAN";
SIG_VALTYPE_ 2650804224 RPM : 1;
