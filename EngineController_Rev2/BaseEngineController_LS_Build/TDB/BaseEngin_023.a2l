/******************************************************************************
* ASAP2 descrition file /
* Generated by Woodward ASAP2 Generator /
* This file was auto-generated on: Tuesday, August 16, 2022 11:26 PM /
******************************************************************************/
ASAP2_VERSION 1 51
/begin PROJECT Project ""
/begin MODULE BaseEngin_023 ""
/begin IF_DATA VISION DEVICE_SETTING "CCP=2.1_ASAP1b" DEVICE_SETTING "DefaultCRCType=5" /end IF_DATA
/begin IF_DATA ASAP1B_CCP
 /begin SOURCE "List 1" 0 0 DISPLAY_IDENTIFIER "DAQ1"
  /begin QP_BLOB 0 LENGTH 8 CAN_ID_FIXED 0x98EF3102 RASTER 0 REDUCTION_ALLOWED FIRST_PID 0 /end QP_BLOB
 /end SOURCE
 /begin SOURCE "List 2" 0 0 DISPLAY_IDENTIFIER "DAQ2"
  /begin QP_BLOB 1 LENGTH 8 CAN_ID_FIXED 0x98EF3102 RASTER 1 REDUCTION_ALLOWED FIRST_PID 8 /end QP_BLOB
 /end SOURCE
 /begin SOURCE "List 3" 0 0 DISPLAY_IDENTIFIER "DAQ3"
  /begin QP_BLOB 2 LENGTH 8 CAN_ID_FIXED 0x98EF3102 RASTER 2 REDUCTION_ALLOWED FIRST_PID 16 /end QP_BLOB
 /end SOURCE
 /begin SOURCE "List 4" 0 0 DISPLAY_IDENTIFIER "DAQ4"
  /begin QP_BLOB 3 LENGTH 8 CAN_ID_FIXED 0x98EF3102 RASTER 3 REDUCTION_ALLOWED FIRST_PID 24 /end QP_BLOB
 /end SOURCE
 /begin SOURCE "List 5" 0 0 DISPLAY_IDENTIFIER "DAQ5"
  /begin QP_BLOB 4 LENGTH 8 CAN_ID_FIXED 0x98EF3102 RASTER 4 REDUCTION_ALLOWED FIRST_PID 32 /end QP_BLOB
 /end SOURCE
 /begin SOURCE "List 6" 0 0 DISPLAY_IDENTIFIER "DAQ6"
  /begin QP_BLOB 5 LENGTH 8 CAN_ID_FIXED 0x98EF3102 RASTER 5 REDUCTION_ALLOWED FIRST_PID 40 /end QP_BLOB
 /end SOURCE
 /begin SOURCE "List 7" 0 0 DISPLAY_IDENTIFIER "DAQ7"
  /begin QP_BLOB 6 LENGTH 8 CAN_ID_FIXED 0x98EF3102 RASTER 6 REDUCTION_ALLOWED FIRST_PID 48 /end QP_BLOB
 /end SOURCE
 /begin SOURCE "List 8" 0 0 DISPLAY_IDENTIFIER "DAQ8"
  /begin QP_BLOB 7 LENGTH 8 CAN_ID_FIXED 0x98EF3102 RASTER 7 REDUCTION_ALLOWED FIRST_PID 56 /end QP_BLOB
 /end SOURCE
 /begin SOURCE "List 9" 0 0 DISPLAY_IDENTIFIER "DAQ9"
  /begin QP_BLOB 8 LENGTH 8 CAN_ID_FIXED 0x98EF3102 RASTER 7 REDUCTION_ALLOWED FIRST_PID 64 /end QP_BLOB
 /end SOURCE
 /begin SOURCE "List 10" 0 0 DISPLAY_IDENTIFIER "DAQ10"
  /begin QP_BLOB 9 LENGTH 8 CAN_ID_FIXED 0x98EF3102 RASTER 7 REDUCTION_ALLOWED FIRST_PID 72 /end QP_BLOB
 /end SOURCE
 /begin RASTER "FGND_RTI_PERIODIC" "FGND_RTI_PERIODIC" 0 3 5 /end RASTER
 /begin RASTER "FGND_5XRTI_PERIODIC" "FGND_5XRTI_PERIODIC" 1 3 25 /end RASTER
 /begin RASTER "FGND_MID_TDC_EVENT" "FGND_MID_TDC_EVENT" 2 103 1 /end RASTER
 /begin RASTER "FGND_20XRTI_PERIODIC" "FGND_20XRTI_PERIODIC" 3 3 100 /end RASTER
 /begin RASTER "BGND_BASE_PERIODIC" "BGND_BASE_PERIODIC" 4 3 50 /end RASTER
 /begin RASTER "BGND_BASEx2_PERIODIC" "BGND_BASEx2_PERIODIC" 5 3 100 /end RASTER
 /begin RASTER "BGND_BASEx10_PERIODIC" "BGND_BASEx10_PERIODIC" 6 3 500 /end RASTER
 /begin RASTER "ONE_SECOND_EVENT" "ONE_SECOND_EVENT" 7 3 1000 /end RASTER
 /* /begin SEED_KEY */ /* DLL for CAL */ /* Uncomment and supply a value "SecurityCAL.dll" */ /* DLL for DAQ */ /* Uncomment and supply a value "SecurityDAQ.dll" */ /* DLL for PGM */ /* Uncomment and supply a value "SecurityPGM.dll" */ /* /end SEED_KEY */
 /begin TP_BLOB /* CCP version */ 0x201 /* Blob version */ 0x204 /* CAN msg ID - send */ 0x98EF0231 /* CAN msg ID - recv */ 0x98EF3102 /* Station address */ 0x31 /* byte order */ 1 BAUDRATE 500000 SAMPLE_RATE 1 SAMPLE_POINT 75 BTL_CYCLES 8 SJW 2 SYNC_EDGE SINGLE DAQ_MODE BURST CONSISTENCY ODT ADDRESS_EXTENSION DAQ
  /begin CHECKSUM_PARAM /* algorithm */ 0x8009 /* limit */ 0x1000 CHECKSUM_CALCULATION ACTIVE_PAGE /end CHECKSUM_PARAM
  /begin DEFINED_PAGES /* Memory page num */ 1 /* Page Name */ "working page" /* address ext. */ 0x00 /* base address */ 0x80000000 /* page length */ 0x00006ABF RAM /* memory page in RAM */ RAM_INIT_BY_ECU /* memory page is initialised by ECU start-up */ /end DEFINED_PAGES
  OPTIONAL_CMD 0x5 /* TEST */ OPTIONAL_CMD 0x8 /* START_STOP_ALL */ OPTIONAL_CMD 0xC /* SET_S_STATUS */ OPTIONAL_CMD 0xD /* GET_S_STATUS */ OPTIONAL_CMD 0xE /* BUILD_CHECKSUM */ OPTIONAL_CMD 0xF /* SHORT_UP */ OPTIONAL_CMD 0x12 /* GET_SEED */ OPTIONAL_CMD 0x13 /* UNLOCK */ OPTIONAL_CMD 0x23 /* DNLOAD_6 */ /end TP_BLOB
/end IF_DATA
/*~~~~~~~~~ 6.3.91 MOD_PAR ~~~~~~~~~*/
/begin MOD_PAR /* MOD_PAR Comment*/ "" ECU_CALIBRATION_OFFSET 0x00000000
 /begin MEMORY_SEGMENT CAL "" DATA FLASH INTERN 0x80000000 /* Size */ 0x00006ABF /* Offset */ -1 -1 -1 -1 -1 /end MEMORY_SEGMENT
 /begin MEMORY_SEGMENT MeasRAM "" VARIABLES RAM INTERN 0x40000000 /* Size */ 0x00000C8C /* Offset */ -1 -1 -1 -1 -1 /end MEMORY_SEGMENT
/end MOD_PAR
/begin MOD_COMMON /* MOD_COMMON Comment */ "" BYTE_ORDER MSB_FIRST ALIGNMENT_BYTE 1 ALIGNMENT_FLOAT32_IEEE 1 ALIGNMENT_FLOAT64_IEEE 1 ALIGNMENT_LONG 1 ALIGNMENT_WORD 1 /end MOD_COMMON
/*~~~~~~~~~ 6.3.86 MEASUREMENTs ~~~~~~~~~*/
/begin MEASUREMENT table_0_rev "VarDec Table0 Revision Number" UBYTE CompuMethod_1 1 0 0 255 ECU_ADDRESS 0x40000000 /end MEASUREMENT
/begin MEASUREMENT table_1_rev "VarDec Table1 Revision Number" UBYTE CompuMethod_1 1 0 0 255 ECU_ADDRESS 0x40000001 /end MEASUREMENT
/begin MEASUREMENT table_2_rev "VarDec Table2 Revision Number" UBYTE CompuMethod_1 1 0 0 255 ECU_ADDRESS 0x40000002 /end MEASUREMENT
/begin MEASUREMENT KeyRev "This is the revision for the key protocol." UBYTE CompuMethod_1 1 0 0 255 ECU_ADDRESS 0x40000003 /end MEASUREMENT
/begin MEASUREMENT EriRev "This is the revision for the ERI protocol." UBYTE CompuMethod_1 1 0 0 255 ECU_ADDRESS 0x40000004 /end MEASUREMENT
/begin MEASUREMENT table_3_rev "VarDec Table3 Revision Number" UBYTE CompuMethod_1 1 0 0 255 ECU_ADDRESS 0x40000005 /end MEASUREMENT
/begin MEASUREMENT table_4_rev "VarDec Table4 Revision Number" UBYTE CompuMethod_1 1 0 0 255 ECU_ADDRESS 0x40000006 /end MEASUREMENT
/begin MEASUREMENT table_5_rev "VarDec Table5 Revision Number" UBYTE CompuMethod_1 1 0 0 255 ECU_ADDRESS 0x40000007 /end MEASUREMENT
/begin MEASUREMENT table_6_rev "VarDec Table6 Revision Number" UBYTE CompuMethod_1 1 0 0 255 ECU_ADDRESS 0x40000008 /end MEASUREMENT
/begin MEASUREMENT table_7_rev "VarDec Table7 Revision Number" UBYTE CompuMethod_1 1 0 0 255 ECU_ADDRESS 0x40000009 /end MEASUREMENT
/begin MEASUREMENT MotProgRev "This is the revision for the MOTPROG protocol." UBYTE CompuMethod_1 1 0 0 255 ECU_ADDRESS 0x40000049 /end MEASUREMENT
/begin MEASUREMENT BootVerMaj "" UBYTE CompuMethod_1 1 0 0 255 ECU_ADDRESS 0x4000004A /end MEASUREMENT
/begin MEASUREMENT BootVerMin "" UBYTE CompuMethod_1 1 0 0 255 ECU_ADDRESS 0x4000004B /end MEASUREMENT
/begin MEASUREMENT EcuHwMaj "" UBYTE CompuMethod_1 1 0 0 255 ECU_ADDRESS 0x4000004C /end MEASUREMENT
/begin MEASUREMENT EcuHwMin "" UBYTE CompuMethod_1 1 0 0 255 ECU_ADDRESS 0x4000004D /end MEASUREMENT
/begin MEASUREMENT ApplicationCompatibilityArr "Software Format ID" UWORD CompuMethod_2 1 0 0 65535 ECU_ADDRESS 0x4000004E MATRIX_DIM 1 50 1 /end MEASUREMENT
/begin MEASUREMENT AC "Display output in engineering units" UBYTE CompuMethod_4 1 0 0 1 ECU_ADDRESS 0x40000116 /end MEASUREMENT
/begin MEASUREMENT ConfigVerMaj "" UBYTE CompuMethod_1 1 0 0 255 ECU_ADDRESS 0x4000039A /end MEASUREMENT
/begin MEASUREMENT ConfigVerMin "" UBYTE CompuMethod_1 1 0 0 255 ECU_ADDRESS 0x4000039B /end MEASUREMENT
/begin MEASUREMENT FaultMarquees.FaultMarquees.Current_Suspected "Displays a rolling marquee for suspected, active and occurred faults." UBYTE CompuMethod_106 1 0 0 255 ECU_ADDRESS 0x400005D5 /end MEASUREMENT
/begin MEASUREMENT FaultMarquees.FaultMarquees.Current_Active "Displays a rolling marquee for suspected, active and occurred faults." UBYTE CompuMethod_106 1 0 0 255 ECU_ADDRESS 0x400005D6 /end MEASUREMENT
/begin MEASUREMENT FaultMarquees.FaultMarquees.Current_Occurred "Displays a rolling marquee for suspected, active and occurred faults." UBYTE CompuMethod_106 1 0 0 255 ECU_ADDRESS 0x400005D7 /end MEASUREMENT
/begin MEASUREMENT LinkStatus "This is the Status of the Comms link." UBYTE CompuMethod_1 1 0 0 255 ECU_ADDRESS 0x400007AE /end MEASUREMENT
/begin MEASUREMENT ModuleCapability "" UBYTE CompuMethod_145 1 0 0 255 ECU_ADDRESS 0x400008B5 /end MEASUREMENT
/begin MEASUREMENT MotoHawkModelSecondsInUse "Total runtime of this MotoHawk software model" ULONG CompuMethod_146 1 0 0 4294970000 ECU_ADDRESS 0x400009A6 /end MEASUREMENT
/begin MEASUREMENT SystemFrequency "The operating CPU frequency." ULONG CompuMethod_173 1 0 0 56 ECU_ADDRESS 0x40000B7D /end MEASUREMENT
/begin MEASUREMENT TPUMaskType "Describes the TPU Mask selected for use." UBYTE CompuMethod_176 1 0 0 0 ECU_ADDRESS 0x40000C0C /end MEASUREMENT
/begin MEASUREMENT TPUMaskVers "Describes the version of the TPU Mask selected." UBYTE CompuMethod_11 1 0 0 255 ECU_ADDRESS 0x40000C0D /end MEASUREMENT
/begin MEASUREMENT Unused "Unused Table Entry" UBYTE CompuMethod_1 1 0 0 255 ECU_ADDRESS 0x40000C18 /end MEASUREMENT
/*~~~~~~~~~ 6.3.27 CHARACTERISTICs ~~~~~~~~~*/
/begin CHARACTERISTIC project_id "This is the Platform ID used by the tools." VALUE 0x80006ABE RecordLayout_1 0 CompuMethod_1 0 255 /end CHARACTERISTIC
/begin CHARACTERISTIC SwIdTxt "Software Format ID" ASCII 0x4000000A RecordLayout_2 0 CompuMethod_2 0 255 NUMBER 13 MATRIX_DIM 13 1 1 READ_ONLY /end CHARACTERISTIC
/begin CHARACTERISTIC CalIdTxt "Calibration ID" ASCII 0x80000002 RecordLayout_2 0 CompuMethod_2 0 255 NUMBER 33 MATRIX_DIM 33 1 1 /end CHARACTERISTIC
/begin CHARACTERISTIC SwRevisionTxt "Software Revision ID" ASCII 0x40000017 RecordLayout_2 0 CompuMethod_2 0 255 NUMBER 50 MATRIX_DIM 50 1 1 READ_ONLY /end CHARACTERISTIC
/begin CHARACTERISTIC FriendlyName "The device's friendly name." ASCII 0x8000002C RecordLayout_2 0 CompuMethod_2 0 255 NUMBER 33 MATRIX_DIM 33 1 1 /end CHARACTERISTIC
/begin CHARACTERISTIC ProductID "Customer's ID used by the tools." VALUE 0x8000004D RecordLayout_3 0 CompuMethod_3 0 4294970000 /end CHARACTERISTIC
/begin CHARACTERISTIC SerialNumber "" ASCII 0x400000B2 RecordLayout_2 0 CompuMethod_2 0 255 NUMBER 50 MATRIX_DIM 50 1 1 READ_ONLY /end CHARACTERISTIC
/begin CHARACTERISTIC ModelNumber "" ASCII 0x400000E4 RecordLayout_2 0 CompuMethod_2 0 255 NUMBER 50 MATRIX_DIM 50 1 1 READ_ONLY /end CHARACTERISTIC
/begin CHARACTERISTIC CompilerVersion "Compiler toolchain version used for the MotoHawk build" ASCII 0x4000034A RecordLayout_2 0 CompuMethod_2 0 255 NUMBER 80 MATRIX_DIM 80 1 1 READ_ONLY /end CHARACTERISTIC
/begin CHARACTERISTIC ControlCoreSDKRelease "ControlCoreSDK Build." ASCII 0x4000039C RecordLayout_2 0 CompuMethod_2 0 255 NUMBER 50 MATRIX_DIM 50 1 1 READ_ONLY /end CHARACTERISTIC
/begin CHARACTERISTIC FaultCommand "Select a command to control the fault manager." VALUE 0x80002E33 RecordLayout_1 0 CompuMethod_107 0 255 /end CHARACTERISTIC
/begin CHARACTERISTIC FaultManager.ACChargeHigh_Fault.Mode "Fault manager configuration.  Select up to 4 actions for each fault." VALUE 0x80002E34 RecordLayout_8 0 CompuMethod_108 0 65535 /end CHARACTERISTIC
/begin CHARACTERISTIC FaultManager.ACChargeHigh_Fault.ID "Fault manager configuration.  Select up to 4 actions for each fault." VALUE 0x80002E36 RecordLayout_8 0 CompuMethod_1 0 65535 /end CHARACTERISTIC
/begin CHARACTERISTIC FaultManager.ACChargeHigh_Fault.Test "Fault manager configuration.  Select up to 4 actions for each fault." VALUE 0x80002E38 RecordLayout_8 0 CompuMethod_109 0 65535 /end CHARACTERISTIC
/begin CHARACTERISTIC FaultManager.ACChargeHigh_Fault.Faulty_Samples__X_ "Fault manager configuration.  Select up to 4 actions for each fault." VALUE 0x80002E3A RecordLayout_8 0 CompuMethod_1 0 65535 /end CHARACTERISTIC
/begin CHARACTERISTIC FaultManager.ACChargeHigh_Fault.Total_Samples__Y_ "Fault manager configuration.  Select up to 4 actions for each fault." VALUE 0x80002E3C RecordLayout_8 0 CompuMethod_1 0 65535 /end CHARACTERISTIC
/begin CHARACTERISTIC FaultManager.ACChargeHigh_Fault.Action_1 "Fault manager configuration.  Select up to 4 actions for each fault." VALUE 0x80002E3E RecordLayout_8 0 CompuMethod_110 0 65535 /end CHARACTERISTIC
/begin CHARACTERISTIC FaultManager.ACChargeHigh_Fault.Action_1_Condition "Fault manager configuration.  Select up to 4 actions for each fault." VALUE 0x80002E40 RecordLayout_8 0 CompuMethod_111 0 65535 /end CHARACTERISTIC
/begin CHARACTERISTIC FaultManager.ACChargeHigh_Fault.Action_2 "Fault manager configuration.  Select up to 4 actions for each fault." VALUE 0x80002E42 RecordLayout_8 0 CompuMethod_110 0 65535 /end CHARACTERISTIC
/begin CHARACTERISTIC FaultManager.ACChargeHigh_Fault.Action_2_Condition "Fault manager configuration.  Select up to 4 actions for each fault." VALUE 0x80002E44 RecordLayout_8 0 CompuMethod_111 0 65535 /end CHARACTERISTIC
/begin CHARACTERISTIC FaultManager.ACChargeHigh_Fault.Action_3 "Fault manager configuration.  Select up to 4 actions for each fault." VALUE 0x80002E46 RecordLayout_8 0 CompuMethod_110 0 65535 /end CHARACTERISTIC
/begin CHARACTERISTIC FaultManager.ACChargeHigh_Fault.Action_3_Condition "Fault manager configuration.  Select up to 4 actions for each fault." VALUE 0x80002E48 RecordLayout_8 0 CompuMethod_111 0 65535 /end CHARACTERISTIC
/begin CHARACTERISTIC FaultManager.ACChargeHigh_Fault.Action_4 "Fault manager configuration.  Select up to 4 actions for each fault." VALUE 0x80002E4A RecordLayout_8 0 CompuMethod_110 0 65535 /end CHARACTERISTIC
/begin CHARACTERISTIC FaultManager.ACChargeHigh_Fault.Action_4_Condition "Fault manager configuration.  Select up to 4 actions for each fault." VALUE 0x80002E4C RecordLayout_8 0 CompuMethod_111 0 65535 /end CHARACTERISTIC
/begin CHARACTERISTIC FaultManager.ACChargeLow_Fault.Mode "Fault manager configuration.  Select up to 4 actions for each fault." VALUE 0x80002E4E RecordLayout_8 0 CompuMethod_108 0 65535 /end CHARACTERISTIC
/begin CHARACTERISTIC FaultManager.ACChargeLow_Fault.ID "Fault manager configuration.  Select up to 4 actions for each fault." VALUE 0x80002E50 RecordLayout_8 0 CompuMethod_1 0 65535 /end CHARACTERISTIC
/begin CHARACTERISTIC FaultManager.ACChargeLow_Fault.Test "Fault manager configuration.  Select up to 4 actions for each fault." VALUE 0x80002E52 RecordLayout_8 0 CompuMethod_109 0 65535 /end CHARACTERISTIC
/begin CHARACTERISTIC FaultManager.ACChargeLow_Fault.Faulty_Samples__X_ "Fault manager configuration.  Select up to 4 actions for each fault." VALUE 0x80002E54 RecordLayout_8 0 CompuMethod_1 0 65535 /end CHARACTERISTIC
/begin CHARACTERISTIC FaultManager.ACChargeLow_Fault.Total_Samples__Y_ "Fault manager configuration.  Select up to 4 actions for each fault." VALUE 0x80002E56 RecordLayout_8 0 CompuMethod_1 0 65535 /end CHARACTERISTIC
/begin CHARACTERISTIC FaultManager.ACChargeLow_Fault.Action_1 "Fault manager configuration.  Select up to 4 actions for each fault." VALUE 0x80002E58 RecordLayout_8 0 CompuMethod_110 0 65535 /end CHARACTERISTIC
/begin CHARACTERISTIC FaultManager.ACChargeLow_Fault.Action_1_Condition "Fault manager configuration.  Select up to 4 actions for each fault." VALUE 0x80002E5A RecordLayout_8 0 CompuMethod_111 0 65535 /end CHARACTERISTIC
/begin CHARACTERISTIC FaultManager.ACChargeLow_Fault.Action_2 "Fault manager configuration.  Select up to 4 actions for each fault." VALUE 0x80002E5C RecordLayout_8 0 CompuMethod_110 0 65535 /end CHARACTERISTIC
/begin CHARACTERISTIC FaultManager.ACChargeLow_Fault.Action_2_Condition "Fault manager configuration.  Select up to 4 actions for each fault." VALUE 0x80002E5E RecordLayout_8 0 CompuMethod_111 0 65535 /end CHARACTERISTIC
/begin CHARACTERISTIC FaultManager.ACChargeLow_Fault.Action_3 "Fault manager configuration.  Select up to 4 actions for each fault." VALUE 0x80002E60 RecordLayout_8 0 CompuMethod_110 0 65535 /end CHARACTERISTIC
/begin CHARACTERISTIC FaultManager.ACChargeLow_Fault.Action_3_Condition "Fault manager configuration.  Select up to 4 actions for each fault." VALUE 0x80002E62 RecordLayout_8 0 CompuMethod_111 0 65535 /end CHARACTERISTIC
/begin CHARACTERISTIC FaultManager.ACChargeLow_Fault.Action_4 "Fault manager configuration.  Select up to 4 actions for each fault." VALUE 0x80002E64 RecordLayout_8 0 CompuMethod_110 0 65535 /end CHARACTERISTIC
/begin CHARACTERISTIC FaultManager.ACChargeLow_Fault.Action_4_Condition "Fault manager configuration.  Select up to 4 actions for each fault." VALUE 0x80002E66 RecordLayout_8 0 CompuMethod_111 0 65535 /end CHARACTERISTIC
/begin CHARACTERISTIC FaultManager.ACPresRangeHigh.Mode "Fault manager configuration.  Select up to 4 actions for each fault." VALUE 0x80002E68 RecordLayout_8 0 CompuMethod_108 0 65535 /end CHARACTERISTIC
/begin CHARACTERISTIC FaultManager.ACPresRangeHigh.ID "Fault manager configuration.  Select up to 4 actions for each fault." VALUE 0x80002E6A RecordLayout_8 0 CompuMethod_1 0 65535 /end CHARACTERISTIC
/begin CHARACTERISTIC FaultManager.ACPresRangeHigh.Test "Fault manager configuration.  Select up to 4 actions for each fault." VALUE 0x80002E6C RecordLayout_8 0 CompuMethod_109 0 65535 /end CHARACTERISTIC
/begin CHARACTERISTIC FaultManager.ACPresRangeHigh.Faulty_Samples__X_ "Fault manager configuration.  Select up to 4 actions for each fault." VALUE 0x80002E6E RecordLayout_8 0 CompuMethod_1 0 65535 /end CHARACTERISTIC
/begin CHARACTERISTIC FaultManager.ACPresRangeHigh.Total_Samples__Y_ "Fault manager configuration.  Select up to 4 actions for each fault." VALUE 0x80002E70 RecordLayout_8 0 CompuMethod_1 0 65535 /end CHARACTERISTIC
/begin CHARACTERISTIC FaultManager.ACPresRangeHigh.Action_1 "Fault manager configuration.  Select up to 4 actions for each fault." VALUE 0x80002E72 RecordLayout_8 0 CompuMethod_110 0 65535 /end CHARACTERISTIC
/begin CHARACTERISTIC FaultManager.ACPresRangeHigh.Action_1_Condition "Fault manager configuration.  Select up to 4 actions for each fault." VALUE 0x80002E74 RecordLayout_8 0 CompuMethod_111 0 65535 /end CHARACTERISTIC
/begin CHARACTERISTIC FaultManager.ACPresRangeHigh.Action_2 "Fault manager configuration.  Select up to 4 actions for each fault." VALUE 0x80002E76 RecordLayout_8 0 CompuMethod_110 0 65535 /end CHARACTERISTIC
/begin CHARACTERISTIC FaultManager.ACPresRangeHigh.Action_2_Condition "Fault manager configuration.  Select up to 4 actions for each fault." VALUE 0x80002E78 RecordLayout_8 0 CompuMethod_111 0 65535 /end CHARACTERISTIC
/begin CHARACTERISTIC FaultManager.ACPresRangeHigh.Action_3 "Fault manager configuration.  Select up to 4 actions for each fault." VALUE 0x80002E7A RecordLayout_8 0 CompuMethod_110 0 65535 /end CHARACTERISTIC
/begin CHARACTERISTIC FaultManager.ACPresRangeHigh.Action_3_Condition "Fault manager configuration.  Select up to 4 actions for each fault." VALUE 0x80002E7C RecordLayout_8 0 CompuMethod_111 0 65535 /end CHARACTERISTIC
/begin CHARACTERISTIC FaultManager.ACPresRangeHigh.Action_4 "Fault manager configuration.  Select up to 4 actions for each fault." VALUE 0x80002E7E RecordLayout_8 0 CompuMethod_110 0 65535 /end CHARACTERISTIC
/begin CHARACTERISTIC FaultManager.ACPresRangeHigh.Action_4_Condition "Fault manager configuration.  Select up to 4 actions for each fault." VALUE 0x80002E80 RecordLayout_8 0 CompuMethod_111 0 65535 /end CHARACTERISTIC
/begin CHARACTERISTIC FaultManager.ACPresRangeLow.Mode "Fault manager configuration.  Select up to 4 actions for each fault." VALUE 0x80002E82 RecordLayout_8 0 CompuMethod_108 0 65535 /end CHARACTERISTIC
/begin CHARACTERISTIC FaultManager.ACPresRangeLow.ID "Fault manager configuration.  Select up to 4 actions for each fault." VALUE 0x80002E84 RecordLayout_8 0 CompuMethod_1 0 65535 /end CHARACTERISTIC
/begin CHARACTERISTIC FaultManager.ACPresRangeLow.Test "Fault manager configuration.  Select up to 4 actions for each fault." VALUE 0x80002E86 RecordLayout_8 0 CompuMethod_109 0 65535 /end CHARACTERISTIC
/begin CHARACTERISTIC FaultManager.ACPresRangeLow.Faulty_Samples__X_ "Fault manager configuration.  Select up to 4 actions for each fault." VALUE 0x80002E88 RecordLayout_8 0 CompuMethod_1 0 65535 /end CHARACTERISTIC
/begin CHARACTERISTIC FaultManager.ACPresRangeLow.Total_Samples__Y_ "Fault manager configuration.  Select up to 4 actions for each fault." VALUE 0x80002E8A RecordLayout_8 0 CompuMethod_1 0 65535 /end CHARACTERISTIC
/begin CHARACTERISTIC FaultManager.ACPresRangeLow.Action_1 "Fault manager configuration.  Select up to 4 actions for each fault." VALUE 0x80002E8C RecordLayout_8 0 CompuMethod_110 0 65535 /end CHARACTERISTIC
/begin CHARACTERISTIC FaultManager.ACPresRangeLow.Action_1_Condition "Fault manager configuration.  Select up to 4 actions for each fault." VALUE 0x80002E8E RecordLayout_8 0 CompuMethod_111 0 65535 /end CHARACTERISTIC
/begin CHARACTERISTIC FaultManager.ACPresRangeLow.Action_2 "Fault manager configuration.  Select up to 4 actions for each fault." VALUE 0x80002E90 RecordLayout_8 0 CompuMethod_110 0 65535 /end CHARACTERISTIC
/begin CHARACTERISTIC FaultManager.ACPresRangeLow.Action_2_Condition "Fault manager configuration.  Select up to 4 actions for each fault." VALUE 0x80002E92 RecordLayout_8 0 CompuMethod_111 0 65535 /end CHARACTERISTIC
/begin CHARACTERISTIC FaultManager.ACPresRangeLow.Action_3 "Fault manager configuration.  Select up to 4 actions for each fault." VALUE 0x80002E94 RecordLayout_8 0 CompuMethod_110 0 65535 /end CHARACTERISTIC
/begin CHARACTERISTIC FaultManager.ACPresRangeLow.Action_3_Condition "Fault manager configuration.  Select up to 4 actions for each fault." VALUE 0x80002E96 RecordLayout_8 0 CompuMethod_111 0 65535 /end CHARACTERISTIC
/begin CHARACTERISTIC FaultManager.ACPresRangeLow.Action_4 "Fault manager configuration.  Select up to 4 actions for each fault." VALUE 0x80002E98 RecordLayout_8 0 CompuMethod_110 0 65535 /end CHARACTERISTIC
/begin CHARACTERISTIC FaultManager.ACPresRangeLow.Action_4_Condition "Fault manager configuration.  Select up to 4 actions for each fault." VALUE 0x80002E9A RecordLayout_8 0 CompuMethod_111 0 65535 /end CHARACTERISTIC
/begin CHARACTERISTIC FaultManager.APP1RangeHigh.Mode "Fault manager configuration.  Select up to 4 actions for each fault." VALUE 0x80002E9C RecordLayout_8 0 CompuMethod_108 0 65535 /end CHARACTERISTIC
/begin CHARACTERISTIC FaultManager.APP1RangeHigh.ID "Fault manager configuration.  Select up to 4 actions for each fault." VALUE 0x80002E9E RecordLayout_8 0 CompuMethod_1 0 65535 /end CHARACTERISTIC
/begin CHARACTERISTIC FaultManager.APP1RangeHigh.Test "Fault manager configuration.  Select up to 4 actions for each fault." VALUE 0x80002EA0 RecordLayout_8 0 CompuMethod_109 0 65535 /end CHARACTERISTIC
/begin CHARACTERISTIC FaultManager.APP1RangeHigh.Faulty_Samples__X_ "Fault manager configuration.  Select up to 4 actions for each fault." VALUE 0x80002EA2 RecordLayout_8 0 CompuMethod_1 0 65535 /end CHARACTERISTIC
/begin CHARACTERISTIC FaultManager.APP1RangeHigh.Total_Samples__Y_ "Fault manager configuration.  Select up to 4 actions for each fault." VALUE 0x80002EA4 RecordLayout_8 0 CompuMethod_1 0 65535 /end CHARACTERISTIC
/begin CHARACTERISTIC FaultManager.APP1RangeHigh.Action_1 "Fault manager configuration.  Select up to 4 actions for each fault." VALUE 0x80002EA6 RecordLayout_8 0 CompuMethod_110 0 65535 /end CHARACTERISTIC
/begin CHARACTERISTIC FaultManager.APP1RangeHigh.Action_1_Condition "Fault manager configuration.  Select up to 4 actions for each fault." VALUE 0x80002EA8 RecordLayout_8 0 CompuMethod_111 0 65535 /end CHARACTERISTIC
/begin CHARACTERISTIC FaultManager.APP1RangeHigh.Action_2 "Fault manager configuration.  Select up to 4 actions for each fault." VALUE 0x80002EAA RecordLayout_8 0 CompuMethod_110 0 65535 /end CHARACTERISTIC
/begin CHARACTERISTIC FaultManager.APP1RangeHigh.Action_2_Condition "Fault manager configuration.  Select up to 4 actions for each fault." VALUE 0x80002EAC RecordLayout_8 0 CompuMethod_111 0 65535 /end CHARACTERISTIC
/begin CHARACTERISTIC FaultManager.APP1RangeHigh.Action_3 "Fault manager configuration.  Select up to 4 actions for each fault." VALUE 0x80002EAE RecordLayout_8 0 CompuMethod_110 0 65535 /end CHARACTERISTIC
/begin CHARACTERISTIC FaultManager.APP1RangeHigh.Action_3_Condition "Fault manager configuration.  Select up to 4 actions for each fault." VALUE 0x80002EB0 RecordLayout_8 0 CompuMethod_111 0 65535 /end CHARACTERISTIC
/begin CHARACTERISTIC FaultManager.APP1RangeHigh.Action_4 "Fault manager configuration.  Select up to 4 actions for each fault." VALUE 0x80002EB2 RecordLayout_8 0 CompuMethod_110 0 65535 /end CHARACTERISTIC
/begin CHARACTERISTIC FaultManager.APP1RangeHigh.Action_4_Condition "Fault manager configuration.  Select up to 4 actions for each fault." VALUE 0x80002EB4 RecordLayout_8 0 CompuMethod_111 0 65535 /end CHARACTERISTIC
/begin CHARACTERISTIC FaultManager.APP1RangeLow.Mode "Fault manager configuration.  Select up to 4 actions for each fault." VALUE 0x80002EB6 RecordLayout_8 0 CompuMethod_108 0 65535 /end CHARACTERISTIC
/begin CHARACTERISTIC FaultManager.APP1RangeLow.ID "Fault manager configuration.  Select up to 4 actions for each fault." VALUE 0x80002EB8 RecordLayout_8 0 CompuMethod_1 0 65535 /end CHARACTERISTIC
/begin CHARACTERISTIC FaultManager.APP1RangeLow.Test "Fault manager configuration.  Select up to 4 actions for each fault." VALUE 0x80002EBA RecordLayout_8 0 CompuMethod_109 0 65535 /end CHARACTERISTIC
/begin CHARACTERISTIC FaultManager.APP1RangeLow.Faulty_Samples__X_ "Fault manager configuration.  Select up to 4 actions for each fault." VALUE 0x80002EBC RecordLayout_8 0 CompuMethod_1 0 65535 /end CHARACTERISTIC
/begin CHARACTERISTIC FaultManager.APP1RangeLow.Total_Samples__Y_ "Fault manager configuration.  Select up to 4 actions for each fault." VALUE 0x80002EBE RecordLayout_8 0 CompuMethod_1 0 65535 /end CHARACTERISTIC
/begin CHARACTERISTIC FaultManager.APP1RangeLow.Action_1 "Fault manager configuration.  Select up to 4 actions for each fault." VALUE 0x80002EC0 RecordLayout_8 0 CompuMethod_110 0 65535 /end CHARACTERISTIC
/begin CHARACTERISTIC FaultManager.APP1RangeLow.Action_1_Condition "Fault manager configuration.  Select up to 4 actions for each fault." VALUE 0x80002EC2 RecordLayout_8 0 CompuMethod_111 0 65535 /end CHARACTERISTIC
/begin CHARACTERISTIC FaultManager.APP1RangeLow.Action_2 "Fault manager configuration.  Select up to 4 actions for each fault." VALUE 0x80002EC4 RecordLayout_8 0 CompuMethod_110 0 65535 /end CHARACTERISTIC
/begin CHARACTERISTIC FaultManager.APP1RangeLow.Action_2_Condition "Fault manager configuration.  Select up to 4 actions for each fault." VALUE 0x80002EC6 RecordLayout_8 0 CompuMethod_111 0 65535 /end CHARACTERISTIC
/begin CHARACTERISTIC FaultManager.APP1RangeLow.Action_3 "Fault manager configuration.  Select up to 4 actions for each fault." VALUE 0x80002EC8 RecordLayout_8 0 CompuMethod_110 0 65535 /end CHARACTERISTIC
/begin CHARACTERISTIC FaultManager.APP1RangeLow.Action_3_Condition "Fault manager configuration.  Select up to 4 actions for each fault." VALUE 0x80002ECA RecordLayout_8 0 CompuMethod_111 0 65535 /end CHARACTERISTIC
/begin CHARACTERISTIC FaultManager.APP1RangeLow.Action_4 "Fault manager configuration.  Select up to 4 actions for each fault." VALUE 0x80002ECC RecordLayout_8 0 CompuMethod_110 0 65535 /end CHARACTERISTIC
/begin CHARACTERISTIC FaultManager.APP1RangeLow.Action_4_Condition "Fault manager configuration.  Select up to 4 actions for each fault." VALUE 0x80002ECE RecordLayout_8 0 CompuMethod_111 0 65535 /end CHARACTERISTIC
/begin CHARACTERISTIC FaultManager.APP1_AdaptAdaptHiMax.Mode "Fault manager configuration.  Select up to 4 actions for each fault." VALUE 0x80002ED0 RecordLayout_8 0 CompuMethod_108 0 65535 /end CHARACTERISTIC
/begin CHARACTERISTIC FaultManager.APP1_AdaptAdaptHiMax.ID "Fault manager configuration.  Select up to 4 actions for each fault." VALUE 0x80002ED2 RecordLayout_8 0 CompuMethod_1 0 65535 /end CHARACTERISTIC
/begin CHARACTERISTIC FaultManager.APP1_AdaptAdaptHiMax.Test "Fault manager configuration.  Select up to 4 actions for each fault." VALUE 0x80002ED4 RecordLayout_8 0 CompuMethod_109 0 65535 /end CHARACTERISTIC
/begin CHARACTERISTIC FaultManager.APP1_AdaptAdaptHiMax.Faulty_Samples__X_ "Fault manager configuration.  Select up to 4 actions for each fault." VALUE 0x80002ED6 RecordLayout_8 0 CompuMethod_1 0 65535 /end CHARACTERISTIC
/begin CHARACTERISTIC FaultManager.APP1_AdaptAdaptHiMax.Total_Samples__Y_ "Fault manager configuration.  Select up to 4 actions for each fault." VALUE 0x80002ED8 RecordLayout_8 0 CompuMethod_1 0 65535 /end CHARACTERISTIC
/begin CHARACTERISTIC FaultManager.APP1_AdaptAdaptHiMax.Action_1 "Fault manager configuration.  Select up to 4 actions for each fault." VALUE 0x80002EDA RecordLayout_8 0 CompuMethod_110 0 65535 /end CHARACTERISTIC
/begin CHARACTERISTIC FaultManager.APP1_AdaptAdaptHiMax.Action_1_Condition "Fault manager configuration.  Select up to 4 actions for each fault." VALUE 0x80002EDC RecordLayout_8 0 CompuMethod_111 0 65535 /end CHARACTERISTIC
/begin CHARACTERISTIC FaultManager.APP1_AdaptAdaptHiMax.Action_2 "Fault manager configuration.  Select up to 4 actions for each fault." VALUE 0x80002EDE RecordLayout_8 0 CompuMethod_110 0 65535 /end CHARACTERISTIC
/begin CHARACTERISTIC FaultManager.APP1_AdaptAdaptHiMax.Action_2_Condition "Fault manager configuration.  Select up to 4 actions for each fault." VALUE 0x80002EE0 RecordLayout_8 0 CompuMethod_111 0 65535 /end CHARACTERISTIC
/begin CHARACTERISTIC FaultManager.APP1_AdaptAdaptHiMax.Action_3 "Fault manager configuration.  Select up to 4 actions for each fault." VALUE 0x80002EE2 RecordLayout_8 0 CompuMethod_110 0 65535 /end CHARACTERISTIC
/begin CHARACTERISTIC FaultManager.APP1_AdaptAdaptHiMax.Action_3_Condition "Fault manager configuration.  Select up to 4 actions for each fault." VALUE 0x80002EE4 RecordLayout_8 0 CompuMethod_111 0 65535 /end CHARACTERISTIC
/begin CHARACTERISTIC FaultManager.APP1_AdaptAdaptHiMax.Action_4 "Fault manager configuration.  Select up to 4 actions for each fault." VALUE 0x80002EE6 RecordLayout_8 0 CompuMethod_110 0 65535 /end CHARACTERISTIC
/begin CHARACTERISTIC FaultManager.APP1_AdaptAdaptHiMax.Action_4_Condition "Fault manager configuration.  Select up to 4 actions for each fault." VALUE 0x80002EE8 RecordLayout_8 0 CompuMethod_111 0 65535 /end CHARACTERISTIC
/begin CHARACTERISTIC FaultManager.APP1_AdaptAdaptHiMin.Mode "Fault manager configuration.  Select up to 4 actions for each fault." VALUE 0x80002EEA RecordLayout_8 0 CompuMethod_108 0 65535 /end CHARACTERISTIC
/begin CHARACTERISTIC FaultManager.APP1_AdaptAdaptHiMin.ID "Fault manager configuration.  Select up to 4 actions for each fault." VALUE 0x80002EEC RecordLayout_8 0 CompuMethod_1 0 65535 /end CHARACTERISTIC
/begin CHARACTERISTIC FaultManager.APP1_AdaptAdaptHiMin.Test "Fault manager configuration.  Select up to 4 actions for each fault." VALUE 0x80002EEE RecordLayout_8 0 CompuMethod_109 0 65535 /end CHARACTERISTIC
/begin CHARACTERISTIC FaultManager.APP1_AdaptAdaptHiMin.Faulty_Samples__X_ "Fault manager configuration.  Select up to 4 actions for each fault." VALUE 0x80002EF0 RecordLayout_8 0 CompuMethod_1 0 65535 /end CHARACTERISTIC
/begin CHARACTERISTIC FaultManager.APP1_AdaptAdaptHiMin.Total_Samples__Y_ "Fault manager configuration.  Select up to 4 actions for each fault." VALUE 0x80002EF2 RecordLayout_8 0 CompuMethod_1 0 65535 /end CHARACTERISTIC
/begin CHARACTERISTIC FaultManager.APP1_AdaptAdaptHiMin.Action_1 "Fault manager configuration.  Select up to 4 actions for each fault." VALUE 0x80002EF4 RecordLayout_8 0 CompuMethod_110 0 65535 /end CHARACTERISTIC
/begin CHARACTERISTIC FaultManager.APP1_AdaptAdaptHiMin.Action_1_Condition "Fault manager configuration.  Select up to 4 actions for each fault." VALUE 0x80002EF6 RecordLayout_8 0 CompuMethod_111 0 65535 /end CHARACTERISTIC
/begin CHARACTERISTIC FaultManager.APP1_AdaptAdaptHiMin.Action_2 "Fault manager configuration.  Select up to 4 actions for each fault." VALUE 0x80002EF8 RecordLayout_8 0 CompuMethod_110 0 65535 /end CHARACTERISTIC
/begin CHARACTERISTIC FaultManager.APP1_AdaptAdaptHiMin.Action_2_Condition "Fault manager configuration.  Select up to 4 actions for each fault." VALUE 0x80002EFA RecordLayout_8 0 CompuMethod_111 0 65535 /end CHARACTERISTIC
/begin CHARACTERISTIC FaultManager.APP1_AdaptAdaptHiMin.Action_3 "Fault manager configuration.  Select up to 4 actions for each fault." VALUE 0x80002EFC RecordLayout_8 0 CompuMethod_110 0 65535 /end CHARACTERISTIC
/begin CHARACTERISTIC FaultManager.APP1_AdaptAdaptHiMin.Action_3_Condition "Fault manager configuration.  Select up to 4 actions for each fault." VALUE 0x80002EFE RecordLayout_8 0 CompuMethod_111 0 65535 /end CHARACTERISTIC
/begin CHARACTERISTIC FaultManager.APP1_AdaptAdaptHiMin.Action_4 "Fault manager configuration.  Select up to 4 actions for each fault." VALUE 0x80002F00 RecordLayout_8 0 CompuMethod_110 0 65535 /end CHARACTERISTIC
/begin CHARACTERISTIC FaultManager.APP1_AdaptAdaptHiMin.Action_4_Condition "Fault manager configuration.  Select up to 4 actions for each fault." VALUE 0x80002F02 RecordLayout_8 0 CompuMethod_111 0 65535 /end CHARACTERISTIC
/begin CHARACTERISTIC FaultManager.APP1_AdaptAdaptLoMax.Mode "Fault manager configuration.  Select up to 4 actions for each fault." VALUE 0x80002F04 RecordLayout_8 0 CompuMethod_108 0 65535 /end CHARACTERISTIC
/begin CHARACTERISTIC FaultManager.APP1_AdaptAdaptLoMax.ID "Fault manager configuration.  Select up to 4 actions for each fault." VALUE 0x80002F06 RecordLayout_8 0 CompuMethod_1 0 65535 /end CHARACTERISTIC
/begin CHARACTERISTIC FaultManager.APP1_AdaptAdaptLoMax.Test "Fault manager configuration.  Select up to 4 actions for each fault." VALUE 0x80002F08 RecordLayout_8 0 CompuMethod_109 0 65535 /end CHARACTERISTIC
/begin CHARACTERISTIC FaultManager.APP1_AdaptAdaptLoMax.Faulty_Samples__X_ "Fault manager configuration.  Select up to 4 actions for each fault." VALUE 0x80002F0A RecordLayout_8 0 CompuMethod_1 0 65535 /end CHARACTERISTIC
/begin CHARACTERISTIC FaultManager.APP1_AdaptAdaptLoMax.Total_Samples__Y_ "Fault manager configuration.  Select up to 4 actions for each fault." VALUE 0x80002F0C RecordLayout_8 0 CompuMethod_1 0 65535 /end CHARACTERISTIC
/begin CHARACTERISTIC FaultManager.APP1_AdaptAdaptLoMax.Action_1 "Fault manager configuration.  Select up to 4 actions for each fault." VALUE 0x80002F0E RecordLayout_8 0 CompuMethod_110 0 65535 /end CHARACTERISTIC
/begin CHARACTERISTIC FaultManager.APP1_AdaptAdaptLoMax.Action_1_Condition "Fault manager configuration.  Select up to 4 actions for each fault." VALUE 0x80002F10 RecordLayout_8 0 CompuMethod_111 0 65535 /end CHARACTERISTIC
/begin CHARACTERISTIC FaultManager.APP1_AdaptAdaptLoMax.Action_2 "Fault manager configuration.  Select up to 4 actions for each fault." VALUE 0x80002F12 RecordLayout_8 0 CompuMethod_110 0 65535 /end CHARACTERISTIC
/begin CHARACTERISTIC FaultManager.APP1_AdaptAdaptLoMax.Action_2_Condition "Fault manager configuration.  Select up to 4 actions for each fault." VALUE 0x80002F14 RecordLayout_8 0 CompuMethod_111 0 65535 /end CHARACTERISTIC
/begin CHARACTERISTIC FaultManager.APP1_AdaptAdaptLoMax.Action_3 "Fault manager configuration.  Select up to 4 actions for each fault." VALUE 0x80002F16 RecordLayout_8 0 CompuMethod_110 0 65535 /end CHARACTERISTIC
/begin CHARACTERISTIC FaultManager.APP1_AdaptAdaptLoMax.Action_3_Condition "Fault manager configuration.  Select up to 4 actions for each fault." VALUE 0x80002F18 RecordLayout_8 0 CompuMethod_111 0 65535 /end CHARACTERISTIC
/begin CHARACTERISTIC FaultManager.APP1_AdaptAdaptLoMax.Action_4 "Fault manager configuration.  Select up to 4 actions for each fault." VALUE 0x80002F1A RecordLayout_8 0 CompuMethod_110 0 65535 /end CHARACTERISTIC
/begin CHARACTERISTIC FaultManager.APP1_AdaptAdaptLoMax.Action_4_Condition "Fault manager configuration.  Select up to 4 actions for each fault." VALUE 0x80002F1C RecordLayout_8 0 CompuMethod_111 0 65535 /end CHARACTERISTIC
/begin CHARACTERISTIC FaultManager.APP1_AdaptAdaptLoMin.Mode "Fault manager configuration.  Select up to 4 actions for each fault." VALUE 0x80002F1E RecordLayout_8 0 CompuMethod_108 0 65535 /end CHARACTERISTIC
/begin CHARACTERISTIC FaultManager.APP1_AdaptAdaptLoMin.ID "Fault manager configuration.  Select up to 4 actions for each fault." VALUE 0x80002F20 RecordLayout_8 0 CompuMethod_1 0 65535 /end CHARACTERISTIC
/begin CHARACTERISTIC FaultManager.APP1_AdaptAdaptLoMin.Test "Fault manager configuration.  Select up to 4 actions for each fault." VALUE 0x80002F22 RecordLayout_8 0 CompuMethod_109 0 65535 /end CHARACTERISTIC
/begin CHARACTERISTIC FaultManager.APP1_AdaptAdaptLoMin.Faulty_Samples__X_ "Fault manager configuration.  Select up to 4 actions for each fault." VALUE 0x80002F24 RecordLayout_8 0 CompuMethod_1 0 65535 /end CHARACTERISTIC
/begin CHARACTERISTIC FaultManager.APP1_AdaptAdaptLoMin.Total_Samples__Y_ "Fault manager configuration.  Select up to 4 actions for each fault." VALUE 0x80002F26 RecordLayout_8 0 CompuMethod_1 0 65535 /end CHARACTERISTIC
/begin CHARACTERISTIC FaultManager.APP1_AdaptAdaptLoMin.Action_1 "Fault manager configuration.  Select up to 4 actions for each fault." VALUE 0x80002F28 RecordLayout_8 0 CompuMethod_110 0 65535 /end CHARACTERISTIC
/begin CHARACTERISTIC FaultManager.APP1_AdaptAdaptLoMin.Action_1_Condition "Fault manager configuration.  Select up to 4 actions for each fault." VALUE 0x80002F2A RecordLayout_8 0 CompuMethod_111 0 65535 /end CHARACTERISTIC
/begin CHARACTERISTIC FaultManager.APP1_AdaptAdaptLoMin.Action_2 "Fault manager configuration.  Select up to 4 actions for each fault." VALUE 0x80002F2C RecordLayout_8 0 CompuMethod_110 0 65535 /end CHARACTERISTIC
/begin CHARACTERISTIC FaultManager.APP1_AdaptAdaptLoMin.Action_2_Condition "Fault manager configuration.  Select up to 4 actions for each fault." VALUE 0x80002F2E RecordLayout_8 0 CompuMethod_111 0 65535 /end CHARACTERISTIC
/begin CHARACTERISTIC FaultManager.APP1_AdaptAdaptLoMin.Action_3 "Fault manager configuration.  Select up to 4 actions for each fault." VALUE 0x80002F30 RecordLayout_8 0 CompuMethod_110 0 65535 /end CHARACTERISTIC
/begin CHARACTERISTIC FaultManager.APP1_AdaptAdaptLoMin.Action_3_Condition "Fault manager configuration.  Select up to 4 actions for each fault." VALUE 0x80002F32 RecordLayout_8 0 CompuMethod_111 0 65535 /end CHARACTERISTIC
/begin CHARACTERISTIC FaultManager.APP1_AdaptAdaptLoMin.Action_4 "Fault manager configuration.  Select up to 4 actions for each fault." VALUE 0x80002F34 RecordLayout_8 0 CompuMethod_110 0 65535 /end CHARACTERISTIC
/begin CHARACTERISTIC FaultManager.APP1_AdaptAdaptLoMin.Action_4_Condition "Fault manager configuration.  Select up to 4 actions for each fault." VALUE 0x80002F36 RecordLayout_8 0 CompuMethod_111 0 65535 /end CHARACTERISTIC
/begin CHARACTERISTIC FaultManager.APP1_AdaptRangeHigh.Mode "Fault manager configuration.  Select up to 4 actions for each fault." VALUE 0x80002F38 RecordLayout_8 0 CompuMethod_108 0 65535 /end CHARACTERISTIC
/begin CHARACTERISTIC FaultManager.APP1_AdaptRangeHigh.ID "Fault manager configuration.  Select up to 4 actions for each fault." VALUE 0x80002F3A RecordLayout_8 0 CompuMethod_1 0 65535 /end CHARACTERISTIC
/begin CHARACTERISTIC FaultManager.APP1_AdaptRangeHigh.Test "Fault manager configuration.  Select up to 4 actions for each fault." VALUE 0x80002F3C RecordLayout_8 0 CompuMethod_109 0 65535 /end CHARACTERISTIC
/begin CHARACTERISTIC FaultManager.APP1_AdaptRangeHigh.Faulty_Samples__X_ "Fault manager configuration.  Select up to 4 actions for each fault." VALUE 0x80002F3E RecordLayout_8 0 CompuMethod_1 0 65535 /end CHARACTERISTIC
/begin CHARACTERISTIC FaultManager.APP1_AdaptRangeHigh.Total_Samples__Y_ "Fault manager configuration.  Select up to 4 actions for each fault." VALUE 0x80002F40 RecordLayout_8 0 CompuMethod_1 0 65535 /end CHARACTERISTIC
/begin CHARACTERISTIC FaultManager.APP1_AdaptRangeHigh.Action_1 "Fault manager configuration.  Select up to 4 actions for each fault." VALUE 0x80002F42 RecordLayout_8 0 CompuMethod_110 0 65535 /end CHARACTERISTIC
/begin CHARACTERISTIC FaultManager.APP1_AdaptRangeHigh.Action_1_Condition "Fault manager configuration.  Select up to 4 actions for each fault." VALUE 0x80002F44 RecordLayout_8 0 CompuMethod_111 0 65535 /end CHARACTERISTIC
/begin CHARACTERISTIC FaultManager.APP1_AdaptRangeHigh.Action_2 "Fault manager configuration.  Select up to 4 actions for each fault." VALUE 0x80002F46 RecordLayout_8 0 CompuMethod_110 0 65535 /end CHARACTERISTIC
/begin CHARACTERISTIC FaultManager.APP1_AdaptRangeHigh.Action_2_Condition "Fault manager configuration.  Select up to 4 actions for each fault." VALUE 0x80002F48 RecordLayout_8 0 CompuMethod_111 0 65535 /end CHARACTERISTIC
/begin CHARACTERISTIC FaultManager.APP1_AdaptRangeHigh.Action_3 "Fault manager configuration.  Select up to 4 actions for each fault." VALUE 0x80002F4A RecordLayout_8 0 CompuMethod_110 0 65535 /end CHARACTERISTIC
/begin CHARACTERISTIC FaultManager.APP1_AdaptRangeHigh.Action_3_Condition "Fault manager configuration.  Select up to 4 actions for each fault." VALUE 0x80002F4C RecordLayout_8 0 CompuMethod_111 0 65535 /end CHARACTERISTIC
/begin CHARACTERISTIC FaultManager.APP1_AdaptRangeHigh.Action_4 "Fault manager configuration.  Select up to 4 actions for each fault." VALUE 0x80002F4E RecordLayout_8 0 CompuMethod_110 0 65535 /end CHARACTERISTIC
/begin CHARACTERISTIC FaultManager.APP1_AdaptRangeHigh.Action_4_Condition "Fault manager configuration.  Select up to 4 actions for each fault." VALUE 0x80002F50 RecordLayout_8 0 CompuMethod_111 0 65535 /end CHARACTERISTIC
/begin CHARACTERISTIC FaultManager.APP1_AdaptRangeLow.Mode "Fault manager configuration.  Select up to 4 actions for each fault." VALUE 0x80002F52 RecordLayout_8 0 CompuMethod_108 0 65535 /end CHARACTERISTIC
/begin CHARACTERISTIC FaultManager.APP1_AdaptRangeLow.ID "Fault manager configuration.  Select up to 4 actions for each fault." VALUE 0x80002F54 RecordLayout_8 0 CompuMethod_1 0 65535 /end CHARACTERISTIC
/begin CHARACTERISTIC FaultManager.APP1_AdaptRangeLow.Test "Fault manager configuration.  Select up to 4 actions for each fault." VALUE 0x80002F56 RecordLayout_8 0 CompuMethod_109 0 65535 /end CHARACTERISTIC
/begin CHARACTERISTIC FaultManager.APP1_AdaptRangeLow.Faulty_Samples__X_ "Fault manager configuration.  Select up to 4 actions for each fault." VALUE 0x80002F58 RecordLayout_8 0 CompuMethod_1 0 65535 /end CHARACTERISTIC
/begin CHARACTERISTIC FaultManager.APP1_AdaptRangeLow.Total_Samples__Y_ "Fault manager configuration.  Select up to 4 actions for each fault." VALUE 0x80002F5A RecordLayout_8 0 CompuMethod_1 0 65535 /end CHARACTERISTIC
/begin CHARACTERISTIC FaultManager.APP1_AdaptRangeLow.Action_1 "Fault manager configuration.  Select up to 4 actions for each fault." VALUE 0x80002F5C RecordLayout_8 0 CompuMethod_110 0 65535 /end CHARACTERISTIC
/begin CHARACTERISTIC FaultManager.APP1_AdaptRangeLow.Action_1_Condition "Fault manager configuration.  Select up to 4 actions for each fault." VALUE 0x80002F5E RecordLayout_8 0 CompuMethod_111 0 65535 /end CHARACTERISTIC
/begin CHARACTERISTIC FaultManager.APP1_AdaptRangeLow.Action_2 "Fault manager configuration.  Select up to 4 actions for each fault." VALUE 0x80002F60 RecordLayout_8 0 CompuMethod_110 0 65535 /end CHARACTERISTIC
/begin CHARACTERISTIC FaultManager.APP1_AdaptRangeLow.Action_2_Condition "Fault manager configuration.  Select up to 4 actions for each fault." VALUE 0x80002F62 RecordLayout_8 0 CompuMethod_111 0 65535 /end CHARACTERISTIC
/begin CHARACTERISTIC FaultManager.APP1_AdaptRangeLow.Action_3 "Fault manager configuration.  Select up to 4 actions for each fault." VALUE 0x80002F64 RecordLayout_8 0 CompuMethod_110 0 65535 /end CHARACTERISTIC
/begin CHARACTERISTIC FaultManager.APP1_AdaptRangeLow.Action_3_Condition "Fault manager configuration.  Select up to 4 actions for each fault." VALUE 0x80002F66 RecordLayout_8 0 CompuMethod_111 0 65535 /end CHARACTERISTIC
/begin CHARACTERISTIC FaultManager.APP1_AdaptRangeLow.Action_4 "Fault manager configuration.  Select up to 4 actions for each fault." VALUE 0x80002F68 RecordLayout_8 0 CompuMethod_110 0 65535 /end CHARACTERISTIC
/begin CHARACTERISTIC FaultManager.APP1_AdaptRangeLow.Action_4_Condition "Fault manager configuration.  Select up to 4 actions for each fault." VALUE 0x80002F6A RecordLayout_8 0 CompuMethod_111 0 65535 /end CHARACTERISTIC
/begin CHARACTERISTIC FaultManager.APP2RangeHigh.Mode "Fault manager configuration.  Select up to 4 actions for each fault." VALUE 0x80002F6C RecordLayout_8 0 CompuMethod_108 0 65535 /end CHARACTERISTIC
/begin CHARACTERISTIC FaultManager.APP2RangeHigh.ID "Fault manager configuration.  Select up to 4 actions for each fault." VALUE 0x80002F6E RecordLayout_8 0 CompuMethod_1 0 65535 /end CHARACTERISTIC
/begin CHARACTERISTIC FaultManager.APP2RangeHigh.Test "Fault manager configuration.  Select up to 4 actions for each fault." VALUE 0x80002F70 RecordLayout_8 0 CompuMethod_109 0 65535 /end CHARACTERISTIC
/begin CHARACTERISTIC FaultManager.APP2RangeHigh.Faulty_Samples__X_ "Fault manager configuration.  Select up to 4 actions for each fault." VALUE 0x80002F72 RecordLayout_8 0 CompuMethod_1 0 65535 /end CHARACTERISTIC
/begin CHARACTERISTIC FaultManager.APP2RangeHigh.Total_Samples__Y_ "Fault manager configuration.  Select up to 4 actions for each fault." VALUE 0x80002F74 RecordLayout_8 0 CompuMethod_1 0 65535 /end CHARACTERISTIC
/begin CHARACTERISTIC FaultManager.APP2RangeHigh.Action_1 "Fault manager configuration.  Select up to 4 actions for each fault." VALUE 0x80002F76 RecordLayout_8 0 CompuMethod_110 0 65535 /end CHARACTERISTIC
/begin CHARACTERISTIC FaultManager.APP2RangeHigh.Action_1_Condition "Fault manager configuration.  Select up to 4 actions for each fault." VALUE 0x80002F78 RecordLayout_8 0 CompuMethod_111 0 65535 /end CHARACTERISTIC
/begin CHARACTERISTIC FaultManager.APP2RangeHigh.Action_2 "Fault manager configuration.  Select up to 4 actions for each fault." VALUE 0x80002F7A RecordLayout_8 0 CompuMethod_110 0 65535 /end CHARACTERISTIC
/begin CHARACTERISTIC FaultManager.APP2RangeHigh.Action_2_Condition "Fault manager configuration.  Select up to 4 actions for each fault." VALUE 0x80002F7C RecordLayout_8 0 CompuMethod_111 0 65535 /end CHARACTERISTIC
/begin CHARACTERISTIC FaultManager.APP2RangeHigh.Action_3 "Fault manager configuration.  Select up to 4 actions for each fault." VALUE 0x80002F7E RecordLayout_8 0 CompuMethod_110 0 65535 /end CHARACTERISTIC
/begin CHARACTERISTIC FaultManager.APP2RangeHigh.Action_3_Condition "Fault manager configuration.  Select up to 4 actions for each fault." VALUE 0x80002F80 RecordLayout_8 0 CompuMethod_111 0 65535 /end CHARACTERISTIC
/begin CHARACTERISTIC FaultManager.APP2RangeHigh.Action_4 "Fault manager configuration.  Select up to 4 actions for each fault." VALUE 0x80002F82 RecordLayout_8 0 CompuMethod_110 0 65535 /end CHARACTERISTIC
/begin CHARACTERISTIC FaultManager.APP2RangeHigh.Action_4_Condition "Fault manager configuration.  Select up to 4 actions for each fault." VALUE 0x80002F84 RecordLayout_8 0 CompuMethod_111 0 65535 /end CHARACTERISTIC
/begin CHARACTERISTIC FaultManager.APP2RangeLow.Mode "Fault manager configuration.  Select up to 4 actions for each fault." VALUE 0x80002F86 RecordLayout_8 0 CompuMethod_108 0 65535 /end CHARACTERISTIC
/begin CHARACTERISTIC FaultManager.APP2RangeLow.ID "Fault manager configuration.  Select up to 4 actions for each fault." VALUE 0x80002F88 RecordLayout_8 0 CompuMethod_1 0 65535 /end CHARACTERISTIC
/begin CHARACTERISTIC FaultManager.APP2RangeLow.Test "Fault manager configuration.  Select up to 4 actions for each fault." VALUE 0x80002F8A RecordLayout_8 0 CompuMethod_109 0 65535 /end CHARACTERISTIC
/begin CHARACTERISTIC FaultManager.APP2RangeLow.Faulty_Samples__X_ "Fault manager configuration.  Select up to 4 actions for each fault." VALUE 0x80002F8C RecordLayout_8 0 CompuMethod_1 0 65535 /end CHARACTERISTIC
/begin CHARACTERISTIC FaultManager.APP2RangeLow.Total_Samples__Y_ "Fault manager configuration.  Select up to 4 actions for each fault." VALUE 0x80002F8E RecordLayout_8 0 CompuMethod_1 0 65535 /end CHARACTERISTIC
/begin CHARACTERISTIC FaultManager.APP2RangeLow.Action_1 "Fault manager configuration.  Select up to 4 actions for each fault." VALUE 0x80002F90 RecordLayout_8 0 CompuMethod_110 0 65535 /end CHARACTERISTIC
/begin CHARACTERISTIC FaultManager.APP2RangeLow.Action_1_Condition "Fault manager configuration.  Select up to 4 actions for each fault." VALUE 0x80002F92 RecordLayout_8 0 CompuMethod_111 0 65535 /end CHARACTERISTIC
/begin CHARACTERISTIC FaultManager.APP2RangeLow.Action_2 "Fault manager configuration.  Select up to 4 actions for each fault." VALUE 0x80002F94 RecordLayout_8 0 CompuMethod_110 0 65535 /end CHARACTERISTIC
/begin CHARACTERISTIC FaultManager.APP2RangeLow.Action_2_Condition "Fault manager configuration.  Select up to 4 actions for each fault." VALUE 0x80002F96 RecordLayout_8 0 CompuMethod_111 0 65535 /end CHARACTERISTIC
/begin CHARACTERISTIC FaultManager.APP2RangeLow.Action_3 "Fault manager configuration.  Select up to 4 actions for each fault." VALUE 0x80002F98 RecordLayout_8 0 CompuMethod_110 0 65535 /end CHARACTERISTIC
/begin CHARACTERISTIC FaultManager.APP2RangeLow.Action_3_Condition "Fault manager configuration.  Select up to 4 actions for each fault." VALUE 0x80002F9A RecordLayout_8 0 CompuMethod_111 0 65535 /end CHARACTERISTIC
/begin CHARACTERISTIC FaultManager.APP2RangeLow.Action_4 "Fault manager configuration.  Select up to 4 actions for each fault." VALUE 0x80002F9C RecordLayout_8 0 CompuMethod_110 0 65535 /end CHARACTERISTIC
/begin CHARACTERISTIC FaultManager.APP2RangeLow.Action_4_Condition "Fault manager configuration.  Select up to 4 actions for each fault." VALUE 0x80002F9E RecordLayout_8 0 CompuMethod_111 0 65535 /end CHARACTERISTIC
/begin CHARACTERISTIC FaultManager.APP2_AdaptAdaptHiMax.Mode "Fault manager configuration.  Select up to 4 actions for each fault." VALUE 0x80002FA0 RecordLayout_8 0 CompuMethod_108 0 65535 /end CHARACTERISTIC
/begin CHARACTERISTIC FaultManager.APP2_AdaptAdaptHiMax.ID "Fault manager configuration.  Select up to 4 actions for each fault." VALUE 0x80002FA2 RecordLayout_8 0 CompuMethod_1 0 65535 /end CHARACTERISTIC
/begin CHARACTERISTIC FaultManager.APP2_AdaptAdaptHiMax.Test "Fault manager configuration.  Select up to 4 actions for each fault." VALUE 0x80002FA4 RecordLayout_8 0 CompuMethod_109 0 65535 /end CHARACTERISTIC
/begin CHARACTERISTIC FaultManager.APP2_AdaptAdaptHiMax.Faulty_Samples__X_ "Fault manager configuration.  Select up to 4 actions for each fault." VALUE 0x80002FA6 RecordLayout_8 0 CompuMethod_1 0 65535 /end CHARACTERISTIC
/begin CHARACTERISTIC FaultManager.APP2_AdaptAdaptHiMax.Total_Samples__Y_ "Fault manager configuration.  Select up to 4 actions for each fault." VALUE 0x80002FA8 RecordLayout_8 0 CompuMethod_1 0 65535 /end CHARACTERISTIC
/begin CHARACTERISTIC FaultManager.APP2_AdaptAdaptHiMax.Action_1 "Fault manager configuration.  Select up to 4 actions for each fault." VALUE 0x80002FAA RecordLayout_8 0 CompuMethod_110 0 65535 /end CHARACTERISTIC
/begin CHARACTERISTIC FaultManager.APP2_AdaptAdaptHiMax.Action_1_Condition "Fault manager configuration.  Select up to 4 actions for each fault." VALUE 0x80002FAC RecordLayout_8 0 CompuMethod_111 0 65535 /end CHARACTERISTIC
/begin CHARACTERISTIC FaultManager.APP2_AdaptAdaptHiMax.Action_2 "Fault manager configuration.  Select up to 4 actions for each fault." VALUE 0x80002FAE RecordLayout_8 0 CompuMethod_110 0 65535 /end CHARACTERISTIC
/begin CHARACTERISTIC FaultManager.APP2_AdaptAdaptHiMax.Action_2_Condition "Fault manager configuration.  Select up to 4 actions for each fault." VALUE 0x80002FB0 RecordLayout_8 0 CompuMethod_111 0 65535 /end CHARACTERISTIC
/begin CHARACTERISTIC FaultManager.APP2_AdaptAdaptHiMax.Action_3 "Fault manager configuration.  Select up to 4 actions for each fault." VALUE 0x80002FB2 RecordLayout_8 0 CompuMethod_110 0 65535 /end CHARACTERISTIC
/begin CHARACTERISTIC FaultManager.APP2_AdaptAdaptHiMax.Action_3_Condition "Fault manager configuration.  Select up to 4 actions for each fault." VALUE 0x80002FB4 RecordLayout_8 0 CompuMethod_111 0 65535 /end CHARACTERISTIC
/begin CHARACTERISTIC FaultManager.APP2_AdaptAdaptHiMax.Action_4 "Fault manager configuration.  Select up to 4 actions for each fault." VALUE 0x80002FB6 RecordLayout_8 0 CompuMethod_110 0 65535 /end CHARACTERISTIC
/begin CHARACTERISTIC FaultManager.APP2_AdaptAdaptHiMax.Action_4_Condition "Fault manager configuration.  Select up to 4 actions for each fault." VALUE 0x80002FB8 RecordLayout_8 0 CompuMethod_111 0 65535 /end CHARACTERISTIC
/begin CHARACTERISTIC FaultManager.APP2_AdaptAdaptHiMin.Mode "Fault manager configuration.  Select up to 4 actions for each fault." VALUE 0x80002FBA RecordLayout_8 0 CompuMethod_108 0 65535 /end CHARACTERISTIC
/begin CHARACTERISTIC FaultManager.APP2_AdaptAdaptHiMin.ID "Fault manager configuration.  Select up to 4 actions for each fault." VALUE 0x80002FBC RecordLayout_8 0 CompuMethod_1 0 65535 /end CHARACTERISTIC
/begin CHARACTERISTIC FaultManager.APP2_AdaptAdaptHiMin.Test "Fault manager configuration.  Select up to 4 actions for each fault." VALUE 0x80002FBE RecordLayout_8 0 CompuMethod_109 0 65535 /end CHARACTERISTIC
/begin CHARACTERISTIC FaultManager.APP2_AdaptAdaptHiMin.Faulty_Samples__X_ "Fault manager configuration.  Select up to 4 actions for each fault." VALUE 0x80002FC0 RecordLayout_8 0 CompuMethod_1 0 65535 /end CHARACTERISTIC
/begin CHARACTERISTIC FaultManager.APP2_AdaptAdaptHiMin.Total_Samples__Y_ "Fault manager configuration.  Select up to 4 actions for each fault." VALUE 0x80002FC2 RecordLayout_8 0 CompuMethod_1 0 65535 /end CHARACTERISTIC
/begin CHARACTERISTIC FaultManager.APP2_AdaptAdaptHiMin.Action_1 "Fault manager configuration.  Select up to 4 actions for each fault." VALUE 0x80002FC4 RecordLayout_8 0 CompuMethod_110 0 65535 /end CHARACTERISTIC
/begin CHARACTERISTIC FaultManager.APP2_AdaptAdaptHiMin.Action_1_Condition "Fault manager configuration.  Select up to 4 actions for each fault." VALUE 0x80002FC6 RecordLayout_8 0 CompuMethod_111 0 65535 /end CHARACTERISTIC
/begin CHARACTERISTIC FaultManager.APP2_AdaptAdaptHiMin.Action_2 "Fault manager configuration.  Select up to 4 actions for each fault." VALUE 0x80002FC8 RecordLayout_8 0 CompuMethod_110 0 65535 /end CHARACTERISTIC
/begin CHARACTERISTIC FaultManager.APP2_AdaptAdaptHiMin.Action_2_Condition "Fault manager configuration.  Select up to 4 actions for each fault." VALUE 0x80002FCA RecordLayout_8 0 CompuMethod_111 0 65535 /end CHARACTERISTIC
/begin CHARACTERISTIC FaultManager.APP2_AdaptAdaptHiMin.Action_3 "Fault manager configuration.  Select up to 4 actions for each fault." VALUE 0x80002FCC RecordLayout_8 0 CompuMethod_110 0 65535 /end CHARACTERISTIC
/begin CHARACTERISTIC FaultManager.APP2_AdaptAdaptHiMin.Action_3_Condition "Fault manager configuration.  Select up to 4 actions for each fault." VALUE 0x80002FCE RecordLayout_8 0 CompuMethod_111 0 65535 /end CHARACTERISTIC
/begin CHARACTERISTIC FaultManager.APP2_AdaptAdaptHiMin.Action_4 "Fault manager configuration.  Select up to 4 actions for each fault." VALUE 0x80002FD0 RecordLayout_8 0 CompuMethod_110 0 65535 /end CHARACTERISTIC
/begin CHARACTERISTIC FaultManager.APP2_AdaptAdaptHiMin.Action_4_Condition "Fault manager configuration.  Select up to 4 actions for each fault." VALUE 0x80002FD2 RecordLayout_8 0 CompuMethod_111 0 65535 /end CHARACTERISTIC
/begin CHARACTERISTIC FaultManager.APP2_AdaptAdaptLoMax.Mode "Fault manager configuration.  Select up to 4 actions for each fault." VALUE 0x80002FD4 RecordLayout_8 0 CompuMethod_108 0 65535 /end CHARACTERISTIC
/begin CHARACTERISTIC FaultManager.APP2_AdaptAdaptLoMax.ID "Fault manager configuration.  Select up to 4 actions for each fault." VALUE 0x80002FD6 RecordLayout_8 0 CompuMethod_1 0 65535 /end CHARACTERISTIC
/begin CHARACTERISTIC FaultManager.APP2_AdaptAdaptLoMax.Test "Fault manager configuration.  Select up to 4 actions for each fault." VALUE 0x80002FD8 RecordLayout_8 0 CompuMethod_109 0 65535 /end CHARACTERISTIC
/begin CHARACTERISTIC FaultManager.APP2_AdaptAdaptLoMax.Faulty_Samples__X_ "Fault manager configuration.  Select up to 4 actions for each fault." VALUE 0x80002FDA RecordLayout_8 0 CompuMethod_1 0 65535 /end CHARACTERISTIC
/begin CHARACTERISTIC FaultManager.APP2_AdaptAdaptLoMax.Total_Samples__Y_ "Fault manager configuration.  Select up to 4 actions for each fault." VALUE 0x80002FDC RecordLayout_8 0 CompuMethod_1 0 65535 /end CHARACTERISTIC
/begin CHARACTERISTIC FaultManager.APP2_AdaptAdaptLoMax.Action_1 "Fault manager configuration.  Select up to 4 actions for each fault." VALUE 0x80002FDE RecordLayout_8 0 CompuMethod_110 0 65535 /end CHARACTERISTIC
/begin CHARACTERISTIC FaultManager.APP2_AdaptAdaptLoMax.Action_1_Condition "Fault manager configuration.  Select up to 4 actions for each fault." VALUE 0x80002FE0 RecordLayout_8 0 CompuMethod_111 0 65535 /end CHARACTERISTIC
/begin CHARACTERISTIC FaultManager.APP2_AdaptAdaptLoMax.Action_2 "Fault manager configuration.  Select up to 4 actions for each fault." VALUE 0x80002FE2 RecordLayout_8 0 CompuMethod_110 0 65535 /end CHARACTERISTIC
/begin CHARACTERISTIC FaultManager.APP2_AdaptAdaptLoMax.Action_2_Condition "Fault manager configuration.  Select up to 4 actions for each fault." VALUE 0x80002FE4 RecordLayout_8 0 CompuMethod_111 0 65535 /end CHARACTERISTIC
/begin CHARACTERISTIC FaultManager.APP2_AdaptAdaptLoMax.Action_3 "Fault manager configuration.  Select up to 4 actions for each fault." VALUE 0x80002FE6 RecordLayout_8 0 CompuMethod_110 0 65535 /end CHARACTERISTIC
/begin CHARACTERISTIC FaultManager.APP2_AdaptAdaptLoMax.Action_3_Condition "Fault manager configuration.  Select up to 4 actions for each fault." VALUE 0x80002FE8 RecordLayout_8 0 CompuMethod_111 0 65535 /end CHARACTERISTIC
/begin CHARACTERISTIC FaultManager.APP2_AdaptAdaptLoMax.Action_4 "Fault manager configuration.  Select up to 4 actions for each fault." VALUE 0x80002FEA RecordLayout_8 0 CompuMethod_110 0 65535 /end CHARACTERISTIC
/begin CHARACTERISTIC FaultManager.APP2_AdaptAdaptLoMax.Action_4_Condition "Fault manager configuration.  Select up to 4 actions for each fault." VALUE 0x80002FEC RecordLayout_8 0 CompuMethod_111 0 65535 /end CHARACTERISTIC
/begin CHARACTERISTIC FaultManager.APP2_AdaptAdaptLoMin.Mode "Fault manager configuration.  Select up to 4 actions for each fault." VALUE 0x80002FEE RecordLayout_8 0 CompuMethod_108 0 65535 /end CHARACTERISTIC
/begin CHARACTERISTIC FaultManager.APP2_AdaptAdaptLoMin.ID "Fault manager configuration.  Select up to 4 actions for each fault." VALUE 0x80002FF0 RecordLayout_8 0 CompuMethod_1 0 65535 /end CHARACTERISTIC
/begin CHARACTERISTIC FaultManager.APP2_AdaptAdaptLoMin.Test "Fault manager configuration.  Select up to 4 actions for each fault." VALUE 0x80002FF2 RecordLayout_8 0 CompuMethod_109 0 65535 /end CHARACTERISTIC
/begin CHARACTERISTIC FaultManager.APP2_AdaptAdaptLoMin.Faulty_Samples__X_ "Fault manager configuration.  Select up to 4 actions for each fault." VALUE 0x80002FF4 RecordLayout_8 0 CompuMethod_1 0 65535 /end CHARACTERISTIC
/begin CHARACTERISTIC FaultManager.APP2_AdaptAdaptLoMin.Total_Samples__Y_ "Fault manager configuration.  Select up to 4 actions for each fault." VALUE 0x80002FF6 RecordLayout_8 0 CompuMethod_1 0 65535 /end CHARACTERISTIC
/begin CHARACTERISTIC FaultManager.APP2_AdaptAdaptLoMin.Action_1 "Fault manager configuration.  Select up to 4 actions for each fault." VALUE 0x80002FF8 RecordLayout_8 0 CompuMethod_110 0 65535 /end CHARACTERISTIC
/begin CHARACTERISTIC FaultManager.APP2_AdaptAdaptLoMin.Action_1_Condition "Fault manager configuration.  Select up to 4 actions for each fault." VALUE 0x80002FFA RecordLayout_8 0 CompuMethod_111 0 65535 /end CHARACTERISTIC
/begin CHARACTERISTIC FaultManager.APP2_AdaptAdaptLoMin.Action_2 "Fault manager configuration.  Select up to 4 actions for each fault." VALUE 0x80002FFC RecordLayout_8 0 CompuMethod_110 0 65535 /end CHARACTERISTIC
/begin CHARACTERISTIC FaultManager.APP2_AdaptAdaptLoMin.Action_2_Condition "Fault manager configuration.  Select up to 4 actions for each fault." VALUE 0x80002FFE RecordLayout_8 0 CompuMethod_111 0 65535 /end CHARACTERISTIC
/begin CHARACTERISTIC FaultManager.APP2_AdaptAdaptLoMin.Action_3 "Fault manager configuration.  Select up to 4 actions for each fault." VALUE 0x80003000 RecordLayout_8 0 CompuMethod_110 0 65535 /end CHARACTERISTIC
/begin CHARACTERISTIC FaultManager.APP2_AdaptAdaptLoMin.Action_3_Condition "Fault manager configuration.  Select up to 4 actions for each fault." VALUE 0x80003002 RecordLayout_8 0 CompuMethod_111 0 65535 /end CHARACTERISTIC
/begin CHARACTERISTIC FaultManager.APP2_AdaptAdaptLoMin.Action_4 "Fault manager configuration.  Select up to 4 actions for each fault." VALUE 0x80003004 RecordLayout_8 0 CompuMethod_110 0 65535 /end CHARACTERISTIC
/begin CHARACTERISTIC FaultManager.APP2_AdaptAdaptLoMin.Action_4_Condition "Fault manager configuration.  Select up to 4 actions for each fault." VALUE 0x80003006 RecordLayout_8 0 CompuMethod_111 0 65535 /end CHARACTERISTIC
/begin CHARACTERISTIC FaultManager.APP2_AdaptRangeHigh.Mode "Fault manager configuration.  Select up to 4 actions for each fault." VALUE 0x80003008 RecordLayout_8 0 CompuMethod_108 0 65535 /end CHARACTERISTIC
/begin CHARACTERISTIC FaultManager.APP2_AdaptRangeHigh.ID "Fault manager configuration.  Select up to 4 actions for each fault." VALUE 0x8000300A RecordLayout_8 0 CompuMethod_1 0 65535 /end CHARACTERISTIC
/begin CHARACTERISTIC FaultManager.APP2_AdaptRangeHigh.Test "Fault manager configuration.  Select up to 4 actions for each fault." VALUE 0x8000300C RecordLayout_8 0 CompuMethod_109 0 65535 /end CHARACTERISTIC
/begin CHARACTERISTIC FaultManager.APP2_AdaptRangeHigh.Faulty_Samples__X_ "Fault manager configuration.  Select up to 4 actions for each fault." VALUE 0x8000300E RecordLayout_8 0 CompuMethod_1 0 65535 /end CHARACTERISTIC
/begin CHARACTERISTIC FaultManager.APP2_AdaptRangeHigh.Total_Samples__Y_ "Fault manager configuration.  Select up to 4 actions for each fault." VALUE 0x80003010 RecordLayout_8 0 CompuMethod_1 0 65535 /end CHARACTERISTIC
/begin CHARACTERISTIC FaultManager.APP2_AdaptRangeHigh.Action_1 "Fault manager configuration.  Select up to 4 actions for each fault." VALUE 0x80003012 RecordLayout_8 0 CompuMethod_110 0 65535 /end CHARACTERISTIC
/begin CHARACTERISTIC FaultManager.APP2_AdaptRangeHigh.Action_1_Condition "Fault manager configuration.  Select up to 4 actions for each fault." VALUE 0x80003014 RecordLayout_8 0 CompuMethod_111 0 65535 /end CHARACTERISTIC
/begin CHARACTERISTIC FaultManager.APP2_AdaptRangeHigh.Action_2 "Fault manager configuration.  Select up to 4 actions for each fault." VALUE 0x80003016 RecordLayout_8 0 CompuMethod_110 0 65535 /end CHARACTERISTIC
/begin CHARACTERISTIC FaultManager.APP2_AdaptRangeHigh.Action_2_Condition "Fault manager configuration.  Select up to 4 actions for each fault." VALUE 0x80003018 RecordLayout_8 0 CompuMethod_111 0 65535 /end CHARACTERISTIC
/begin CHARACTERISTIC FaultManager.APP2_AdaptRangeHigh.Action_3 "Fault manager configuration.  Select up to 4 actions for each fault." VALUE 0x8000301A RecordLayout_8 0 CompuMethod_110 0 65535 /end CHARACTERISTIC
/begin CHARACTERISTIC FaultManager.APP2_AdaptRangeHigh.Action_3_Condition "Fault manager configuration.  Select up to 4 actions for each fault." VALUE 0x8000301C RecordLayout_8 0 CompuMethod_111 0 65535 /end CHARACTERISTIC
/begin CHARACTERISTIC FaultManager.APP2_AdaptRangeHigh.Action_4 "Fault manager configuration.  Select up to 4 actions for each fault." VALUE 0x8000301E RecordLayout_8 0 CompuMethod_110 0 65535 /end CHARACTERISTIC
/begin CHARACTERISTIC FaultManager.APP2_AdaptRangeHigh.Action_4_Condition "Fault manager configuration.  Select up to 4 actions for each fault." VALUE 0x80003020 RecordLayout_8 0 CompuMethod_111 0 65535 /end CHARACTERISTIC
/begin CHARACTERISTIC FaultManager.APP2_AdaptRangeLow.Mode "Fault manager configuration.  Select up to 4 actions for each fault." VALUE 0x80003022 RecordLayout_8 0 CompuMethod_108 0 65535 /end CHARACTERISTIC
/begin CHARACTERISTIC FaultManager.APP2_AdaptRangeLow.ID "Fault manager configuration.  Select up to 4 actions for each fault." VALUE 0x80003024 RecordLayout_8 0 CompuMethod_1 0 65535 /end CHARACTERISTIC
/begin CHARACTERISTIC FaultManager.APP2_AdaptRangeLow.Test "Fault manager configuration.  Select up to 4 actions for each fault." VALUE 0x80003026 RecordLayout_8 0 CompuMethod_109 0 65535 /end CHARACTERISTIC
/begin CHARACTERISTIC FaultManager.APP2_AdaptRangeLow.Faulty_Samples__X_ "Fault manager configuration.  Select up to 4 actions for each fault." VALUE 0x80003028 RecordLayout_8 0 CompuMethod_1 0 65535 /end CHARACTERISTIC
/begin CHARACTERISTIC FaultManager.APP2_AdaptRangeLow.Total_Samples__Y_ "Fault manager configuration.  Select up to 4 actions for each fault." VALUE 0x8000302A RecordLayout_8 0 CompuMethod_1 0 65535 /end CHARACTERISTIC
/begin CHARACTERISTIC FaultManager.APP2_AdaptRangeLow.Action_1 "Fault manager configuration.  Select up to 4 actions for each fault." VALUE 0x8000302C RecordLayout_8 0 CompuMethod_110 0 65535 /end CHARACTERISTIC
/begin CHARACTERISTIC FaultManager.APP2_AdaptRangeLow.Action_1_Condition "Fault manager configuration.  Select up to 4 actions for each fault." VALUE 0x8000302E RecordLayout_8 0 CompuMethod_111 0 65535 /end CHARACTERISTIC
/begin CHARACTERISTIC FaultManager.APP2_AdaptRangeLow.Action_2 "Fault manager configuration.  Select up to 4 actions for each fault." VALUE 0x80003030 RecordLayout_8 0 CompuMethod_110 0 65535 /end CHARACTERISTIC
/begin CHARACTERISTIC FaultManager.APP2_AdaptRangeLow.Action_2_Condition "Fault manager configuration.  Select up to 4 actions for each fault." VALUE 0x80003032 RecordLayout_8 0 CompuMethod_111 0 65535 /end CHARACTERISTIC
/begin CHARACTERISTIC FaultManager.APP2_AdaptRangeLow.Action_3 "Fault manager configuration.  Select up to 4 actions for each fault." VALUE 0x80003034 RecordLayout_8 0 CompuMethod_110 0 65535 /end CHARACTERISTIC
/begin CHARACTERISTIC FaultManager.APP2_AdaptRangeLow.Action_3_Condition "Fault manager configuration.  Select up to 4 actions for each fault." VALUE 0x80003036 RecordLayout_8 0 CompuMethod_111 0 65535 /end CHARACTERISTIC
/begin CHARACTERISTIC FaultManager.APP2_AdaptRangeLow.Action_4 "Fault manager configuration.  Select up to 4 actions for each fault." VALUE 0x80003038 RecordLayout_8 0 CompuMethod_110 0 65535 /end CHARACTERISTIC
/begin CHARACTERISTIC FaultManager.APP2_AdaptRangeLow.Action_4_Condition "Fault manager configuration.  Select up to 4 actions for each fault." VALUE 0x8000303A RecordLayout_8 0 CompuMethod_111 0 65535 /end CHARACTERISTIC
/begin CHARACTERISTIC FaultManager.APP_Sensors_Conflict.Mode "Fault manager configuration.  Select up to 4 actions for each fault." VALUE 0x8000303C RecordLayout_8 0 CompuMethod_108 0 65535 /end CHARACTERISTIC
/begin CHARACTERISTIC FaultManager.APP_Sensors_Conflict.ID "Fault manager configuration.  Select up to 4 actions for each fault." VALUE 0x8000303E RecordLayout_8 0 CompuMethod_1 0 65535 /end CHARACTERISTIC
/begin CHARACTERISTIC FaultManager.APP_Sensors_Conflict.Test "Fault manager configuration.  Select up to 4 actions for each fault." VALUE 0x80003040 RecordLayout_8 0 CompuMethod_109 0 65535 /end CHARACTERISTIC
/begin CHARACTERISTIC FaultManager.APP_Sensors_Conflict.Faulty_Samples__X_ "Fault manager configuration.  Select up to 4 actions for each fault." VALUE 0x80003042 RecordLayout_8 0 CompuMethod_1 0 65535 /end CHARACTERISTIC
/begin CHARACTERISTIC FaultManager.APP_Sensors_Conflict.Total_Samples__Y_ "Fault manager configuration.  Select up to 4 actions for each fault." VALUE 0x80003044 RecordLayout_8 0 CompuMethod_1 0 65535 /end CHARACTERISTIC
/begin CHARACTERISTIC FaultManager.APP_Sensors_Conflict.Action_1 "Fault manager configuration.  Select up to 4 actions for each fault." VALUE 0x80003046 RecordLayout_8 0 CompuMethod_110 0 65535 /end CHARACTERISTIC
/begin CHARACTERISTIC FaultManager.APP_Sensors_Conflict.Action_1_Condition "Fault manager configuration.  Select up to 4 actions for each fault." VALUE 0x80003048 RecordLayout_8 0 CompuMethod_111 0 65535 /end CHARACTERISTIC
/begin CHARACTERISTIC FaultManager.APP_Sensors_Conflict.Action_2 "Fault manager configuration.  Select up to 4 actions for each fault." VALUE 0x8000304A RecordLayout_8 0 CompuMethod_110 0 65535 /end CHARACTERISTIC
/begin CHARACTERISTIC FaultManager.APP_Sensors_Conflict.Action_2_Condition "Fault manager configuration.  Select up to 4 actions for each fault." VALUE 0x8000304C RecordLayout_8 0 CompuMethod_111 0 65535 /end CHARACTERISTIC
/begin CHARACTERISTIC FaultManager.APP_Sensors_Conflict.Action_3 "Fault manager configuration.  Select up to 4 actions for each fault." VALUE 0x8000304E RecordLayout_8 0 CompuMethod_110 0 65535 /end CHARACTERISTIC
/begin CHARACTERISTIC FaultManager.APP_Sensors_Conflict.Action_3_Condition "Fault manager configuration.  Select up to 4 actions for each fault." VALUE 0x80003050 RecordLayout_8 0 CompuMethod_111 0 65535 /end CHARACTERISTIC
/begin CHARACTERISTIC FaultManager.APP_Sensors_Conflict.Action_4 "Fault manager configuration.  Select up to 4 actions for each fault." VALUE 0x80003052 RecordLayout_8 0 CompuMethod_110 0 65535 /end CHARACTERISTIC
/begin CHARACTERISTIC FaultManager.APP_Sensors_Conflict.Action_4_Condition "Fault manager configuration.  Select up to 4 actions for each fault." VALUE 0x80003054 RecordLayout_8 0 CompuMethod_111 0 65535 /end CHARACTERISTIC
/begin CHARACTERISTIC FaultManager.Bank1_EquivRatioRangeHigh.Mode "Fault manager configuration.  Select up to 4 actions for each fault." VALUE 0x80003056 RecordLayout_8 0 CompuMethod_108 0 65535 /end CHARACTERISTIC
/begin CHARACTERISTIC FaultManager.Bank1_EquivRatioRangeHigh.ID "Fault manager configuration.  Select up to 4 actions for each fault." VALUE 0x80003058 RecordLayout_8 0 CompuMethod_1 0 65535 /end CHARACTERISTIC
/begin CHARACTERISTIC FaultManager.Bank1_EquivRatioRangeHigh.Test "Fault manager configuration.  Select up to 4 actions for each fault." VALUE 0x8000305A RecordLayout_8 0 CompuMethod_109 0 65535 /end CHARACTERISTIC
/begin CHARACTERISTIC FaultManager.Bank1_EquivRatioRangeHigh.Faulty_Samples__X_ "Fault manager configuration.  Select up to 4 actions for each fault." VALUE 0x8000305C RecordLayout_8 0 CompuMethod_1 0 65535 /end CHARACTERISTIC
/begin CHARACTERISTIC FaultManager.Bank1_EquivRatioRangeHigh.Total_Samples__Y_ "Fault manager configuration.  Select up to 4 actions for each fault." VALUE 0x8000305E RecordLayout_8 0 CompuMethod_1 0 65535 /end CHARACTERISTIC
/begin CHARACTERISTIC FaultManager.Bank1_EquivRatioRangeHigh.Action_1 "Fault manager configuration.  Select up to 4 actions for each fault." VALUE 0x80003060 RecordLayout_8 0 CompuMethod_110 0 65535 /end CHARACTERISTIC
/begin CHARACTERISTIC FaultManager.Bank1_EquivRatioRangeHigh.Action_1_Condition "Fault manager configuration.  Select up to 4 actions for each fault." VALUE 0x80003062 RecordLayout_8 0 CompuMethod_111 0 65535 /end CHARACTERISTIC
/begin CHARACTERISTIC FaultManager.Bank1_EquivRatioRangeHigh.Action_2 "Fault manager configuration.  Select up to 4 actions for each fault." VALUE 0x80003064 RecordLayout_8 0 CompuMethod_110 0 65535 /end CHARACTERISTIC
/begin CHARACTERISTIC FaultManager.Bank1_EquivRatioRangeHigh.Action_2_Condition "Fault manager configuration.  Select up to 4 actions for each fault." VALUE 0x80003066 RecordLayout_8 0 CompuMethod_111 0 65535 /end CHARACTERISTIC
/begin CHARACTERISTIC FaultManager.Bank1_EquivRatioRangeHigh.Action_3 "Fault manager configuration.  Select up to 4 actions for each fault." VALUE 0x80003068 RecordLayout_8 0 CompuMethod_110 0 65535 /end CHARACTERISTIC
/begin CHARACTERISTIC FaultManager.Bank1_EquivRatioRangeHigh.Action_3_Condition "Fault manager configuration.  Select up to 4 actions for each fault." VALUE 0x8000306A RecordLayout_8 0 CompuMethod_111 0 65535 /end CHARACTERISTIC
/begin CHARACTERISTIC FaultManager.Bank1_EquivRatioRangeHigh.Action_4 "Fault manager configuration.  Select up to 4 actions for each fault." VALUE 0x8000306C RecordLayout_8 0 CompuMethod_110 0 65535 /end CHARACTERISTIC
/begin CHARACTERISTIC FaultManager.Bank1_EquivRatioRangeHigh.Action_4_Condition "Fault manager configuration.  Select up to 4 actions for each fault." VALUE 0x8000306E RecordLayout_8 0 CompuMethod_111 0 65535 /end CHARACTERISTIC
/begin CHARACTERISTIC FaultManager.Bank1_EquivRatioRangeLow.Mode "Fault manager configuration.  Select up to 4 actions for each fault." VALUE 0x80003070 RecordLayout_8 0 CompuMethod_108 0 65535 /end CHARACTERISTIC
/begin CHARACTERISTIC FaultManager.Bank1_EquivRatioRangeLow.ID "Fault manager configuration.  Select up to 4 actions for each fault." VALUE 0x80003072 RecordLayout_8 0 CompuMethod_1 0 65535 /end CHARACTERISTIC
/begin CHARACTERISTIC FaultManager.Bank1_EquivRatioRangeLow.Test "Fault manager configuration.  Select up to 4 actions for each fault." VALUE 0x80003074 RecordLayout_8 0 CompuMethod_109 0 65535 /end CHARACTERISTIC
/begin CHARACTERISTIC FaultManager.Bank1_EquivRatioRangeLow.Faulty_Samples__X_ "Fault manager configuration.  Select up to 4 actions for each fault." VALUE 0x80003076 RecordLayout_8 0 CompuMethod_1 0 65535 /end CHARACTERISTIC
/begin CHARACTERISTIC FaultManager.Bank1_EquivRatioRangeLow.Total_Samples__Y_ "Fault manager configuration.  Select up to 4 actions for each fault." VALUE 0x80003078 RecordLayout_8 0 CompuMethod_1 0 65535 /end CHARACTERISTIC
/begin CHARACTERISTIC FaultManager.Bank1_EquivRatioRangeLow.Action_1 "Fault manager configuration.  Select up to 4 actions for each fault." VALUE 0x8000307A RecordLayout_8 0 CompuMethod_110 0 65535 /end CHARACTERISTIC
/begin CHARACTERISTIC FaultManager.Bank1_EquivRatioRangeLow.Action_1_Condition "Fault manager configuration.  Select up to 4 actions for each fault." VALUE 0x8000307C RecordLayout_8 0 CompuMethod_111 0 65535 /end CHARACTERISTIC
/begin CHARACTERISTIC FaultManager.Bank1_EquivRatioRangeLow.Action_2 "Fault manager configuration.  Select up to 4 actions for each fault." VALUE 0x8000307E RecordLayout_8 0 CompuMethod_110 0 65535 /end CHARACTERISTIC
/begin CHARACTERISTIC FaultManager.Bank1_EquivRatioRangeLow.Action_2_Condition "Fault manager configuration.  Select up to 4 actions for each fault." VALUE 0x80003080 RecordLayout_8 0 CompuMethod_111 0 65535 /end CHARACTERISTIC
/begin CHARACTERISTIC FaultManager.Bank1_EquivRatioRangeLow.Action_3 "Fault manager configuration.  Select up to 4 actions for each fault." VALUE 0x80003082 RecordLayout_8 0 CompuMethod_110 0 65535 /end CHARACTERISTIC
/begin CHARACTERISTIC FaultManager.Bank1_EquivRatioRangeLow.Action_3_Condition "Fault manager configuration.  Select up to 4 actions for each fault." VALUE 0x80003084 RecordLayout_8 0 CompuMethod_111 0 65535 /end CHARACTERISTIC
/begin CHARACTERISTIC FaultManager.Bank1_EquivRatioRangeLow.Action_4 "Fault manager configuration.  Select up to 4 actions for each fault." VALUE 0x80003086 RecordLayout_8 0 CompuMethod_110 0 65535 /end CHARACTERISTIC
/begin CHARACTERISTIC FaultManager.Bank1_EquivRatioRangeLow.Action_4_Condition "Fault manager configuration.  Select up to 4 actions for each fault." VALUE 0x80003088 RecordLayout_8 0 CompuMethod_111 0 65535 /end CHARACTERISTIC
/begin CHARACTERISTIC FaultManager.Bank2_EquivRatioRangeHigh.Mode "Fault manager configuration.  Select up to 4 actions for each fault." VALUE 0x8000308A RecordLayout_8 0 CompuMethod_108 0 65535 /end CHARACTERISTIC
/begin CHARACTERISTIC FaultManager.Bank2_EquivRatioRangeHigh.ID "Fault manager configuration.  Select up to 4 actions for each fault." VALUE 0x8000308C RecordLayout_8 0 CompuMethod_1 0 65535 /end CHARACTERISTIC
/begin CHARACTERISTIC FaultManager.Bank2_EquivRatioRangeHigh.Test "Fault manager configuration.  Select up to 4 actions for each fault." VALUE 0x8000308E RecordLayout_8 0 CompuMethod_109 0 65535 /end CHARACTERISTIC
/begin CHARACTERISTIC FaultManager.Bank2_EquivRatioRangeHigh.Faulty_Samples__X_ "Fault manager configuration.  Select up to 4 actions for each fault." VALUE 0x80003090 RecordLayout_8 0 CompuMethod_1 0 65535 /end CHARACTERISTIC
/begin CHARACTERISTIC FaultManager.Bank2_EquivRatioRangeHigh.Total_Samples__Y_ "Fault manager configuration.  Select up to 4 actions for each fault." VALUE 0x80003092 RecordLayout_8 0 CompuMethod_1 0 65535 /end CHARACTERISTIC
/begin CHARACTERISTIC FaultManager.Bank2_EquivRatioRangeHigh.Action_1 "Fault manager configuration.  Select up to 4 actions for each fault." VALUE 0x80003094 RecordLayout_8 0 CompuMethod_110 0 65535 /end CHARACTERISTIC
/begin CHARACTERISTIC FaultManager.Bank2_EquivRatioRangeHigh.Action_1_Condition "Fault manager configuration.  Select up to 4 actions for each fault." VALUE 0x80003096 RecordLayout_8 0 CompuMethod_111 0 65535 /end CHARACTERISTIC
/begin CHARACTERISTIC FaultManager.Bank2_EquivRatioRangeHigh.Action_2 "Fault manager configuration.  Select up to 4 actions for each fault." VALUE 0x80003098 RecordLayout_8 0 CompuMethod_110 0 65535 /end CHARACTERISTIC
/begin CHARACTERISTIC FaultManager.Bank2_EquivRatioRangeHigh.Action_2_Condition "Fault manager configuration.  Select up to 4 actions for each fault." VALUE 0x8000309A RecordLayout_8 0 CompuMethod_111 0 65535 /end CHARACTERISTIC
/begin CHARACTERISTIC FaultManager.Bank2_EquivRatioRangeHigh.Action_3 "Fault manager configuration.  Select up to 4 actions for each fault." VALUE 0x8000309C RecordLayout_8 0 CompuMethod_110 0 65535 /end CHARACTERISTIC
/begin CHARACTERISTIC FaultManager.Bank2_EquivRatioRangeHigh.Action_3_Condition "Fault manager configuration.  Select up to 4 actions for each fault." VALUE 0x8000309E RecordLayout_8 0 CompuMethod_111 0 65535 /end CHARACTERISTIC
/begin CHARACTERISTIC FaultManager.Bank2_EquivRatioRangeHigh.Action_4 "Fault manager configuration.  Select up to 4 actions for each fault." VALUE 0x800030A0 RecordLayout_8 0 CompuMethod_110 0 65535 /end CHARACTERISTIC
/begin CHARACTERISTIC FaultManager.Bank2_EquivRatioRangeHigh.Action_4_Condition "Fault manager configuration.  Select up to 4 actions for each fault." VALUE 0x800030A2 RecordLayout_8 0 CompuMethod_111 0 65535 /end CHARACTERISTIC
/begin CHARACTERISTIC FaultManager.Bank2_EquivRatioRangeLow.Mode "Fault manager configuration.  Select up to 4 actions for each fault." VALUE 0x800030A4 RecordLayout_8 0 CompuMethod_108 0 65535 /end CHARACTERISTIC
/begin CHARACTERISTIC FaultManager.Bank2_EquivRatioRangeLow.ID "Fault manager configuration.  Select up to 4 actions for each fault." VALUE 0x800030A6 RecordLayout_8 0 CompuMethod_1 0 65535 /end CHARACTERISTIC
/begin CHARACTERISTIC FaultManager.Bank2_EquivRatioRangeLow.Test "Fault manager configuration.  Select up to 4 actions for each fault." VALUE 0x800030A8 RecordLayout_8 0 CompuMethod_109 0 65535 /end CHARACTERISTIC
/begin CHARACTERISTIC FaultManager.Bank2_EquivRatioRangeLow.Faulty_Samples__X_ "Fault manager configuration.  Select up to 4 actions for each fault." VALUE 0x800030AA RecordLayout_8 0 CompuMethod_1 0 65535 /end CHARACTERISTIC
/begin CHARACTERISTIC FaultManager.Bank2_EquivRatioRangeLow.Total_Samples__Y_ "Fault manager configuration.  Select up to 4 actions for each fault." VALUE 0x800030AC RecordLayout_8 0 CompuMethod_1 0 65535 /end CHARACTERISTIC
/begin CHARACTERISTIC FaultManager.Bank2_EquivRatioRangeLow.Action_1 "Fault manager configuration.  Select up to 4 actions for each fault." VALUE 0x800030AE RecordLayout_8 0 CompuMethod_110 0 65535 /end CHARACTERISTIC
/begin CHARACTERISTIC FaultManager.Bank2_EquivRatioRangeLow.Action_1_Condition "Fault manager configuration.  Select up to 4 actions for each fault." VALUE 0x800030B0 RecordLayout_8 0 CompuMethod_111 0 65535 /end CHARACTERISTIC
/begin CHARACTERISTIC FaultManager.Bank2_EquivRatioRangeLow.Action_2 "Fault manager configuration.  Select up to 4 actions for each fault." VALUE 0x800030B2 RecordLayout_8 0 CompuMethod_110 0 65535 /end CHARACTERISTIC
/begin CHARACTERISTIC FaultManager.Bank2_EquivRatioRangeLow.Action_2_Condition "Fault manager configuration.  Select up to 4 actions for each fault." VALUE 0x800030B4 RecordLayout_8 0 CompuMethod_111 0 65535 /end CHARACTERISTIC
/begin CHARACTERISTIC FaultManager.Bank2_EquivRatioRangeLow.Action_3 "Fault manager configuration.  Select up to 4 actions for each fault." VALUE 0x800030B6 RecordLayout_8 0 CompuMethod_110 0 65535 /end CHARACTERISTIC
/begin CHARACTERISTIC FaultManager.Bank2_EquivRatioRangeLow.Action_3_Condition "Fault manager configuration.  Select up to 4 actions for each fault." VALUE 0x800030B8 RecordLayout_8 0 CompuMethod_111 0 65535 /end CHARACTERISTIC
/begin CHARACTERISTIC FaultManager.Bank2_EquivRatioRangeLow.Action_4 "Fault manager configuration.  Select up to 4 actions for each fault." VALUE 0x800030BA RecordLayout_8 0 CompuMethod_110 0 65535 /end CHARACTERISTIC
/begin CHARACTERISTIC FaultManager.Bank2_EquivRatioRangeLow.Action_4_Condition "Fault manager configuration.  Select up to 4 actions for each fault." VALUE 0x800030BC RecordLayout_8 0 CompuMethod_111 0 65535 /end CHARACTERISTIC
/begin CHARACTERISTIC FaultManager.CATRangeHigh.Mode "Fault manager configuration.  Select up to 4 actions for each fault." VALUE 0x800030BE RecordLayout_8 0 CompuMethod_108 0 65535 /end CHARACTERISTIC
/begin CHARACTERISTIC FaultManager.CATRangeHigh.ID "Fault manager configuration.  Select up to 4 actions for each fault." VALUE 0x800030C0 RecordLayout_8 0 CompuMethod_1 0 65535 /end CHARACTERISTIC
/begin CHARACTERISTIC FaultManager.CATRangeHigh.Test "Fault manager configuration.  Select up to 4 actions for each fault." VALUE 0x800030C2 RecordLayout_8 0 CompuMethod_109 0 65535 /end CHARACTERISTIC
/begin CHARACTERISTIC FaultManager.CATRangeHigh.Faulty_Samples__X_ "Fault manager configuration.  Select up to 4 actions for each fault." VALUE 0x800030C4 RecordLayout_8 0 CompuMethod_1 0 65535 /end CHARACTERISTIC
/begin CHARACTERISTIC FaultManager.CATRangeHigh.Total_Samples__Y_ "Fault manager configuration.  Select up to 4 actions for each fault." VALUE 0x800030C6 RecordLayout_8 0 CompuMethod_1 0 65535 /end CHARACTERISTIC
/begin CHARACTERISTIC FaultManager.CATRangeHigh.Action_1 "Fault manager configuration.  Select up to 4 actions for each fault." VALUE 0x800030C8 RecordLayout_8 0 CompuMethod_110 0 65535 /end CHARACTERISTIC
/begin CHARACTERISTIC FaultManager.CATRangeHigh.Action_1_Condition "Fault manager configuration.  Select up to 4 actions for each fault." VALUE 0x800030CA RecordLayout_8 0 CompuMethod_111 0 65535 /end CHARACTERISTIC
/begin CHARACTERISTIC FaultManager.CATRangeHigh.Action_2 "Fault manager configuration.  Select up to 4 actions for each fault." VALUE 0x800030CC RecordLayout_8 0 CompuMethod_110 0 65535 /end CHARACTERISTIC
/begin CHARACTERISTIC FaultManager.CATRangeHigh.Action_2_Condition "Fault manager configuration.  Select up to 4 actions for each fault." VALUE 0x800030CE RecordLayout_8 0 CompuMethod_111 0 65535 /end CHARACTERISTIC
/begin CHARACTERISTIC FaultManager.CATRangeHigh.Action_3 "Fault manager configuration.  Select up to 4 actions for each fault." VALUE 0x800030D0 RecordLayout_8 0 CompuMethod_110 0 65535 /end CHARACTERISTIC
/begin CHARACTERISTIC FaultManager.CATRangeHigh.Action_3_Condition "Fault manager configuration.  Select up to 4 actions for each fault." VALUE 0x800030D2 RecordLayout_8 0 CompuMethod_111 0 65535 /end CHARACTERISTIC
/begin CHARACTERISTIC FaultManager.CATRangeHigh.Action_4 "Fault manager configuration.  Select up to 4 actions for each fault." VALUE 0x800030D4 RecordLayout_8 0 CompuMethod_110 0 65535 /end CHARACTERISTIC
/begin CHARACTERISTIC FaultManager.CATRangeHigh.Action_4_Condition "Fault manager configuration.  Select up to 4 actions for each fault." VALUE 0x800030D6 RecordLayout_8 0 CompuMethod_111 0 65535 /end CHARACTERISTIC
/begin CHARACTERISTIC FaultManager.CATRangeLow.Mode "Fault manager configuration.  Select up to 4 actions for each fault." VALUE 0x800030D8 RecordLayout_8 0 CompuMethod_108 0 65535 /end CHARACTERISTIC
/begin CHARACTERISTIC FaultManager.CATRangeLow.ID "Fault manager configuration.  Select up to 4 actions for each fault." VALUE 0x800030DA RecordLayout_8 0 CompuMethod_1 0 65535 /end CHARACTERISTIC
/begin CHARACTERISTIC FaultManager.CATRangeLow.Test "Fault manager configuration.  Select up to 4 actions for each fault." VALUE 0x800030DC RecordLayout_8 0 CompuMethod_109 0 65535 /end CHARACTERISTIC
/begin CHARACTERISTIC FaultManager.CATRangeLow.Faulty_Samples__X_ "Fault manager configuration.  Select up to 4 actions for each fault." VALUE 0x800030DE RecordLayout_8 0 CompuMethod_1 0 65535 /end CHARACTERISTIC
/begin CHARACTERISTIC FaultManager.CATRangeLow.Total_Samples__Y_ "Fault manager configuration.  Select up to 4 actions for each fault." VALUE 0x800030E0 RecordLayout_8 0 CompuMethod_1 0 65535 /end CHARACTERISTIC
/begin CHARACTERISTIC FaultManager.CATRangeLow.Action_1 "Fault manager configuration.  Select up to 4 actions for each fault." VALUE 0x800030E2 RecordLayout_8 0 CompuMethod_110 0 65535 /end CHARACTERISTIC
/begin CHARACTERISTIC FaultManager.CATRangeLow.Action_1_Condition "Fault manager configuration.  Select up to 4 actions for each fault." VALUE 0x800030E4 RecordLayout_8 0 CompuMethod_111 0 65535 /end CHARACTERISTIC
/begin CHARACTERISTIC FaultManager.CATRangeLow.Action_2 "Fault manager configuration.  Select up to 4 actions for each fault." VALUE 0x800030E6 RecordLayout_8 0 CompuMethod_110 0 65535 /end CHARACTERISTIC
/begin CHARACTERISTIC FaultManager.CATRangeLow.Action_2_Condition "Fault manager configuration.  Select up to 4 actions for each fault." VALUE 0x800030E8 RecordLayout_8 0 CompuMethod_111 0 65535 /end CHARACTERISTIC
/begin CHARACTERISTIC FaultManager.CATRangeLow.Action_3 "Fault manager configuration.  Select up to 4 actions for each fault." VALUE 0x800030EA RecordLayout_8 0 CompuMethod_110 0 65535 /end CHARACTERISTIC
/begin CHARACTERISTIC FaultManager.CATRangeLow.Action_3_Condition "Fault manager configuration.  Select up to 4 actions for each fault." VALUE 0x800030EC RecordLayout_8 0 CompuMethod_111 0 65535 /end CHARACTERISTIC
/begin CHARACTERISTIC FaultManager.CATRangeLow.Action_4 "Fault manager configuration.  Select up to 4 actions for each fault." VALUE 0x800030EE RecordLayout_8 0 CompuMethod_110 0 65535 /end CHARACTERISTIC
/begin CHARACTERISTIC FaultManager.CATRangeLow.Action_4_Condition "Fault manager configuration.  Select up to 4 actions for each fault." VALUE 0x800030F0 RecordLayout_8 0 CompuMethod_111 0 65535 /end CHARACTERISTIC
/begin CHARACTERISTIC FaultManager.CamEdgesFault.Mode "Fault manager configuration.  Select up to 4 actions for each fault." VALUE 0x800030F2 RecordLayout_8 0 CompuMethod_108 0 65535 /end CHARACTERISTIC
/begin CHARACTERISTIC FaultManager.CamEdgesFault.ID "Fault manager configuration.  Select up to 4 actions for each fault." VALUE 0x800030F4 RecordLayout_8 0 CompuMethod_1 0 65535 /end CHARACTERISTIC
/begin CHARACTERISTIC FaultManager.CamEdgesFault.Test "Fault manager configuration.  Select up to 4 actions for each fault." VALUE 0x800030F6 RecordLayout_8 0 CompuMethod_109 0 65535 /end CHARACTERISTIC
/begin CHARACTERISTIC FaultManager.CamEdgesFault.Faulty_Samples__X_ "Fault manager configuration.  Select up to 4 actions for each fault." VALUE 0x800030F8 RecordLayout_8 0 CompuMethod_1 0 65535 /end CHARACTERISTIC
/begin CHARACTERISTIC FaultManager.CamEdgesFault.Total_Samples__Y_ "Fault manager configuration.  Select up to 4 actions for each fault." VALUE 0x800030FA RecordLayout_8 0 CompuMethod_1 0 65535 /end CHARACTERISTIC
/begin CHARACTERISTIC FaultManager.CamEdgesFault.Action_1 "Fault manager configuration.  Select up to 4 actions for each fault." VALUE 0x800030FC RecordLayout_8 0 CompuMethod_110 0 65535 /end CHARACTERISTIC
/begin CHARACTERISTIC FaultManager.CamEdgesFault.Action_1_Condition "Fault manager configuration.  Select up to 4 actions for each fault." VALUE 0x800030FE RecordLayout_8 0 CompuMethod_111 0 65535 /end CHARACTERISTIC
/begin CHARACTERISTIC FaultManager.CamEdgesFault.Action_2 "Fault manager configuration.  Select up to 4 actions for each fault." VALUE 0x80003100 RecordLayout_8 0 CompuMethod_110 0 65535 /end CHARACTERISTIC
/begin CHARACTERISTIC FaultManager.CamEdgesFault.Action_2_Condition "Fault manager configuration.  Select up to 4 actions for each fault." VALUE 0x80003102 RecordLayout_8 0 CompuMethod_111 0 65535 /end CHARACTERISTIC
/begin CHARACTERISTIC FaultManager.CamEdgesFault.Action_3 "Fault manager configuration.  Select up to 4 actions for each fault." VALUE 0x80003104 RecordLayout_8 0 CompuMethod_110 0 65535 /end CHARACTERISTIC
/begin CHARACTERISTIC FaultManager.CamEdgesFault.Action_3_Condition "Fault manager configuration.  Select up to 4 actions for each fault." VALUE 0x80003106 RecordLayout_8 0 CompuMethod_111 0 65535 /end CHARACTERISTIC
/begin CHARACTERISTIC FaultManager.CamEdgesFault.Action_4 "Fault manager configuration.  Select up to 4 actions for each fault." VALUE 0x80003108 RecordLayout_8 0 CompuMethod_110 0 65535 /end CHARACTERISTIC
/begin CHARACTERISTIC FaultManager.CamEdgesFault.Action_4_Condition "Fault manager configuration.  Select up to 4 actions for each fault." VALUE 0x8000310A RecordLayout_8 0 CompuMethod_111 0 65535 /end CHARACTERISTIC
/begin CHARACTERISTIC FaultManager.CamSyncFault.Mode "Fault manager configuration.  Select up to 4 actions for each fault." VALUE 0x8000310C RecordLayout_8 0 CompuMethod_108 0 65535 /end CHARACTERISTIC
/begin CHARACTERISTIC FaultManager.CamSyncFault.ID "Fault manager configuration.  Select up to 4 actions for each fault." VALUE 0x8000310E RecordLayout_8 0 CompuMethod_1 0 65535 /end CHARACTERISTIC
/begin CHARACTERISTIC FaultManager.CamSyncFault.Test "Fault manager configuration.  Select up to 4 actions for each fault." VALUE 0x80003110 RecordLayout_8 0 CompuMethod_109 0 65535 /end CHARACTERISTIC
/begin CHARACTERISTIC FaultManager.CamSyncFault.Faulty_Samples__X_ "Fault manager configuration.  Select up to 4 actions for each fault." VALUE 0x80003112 RecordLayout_8 0 CompuMethod_1 0 65535 /end CHARACTERISTIC
/begin CHARACTERISTIC FaultManager.CamSyncFault.Total_Samples__Y_ "Fault manager configuration.  Select up to 4 actions for each fault." VALUE 0x80003114 RecordLayout_8 0 CompuMethod_1 0 65535 /end CHARACTERISTIC
/begin CHARACTERISTIC FaultManager.CamSyncFault.Action_1 "Fault manager configuration.  Select up to 4 actions for each fault." VALUE 0x80003116 RecordLayout_8 0 CompuMethod_110 0 65535 /end CHARACTERISTIC
/begin CHARACTERISTIC FaultManager.CamSyncFault.Action_1_Condition "Fault manager configuration.  Select up to 4 actions for each fault." VALUE 0x80003118 RecordLayout_8 0 CompuMethod_111 0 65535 /end CHARACTERISTIC
/begin CHARACTERISTIC FaultManager.CamSyncFault.Action_2 "Fault manager configuration.  Select up to 4 actions for each fault." VALUE 0x8000311A RecordLayout_8 0 CompuMethod_110 0 65535 /end CHARACTERISTIC
/begin CHARACTERISTIC FaultManager.CamSyncFault.Action_2_Condition "Fault manager configuration.  Select up to 4 actions for each fault." VALUE 0x8000311C RecordLayout_8 0 CompuMethod_111 0 65535 /end CHARACTERISTIC
/begin CHARACTERISTIC FaultManager.CamSyncFault.Action_3 "Fault manager configuration.  Select up to 4 actions for each fault." VALUE 0x8000311E RecordLayout_8 0 CompuMethod_110 0 65535 /end CHARACTERISTIC
/begin CHARACTERISTIC FaultManager.CamSyncFault.Action_3_Condition "Fault manager configuration.  Select up to 4 actions for each fault." VALUE 0x80003120 RecordLayout_8 0 CompuMethod_111 0 65535 /end CHARACTERISTIC
/begin CHARACTERISTIC FaultManager.CamSyncFault.Action_4 "Fault manager configuration.  Select up to 4 actions for each fault." VALUE 0x80003122 RecordLayout_8 0 CompuMethod_110 0 65535 /end CHARACTERISTIC
/begin CHARACTERISTIC FaultManager.CamSyncFault.Action_4_Condition "Fault manager configuration.  Select up to 4 actions for each fault." VALUE 0x80003124 RecordLayout_8 0 CompuMethod_111 0 65535 /end CHARACTERISTIC
/begin CHARACTERISTIC FaultManager.CrankEdgesFault.Mode "Fault manager configuration.  Select up to 4 actions for each fault." VALUE 0x80003126 RecordLayout_8 0 CompuMethod_108 0 65535 /end CHARACTERISTIC
/begin CHARACTERISTIC FaultManager.CrankEdgesFault.ID "Fault manager configuration.  Select up to 4 actions for each fault." VALUE 0x80003128 RecordLayout_8 0 CompuMethod_1 0 65535 /end CHARACTERISTIC
/begin CHARACTERISTIC FaultManager.CrankEdgesFault.Test "Fault manager configuration.  Select up to 4 actions for each fault." VALUE 0x8000312A RecordLayout_8 0 CompuMethod_109 0 65535 /end CHARACTERISTIC
/begin CHARACTERISTIC FaultManager.CrankEdgesFault.Faulty_Samples__X_ "Fault manager configuration.  Select up to 4 actions for each fault." VALUE 0x8000312C RecordLayout_8 0 CompuMethod_1 0 65535 /end CHARACTERISTIC
/begin CHARACTERISTIC FaultManager.CrankEdgesFault.Total_Samples__Y_ "Fault manager configuration.  Select up to 4 actions for each fault." VALUE 0x8000312E RecordLayout_8 0 CompuMethod_1 0 65535 /end CHARACTERISTIC
/begin CHARACTERISTIC FaultManager.CrankEdgesFault.Action_1 "Fault manager configuration.  Select up to 4 actions for each fault." VALUE 0x80003130 RecordLayout_8 0 CompuMethod_110 0 65535 /end CHARACTERISTIC
/begin CHARACTERISTIC FaultManager.CrankEdgesFault.Action_1_Condition "Fault manager configuration.  Select up to 4 actions for each fault." VALUE 0x80003132 RecordLayout_8 0 CompuMethod_111 0 65535 /end CHARACTERISTIC
/begin CHARACTERISTIC FaultManager.CrankEdgesFault.Action_2 "Fault manager configuration.  Select up to 4 actions for each fault." VALUE 0x80003134 RecordLayout_8 0 CompuMethod_110 0 65535 /end CHARACTERISTIC
/begin CHARACTERISTIC FaultManager.CrankEdgesFault.Action_2_Condition "Fault manager configuration.  Select up to 4 actions for each fault." VALUE 0x80003136 RecordLayout_8 0 CompuMethod_111 0 65535 /end CHARACTERISTIC
/begin CHARACTERISTIC FaultManager.CrankEdgesFault.Action_3 "Fault manager configuration.  Select up to 4 actions for each fault." VALUE 0x80003138 RecordLayout_8 0 CompuMethod_110 0 65535 /end CHARACTERISTIC
/begin CHARACTERISTIC FaultManager.CrankEdgesFault.Action_3_Condition "Fault manager configuration.  Select up to 4 actions for each fault." VALUE 0x8000313A RecordLayout_8 0 CompuMethod_111 0 65535 /end CHARACTERISTIC
/begin CHARACTERISTIC FaultManager.CrankEdgesFault.Action_4 "Fault manager configuration.  Select up to 4 actions for each fault." VALUE 0x8000313C RecordLayout_8 0 CompuMethod_110 0 65535 /end CHARACTERISTIC
/begin CHARACTERISTIC FaultManager.CrankEdgesFault.Action_4_Condition "Fault manager configuration.  Select up to 4 actions for each fault." VALUE 0x8000313E RecordLayout_8 0 CompuMethod_111 0 65535 /end CHARACTERISTIC
/begin CHARACTERISTIC FaultManager.CrankSyncFault.Mode "Fault manager configuration.  Select up to 4 actions for each fault." VALUE 0x80003140 RecordLayout_8 0 CompuMethod_108 0 65535 /end CHARACTERISTIC
/begin CHARACTERISTIC FaultManager.CrankSyncFault.ID "Fault manager configuration.  Select up to 4 actions for each fault." VALUE 0x80003142 RecordLayout_8 0 CompuMethod_1 0 65535 /end CHARACTERISTIC
/begin CHARACTERISTIC FaultManager.CrankSyncFault.Test "Fault manager configuration.  Select up to 4 actions for each fault." VALUE 0x80003144 RecordLayout_8 0 CompuMethod_109 0 65535 /end CHARACTERISTIC
/begin CHARACTERISTIC FaultManager.CrankSyncFault.Faulty_Samples__X_ "Fault manager configuration.  Select up to 4 actions for each fault." VALUE 0x80003146 RecordLayout_8 0 CompuMethod_1 0 65535 /end CHARACTERISTIC
/begin CHARACTERISTIC FaultManager.CrankSyncFault.Total_Samples__Y_ "Fault manager configuration.  Select up to 4 actions for each fault." VALUE 0x80003148 RecordLayout_8 0 CompuMethod_1 0 65535 /end CHARACTERISTIC
/begin CHARACTERISTIC FaultManager.CrankSyncFault.Action_1 "Fault manager configuration.  Select up to 4 actions for each fault." VALUE 0x8000314A RecordLayout_8 0 CompuMethod_110 0 65535 /end CHARACTERISTIC
/begin CHARACTERISTIC FaultManager.CrankSyncFault.Action_1_Condition "Fault manager configuration.  Select up to 4 actions for each fault." VALUE 0x8000314C RecordLayout_8 0 CompuMethod_111 0 65535 /end CHARACTERISTIC
/begin CHARACTERISTIC FaultManager.CrankSyncFault.Action_2 "Fault manager configuration.  Select up to 4 actions for each fault." VALUE 0x8000314E RecordLayout_8 0 CompuMethod_110 0 65535 /end CHARACTERISTIC
/begin CHARACTERISTIC FaultManager.CrankSyncFault.Action_2_Condition "Fault manager configuration.  Select up to 4 actions for each fault." VALUE 0x80003150 RecordLayout_8 0 CompuMethod_111 0 65535 /end CHARACTERISTIC
/begin CHARACTERISTIC FaultManager.CrankSyncFault.Action_3 "Fault manager configuration.  Select up to 4 actions for each fault." VALUE 0x80003152 RecordLayout_8 0 CompuMethod_110 0 65535 /end CHARACTERISTIC
/begin CHARACTERISTIC FaultManager.CrankSyncFault.Action_3_Condition "Fault manager configuration.  Select up to 4 actions for each fault." VALUE 0x80003154 RecordLayout_8 0 CompuMethod_111 0 65535 /end CHARACTERISTIC
/begin CHARACTERISTIC FaultManager.CrankSyncFault.Action_4 "Fault manager configuration.  Select up to 4 actions for each fault." VALUE 0x80003156 RecordLayout_8 0 CompuMethod_110 0 65535 /end CHARACTERISTIC
/begin CHARACTERISTIC FaultManager.CrankSyncFault.Action_4_Condition "Fault manager configuration.  Select up to 4 actions for each fault." VALUE 0x80003158 RecordLayout_8 0 CompuMethod_111 0 65535 /end CHARACTERISTIC
/begin CHARACTERISTIC FaultManager.ECTOverTempFault.Mode "Fault manager configuration.  Select up to 4 actions for each fault." VALUE 0x8000315A RecordLayout_8 0 CompuMethod_108 0 65535 /end CHARACTERISTIC
/begin CHARACTERISTIC FaultManager.ECTOverTempFault.ID "Fault manager configuration.  Select up to 4 actions for each fault." VALUE 0x8000315C RecordLayout_8 0 CompuMethod_1 0 65535 /end CHARACTERISTIC
/begin CHARACTERISTIC FaultManager.ECTOverTempFault.Test "Fault manager configuration.  Select up to 4 actions for each fault." VALUE 0x8000315E RecordLayout_8 0 CompuMethod_109 0 65535 /end CHARACTERISTIC
/begin CHARACTERISTIC FaultManager.ECTOverTempFault.Faulty_Samples__X_ "Fault manager configuration.  Select up to 4 actions for each fault." VALUE 0x80003160 RecordLayout_8 0 CompuMethod_1 0 65535 /end CHARACTERISTIC
/begin CHARACTERISTIC FaultManager.ECTOverTempFault.Total_Samples__Y_ "Fault manager configuration.  Select up to 4 actions for each fault." VALUE 0x80003162 RecordLayout_8 0 CompuMethod_1 0 65535 /end CHARACTERISTIC
/begin CHARACTERISTIC FaultManager.ECTOverTempFault.Action_1 "Fault manager configuration.  Select up to 4 actions for each fault." VALUE 0x80003164 RecordLayout_8 0 CompuMethod_110 0 65535 /end CHARACTERISTIC
/begin CHARACTERISTIC FaultManager.ECTOverTempFault.Action_1_Condition "Fault manager configuration.  Select up to 4 actions for each fault." VALUE 0x80003166 RecordLayout_8 0 CompuMethod_111 0 65535 /end CHARACTERISTIC
/begin CHARACTERISTIC FaultManager.ECTOverTempFault.Action_2 "Fault manager configuration.  Select up to 4 actions for each fault." VALUE 0x80003168 RecordLayout_8 0 CompuMethod_110 0 65535 /end CHARACTERISTIC
/begin CHARACTERISTIC FaultManager.ECTOverTempFault.Action_2_Condition "Fault manager configuration.  Select up to 4 actions for each fault." VALUE 0x8000316A RecordLayout_8 0 CompuMethod_111 0 65535 /end CHARACTERISTIC
/begin CHARACTERISTIC FaultManager.ECTOverTempFault.Action_3 "Fault manager configuration.  Select up to 4 actions for each fault." VALUE 0x8000316C RecordLayout_8 0 CompuMethod_110 0 65535 /end CHARACTERISTIC
/begin CHARACTERISTIC FaultManager.ECTOverTempFault.Action_3_Condition "Fault manager configuration.  Select up to 4 actions for each fault." VALUE 0x8000316E RecordLayout_8 0 CompuMethod_111 0 65535 /end CHARACTERISTIC
/begin CHARACTERISTIC FaultManager.ECTOverTempFault.Action_4 "Fault manager configuration.  Select up to 4 actions for each fault." VALUE 0x80003170 RecordLayout_8 0 CompuMethod_110 0 65535 /end CHARACTERISTIC
/begin CHARACTERISTIC FaultManager.ECTOverTempFault.Action_4_Condition "Fault manager configuration.  Select up to 4 actions for each fault." VALUE 0x80003172 RecordLayout_8 0 CompuMethod_111 0 65535 /end CHARACTERISTIC
/begin CHARACTERISTIC FaultManager.ECTRangeHigh.Mode "Fault manager configuration.  Select up to 4 actions for each fault." VALUE 0x80003174 RecordLayout_8 0 CompuMethod_108 0 65535 /end CHARACTERISTIC
/begin CHARACTERISTIC FaultManager.ECTRangeHigh.ID "Fault manager configuration.  Select up to 4 actions for each fault." VALUE 0x80003176 RecordLayout_8 0 CompuMethod_1 0 65535 /end CHARACTERISTIC
/begin CHARACTERISTIC FaultManager.ECTRangeHigh.Test "Fault manager configuration.  Select up to 4 actions for each fault." VALUE 0x80003178 RecordLayout_8 0 CompuMethod_109 0 65535 /end CHARACTERISTIC
/begin CHARACTERISTIC FaultManager.ECTRangeHigh.Faulty_Samples__X_ "Fault manager configuration.  Select up to 4 actions for each fault." VALUE 0x8000317A RecordLayout_8 0 CompuMethod_1 0 65535 /end CHARACTERISTIC
/begin CHARACTERISTIC FaultManager.ECTRangeHigh.Total_Samples__Y_ "Fault manager configuration.  Select up to 4 actions for each fault." VALUE 0x8000317C RecordLayout_8 0 CompuMethod_1 0 65535 /end CHARACTERISTIC
/begin CHARACTERISTIC FaultManager.ECTRangeHigh.Action_1 "Fault manager configuration.  Select up to 4 actions for each fault." VALUE 0x8000317E RecordLayout_8 0 CompuMethod_110 0 65535 /end CHARACTERISTIC
/begin CHARACTERISTIC FaultManager.ECTRangeHigh.Action_1_Condition "Fault manager configuration.  Select up to 4 actions for each fault." VALUE 0x80003180 RecordLayout_8 0 CompuMethod_111 0 65535 /end CHARACTERISTIC
/begin CHARACTERISTIC FaultManager.ECTRangeHigh.Action_2 "Fault manager configuration.  Select up to 4 actions for each fault." VALUE 0x80003182 RecordLayout_8 0 CompuMethod_110 0 65535 /end CHARACTERISTIC
/begin CHARACTERISTIC FaultManager.ECTRangeHigh.Action_2_Condition "Fault manager configuration.  Select up to 4 actions for each fault." VALUE 0x80003184 RecordLayout_8 0 CompuMethod_111 0 65535 /end CHARACTERISTIC
/begin CHARACTERISTIC FaultManager.ECTRangeHigh.Action_3 "Fault manager configuration.  Select up to 4 actions for each fault." VALUE 0x80003186 RecordLayout_8 0 CompuMethod_110 0 65535 /end CHARACTERISTIC
/begin CHARACTERISTIC FaultManager.ECTRangeHigh.Action_3_Condition "Fault manager configuration.  Select up to 4 actions for each fault." VALUE 0x80003188 RecordLayout_8 0 CompuMethod_111 0 65535 /end CHARACTERISTIC
/begin CHARACTERISTIC FaultManager.ECTRangeHigh.Action_4 "Fault manager configuration.  Select up to 4 actions for each fault." VALUE 0x8000318A RecordLayout_8 0 CompuMethod_110 0 65535 /end CHARACTERISTIC
/begin CHARACTERISTIC FaultManager.ECTRangeHigh.Action_4_Condition "Fault manager configuration.  Select up to 4 actions for each fault." VALUE 0x8000318C RecordLayout_8 0 CompuMethod_111 0 65535 /end CHARACTERISTIC
/begin CHARACTERISTIC FaultManager.ECTRangeLow.Mode "Fault manager configuration.  Select up to 4 actions for each fault." VALUE 0x8000318E RecordLayout_8 0 CompuMethod_108 0 65535 /end CHARACTERISTIC
/begin CHARACTERISTIC FaultManager.ECTRangeLow.ID "Fault manager configuration.  Select up to 4 actions for each fault." VALUE 0x80003190 RecordLayout_8 0 CompuMethod_1 0 65535 /end CHARACTERISTIC
/begin CHARACTERISTIC FaultManager.ECTRangeLow.Test "Fault manager configuration.  Select up to 4 actions for each fault." VALUE 0x80003192 RecordLayout_8 0 CompuMethod_109 0 65535 /end CHARACTERISTIC
/begin CHARACTERISTIC FaultManager.ECTRangeLow.Faulty_Samples__X_ "Fault manager configuration.  Select up to 4 actions for each fault." VALUE 0x80003194 RecordLayout_8 0 CompuMethod_1 0 65535 /end CHARACTERISTIC
/begin CHARACTERISTIC FaultManager.ECTRangeLow.Total_Samples__Y_ "Fault manager configuration.  Select up to 4 actions for each fault." VALUE 0x80003196 RecordLayout_8 0 CompuMethod_1 0 65535 /end CHARACTERISTIC
/begin CHARACTERISTIC FaultManager.ECTRangeLow.Action_1 "Fault manager configuration.  Select up to 4 actions for each fault." VALUE 0x80003198 RecordLayout_8 0 CompuMethod_110 0 65535 /end CHARACTERISTIC
/begin CHARACTERISTIC FaultManager.ECTRangeLow.Action_1_Condition "Fault manager configuration.  Select up to 4 actions for each fault." VALUE 0x8000319A RecordLayout_8 0 CompuMethod_111 0 65535 /end CHARACTERISTIC
/begin CHARACTERISTIC FaultManager.ECTRangeLow.Action_2 "Fault manager configuration.  Select up to 4 actions for each fault." VALUE 0x8000319C RecordLayout_8 0 CompuMethod_110 0 65535 /end CHARACTERISTIC
/begin CHARACTERISTIC FaultManager.ECTRangeLow.Action_2_Condition "Fault manager configuration.  Select up to 4 actions for each fault." VALUE 0x8000319E RecordLayout_8 0 CompuMethod_111 0 65535 /end CHARACTERISTIC
/begin CHARACTERISTIC FaultManager.ECTRangeLow.Action_3 "Fault manager configuration.  Select up to 4 actions for each fault." VALUE 0x800031A0 RecordLayout_8 0 CompuMethod_110 0 65535 /end CHARACTERISTIC
/begin CHARACTERISTIC FaultManager.ECTRangeLow.Action_3_Condition "Fault manager configuration.  Select up to 4 actions for each fault." VALUE 0x800031A2 RecordLayout_8 0 CompuMethod_111 0 65535 /end CHARACTERISTIC
/begin CHARACTERISTIC FaultManager.ECTRangeLow.Action_4 "Fault manager configuration.  Select up to 4 actions for each fault." VALUE 0x800031A4 RecordLayout_8 0 CompuMethod_110 0 65535 /end CHARACTERISTIC
/begin CHARACTERISTIC FaultManager.ECTRangeLow.Action_4_Condition "Fault manager configuration.  Select up to 4 actions for each fault." VALUE 0x800031A6 RecordLayout_8 0 CompuMethod_111 0 65535 /end CHARACTERISTIC
/begin CHARACTERISTIC FaultManager.ECTSevereOverTempFault.Mode "Fault manager configuration.  Select up to 4 actions for each fault." VALUE 0x800031A8 RecordLayout_8 0 CompuMethod_108 0 65535 /end CHARACTERISTIC
/begin CHARACTERISTIC FaultManager.ECTSevereOverTempFault.ID "Fault manager configuration.  Select up to 4 actions for each fault." VALUE 0x800031AA RecordLayout_8 0 CompuMethod_1 0 65535 /end CHARACTERISTIC
/begin CHARACTERISTIC FaultManager.ECTSevereOverTempFault.Test "Fault manager configuration.  Select up to 4 actions for each fault." VALUE 0x800031AC RecordLayout_8 0 CompuMethod_109 0 65535 /end CHARACTERISTIC
/begin CHARACTERISTIC FaultManager.ECTSevereOverTempFault.Faulty_Samples__X_ "Fault manager configuration.  Select up to 4 actions for each fault." VALUE 0x800031AE RecordLayout_8 0 CompuMethod_1 0 65535 /end CHARACTERISTIC
/begin CHARACTERISTIC FaultManager.ECTSevereOverTempFault.Total_Samples__Y_ "Fault manager configuration.  Select up to 4 actions for each fault." VALUE 0x800031B0 RecordLayout_8 0 CompuMethod_1 0 65535 /end CHARACTERISTIC
/begin CHARACTERISTIC FaultManager.ECTSevereOverTempFault.Action_1 "Fault manager configuration.  Select up to 4 actions for each fault." VALUE 0x800031B2 RecordLayout_8 0 CompuMethod_110 0 65535 /end CHARACTERISTIC
/begin CHARACTERISTIC FaultManager.ECTSevereOverTempFault.Action_1_Condition "Fault manager configuration.  Select up to 4 actions for each fault." VALUE 0x800031B4 RecordLayout_8 0 CompuMethod_111 0 65535 /end CHARACTERISTIC
/begin CHARACTERISTIC FaultManager.ECTSevereOverTempFault.Action_2 "Fault manager configuration.  Select up to 4 actions for each fault." VALUE 0x800031B6 RecordLayout_8 0 CompuMethod_110 0 65535 /end CHARACTERISTIC
/begin CHARACTERISTIC FaultManager.ECTSevereOverTempFault.Action_2_Condition "Fault manager configuration.  Select up to 4 actions for each fault." VALUE 0x800031B8 RecordLayout_8 0 CompuMethod_111 0 65535 /end CHARACTERISTIC
/begin CHARACTERISTIC FaultManager.ECTSevereOverTempFault.Action_3 "Fault manager configuration.  Select up to 4 actions for each fault." VALUE 0x800031BA RecordLayout_8 0 CompuMethod_110 0 65535 /end CHARACTERISTIC
/begin CHARACTERISTIC FaultManager.ECTSevereOverTempFault.Action_3_Condition "Fault manager configuration.  Select up to 4 actions for each fault." VALUE 0x800031BC RecordLayout_8 0 CompuMethod_111 0 65535 /end CHARACTERISTIC
/begin CHARACTERISTIC FaultManager.ECTSevereOverTempFault.Action_4 "Fault manager configuration.  Select up to 4 actions for each fault." VALUE 0x800031BE RecordLayout_8 0 CompuMethod_110 0 65535 /end CHARACTERISTIC
/begin CHARACTERISTIC FaultManager.ECTSevereOverTempFault.Action_4_Condition "Fault manager configuration.  Select up to 4 actions for each fault." VALUE 0x800031C0 RecordLayout_8 0 CompuMethod_111 0 65535 /end CHARACTERISTIC
/begin CHARACTERISTIC FaultManager.EST1_Open.Mode "Fault manager configuration.  Select up to 4 actions for each fault." VALUE 0x800031C2 RecordLayout_8 0 CompuMethod_108 0 65535 /end CHARACTERISTIC
/begin CHARACTERISTIC FaultManager.EST1_Open.ID "Fault manager configuration.  Select up to 4 actions for each fault." VALUE 0x800031C4 RecordLayout_8 0 CompuMethod_1 0 65535 /end CHARACTERISTIC
/begin CHARACTERISTIC FaultManager.EST1_Open.Test "Fault manager configuration.  Select up to 4 actions for each fault." VALUE 0x800031C6 RecordLayout_8 0 CompuMethod_109 0 65535 /end CHARACTERISTIC
/begin CHARACTERISTIC FaultManager.EST1_Open.Faulty_Samples__X_ "Fault manager configuration.  Select up to 4 actions for each fault." VALUE 0x800031C8 RecordLayout_8 0 CompuMethod_1 0 65535 /end CHARACTERISTIC
/begin CHARACTERISTIC FaultManager.EST1_Open.Total_Samples__Y_ "Fault manager configuration.  Select up to 4 actions for each fault." VALUE 0x800031CA RecordLayout_8 0 CompuMethod_1 0 65535 /end CHARACTERISTIC
/begin CHARACTERISTIC FaultManager.EST1_Open.Action_1 "Fault manager configuration.  Select up to 4 actions for each fault." VALUE 0x800031CC RecordLayout_8 0 CompuMethod_110 0 65535 /end CHARACTERISTIC
/begin CHARACTERISTIC FaultManager.EST1_Open.Action_1_Condition "Fault manager configuration.  Select up to 4 actions for each fault." VALUE 0x800031CE RecordLayout_8 0 CompuMethod_111 0 65535 /end CHARACTERISTIC
/begin CHARACTERISTIC FaultManager.EST1_Open.Action_2 "Fault manager configuration.  Select up to 4 actions for each fault." VALUE 0x800031D0 RecordLayout_8 0 CompuMethod_110 0 65535 /end CHARACTERISTIC
/begin CHARACTERISTIC FaultManager.EST1_Open.Action_2_Condition "Fault manager configuration.  Select up to 4 actions for each fault." VALUE 0x800031D2 RecordLayout_8 0 CompuMethod_111 0 65535 /end CHARACTERISTIC
/begin CHARACTERISTIC FaultManager.EST1_Open.Action_3 "Fault manager configuration.  Select up to 4 actions for each fault." VALUE 0x800031D4 RecordLayout_8 0 CompuMethod_110 0 65535 /end CHARACTERISTIC
/begin CHARACTERISTIC FaultManager.EST1_Open.Action_3_Condition "Fault manager configuration.  Select up to 4 actions for each fault." VALUE 0x800031D6 RecordLayout_8 0 CompuMethod_111 0 65535 /end CHARACTERISTIC
/begin CHARACTERISTIC FaultManager.EST1_Open.Action_4 "Fault manager configuration.  Select up to 4 actions for each fault." VALUE 0x800031D8 RecordLayout_8 0 CompuMethod_110 0 65535 /end CHARACTERISTIC
/begin CHARACTERISTIC FaultManager.EST1_Open.Action_4_Condition "Fault manager configuration.  Select up to 4 actions for each fault." VALUE 0x800031DA RecordLayout_8 0 CompuMethod_111 0 65535 /end CHARACTERISTIC
/begin CHARACTERISTIC FaultManager.EST1_Short.Mode "Fault manager configuration.  Select up to 4 actions for each fault." VALUE 0x800031DC RecordLayout_8 0 CompuMethod_108 0 65535 /end CHARACTERISTIC
/begin CHARACTERISTIC FaultManager.EST1_Short.ID "Fault manager configuration.  Select up to 4 actions for each fault." VALUE 0x800031DE RecordLayout_8 0 CompuMethod_1 0 65535 /end CHARACTERISTIC
/begin CHARACTERISTIC FaultManager.EST1_Short.Test "Fault manager configuration.  Select up to 4 actions for each fault." VALUE 0x800031E0 RecordLayout_8 0 CompuMethod_109 0 65535 /end CHARACTERISTIC
/begin CHARACTERISTIC FaultManager.EST1_Short.Faulty_Samples__X_ "Fault manager configuration.  Select up to 4 actions for each fault." VALUE 0x800031E2 RecordLayout_8 0 CompuMethod_1 0 65535 /end CHARACTERISTIC
/begin CHARACTERISTIC FaultManager.EST1_Short.Total_Samples__Y_ "Fault manager configuration.  Select up to 4 actions for each fault." VALUE 0x800031E4 RecordLayout_8 0 CompuMethod_1 0 65535 /end CHARACTERISTIC
/begin CHARACTERISTIC FaultManager.EST1_Short.Action_1 "Fault manager configuration.  Select up to 4 actions for each fault." VALUE 0x800031E6 RecordLayout_8 0 CompuMethod_110 0 65535 /end CHARACTERISTIC
/begin CHARACTERISTIC FaultManager.EST1_Short.Action_1_Condition "Fault manager configuration.  Select up to 4 actions for each fault." VALUE 0x800031E8 RecordLayout_8 0 CompuMethod_111 0 65535 /end CHARACTERISTIC
/begin CHARACTERISTIC FaultManager.EST1_Short.Action_2 "Fault manager configuration.  Select up to 4 actions for each fault." VALUE 0x800031EA RecordLayout_8 0 CompuMethod_110 0 65535 /end CHARACTERISTIC
/begin CHARACTERISTIC FaultManager.EST1_Short.Action_2_Condition "Fault manager configuration.  Select up to 4 actions for each fault." VALUE 0x800031EC RecordLayout_8 0 CompuMethod_111 0 65535 /end CHARACTERISTIC
/begin CHARACTERISTIC FaultManager.EST1_Short.Action_3 "Fault manager configuration.  Select up to 4 actions for each fault." VALUE 0x800031EE RecordLayout_8 0 CompuMethod_110 0 65535 /end CHARACTERISTIC
/begin CHARACTERISTIC FaultManager.EST1_Short.Action_3_Condition "Fault manager configuration.  Select up to 4 actions for each fault." VALUE 0x800031F0 RecordLayout_8 0 CompuMethod_111 0 65535 /end CHARACTERISTIC
/begin CHARACTERISTIC FaultManager.EST1_Short.Action_4 "Fault manager configuration.  Select up to 4 actions for each fault." VALUE 0x800031F2 RecordLayout_8 0 CompuMethod_110 0 65535 /end CHARACTERISTIC
/begin CHARACTERISTIC FaultManager.EST1_Short.Action_4_Condition "Fault manager configuration.  Select up to 4 actions for each fault." VALUE 0x800031F4 RecordLayout_8 0 CompuMethod_111 0 65535 /end CHARACTERISTIC
/begin CHARACTERISTIC FaultManager.EST2_Open.Mode "Fault manager configuration.  Select up to 4 actions for each fault." VALUE 0x800031F6 RecordLayout_8 0 CompuMethod_108 0 65535 /end CHARACTERISTIC
/begin CHARACTERISTIC FaultManager.EST2_Open.ID "Fault manager configuration.  Select up to 4 actions for each fault." VALUE 0x800031F8 RecordLayout_8 0 CompuMethod_1 0 65535 /end CHARACTERISTIC
/begin CHARACTERISTIC FaultManager.EST2_Open.Test "Fault manager configuration.  Select up to 4 actions for each fault." VALUE 0x800031FA RecordLayout_8 0 CompuMethod_109 0 65535 /end CHARACTERISTIC
/begin CHARACTERISTIC FaultManager.EST2_Open.Faulty_Samples__X_ "Fault manager configuration.  Select up to 4 actions for each fault." VALUE 0x800031FC RecordLayout_8 0 CompuMethod_1 0 65535 /end CHARACTERISTIC
/begin CHARACTERISTIC FaultManager.EST2_Open.Total_Samples__Y_ "Fault manager configuration.  Select up to 4 actions for each fault." VALUE 0x800031FE RecordLayout_8 0 CompuMethod_1 0 65535 /end CHARACTERISTIC
/begin CHARACTERISTIC FaultManager.EST2_Open.Action_1 "Fault manager configuration.  Select up to 4 actions for each fault." VALUE 0x80003200 RecordLayout_8 0 CompuMethod_110 0 65535 /end CHARACTERISTIC
/begin CHARACTERISTIC FaultManager.EST2_Open.Action_1_Condition "Fault manager configuration.  Select up to 4 actions for each fault." VALUE 0x80003202 RecordLayout_8 0 CompuMethod_111 0 65535 /end CHARACTERISTIC
/begin CHARACTERISTIC FaultManager.EST2_Open.Action_2 "Fault manager configuration.  Select up to 4 actions for each fault." VALUE 0x80003204 RecordLayout_8 0 CompuMethod_110 0 65535 /end CHARACTERISTIC
/begin CHARACTERISTIC FaultManager.EST2_Open.Action_2_Condition "Fault manager configuration.  Select up to 4 actions for each fault." VALUE 0x80003206 RecordLayout_8 0 CompuMethod_111 0 65535 /end CHARACTERISTIC
/begin CHARACTERISTIC FaultManager.EST2_Open.Action_3 "Fault manager configuration.  Select up to 4 actions for each fault." VALUE 0x80003208 RecordLayout_8 0 CompuMethod_110 0 65535 /end CHARACTERISTIC
/begin CHARACTERISTIC FaultManager.EST2_Open.Action_3_Condition "Fault manager configuration.  Select up to 4 actions for each fault." VALUE 0x8000320A RecordLayout_8 0 CompuMethod_111 0 65535 /end CHARACTERISTIC
/begin CHARACTERISTIC FaultManager.EST2_Open.Action_4 "Fault manager configuration.  Select up to 4 actions for each fault." VALUE 0x8000320C RecordLayout_8 0 CompuMethod_110 0 65535 /end CHARACTERISTIC
/begin CHARACTERISTIC FaultManager.EST2_Open.Action_4_Condition "Fault manager configuration.  Select up to 4 actions for each fault." VALUE 0x8000320E RecordLayout_8 0 CompuMethod_111 0 65535 /end CHARACTERISTIC
/begin CHARACTERISTIC FaultManager.EST2_Short.Mode "Fault manager configuration.  Select up to 4 actions for each fault." VALUE 0x80003210 RecordLayout_8 0 CompuMethod_108 0 65535 /end CHARACTERISTIC
/begin CHARACTERISTIC FaultManager.EST2_Short.ID "Fault manager configuration.  Select up to 4 actions for each fault." VALUE 0x80003212 RecordLayout_8 0 CompuMethod_1 0 65535 /end CHARACTERISTIC
/begin CHARACTERISTIC FaultManager.EST2_Short.Test "Fault manager configuration.  Select up to 4 actions for each fault." VALUE 0x80003214 RecordLayout_8 0 CompuMethod_109 0 65535 /end CHARACTERISTIC
/begin CHARACTERISTIC FaultManager.EST2_Short.Faulty_Samples__X_ "Fault manager configuration.  Select up to 4 actions for each fault." VALUE 0x80003216 RecordLayout_8 0 CompuMethod_1 0 65535 /end CHARACTERISTIC
/begin CHARACTERISTIC FaultManager.EST2_Short.Total_Samples__Y_ "Fault manager configuration.  Select up to 4 actions for each fault." VALUE 0x80003218 RecordLayout_8 0 CompuMethod_1 0 65535 /end CHARACTERISTIC
/begin CHARACTERISTIC FaultManager.EST2_Short.Action_1 "Fault manager configuration.  Select up to 4 actions for each fault." VALUE 0x8000321A RecordLayout_8 0 CompuMethod_110 0 65535 /end CHARACTERISTIC
/begin CHARACTERISTIC FaultManager.EST2_Short.Action_1_Condition "Fault manager configuration.  Select up to 4 actions for each fault." VALUE 0x8000321C RecordLayout_8 0 CompuMethod_111 0 65535 /end CHARACTERISTIC
/begin CHARACTERISTIC FaultManager.EST2_Short.Action_2 "Fault manager configuration.  Select up to 4 actions for each fault." VALUE 0x8000321E RecordLayout_8 0 CompuMethod_110 0 65535 /end CHARACTERISTIC
/begin CHARACTERISTIC FaultManager.EST2_Short.Action_2_Condition "Fault manager configuration.  Select up to 4 actions for each fault." VALUE 0x80003220 RecordLayout_8 0 CompuMethod_111 0 65535 /end CHARACTERISTIC
/begin CHARACTERISTIC FaultManager.EST2_Short.Action_3 "Fault manager configuration.  Select up to 4 actions for each fault." VALUE 0x80003222 RecordLayout_8 0 CompuMethod_110 0 65535 /end CHARACTERISTIC
/begin CHARACTERISTIC FaultManager.EST2_Short.Action_3_Condition "Fault manager configuration.  Select up to 4 actions for each fault." VALUE 0x80003224 RecordLayout_8 0 CompuMethod_111 0 65535 /end CHARACTERISTIC
/begin CHARACTERISTIC FaultManager.EST2_Short.Action_4 "Fault manager configuration.  Select up to 4 actions for each fault." VALUE 0x80003226 RecordLayout_8 0 CompuMethod_110 0 65535 /end CHARACTERISTIC
/begin CHARACTERISTIC FaultManager.EST2_Short.Action_4_Condition "Fault manager configuration.  Select up to 4 actions for each fault." VALUE 0x80003228 RecordLayout_8 0 CompuMethod_111 0 65535 /end CHARACTERISTIC
/begin CHARACTERISTIC FaultManager.EST3_Open.Mode "Fault manager configuration.  Select up to 4 actions for each fault." VALUE 0x8000322A RecordLayout_8 0 CompuMethod_108 0 65535 /end CHARACTERISTIC
/begin CHARACTERISTIC FaultManager.EST3_Open.ID "Fault manager configuration.  Select up to 4 actions for each fault." VALUE 0x8000322C RecordLayout_8 0 CompuMethod_1 0 65535 /end CHARACTERISTIC
/begin CHARACTERISTIC FaultManager.EST3_Open.Test "Fault manager configuration.  Select up to 4 actions for each fault." VALUE 0x8000322E RecordLayout_8 0 CompuMethod_109 0 65535 /end CHARACTERISTIC
/begin CHARACTERISTIC FaultManager.EST3_Open.Faulty_Samples__X_ "Fault manager configuration.  Select up to 4 actions for each fault." VALUE 0x80003230 RecordLayout_8 0 CompuMethod_1 0 65535 /end CHARACTERISTIC
/begin CHARACTERISTIC FaultManager.EST3_Open.Total_Samples__Y_ "Fault manager configuration.  Select up to 4 actions for each fault." VALUE 0x80003232 RecordLayout_8 0 CompuMethod_1 0 65535 /end CHARACTERISTIC
/begin CHARACTERISTIC FaultManager.EST3_Open.Action_1 "Fault manager configuration.  Select up to 4 actions for each fault." VALUE 0x80003234 RecordLayout_8 0 CompuMethod_110 0 65535 /end CHARACTERISTIC
/begin CHARACTERISTIC FaultManager.EST3_Open.Action_1_Condition "Fault manager configuration.  Select up to 4 actions for each fault." VALUE 0x80003236 RecordLayout_8 0 CompuMethod_111 0 65535 /end CHARACTERISTIC
/begin CHARACTERISTIC FaultManager.EST3_Open.Action_2 "Fault manager configuration.  Select up to 4 actions for each fault." VALUE 0x80003238 RecordLayout_8 0 CompuMethod_110 0 65535 /end CHARACTERISTIC
/begin CHARACTERISTIC FaultManager.EST3_Open.Action_2_Condition "Fault manager configuration.  Select up to 4 actions for each fault." VALUE 0x8000323A RecordLayout_8 0 CompuMethod_111 0 65535 /end CHARACTERISTIC
/begin CHARACTERISTIC FaultManager.EST3_Open.Action_3 "Fault manager configuration.  Select up to 4 actions for each fault." VALUE 0x8000323C RecordLayout_8 0 CompuMethod_110 0 65535 /end CHARACTERISTIC
/begin CHARACTERISTIC FaultManager.EST3_Open.Action_3_Condition "Fault manager configuration.  Select up to 4 actions for each fault." VALUE 0x8000323E RecordLayout_8 0 CompuMethod_111 0 65535 /end CHARACTERISTIC
/begin CHARACTERISTIC FaultManager.EST3_Open.Action_4 "Fault manager configuration.  Select up to 4 actions for each fault." VALUE 0x80003240 RecordLayout_8 0 CompuMethod_110 0 65535 /end CHARACTERISTIC
/begin CHARACTERISTIC FaultManager.EST3_Open.Action_4_Condition "Fault manager configuration.  Select up to 4 actions for each fault." VALUE 0x80003242 RecordLayout_8 0 CompuMethod_111 0 65535 /end CHARACTERISTIC
/begin CHARACTERISTIC FaultManager.EST3_Short.Mode "Fault manager configuration.  Select up to 4 actions for each fault." VALUE 0x80003244 RecordLayout_8 0 CompuMethod_108 0 65535 /end CHARACTERISTIC
/begin CHARACTERISTIC FaultManager.EST3_Short.ID "Fault manager configuration.  Select up to 4 actions for each fault." VALUE 0x80003246 RecordLayout_8 0 CompuMethod_1 0 65535 /end CHARACTERISTIC
/begin CHARACTERISTIC FaultManager.EST3_Short.Test "Fault manager configuration.  Select up to 4 actions for each fault." VALUE 0x80003248 RecordLayout_8 0 CompuMethod_109 0 65535 /end CHARACTERISTIC
/begin CHARACTERISTIC FaultManager.EST3_Short.Faulty_Samples__X_ "Fault manager configuration.  Select up to 4 actions for each fault." VALUE 0x8000324A RecordLayout_8 0 CompuMethod_1 0 65535 /end CHARACTERISTIC
/begin CHARACTERISTIC FaultManager.EST3_Short.Total_Samples__Y_ "Fault manager configuration.  Select up to 4 actions for each fault." VALUE 0x8000324C RecordLayout_8 0 CompuMethod_1 0 65535 /end CHARACTERISTIC
/begin CHARACTERISTIC FaultManager.EST3_Short.Action_1 "Fault manager configuration.  Select up to 4 actions for each fault." VALUE 0x8000324E RecordLayout_8 0 CompuMethod_110 0 65535 /end CHARACTERISTIC
/begin CHARACTERISTIC FaultManager.EST3_Short.Action_1_Condition "Fault manager configuration.  Select up to 4 actions for each fault." VALUE 0x80003250 RecordLayout_8 0 CompuMethod_111 0 65535 /end CHARACTERISTIC
/begin CHARACTERISTIC FaultManager.EST3_Short.Action_2 "Fault manager configuration.  Select up to 4 actions for each fault." VALUE 0x80003252 RecordLayout_8 0 CompuMethod_110 0 65535 /end CHARACTERISTIC
/begin CHARACTERISTIC FaultManager.EST3_Short.Action_2_Condition "Fault manager configuration.  Select up to 4 actions for each fault." VALUE 0x80003254 RecordLayout_8 0 CompuMethod_111 0 65535 /end CHARACTERISTIC
/begin CHARACTERISTIC FaultManager.EST3_Short.Action_3 "Fault manager configuration.  Select up to 4 actions for each fault." VALUE 0x80003256 RecordLayout_8 0 CompuMethod_110 0 65535 /end CHARACTERISTIC
/begin CHARACTERISTIC FaultManager.EST3_Short.Action_3_Condition "Fault manager configuration.  Select up to 4 actions for each fault." VALUE 0x80003258 RecordLayout_8 0 CompuMethod_111 0 65535 /end CHARACTERISTIC
/begin CHARACTERISTIC FaultManager.EST3_Short.Action_4 "Fault manager configuration.  Select up to 4 actions for each fault." VALUE 0x8000325A RecordLayout_8 0 CompuMethod_110 0 65535 /end CHARACTERISTIC
/begin CHARACTERISTIC FaultManager.EST3_Short.Action_4_Condition "Fault manager configuration.  Select up to 4 actions for each fault." VALUE 0x8000325C RecordLayout_8 0 CompuMethod_111 0 65535 /end CHARACTERISTIC
/begin CHARACTERISTIC FaultManager.EST4_Open.Mode "Fault manager configuration.  Select up to 4 actions for each fault." VALUE 0x8000325E RecordLayout_8 0 CompuMethod_108 0 65535 /end CHARACTERISTIC
/begin CHARACTERISTIC FaultManager.EST4_Open.ID "Fault manager configuration.  Select up to 4 actions for each fault." VALUE 0x80003260 RecordLayout_8 0 CompuMethod_1 0 65535 /end CHARACTERISTIC
/begin CHARACTERISTIC FaultManager.EST4_Open.Test "Fault manager configuration.  Select up to 4 actions for each fault." VALUE 0x80003262 RecordLayout_8 0 CompuMethod_109 0 65535 /end CHARACTERISTIC
/begin CHARACTERISTIC FaultManager.EST4_Open.Faulty_Samples__X_ "Fault manager configuration.  Select up to 4 actions for each fault." VALUE 0x80003264 RecordLayout_8 0 CompuMethod_1 0 65535 /end CHARACTERISTIC
/begin CHARACTERISTIC FaultManager.EST4_Open.Total_Samples__Y_ "Fault manager configuration.  Select up to 4 actions for each fault." VALUE 0x80003266 RecordLayout_8 0 CompuMethod_1 0 65535 /end CHARACTERISTIC
/begin CHARACTERISTIC FaultManager.EST4_Open.Action_1 "Fault manager configuration.  Select up to 4 actions for each fault." VALUE 0x80003268 RecordLayout_8 0 CompuMethod_110 0 65535 /end CHARACTERISTIC
/begin CHARACTERISTIC FaultManager.EST4_Open.Action_1_Condition "Fault manager configuration.  Select up to 4 actions for each fault." VALUE 0x8000326A RecordLayout_8 0 CompuMethod_111 0 65535 /end CHARACTERISTIC
/begin CHARACTERISTIC FaultManager.EST4_Open.Action_2 "Fault manager configuration.  Select up to 4 actions for each fault." VALUE 0x8000326C RecordLayout_8 0 CompuMethod_110 0 65535 /end CHARACTERISTIC
/begin CHARACTERISTIC FaultManager.EST4_Open.Action_2_Condition "Fault manager configuration.  Select up to 4 actions for each fault." VALUE 0x8000326E RecordLayout_8 0 CompuMethod_111 0 65535 /end CHARACTERISTIC
/begin CHARACTERISTIC FaultManager.EST4_Open.Action_3 "Fault manager configuration.  Select up to 4 actions for each fault." VALUE 0x80003270 RecordLayout_8 0 CompuMethod_110 0 65535 /end CHARACTERISTIC
/begin CHARACTERISTIC FaultManager.EST4_Open.Action_3_Condition "Fault manager configuration.  Select up to 4 actions for each fault." VALUE 0x80003272 RecordLayout_8 0 CompuMethod_111 0 65535 /end CHARACTERISTIC
/begin CHARACTERISTIC FaultManager.EST4_Open.Action_4 "Fault manager configuration.  Select up to 4 actions for each fault." VALUE 0x80003274 RecordLayout_8 0 CompuMethod_110 0 65535 /end CHARACTERISTIC
/begin CHARACTERISTIC FaultManager.EST4_Open.Action_4_Condition "Fault manager configuration.  Select up to 4 actions for each fault." VALUE 0x80003276 RecordLayout_8 0 CompuMethod_111 0 65535 /end CHARACTERISTIC
/begin CHARACTERISTIC FaultManager.EST4_Short.Mode "Fault manager configuration.  Select up to 4 actions for each fault." VALUE 0x80003278 RecordLayout_8 0 CompuMethod_108 0 65535 /end CHARACTERISTIC
/begin CHARACTERISTIC FaultManager.EST4_Short.ID "Fault manager configuration.  Select up to 4 actions for each fault." VALUE 0x8000327A RecordLayout_8 0 CompuMethod_1 0 65535 /end CHARACTERISTIC
/begin CHARACTERISTIC FaultManager.EST4_Short.Test "Fault manager configuration.  Select up to 4 actions for each fault." VALUE 0x8000327C RecordLayout_8 0 CompuMethod_109 0 65535 /end CHARACTERISTIC
/begin CHARACTERISTIC FaultManager.EST4_Short.Faulty_Samples__X_ "Fault manager configuration.  Select up to 4 actions for each fault." VALUE 0x8000327E RecordLayout_8 0 CompuMethod_1 0 65535 /end CHARACTERISTIC
/begin CHARACTERISTIC FaultManager.EST4_Short.Total_Samples__Y_ "Fault manager configuration.  Select up to 4 actions for each fault." VALUE 0x80003280 RecordLayout_8 0 CompuMethod_1 0 65535 /end CHARACTERISTIC
/begin CHARACTERISTIC FaultManager.EST4_Short.Action_1 "Fault manager configuration.  Select up to 4 actions for each fault." VALUE 0x80003282 RecordLayout_8 0 CompuMethod_110 0 65535 /end CHARACTERISTIC
/begin CHARACTERISTIC FaultManager.EST4_Short.Action_1_Condition "Fault manager configuration.  Select up to 4 actions for each fault." VALUE 0x80003284 RecordLayout_8 0 CompuMethod_111 0 65535 /end CHARACTERISTIC
/begin CHARACTERISTIC FaultManager.EST4_Short.Action_2 "Fault manager configuration.  Select up to 4 actions for each fault." VALUE 0x80003286 RecordLayout_8 0 CompuMethod_110 0 65535 /end CHARACTERISTIC
/begin CHARACTERISTIC FaultManager.EST4_Short.Action_2_Condition "Fault manager configuration.  Select up to 4 actions for each fault." VALUE 0x80003288 RecordLayout_8 0 CompuMethod_111 0 65535 /end CHARACTERISTIC
/begin CHARACTERISTIC FaultManager.EST4_Short.Action_3 "Fault manager configuration.  Select up to 4 actions for each fault." VALUE 0x8000328A RecordLayout_8 0 CompuMethod_110 0 65535 /end CHARACTERISTIC
/begin CHARACTERISTIC FaultManager.EST4_Short.Action_3_Condition "Fault manager configuration.  Select up to 4 actions for each fault." VALUE 0x8000328C RecordLayout_8 0 CompuMethod_111 0 65535 /end CHARACTERISTIC
/begin CHARACTERISTIC FaultManager.EST4_Short.Action_4 "Fault manager configuration.  Select up to 4 actions for each fault." VALUE 0x8000328E RecordLayout_8 0 CompuMethod_110 0 65535 /end CHARACTERISTIC
/begin CHARACTERISTIC FaultManager.EST4_Short.Action_4_Condition "Fault manager configuration.  Select up to 4 actions for each fault." VALUE 0x80003290 RecordLayout_8 0 CompuMethod_111 0 65535 /end CHARACTERISTIC
/begin CHARACTERISTIC FaultManager.EST5_Open.Mode "Fault manager configuration.  Select up to 4 actions for each fault." VALUE 0x80003292 RecordLayout_8 0 CompuMethod_108 0 65535 /end CHARACTERISTIC
/begin CHARACTERISTIC FaultManager.EST5_Open.ID "Fault manager configuration.  Select up to 4 actions for each fault." VALUE 0x80003294 RecordLayout_8 0 CompuMethod_1 0 65535 /end CHARACTERISTIC
/begin CHARACTERISTIC FaultManager.EST5_Open.Test "Fault manager configuration.  Select up to 4 actions for each fault." VALUE 0x80003296 RecordLayout_8 0 CompuMethod_109 0 65535 /end CHARACTERISTIC
/begin CHARACTERISTIC FaultManager.EST5_Open.Faulty_Samples__X_ "Fault manager configuration.  Select up to 4 actions for each fault." VALUE 0x80003298 RecordLayout_8 0 CompuMethod_1 0 65535 /end CHARACTERISTIC
/begin CHARACTERISTIC FaultManager.EST5_Open.Total_Samples__Y_ "Fault manager configuration.  Select up to 4 actions for each fault." VALUE 0x8000329A RecordLayout_8 0 CompuMethod_1 0 65535 /end CHARACTERISTIC
/begin CHARACTERISTIC FaultManager.EST5_Open.Action_1 "Fault manager configuration.  Select up to 4 actions for each fault." VALUE 0x8000329C RecordLayout_8 0 CompuMethod_110 0 65535 /end CHARACTERISTIC
/begin CHARACTERISTIC FaultManager.EST5_Open.Action_1_Condition "Fault manager configuration.  Select up to 4 actions for each fault." VALUE 0x8000329E RecordLayout_8 0 CompuMethod_111 0 65535 /end CHARACTERISTIC
/begin CHARACTERISTIC FaultManager.EST5_Open.Action_2 "Fault manager configuration.  Select up to 4 actions for each fault." VALUE 0x800032A0 RecordLayout_8 0 CompuMethod_110 0 65535 /end CHARACTERISTIC
/begin CHARACTERISTIC FaultManager.EST5_Open.Action_2_Condition "Fault manager configuration.  Select up to 4 actions for each fault." VALUE 0x800032A2 RecordLayout_8 0 CompuMethod_111 0 65535 /end CHARACTERISTIC
/begin CHARACTERISTIC FaultManager.EST5_Open.Action_3 "Fault manager configuration.  Select up to 4 actions for each fault." VALUE 0x800032A4 RecordLayout_8 0 CompuMethod_110 0 65535 /end CHARACTERISTIC
/begin CHARACTERISTIC FaultManager.EST5_Open.Action_3_Condition "Fault manager configuration.  Select up to 4 actions for each fault." VALUE 0x800032A6 RecordLayout_8 0 CompuMethod_111 0 65535 /end CHARACTERISTIC
/begin CHARACTERISTIC FaultManager.EST5_Open.Action_4 "Fault manager configuration.  Select up to 4 actions for each fault." VALUE 0x800032A8 RecordLayout_8 0 CompuMethod_110 0 65535 /end CHARACTERISTIC
/begin CHARACTERISTIC FaultManager.EST5_Open.Action_4_Condition "Fault manager configuration.  Select up to 4 actions for each fault." VALUE 0x800032AA RecordLayout_8 0 CompuMethod_111 0 65535 /end CHARACTERISTIC
/begin CHARACTERISTIC FaultManager.EST5_Short.Mode "Fault manager configuration.  Select up to 4 actions for each fault." VALUE 0x800032AC RecordLayout_8 0 CompuMethod_108 0 65535 /end CHARACTERISTIC
/begin CHARACTERISTIC FaultManager.EST5_Short.ID "Fault manager configuration.  Select up to 4 actions for each fault." VALUE 0x800032AE RecordLayout_8 0 CompuMethod_1 0 65535 /end CHARACTERISTIC
/begin CHARACTERISTIC FaultManager.EST5_Short.Test "Fault manager configuration.  Select up to 4 actions for each fault." VALUE 0x800032B0 RecordLayout_8 0 CompuMethod_109 0 65535 /end CHARACTERISTIC
/begin CHARACTERISTIC FaultManager.EST5_Short.Faulty_Samples__X_ "Fault manager configuration.  Select up to 4 actions for each fault." VALUE 0x800032B2 RecordLayout_8 0 CompuMethod_1 0 65535 /end CHARACTERISTIC
/begin CHARACTERISTIC FaultManager.EST5_Short.Total_Samples__Y_ "Fault manager configuration.  Select up to 4 actions for each fault." VALUE 0x800032B4 RecordLayout_8 0 CompuMethod_1 0 65535 /end CHARACTERISTIC
/begin CHARACTERISTIC FaultManager.EST5_Short.Action_1 "Fault manager configuration.  Select up to 4 actions for each fault." VALUE 0x800032B6 RecordLayout_8 0 CompuMethod_110 0 65535 /end CHARACTERISTIC
/begin CHARACTERISTIC FaultManager.EST5_Short.Action_1_Condition "Fault manager configuration.  Select up to 4 actions for each fault." VALUE 0x800032B8 RecordLayout_8 0 CompuMethod_111 0 65535 /end CHARACTERISTIC
/begin CHARACTERISTIC FaultManager.EST5_Short.Action_2 "Fault manager configuration.  Select up to 4 actions for each fault." VALUE 0x800032BA RecordLayout_8 0 CompuMethod_110 0 65535 /end CHARACTERISTIC
/begin CHARACTERISTIC FaultManager.EST5_Short.Action_2_Condition "Fault manager configuration.  Select up to 4 actions for each fault." VALUE 0x800032BC RecordLayout_8 0 CompuMethod_111 0 65535 /end CHARACTERISTIC
/begin CHARACTERISTIC FaultManager.EST5_Short.Action_3 "Fault manager configuration.  Select up to 4 actions for each fault." VALUE 0x800032BE RecordLayout_8 0 CompuMethod_110 0 65535 /end CHARACTERISTIC
/begin CHARACTERISTIC FaultManager.EST5_Short.Action_3_Condition "Fault manager configuration.  Select up to 4 actions for each fault." VALUE 0x800032C0 RecordLayout_8 0 CompuMethod_111 0 65535 /end CHARACTERISTIC
/begin CHARACTERISTIC FaultManager.EST5_Short.Action_4 "Fault manager configuration.  Select up to 4 actions for each fault." VALUE 0x800032C2 RecordLayout_8 0 CompuMethod_110 0 65535 /end CHARACTERISTIC
/begin CHARACTERISTIC FaultManager.EST5_Short.Action_4_Condition "Fault manager configuration.  Select up to 4 actions for each fault." VALUE 0x800032C4 RecordLayout_8 0 CompuMethod_111 0 65535 /end CHARACTERISTIC
/begin CHARACTERISTIC FaultManager.EST6_Open.Mode "Fault manager configuration.  Select up to 4 actions for each fault." VALUE 0x800032C6 RecordLayout_8 0 CompuMethod_108 0 65535 /end CHARACTERISTIC
/begin CHARACTERISTIC FaultManager.EST6_Open.ID "Fault manager configuration.  Select up to 4 actions for each fault." VALUE 0x800032C8 RecordLayout_8 0 CompuMethod_1 0 65535 /end CHARACTERISTIC
/begin CHARACTERISTIC FaultManager.EST6_Open.Test "Fault manager configuration.  Select up to 4 actions for each fault." VALUE 0x800032CA RecordLayout_8 0 CompuMethod_109 0 65535 /end CHARACTERISTIC
/begin CHARACTERISTIC FaultManager.EST6_Open.Faulty_Samples__X_ "Fault manager configuration.  Select up to 4 actions for each fault." VALUE 0x800032CC RecordLayout_8 0 CompuMethod_1 0 65535 /end CHARACTERISTIC
/begin CHARACTERISTIC FaultManager.EST6_Open.Total_Samples__Y_ "Fault manager configuration.  Select up to 4 actions for each fault." VALUE 0x800032CE RecordLayout_8 0 CompuMethod_1 0 65535 /end CHARACTERISTIC
/begin CHARACTERISTIC FaultManager.EST6_Open.Action_1 "Fault manager configuration.  Select up to 4 actions for each fault." VALUE 0x800032D0 RecordLayout_8 0 CompuMethod_110 0 65535 /end CHARACTERISTIC
/begin CHARACTERISTIC FaultManager.EST6_Open.Action_1_Condition "Fault manager configuration.  Select up to 4 actions for each fault." VALUE 0x800032D2 RecordLayout_8 0 CompuMethod_111 0 65535 /end CHARACTERISTIC
/begin CHARACTERISTIC FaultManager.EST6_Open.Action_2 "Fault manager configuration.  Select up to 4 actions for each fault." VALUE 0x800032D4 RecordLayout_8 0 CompuMethod_110 0 65535 /end CHARACTERISTIC
/begin CHARACTERISTIC FaultManager.EST6_Open.Action_2_Condition "Fault manager configuration.  Select up to 4 actions for each fault." VALUE 0x800032D6 RecordLayout_8 0 CompuMethod_111 0 65535 /end CHARACTERISTIC
/begin CHARACTERISTIC FaultManager.EST6_Open.Action_3 "Fault manager configuration.  Select up to 4 actions for each fault." VALUE 0x800032D8 RecordLayout_8 0 CompuMethod_110 0 65535 /end CHARACTERISTIC
/begin CHARACTERISTIC FaultManager.EST6_Open.Action_3_Condition "Fault manager configuration.  Select up to 4 actions for each fault." VALUE 0x800032DA RecordLayout_8 0 CompuMethod_111 0 65535 /end CHARACTERISTIC
/begin CHARACTERISTIC FaultManager.EST6_Open.Action_4 "Fault manager configuration.  Select up to 4 actions for each fault." VALUE 0x800032DC RecordLayout_8 0 CompuMethod_110 0 65535 /end CHARACTERISTIC
/begin CHARACTERISTIC FaultManager.EST6_Open.Action_4_Condition "Fault manager configuration.  Select up to 4 actions for each fault." VALUE 0x800032DE RecordLayout_8 0 CompuMethod_111 0 65535 /end CHARACTERISTIC
/begin CHARACTERISTIC FaultManager.EST6_Short.Mode "Fault manager configuration.  Select up to 4 actions for each fault." VALUE 0x800032E0 RecordLayout_8 0 CompuMethod_108 0 65535 /end CHARACTERISTIC
/begin CHARACTERISTIC FaultManager.EST6_Short.ID "Fault manager configuration.  Select up to 4 actions for each fault." VALUE 0x800032E2 RecordLayout_8 0 CompuMethod_1 0 65535 /end CHARACTERISTIC
/begin CHARACTERISTIC FaultManager.EST6_Short.Test "Fault manager configuration.  Select up to 4 actions for each fault." VALUE 0x800032E4 RecordLayout_8 0 CompuMethod_109 0 65535 /end CHARACTERISTIC
/begin CHARACTERISTIC FaultManager.EST6_Short.Faulty_Samples__X_ "Fault manager configuration.  Select up to 4 actions for each fault." VALUE 0x800032E6 RecordLayout_8 0 CompuMethod_1 0 65535 /end CHARACTERISTIC
/begin CHARACTERISTIC FaultManager.EST6_Short.Total_Samples__Y_ "Fault manager configuration.  Select up to 4 actions for each fault." VALUE 0x800032E8 RecordLayout_8 0 CompuMethod_1 0 65535 /end CHARACTERISTIC
/begin CHARACTERISTIC FaultManager.EST6_Short.Action_1 "Fault manager configuration.  Select up to 4 actions for each fault." VALUE 0x800032EA RecordLayout_8 0 CompuMethod_110 0 65535 /end CHARACTERISTIC
/begin CHARACTERISTIC FaultManager.EST6_Short.Action_1_Condition "Fault manager configuration.  Select up to 4 actions for each fault." VALUE 0x800032EC RecordLayout_8 0 CompuMethod_111 0 65535 /end CHARACTERISTIC
/begin CHARACTERISTIC FaultManager.EST6_Short.Action_2 "Fault manager configuration.  Select up to 4 actions for each fault." VALUE 0x800032EE RecordLayout_8 0 CompuMethod_110 0 65535 /end CHARACTERISTIC
/begin CHARACTERISTIC FaultManager.EST6_Short.Action_2_Condition "Fault manager configuration.  Select up to 4 actions for each fault." VALUE 0x800032F0 RecordLayout_8 0 CompuMethod_111 0 65535 /end CHARACTERISTIC
/begin CHARACTERISTIC FaultManager.EST6_Short.Action_3 "Fault manager configuration.  Select up to 4 actions for each fault." VALUE 0x800032F2 RecordLayout_8 0 CompuMethod_110 0 65535 /end CHARACTERISTIC
/begin CHARACTERISTIC FaultManager.EST6_Short.Action_3_Condition "Fault manager configuration.  Select up to 4 actions for each fault." VALUE 0x800032F4 RecordLayout_8 0 CompuMethod_111 0 65535 /end CHARACTERISTIC
/begin CHARACTERISTIC FaultManager.EST6_Short.Action_4 "Fault manager configuration.  Select up to 4 actions for each fault." VALUE 0x800032F6 RecordLayout_8 0 CompuMethod_110 0 65535 /end CHARACTERISTIC
/begin CHARACTERISTIC FaultManager.EST6_Short.Action_4_Condition "Fault manager configuration.  Select up to 4 actions for each fault." VALUE 0x800032F8 RecordLayout_8 0 CompuMethod_111 0 65535 /end CHARACTERISTIC
/begin CHARACTERISTIC FaultManager.EST7_Open.Mode "Fault manager configuration.  Select up to 4 actions for each fault." VALUE 0x800032FA RecordLayout_8 0 CompuMethod_108 0 65535 /end CHARACTERISTIC
/begin CHARACTERISTIC FaultManager.EST7_Open.ID "Fault manager configuration.  Select up to 4 actions for each fault." VALUE 0x800032FC RecordLayout_8 0 CompuMethod_1 0 65535 /end CHARACTERISTIC
/begin CHARACTERISTIC FaultManager.EST7_Open.Test "Fault manager configuration.  Select up to 4 actions for each fault." VALUE 0x800032FE RecordLayout_8 0 CompuMethod_109 0 65535 /end CHARACTERISTIC
/begin CHARACTERISTIC FaultManager.EST7_Open.Faulty_Samples__X_ "Fault manager configuration.  Select up to 4 actions for each fault." VALUE 0x80003300 RecordLayout_8 0 CompuMethod_1 0 65535 /end CHARACTERISTIC
/begin CHARACTERISTIC FaultManager.EST7_Open.Total_Samples__Y_ "Fault manager configuration.  Select up to 4 actions for each fault." VALUE 0x80003302 RecordLayout_8 0 CompuMethod_1 0 65535 /end CHARACTERISTIC
/begin CHARACTERISTIC FaultManager.EST7_Open.Action_1 "Fault manager configuration.  Select up to 4 actions for each fault." VALUE 0x80003304 RecordLayout_8 0 CompuMethod_110 0 65535 /end CHARACTERISTIC
/begin CHARACTERISTIC FaultManager.EST7_Open.Action_1_Condition "Fault manager configuration.  Select up to 4 actions for each fault." VALUE 0x80003306 RecordLayout_8 0 CompuMethod_111 0 65535 /end CHARACTERISTIC
/begin CHARACTERISTIC FaultManager.EST7_Open.Action_2 "Fault manager configuration.  Select up to 4 actions for each fault." VALUE 0x80003308 RecordLayout_8 0 CompuMethod_110 0 65535 /end CHARACTERISTIC
/begin CHARACTERISTIC FaultManager.EST7_Open.Action_2_Condition "Fault manager configuration.  Select up to 4 actions for each fault." VALUE 0x8000330A RecordLayout_8 0 CompuMethod_111 0 65535 /end CHARACTERISTIC
/begin CHARACTERISTIC FaultManager.EST7_Open.Action_3 "Fault manager configuration.  Select up to 4 actions for each fault." VALUE 0x8000330C RecordLayout_8 0 CompuMethod_110 0 65535 /end CHARACTERISTIC
/begin CHARACTERISTIC FaultManager.EST7_Open.Action_3_Condition "Fault manager configuration.  Select up to 4 actions for each fault." VALUE 0x8000330E RecordLayout_8 0 CompuMethod_111 0 65535 /end CHARACTERISTIC
/begin CHARACTERISTIC FaultManager.EST7_Open.Action_4 "Fault manager configuration.  Select up to 4 actions for each fault." VALUE 0x80003310 RecordLayout_8 0 CompuMethod_110 0 65535 /end CHARACTERISTIC
/begin CHARACTERISTIC FaultManager.EST7_Open.Action_4_Condition "Fault manager configuration.  Select up to 4 actions for each fault." VALUE 0x80003312 RecordLayout_8 0 CompuMethod_111 0 65535 /end CHARACTERISTIC
/begin CHARACTERISTIC MatlabVersionTxt "MATLAB version used to build the application." ASCII 0x40000812 RecordLayout_2 0 CompuMethod_2 0 255 NUMBER 80 MATRIX_DIM 80 1 1 READ_ONLY /end CHARACTERISTIC
/begin CHARACTERISTIC MotoHawkBuildGUID "GUID identifying the MotoHawk build session" ASCII 0x400008B6 RecordLayout_2 0 CompuMethod_2 0 255 NUMBER 80 MATRIX_DIM 80 1 1 READ_ONLY /end CHARACTERISTIC
/begin CHARACTERISTIC MotoHawkModelGUID "GUID identifying the MotoHawk model" ASCII 0x40000906 RecordLayout_2 0 CompuMethod_2 0 255 NUMBER 80 MATRIX_DIM 80 1 1 READ_ONLY /end CHARACTERISTIC
/begin CHARACTERISTIC MotoHawkModelName "Simulink model name used for the MotoHawk build" ASCII 0x40000956 RecordLayout_2 0 CompuMethod_2 0 255 NUMBER 80 MATRIX_DIM 80 1 1 READ_ONLY /end CHARACTERISTIC
/begin CHARACTERISTIC MotoHawkTokenGUID "GUID identifying the token inserted during the build.  May be empty if no token was available" ASCII 0x400009AA RecordLayout_2 0 CompuMethod_2 0 255 NUMBER 80 MATRIX_DIM 80 1 1 READ_ONLY /end CHARACTERISTIC
/begin CHARACTERISTIC MotoHawkVersionTxt "MotoHawk version used to build the application." ASCII 0x400009FA RecordLayout_2 0 CompuMethod_2 0 255 NUMBER 50 MATRIX_DIM 50 1 1 READ_ONLY /end CHARACTERISTIC
/begin CHARACTERISTIC PartNumber "" ASCII 0x40000A91 RecordLayout_2 0 CompuMethod_2 0 255 NUMBER 40 MATRIX_DIM 40 1 1 READ_ONLY /end CHARACTERISTIC
/begin CHARACTERISTIC PasswordTxt "Password protection for this calibration" ASCII 0x80004FAA RecordLayout_2 0 CompuMethod_2 0 255 NUMBER 33 MATRIX_DIM 33 1 1 /end CHARACTERISTIC
/*~~~~~~~~~ 6.3.106 RECORD_LAYOUTs ~~~~~~~~~*/
/begin RECORD_LAYOUT RecordLayout_1 FNC_VALUES 1 UBYTE ROW_DIR DIRECT /end RECORD_LAYOUT
/begin RECORD_LAYOUT RecordLayout_2 FNC_VALUES 1 UBYTE ROW_DIR DIRECT /end RECORD_LAYOUT
/begin RECORD_LAYOUT RecordLayout_3 FNC_VALUES 1 ULONG ROW_DIR DIRECT /end RECORD_LAYOUT
/begin RECORD_LAYOUT RecordLayout_8 FNC_VALUES 1 UWORD ROW_DIR DIRECT /end RECORD_LAYOUT
/*~~~~~~~~~ 6.3.31 COMPU_METHODs ~~~~~~~~~*/
/begin COMPU_METHOD CompuMethod_1 "" RAT_FUNC "%3.0" "" COEFFS 0 1 0 0 0 1 /end COMPU_METHOD
/begin COMPU_METHOD CompuMethod_2 "" RAT_FUNC "%6.2" "" COEFFS 0 1 0 0 0 1 /end COMPU_METHOD
/begin COMPU_METHOD CompuMethod_3 "" RAT_FUNC "%6.2" "ID" COEFFS 0 1 0 0 0 1 /end COMPU_METHOD
/begin COMPU_METHOD CompuMethod_4 "" RAT_FUNC "%1.0" "bool" COEFFS 0 1 0 0 0 1 /end COMPU_METHOD
/begin COMPU_METHOD CompuMethod_11 "" RAT_FUNC "%1.0" "" COEFFS 0 1 0 0 0 1 /end COMPU_METHOD
/begin COMPU_METHOD CompuMethod_106 "" TAB_VERB "%3.0" "" COMPU_TAB_REF CompuVtab_30 /end COMPU_METHOD
/begin COMPU_METHOD CompuMethod_107 "" TAB_VERB "%3.0" "" COMPU_TAB_REF CompuVtab_31 /end COMPU_METHOD
/begin COMPU_METHOD CompuMethod_108 "" TAB_VERB "%3.0" "" COMPU_TAB_REF CompuVtab_32 /end COMPU_METHOD
/begin COMPU_METHOD CompuMethod_109 "" TAB_VERB "%3.0" "" COMPU_TAB_REF CompuVtab_33 /end COMPU_METHOD
/begin COMPU_METHOD CompuMethod_110 "" TAB_VERB "%3.0" "" COMPU_TAB_REF CompuVtab_34 /end COMPU_METHOD
/begin COMPU_METHOD CompuMethod_111 "" TAB_VERB "%3.0" "" COMPU_TAB_REF CompuVtab_35 /end COMPU_METHOD
/begin COMPU_METHOD CompuMethod_145 "" TAB_VERB "%3.0" "" COMPU_TAB_REF CompuVtab_52 /end COMPU_METHOD
/begin COMPU_METHOD CompuMethod_146 "" RAT_FUNC "%8.0" "seconds" COEFFS 0 1 0 0 0 1 /end COMPU_METHOD
/begin COMPU_METHOD CompuMethod_173 "" RAT_FUNC "%5.0" "MHz" COEFFS 0 1 0 0 0 1E-06 /end COMPU_METHOD
/begin COMPU_METHOD CompuMethod_176 "" TAB_VERB "%1.0" "" COMPU_TAB_REF CompuVtab_66 /end COMPU_METHOD
/begin COMPU_VTAB CompuVtab_30 "" TAB_VERB 126 0 "ACChargeHigh_Fault" 1 "ACChargeLow_Fault" 2 "ACPresRangeHigh" 3 "ACPresRangeLow" 4 "APP1RangeHigh" 5 "APP1RangeLow" 6 "APP1_AdaptAdaptHiMax" 7 "APP1_AdaptAdaptHiMin" 8 "APP1_AdaptAdaptLoMax" 9 "APP1_AdaptAdaptLoMin" 10 "APP1_AdaptRangeHigh" 11 "APP1_AdaptRangeLow" 12 "APP2RangeHigh" 13 "APP2RangeLow" 14 "APP2_AdaptAdaptHiMax" 15 "APP2_AdaptAdaptHiMin" 16 "APP2_AdaptAdaptLoMax" 17 "APP2_AdaptAdaptLoMin" 18 "APP2_AdaptRangeHigh" 19 "APP2_AdaptRangeLow" 20 "APP_Sensors_Conflict" 21 "Bank1_EquivRatioRangeHigh" 22 "Bank1_EquivRatioRangeLow" 23 "Bank2_EquivRatioRangeHigh" 24 "Bank2_EquivRatioRangeLow" 25 "CATRangeHigh" 26 "CATRangeLow" 27 "CamEdgesFault" 28 "CamSyncFault" 29 "CrankEdgesFault" 30 "CrankSyncFault" 31 "ECTOverTempFault" 32 "ECTRangeHigh" 33 "ECTRangeLow" 34 "ECTSevereOverTempFault" 35 "EST1_Open" 36 "EST1_Short" 37 "EST2_Open" 38 "EST2_Short" 39 "EST3_Open" 40 "EST3_Short" 41 "EST4_Open" 42 "EST4_Short" 43 "EST5_Open" 44 "EST5_Short" 45 "EST6_Open" 46 "EST6_Short" 47 "EST7_Open" 48 "EST7_Short" 49 "EST8_Open" 50 "EST8_Short" 51 "ETCSpringTest" 52 "ETC_Open_Fault" 53 "ETC_Sticking" 54 "EVAPRangeHigh" 55 "EVAPRangeLow" 56 "FuelAdaptRangeHi" 57 "FuelAdaptRangeLow" 58 "FuelPresHigh_Fault" 59 "FuelPresLow_Fault" 60 "FuelPresRangeHigh" 61 "FuelPresRangeLow" 62 "FuelSensRangeHigh" 63 "FuelSensRangeLow" 64 "Fuel_LvlRangeHigh" 65 "Fuel_LvlRangeLow" 66 "GPS_DateTime_Timeout" 67 "GPS_LatLong_Timeout" 68 "GPS_NotReady" 69 "GPS_SpeedDir_Timeout" 70 "HardOverBoost_Fault" 71 "HardOverspeed" 72 "IATRangeHigh" 73 "IATRangeLow" 74 "Inj1Open" 75 "Inj2Open" 76 "Inj3Open" 77 "Inj4Open" 78 "Inj5Open" 79 "Inj6Open" 80 "Inj7Open" 81 "Inj8Open" 82 "Lambda_1_NotReady" 83 "Lambda_1_Timeout" 84 "Lambda_2_NotReady" 85 "Lambda_2_Timeout" 86 "LeanProtect_Fault" 87 "MAFRangeHigh" 88 "MAFRangeLow" 89 "MAPRangeHigh" 90 "MAPRangeLow" 91 "MAPTimeRangeHigh" 92 "MAPTimeRangeLow" 93 "MAP_IR_HI" 94 "MAP_IR_LO" 95 "MAP_STICKING" 96 "MediumOverspeed" 97 "NoOil_Fault" 98 "O2FailedLean" 99 "O2FailedRich" 100 "O2NotActive" 101 "OilPresRangeHigh" 102 "OilPresRangeLow" 103 "SensVoltRangeHigh" 104 "SensVoltRangeLow" 105 "SoftOverBoost_Fault" 106 "SoftOverspeed" 107 "SysVoltRangeHigh" 108 "SysVoltRangeLow" 109 "TPS1AdaptHiMax" 110 "TPS1AdaptHiMin" 111 "TPS1AdaptLoMax" 112 "TPS1AdaptLoMin" 113 "TPS1RangeHigh" 114 "TPS1RangeLow" 115 "TPS2AdaptHiMax" 116 "TPS2AdaptHiMin" 117 "TPS2AdaptLoMax" 118 "TPS2AdaptLoMin" 119 "TPS2RangeHigh" 120 "TPS2RangeLow" 121 "TPS_Sensors_Conflict" 122 "VSPDRangeHigh" 123 "VSPDRangeLow" 124 "Wastegate_Fault" 125 "(None)" /end COMPU_VTAB
/begin COMPU_VTAB CompuVtab_31 "" TAB_VERB 2 0 "-" 1 "Clear All Faults" /end COMPU_VTAB
/begin COMPU_VTAB CompuVtab_32 "" TAB_VERB 6 0 "Disabled" 1 "Enabled" 2 "Sticky" 3 "Enabled - Persistent" 4 "Sticky - Persistent" 5 "Save Occurred" /end COMPU_VTAB
/begin COMPU_VTAB CompuVtab_33 "" TAB_VERB 2 0 "-" 1 "Test" /end COMPU_VTAB
/begin COMPU_VTAB CompuVtab_34 "" TAB_VERB 14 0 "CutThrottle" 1 "DFCODisable" 2 "DelayedEngineShutdown" 3 "DisableAC" 4 "DisableO2Ctrl" 5 "DisableVEAdapt" 6 "DisableWastegate" 7 "EngineProtectLED" 8 "EngineShutdown" 9 "HardRevLimit" 10 "MIL_LED" 11 "MediumRevLimit" 12 "SoftRevLimit" 13 "(None)" /end COMPU_VTAB
/begin COMPU_VTAB CompuVtab_35 "" TAB_VERB 8 0 "(None)" 1 "Suspected" 2 "Active" 3 "Suspected or Active" 4 "Occurred" 5 "Suspected or Occurred" 6 "Active or Occurred" 7 "Suspected or Active or Occurred" /end COMPU_VTAB
/begin COMPU_VTAB CompuVtab_52 "" TAB_VERB 6 0 "Calibratable Development Module" 1 "Non-Calibratable Production Module" 2 "Software Dev Module (with RAM overlay only)" 3 "Software Dev Module (with Trace Pod & RAM)" 4 "Calibratable Development Module with Censorship disabled" 5 "Non-Calibratable Production Module with Censorship disabled" /end COMPU_VTAB
/begin COMPU_VTAB CompuVtab_66 "" TAB_VERB 40 0 "TPU Mask Undefined" 1 "60-6" 2 "GM24Xe" 3 "GM24Xe on Cam" 4 "N-1/N-2 [Half Moon Cam]" 5 "NX Encoder" 6 "NX Encoder on Cam" 7 "30-5 on Cnk" 8 "Hyundai 60" 9 "X Plus 1 on Cnk with ToothCam" 10 "X Shift 1 on Cnk" 11 "N Encoder" 12 "N-1/N-2 [Tooth Cam]" 13 "ISDL" 14 "X Pulse Width on Cam" 15 "X Pulse Width on Cnk" 16 "1 Pulse on Cnk" 17 "1 Pulse on Cam" 18 "N-1/N-2 Dual Redundancy" 19 "N-1/N-2 Variable Cam" 20 "N-1/N-2 [Duramax CAM] [Multiplexed EST (1,2, or 4,5,6,7,8) (9,10,11 or 13,14,15)]" 21 "X Plus 1 on Cnk + MuxPSP on EST > 9" 22 "NX Encoder with Hyundai 4 Tooth CAM with one wide" 23 "NX Encoder with 360Deg CAM Providing Crank Sync" 24 "NissanZ 36-6 Encoder, sync on custom CAM" 25 "36-1 Encoder, sync on custom Coyote CAM" 26 "N Groups of 4 teeth - 2, sync on CAM" 27 "NissanZ 36-6 Encoder, sync on 6Tooth 2Missing Plus2 Variable CAM" 28 "EVO9 2X Encoder with 1X_PLUS1 CAM on Exhaust and 4X Variable CAM on Intake" 29 "N-1/N-2 Variable Cam with Windowed Sync" 30 "36M4 (2x18 teeth sectors with 2 missing) and Kohki Cam" 31 "N-3/N-4 [ToothCam]" 32 "N-3/N-4 [Plus1Cam (X+1)]" 33 "Hyundai 60 with EncoderSynthesizer variant on TPUC" 34 "N-1/N-2 [Half Moon Cam]" 35 "X Plus 1 on Cnk with X Plus 1 Cam" 36 "X Plus 1 on Cnk with X Plus 1 Cam with Encoder Synthesizer" 37 "N-1/N-2 [XPlus1 Cam]" 38 "X Shift 1 Retarded [ToothCam]" 39 "N-1/N-2 [Tooth Cam] with MuxPSP" /end COMPU_VTAB
/*~~~~~~~~~ 6.3.65 FUNCTIONs ~~~~~~~~~*/
/begin FUNCTION Project_Config "" /begin DEF_CHARACTERISTIC project_id ProductID /end DEF_CHARACTERISTIC /end FUNCTION
/begin FUNCTION System_Config "" /begin DEF_CHARACTERISTIC FriendlyName PasswordTxt /end DEF_CHARACTERISTIC /begin SUB_FUNCTION Project_Config Trigger_Config Communication_Config /end SUB_FUNCTION /end FUNCTION
/begin FUNCTION System ""
 /begin SUB_FUNCTION System_Config Version Status I_O_Pins Debug CCP Performance Main_Power_Relay NonVolatile_Storage /end SUB_FUNCTION
/end FUNCTION
/begin FUNCTION Version ""
 /begin DEF_CHARACTERISTIC SwIdTxt CalIdTxt SwRevisionTxt CompilerVersion ControlCoreSDKRelease MatlabVersionTxt MotoHawkBuildGUID MotoHawkModelGUID MotoHawkModelName MotoHawkTokenGUID MotoHawkVersionTxt /end DEF_CHARACTERISTIC
 /begin OUT_MEASUREMENT table_0_rev table_1_rev table_2_rev KeyRev EriRev table_3_rev table_4_rev table_5_rev table_6_rev table_7_rev MotProgRev ApplicationCompatibilityArr LinkStatus MotoHawkModelSecondsInUse SystemFrequency TPUMaskType TPUMaskVers Unused /end OUT_MEASUREMENT
/end FUNCTION
/begin FUNCTION Module_Config "" /begin DEF_CHARACTERISTIC SerialNumber ModelNumber PartNumber /end DEF_CHARACTERISTIC
 /begin OUT_MEASUREMENT BootVerMaj BootVerMin EcuHwMaj EcuHwMin ConfigVerMaj ConfigVerMin ModuleCapability /end OUT_MEASUREMENT
/end FUNCTION
/begin FUNCTION Status "" /begin SUB_FUNCTION Module_Config OS Framework /end SUB_FUNCTION /end FUNCTION
/begin FUNCTION AC "" /begin OUT_MEASUREMENT AC /end OUT_MEASUREMENT /begin SUB_FUNCTION AC_Override AC_Config /end SUB_FUNCTION /end FUNCTION
/begin FUNCTION AC_Control "" /begin SUB_FUNCTION AC /end SUB_FUNCTION /end FUNCTION
/begin FUNCTION Outputs ""
 /begin SUB_FUNCTION AC_Control AEM_Infinity_Dash Coil_Control Injector_Control HBridge ETC_CutPower FAN_Control_2 FuelPump IAC_Control WASTEGATE_Control /end SUB_FUNCTION
/end FUNCTION
/begin FUNCTION Foreground "" /begin SUB_FUNCTION Outputs Control Inputs /end SUB_FUNCTION /end FUNCTION
/begin FUNCTION BaseEngineController_LS ""
 /begin DEF_CHARACTERISTIC FaultCommand FaultManager.ACChargeHigh_Fault.Mode FaultManager.ACChargeHigh_Fault.ID FaultManager.ACChargeHigh_Fault.Test FaultManager.ACChargeHigh_Fault.Faulty_Samples__X_ FaultManager.ACChargeHigh_Fault.Total_Samples__Y_ FaultManager.ACChargeHigh_Fault.Action_1 FaultManager.ACChargeHigh_Fault.Action_1_Condition FaultManager.ACChargeHigh_Fault.Action_2 FaultManager.ACChargeHigh_Fault.Action_2_Condition FaultManager.ACChargeHigh_Fault.Action_3 FaultManager.ACChargeHigh_Fault.Action_3_Condition FaultManager.ACChargeHigh_Fault.Action_4 FaultManager.ACChargeHigh_Fault.Action_4_Condition FaultManager.ACChargeLow_Fault.Mode FaultManager.ACChargeLow_Fault.ID FaultManager.ACChargeLow_Fault.Test FaultManager.ACChargeLow_Fault.Faulty_Samples__X_ FaultManager.ACChargeLow_Fault.Total_Samples__Y_ FaultManager.ACChargeLow_Fault.Action_1 FaultManager.ACChargeLow_Fault.Action_1_Condition FaultManager.ACChargeLow_Fault.Action_2 FaultManager.ACChargeLow_Fault.Action_2_Condition FaultManager.ACChargeLow_Fault.Action_3 FaultManager.ACChargeLow_Fault.Action_3_Condition FaultManager.ACChargeLow_Fault.Action_4 FaultManager.ACChargeLow_Fault.Action_4_Condition FaultManager.ACPresRangeHigh.Mode FaultManager.ACPresRangeHigh.ID FaultManager.ACPresRangeHigh.Test FaultManager.ACPresRangeHigh.Faulty_Samples__X_ FaultManager.ACPresRangeHigh.Total_Samples__Y_ FaultManager.ACPresRangeHigh.Action_1 FaultManager.ACPresRangeHigh.Action_1_Condition FaultManager.ACPresRangeHigh.Action_2 FaultManager.ACPresRangeHigh.Action_2_Condition FaultManager.ACPresRangeHigh.Action_3 FaultManager.ACPresRangeHigh.Action_3_Condition FaultManager.ACPresRangeHigh.Action_4 FaultManager.ACPresRangeHigh.Action_4_Condition FaultManager.ACPresRangeLow.Mode FaultManager.ACPresRangeLow.ID FaultManager.ACPresRangeLow.Test FaultManager.ACPresRangeLow.Faulty_Samples__X_ FaultManager.ACPresRangeLow.Total_Samples__Y_ FaultManager.ACPresRangeLow.Action_1 FaultManager.ACPresRangeLow.Action_1_Condition FaultManager.ACPresRangeLow.Action_2 FaultManager.ACPresRangeLow.Action_2_Condition FaultManager.ACPresRangeLow.Action_3 FaultManager.ACPresRangeLow.Action_3_Condition FaultManager.ACPresRangeLow.Action_4 FaultManager.ACPresRangeLow.Action_4_Condition FaultManager.APP1RangeHigh.Mode FaultManager.APP1RangeHigh.ID FaultManager.APP1RangeHigh.Test FaultManager.APP1RangeHigh.Faulty_Samples__X_ FaultManager.APP1RangeHigh.Total_Samples__Y_ FaultManager.APP1RangeHigh.Action_1 FaultManager.APP1RangeHigh.Action_1_Condition FaultManager.APP1RangeHigh.Action_2 FaultManager.APP1RangeHigh.Action_2_Condition FaultManager.APP1RangeHigh.Action_3 FaultManager.APP1RangeHigh.Action_3_Condition FaultManager.APP1RangeHigh.Action_4 FaultManager.APP1RangeHigh.Action_4_Condition FaultManager.APP1RangeLow.Mode FaultManager.APP1RangeLow.ID FaultManager.APP1RangeLow.Test FaultManager.APP1RangeLow.Faulty_Samples__X_ FaultManager.APP1RangeLow.Total_Samples__Y_ FaultManager.APP1RangeLow.Action_1 FaultManager.APP1RangeLow.Action_1_Condition FaultManager.APP1RangeLow.Action_2 FaultManager.APP1RangeLow.Action_2_Condition FaultManager.APP1RangeLow.Action_3 FaultManager.APP1RangeLow.Action_3_Condition FaultManager.APP1RangeLow.Action_4 FaultManager.APP1RangeLow.Action_4_Condition FaultManager.APP1_AdaptAdaptHiMax.Mode FaultManager.APP1_AdaptAdaptHiMax.ID FaultManager.APP1_AdaptAdaptHiMax.Test FaultManager.APP1_AdaptAdaptHiMax.Faulty_Samples__X_ FaultManager.APP1_AdaptAdaptHiMax.Total_Samples__Y_ FaultManager.APP1_AdaptAdaptHiMax.Action_1 FaultManager.APP1_AdaptAdaptHiMax.Action_1_Condition FaultManager.APP1_AdaptAdaptHiMax.Action_2 FaultManager.APP1_AdaptAdaptHiMax.Action_2_Condition FaultManager.APP1_AdaptAdaptHiMax.Action_3 FaultManager.APP1_AdaptAdaptHiMax.Action_3_Condition FaultManager.APP1_AdaptAdaptHiMax.Action_4 FaultManager.APP1_AdaptAdaptHiMax.Action_4_Condition FaultManager.APP1_AdaptAdaptHiMin.Mode FaultManager.APP1_AdaptAdaptHiMin.ID FaultManager.APP1_AdaptAdaptHiMin.Test FaultManager.APP1_AdaptAdaptHiMin.Faulty_Samples__X_ FaultManager.APP1_AdaptAdaptHiMin.Total_Samples__Y_ FaultManager.APP1_AdaptAdaptHiMin.Action_1 FaultManager.APP1_AdaptAdaptHiMin.Action_1_Condition FaultManager.APP1_AdaptAdaptHiMin.Action_2 FaultManager.APP1_AdaptAdaptHiMin.Action_2_Condition FaultManager.APP1_AdaptAdaptHiMin.Action_3 FaultManager.APP1_AdaptAdaptHiMin.Action_3_Condition FaultManager.APP1_AdaptAdaptHiMin.Action_4 FaultManager.APP1_AdaptAdaptHiMin.Action_4_Condition FaultManager.APP1_AdaptAdaptLoMax.Mode FaultManager.APP1_AdaptAdaptLoMax.ID FaultManager.APP1_AdaptAdaptLoMax.Test FaultManager.APP1_AdaptAdaptLoMax.Faulty_Samples__X_ FaultManager.APP1_AdaptAdaptLoMax.Total_Samples__Y_ FaultManager.APP1_AdaptAdaptLoMax.Action_1 FaultManager.APP1_AdaptAdaptLoMax.Action_1_Condition FaultManager.APP1_AdaptAdaptLoMax.Action_2 FaultManager.APP1_AdaptAdaptLoMax.Action_2_Condition FaultManager.APP1_AdaptAdaptLoMax.Action_3 FaultManager.APP1_AdaptAdaptLoMax.Action_3_Condition FaultManager.APP1_AdaptAdaptLoMax.Action_4 FaultManager.APP1_AdaptAdaptLoMax.Action_4_Condition FaultManager.APP1_AdaptAdaptLoMin.Mode FaultManager.APP1_AdaptAdaptLoMin.ID FaultManager.APP1_AdaptAdaptLoMin.Test FaultManager.APP1_AdaptAdaptLoMin.Faulty_Samples__X_ FaultManager.APP1_AdaptAdaptLoMin.Total_Samples__Y_ FaultManager.APP1_AdaptAdaptLoMin.Action_1 FaultManager.APP1_AdaptAdaptLoMin.Action_1_Condition FaultManager.APP1_AdaptAdaptLoMin.Action_2 FaultManager.APP1_AdaptAdaptLoMin.Action_2_Condition FaultManager.APP1_AdaptAdaptLoMin.Action_3 FaultManager.APP1_AdaptAdaptLoMin.Action_3_Condition FaultManager.APP1_AdaptAdaptLoMin.Action_4 FaultManager.APP1_AdaptAdaptLoMin.Action_4_Condition FaultManager.APP1_AdaptRangeHigh.Mode FaultManager.APP1_AdaptRangeHigh.ID FaultManager.APP1_AdaptRangeHigh.Test FaultManager.APP1_AdaptRangeHigh.Faulty_Samples__X_ FaultManager.APP1_AdaptRangeHigh.Total_Samples__Y_ FaultManager.APP1_AdaptRangeHigh.Action_1 FaultManager.APP1_AdaptRangeHigh.Action_1_Condition FaultManager.APP1_AdaptRangeHigh.Action_2 FaultManager.APP1_AdaptRangeHigh.Action_2_Condition FaultManager.APP1_AdaptRangeHigh.Action_3 FaultManager.APP1_AdaptRangeHigh.Action_3_Condition FaultManager.APP1_AdaptRangeHigh.Action_4 FaultManager.APP1_AdaptRangeHigh.Action_4_Condition FaultManager.APP1_AdaptRangeLow.Mode FaultManager.APP1_AdaptRangeLow.ID FaultManager.APP1_AdaptRangeLow.Test FaultManager.APP1_AdaptRangeLow.Faulty_Samples__X_ FaultManager.APP1_AdaptRangeLow.Total_Samples__Y_ FaultManager.APP1_AdaptRangeLow.Action_1 FaultManager.APP1_AdaptRangeLow.Action_1_Condition FaultManager.APP1_AdaptRangeLow.Action_2 FaultManager.APP1_AdaptRangeLow.Action_2_Condition FaultManager.APP1_AdaptRangeLow.Action_3 FaultManager.APP1_AdaptRangeLow.Action_3_Condition FaultManager.APP1_AdaptRangeLow.Action_4 FaultManager.APP1_AdaptRangeLow.Action_4_Condition FaultManager.APP2RangeHigh.Mode FaultManager.APP2RangeHigh.ID FaultManager.APP2RangeHigh.Test FaultManager.APP2RangeHigh.Faulty_Samples__X_ FaultManager.APP2RangeHigh.Total_Samples__Y_ FaultManager.APP2RangeHigh.Action_1 FaultManager.APP2RangeHigh.Action_1_Condition FaultManager.APP2RangeHigh.Action_2 FaultManager.APP2RangeHigh.Action_2_Condition FaultManager.APP2RangeHigh.Action_3 FaultManager.APP2RangeHigh.Action_3_Condition FaultManager.APP2RangeHigh.Action_4 FaultManager.APP2RangeHigh.Action_4_Condition FaultManager.APP2RangeLow.Mode FaultManager.APP2RangeLow.ID FaultManager.APP2RangeLow.Test FaultManager.APP2RangeLow.Faulty_Samples__X_ FaultManager.APP2RangeLow.Total_Samples__Y_ FaultManager.APP2RangeLow.Action_1 FaultManager.APP2RangeLow.Action_1_Condition FaultManager.APP2RangeLow.Action_2 FaultManager.APP2RangeLow.Action_2_Condition FaultManager.APP2RangeLow.Action_3 FaultManager.APP2RangeLow.Action_3_Condition FaultManager.APP2RangeLow.Action_4 FaultManager.APP2RangeLow.Action_4_Condition FaultManager.APP2_AdaptAdaptHiMax.Mode FaultManager.APP2_AdaptAdaptHiMax.ID FaultManager.APP2_AdaptAdaptHiMax.Test FaultManager.APP2_AdaptAdaptHiMax.Faulty_Samples__X_ FaultManager.APP2_AdaptAdaptHiMax.Total_Samples__Y_ FaultManager.APP2_AdaptAdaptHiMax.Action_1 FaultManager.APP2_AdaptAdaptHiMax.Action_1_Condition FaultManager.APP2_AdaptAdaptHiMax.Action_2 FaultManager.APP2_AdaptAdaptHiMax.Action_2_Condition FaultManager.APP2_AdaptAdaptHiMax.Action_3 FaultManager.APP2_AdaptAdaptHiMax.Action_3_Condition FaultManager.APP2_AdaptAdaptHiMax.Action_4 FaultManager.APP2_AdaptAdaptHiMax.Action_4_Condition FaultManager.APP2_AdaptAdaptHiMin.Mode FaultManager.APP2_AdaptAdaptHiMin.ID FaultManager.APP2_AdaptAdaptHiMin.Test FaultManager.APP2_AdaptAdaptHiMin.Faulty_Samples__X_ FaultManager.APP2_AdaptAdaptHiMin.Total_Samples__Y_ FaultManager.APP2_AdaptAdaptHiMin.Action_1 FaultManager.APP2_AdaptAdaptHiMin.Action_1_Condition FaultManager.APP2_AdaptAdaptHiMin.Action_2 FaultManager.APP2_AdaptAdaptHiMin.Action_2_Condition FaultManager.APP2_AdaptAdaptHiMin.Action_3 FaultManager.APP2_AdaptAdaptHiMin.Action_3_Condition FaultManager.APP2_AdaptAdaptHiMin.Action_4 FaultManager.APP2_AdaptAdaptHiMin.Action_4_Condition FaultManager.APP2_AdaptAdaptLoMax.Mode FaultManager.APP2_AdaptAdaptLoMax.ID FaultManager.APP2_AdaptAdaptLoMax.Test FaultManager.APP2_AdaptAdaptLoMax.Faulty_Samples__X_ FaultManager.APP2_AdaptAdaptLoMax.Total_Samples__Y_ FaultManager.APP2_AdaptAdaptLoMax.Action_1 FaultManager.APP2_AdaptAdaptLoMax.Action_1_Condition FaultManager.APP2_AdaptAdaptLoMax.Action_2 FaultManager.APP2_AdaptAdaptLoMax.Action_2_Condition FaultManager.APP2_AdaptAdaptLoMax.Action_3 FaultManager.APP2_AdaptAdaptLoMax.Action_3_Condition FaultManager.APP2_AdaptAdaptLoMax.Action_4 FaultManager.APP2_AdaptAdaptLoMax.Action_4_Condition FaultManager.APP2_AdaptAdaptLoMin.Mode FaultManager.APP2_AdaptAdaptLoMin.ID FaultManager.APP2_AdaptAdaptLoMin.Test FaultManager.APP2_AdaptAdaptLoMin.Faulty_Samples__X_ FaultManager.APP2_AdaptAdaptLoMin.Total_Samples__Y_ FaultManager.APP2_AdaptAdaptLoMin.Action_1 FaultManager.APP2_AdaptAdaptLoMin.Action_1_Condition FaultManager.APP2_AdaptAdaptLoMin.Action_2 FaultManager.APP2_AdaptAdaptLoMin.Action_2_Condition FaultManager.APP2_AdaptAdaptLoMin.Action_3 FaultManager.APP2_AdaptAdaptLoMin.Action_3_Condition FaultManager.APP2_AdaptAdaptLoMin.Action_4 FaultManager.APP2_AdaptAdaptLoMin.Action_4_Condition FaultManager.APP2_AdaptRangeHigh.Mode FaultManager.APP2_AdaptRangeHigh.ID FaultManager.APP2_AdaptRangeHigh.Test FaultManager.APP2_AdaptRangeHigh.Faulty_Samples__X_ FaultManager.APP2_AdaptRangeHigh.Total_Samples__Y_ FaultManager.APP2_AdaptRangeHigh.Action_1 FaultManager.APP2_AdaptRangeHigh.Action_1_Condition FaultManager.APP2_AdaptRangeHigh.Action_2 FaultManager.APP2_AdaptRangeHigh.Action_2_Condition FaultManager.APP2_AdaptRangeHigh.Action_3 FaultManager.APP2_AdaptRangeHigh.Action_3_Condition FaultManager.APP2_AdaptRangeHigh.Action_4 FaultManager.APP2_AdaptRangeHigh.Action_4_Condition FaultManager.APP2_AdaptRangeLow.Mode FaultManager.APP2_AdaptRangeLow.ID FaultManager.APP2_AdaptRangeLow.Test FaultManager.APP2_AdaptRangeLow.Faulty_Samples__X_ FaultManager.APP2_AdaptRangeLow.Total_Samples__Y_ FaultManager.APP2_AdaptRangeLow.Action_1 FaultManager.APP2_AdaptRangeLow.Action_1_Condition FaultManager.APP2_AdaptRangeLow.Action_2 FaultManager.APP2_AdaptRangeLow.Action_2_Condition FaultManager.APP2_AdaptRangeLow.Action_3 FaultManager.APP2_AdaptRangeLow.Action_3_Condition FaultManager.APP2_AdaptRangeLow.Action_4 FaultManager.APP2_AdaptRangeLow.Action_4_Condition FaultManager.APP_Sensors_Conflict.Mode FaultManager.APP_Sensors_Conflict.ID FaultManager.APP_Sensors_Conflict.Test FaultManager.APP_Sensors_Conflict.Faulty_Samples__X_ FaultManager.APP_Sensors_Conflict.Total_Samples__Y_ FaultManager.APP_Sensors_Conflict.Action_1 FaultManager.APP_Sensors_Conflict.Action_1_Condition FaultManager.APP_Sensors_Conflict.Action_2 FaultManager.APP_Sensors_Conflict.Action_2_Condition FaultManager.APP_Sensors_Conflict.Action_3 FaultManager.APP_Sensors_Conflict.Action_3_Condition FaultManager.APP_Sensors_Conflict.Action_4 FaultManager.APP_Sensors_Conflict.Action_4_Condition FaultManager.Bank1_EquivRatioRangeHigh.Mode FaultManager.Bank1_EquivRatioRangeHigh.ID FaultManager.Bank1_EquivRatioRangeHigh.Test FaultManager.Bank1_EquivRatioRangeHigh.Faulty_Samples__X_ FaultManager.Bank1_EquivRatioRangeHigh.Total_Samples__Y_ FaultManager.Bank1_EquivRatioRangeHigh.Action_1 FaultManager.Bank1_EquivRatioRangeHigh.Action_1_Condition FaultManager.Bank1_EquivRatioRangeHigh.Action_2 FaultManager.Bank1_EquivRatioRangeHigh.Action_2_Condition FaultManager.Bank1_EquivRatioRangeHigh.Action_3 FaultManager.Bank1_EquivRatioRangeHigh.Action_3_Condition FaultManager.Bank1_EquivRatioRangeHigh.Action_4 FaultManager.Bank1_EquivRatioRangeHigh.Action_4_Condition FaultManager.Bank1_EquivRatioRangeLow.Mode FaultManager.Bank1_EquivRatioRangeLow.ID FaultManager.Bank1_EquivRatioRangeLow.Test FaultManager.Bank1_EquivRatioRangeLow.Faulty_Samples__X_ FaultManager.Bank1_EquivRatioRangeLow.Total_Samples__Y_ FaultManager.Bank1_EquivRatioRangeLow.Action_1 FaultManager.Bank1_EquivRatioRangeLow.Action_1_Condition FaultManager.Bank1_EquivRatioRangeLow.Action_2 FaultManager.Bank1_EquivRatioRangeLow.Action_2_Condition FaultManager.Bank1_EquivRatioRangeLow.Action_3 FaultManager.Bank1_EquivRatioRangeLow.Action_3_Condition FaultManager.Bank1_EquivRatioRangeLow.Action_4 FaultManager.Bank1_EquivRatioRangeLow.Action_4_Condition FaultManager.Bank2_EquivRatioRangeHigh.Mode FaultManager.Bank2_EquivRatioRangeHigh.ID FaultManager.Bank2_EquivRatioRangeHigh.Test FaultManager.Bank2_EquivRatioRangeHigh.Faulty_Samples__X_ FaultManager.Bank2_EquivRatioRangeHigh.Total_Samples__Y_ FaultManager.Bank2_EquivRatioRangeHigh.Action_1 FaultManager.Bank2_EquivRatioRangeHigh.Action_1_Condition FaultManager.Bank2_EquivRatioRangeHigh.Action_2 FaultManager.Bank2_EquivRatioRangeHigh.Action_2_Condition FaultManager.Bank2_EquivRatioRangeHigh.Action_3 FaultManager.Bank2_EquivRatioRangeHigh.Action_3_Condition FaultManager.Bank2_EquivRatioRangeHigh.Action_4 FaultManager.Bank2_EquivRatioRangeHigh.Action_4_Condition FaultManager.Bank2_EquivRatioRangeLow.Mode FaultManager.Bank2_EquivRatioRangeLow.ID FaultManager.Bank2_EquivRatioRangeLow.Test FaultManager.Bank2_EquivRatioRangeLow.Faulty_Samples__X_ FaultManager.Bank2_EquivRatioRangeLow.Total_Samples__Y_ FaultManager.Bank2_EquivRatioRangeLow.Action_1 FaultManager.Bank2_EquivRatioRangeLow.Action_1_Condition FaultManager.Bank2_EquivRatioRangeLow.Action_2 FaultManager.Bank2_EquivRatioRangeLow.Action_2_Condition FaultManager.Bank2_EquivRatioRangeLow.Action_3 FaultManager.Bank2_EquivRatioRangeLow.Action_3_Condition FaultManager.Bank2_EquivRatioRangeLow.Action_4 FaultManager.Bank2_EquivRatioRangeLow.Action_4_Condition FaultManager.CATRangeHigh.Mode FaultManager.CATRangeHigh.ID FaultManager.CATRangeHigh.Test FaultManager.CATRangeHigh.Faulty_Samples__X_ FaultManager.CATRangeHigh.Total_Samples__Y_ FaultManager.CATRangeHigh.Action_1 FaultManager.CATRangeHigh.Action_1_Condition FaultManager.CATRangeHigh.Action_2 FaultManager.CATRangeHigh.Action_2_Condition FaultManager.CATRangeHigh.Action_3 FaultManager.CATRangeHigh.Action_3_Condition FaultManager.CATRangeHigh.Action_4 FaultManager.CATRangeHigh.Action_4_Condition FaultManager.CATRangeLow.Mode FaultManager.CATRangeLow.ID FaultManager.CATRangeLow.Test FaultManager.CATRangeLow.Faulty_Samples__X_ FaultManager.CATRangeLow.Total_Samples__Y_ FaultManager.CATRangeLow.Action_1 FaultManager.CATRangeLow.Action_1_Condition FaultManager.CATRangeLow.Action_2 FaultManager.CATRangeLow.Action_2_Condition FaultManager.CATRangeLow.Action_3 FaultManager.CATRangeLow.Action_3_Condition FaultManager.CATRangeLow.Action_4 FaultManager.CATRangeLow.Action_4_Condition FaultManager.CamEdgesFault.Mode FaultManager.CamEdgesFault.ID FaultManager.CamEdgesFault.Test FaultManager.CamEdgesFault.Faulty_Samples__X_ FaultManager.CamEdgesFault.Total_Samples__Y_ FaultManager.CamEdgesFault.Action_1 FaultManager.CamEdgesFault.Action_1_Condition FaultManager.CamEdgesFault.Action_2 FaultManager.CamEdgesFault.Action_2_Condition FaultManager.CamEdgesFault.Action_3 FaultManager.CamEdgesFault.Action_3_Condition FaultManager.CamEdgesFault.Action_4 FaultManager.CamEdgesFault.Action_4_Condition FaultManager.CamSyncFault.Mode FaultManager.CamSyncFault.ID FaultManager.CamSyncFault.Test FaultManager.CamSyncFault.Faulty_Samples__X_ FaultManager.CamSyncFault.Total_Samples__Y_ FaultManager.CamSyncFault.Action_1 FaultManager.CamSyncFault.Action_1_Condition FaultManager.CamSyncFault.Action_2 FaultManager.CamSyncFault.Action_2_Condition FaultManager.CamSyncFault.Action_3 FaultManager.CamSyncFault.Action_3_Condition FaultManager.CamSyncFault.Action_4 FaultManager.CamSyncFault.Action_4_Condition FaultManager.CrankEdgesFault.Mode FaultManager.CrankEdgesFault.ID FaultManager.CrankEdgesFault.Test FaultManager.CrankEdgesFault.Faulty_Samples__X_ FaultManager.CrankEdgesFault.Total_Samples__Y_ FaultManager.CrankEdgesFault.Action_1 FaultManager.CrankEdgesFault.Action_1_Condition FaultManager.CrankEdgesFault.Action_2 FaultManager.CrankEdgesFault.Action_2_Condition FaultManager.CrankEdgesFault.Action_3 FaultManager.CrankEdgesFault.Action_3_Condition FaultManager.CrankEdgesFault.Action_4 FaultManager.CrankEdgesFault.Action_4_Condition FaultManager.CrankSyncFault.Mode FaultManager.CrankSyncFault.ID FaultManager.CrankSyncFault.Test FaultManager.CrankSyncFault.Faulty_Samples__X_ FaultManager.CrankSyncFault.Total_Samples__Y_ FaultManager.CrankSyncFault.Action_1 FaultManager.CrankSyncFault.Action_1_Condition FaultManager.CrankSyncFault.Action_2 FaultManager.CrankSyncFault.Action_2_Condition FaultManager.CrankSyncFault.Action_3 FaultManager.CrankSyncFault.Action_3_Condition FaultManager.CrankSyncFault.Action_4 FaultManager.CrankSyncFault.Action_4_Condition FaultManager.ECTOverTempFault.Mode FaultManager.ECTOverTempFault.ID FaultManager.ECTOverTempFault.Test FaultManager.ECTOverTempFault.Faulty_Samples__X_ FaultManager.ECTOverTempFault.Total_Samples__Y_ FaultManager.ECTOverTempFault.Action_1 FaultManager.ECTOverTempFault.Action_1_Condition FaultManager.ECTOverTempFault.Action_2 FaultManager.ECTOverTempFault.Action_2_Condition FaultManager.ECTOverTempFault.Action_3 FaultManager.ECTOverTempFault.Action_3_Condition FaultManager.ECTOverTempFault.Action_4 FaultManager.ECTOverTempFault.Action_4_Condition FaultManager.ECTRangeHigh.Mode FaultManager.ECTRangeHigh.ID FaultManager.ECTRangeHigh.Test FaultManager.ECTRangeHigh.Faulty_Samples__X_ FaultManager.ECTRangeHigh.Total_Samples__Y_ FaultManager.ECTRangeHigh.Action_1 FaultManager.ECTRangeHigh.Action_1_Condition FaultManager.ECTRangeHigh.Action_2 FaultManager.ECTRangeHigh.Action_2_Condition FaultManager.ECTRangeHigh.Action_3 FaultManager.ECTRangeHigh.Action_3_Condition FaultManager.ECTRangeHigh.Action_4 FaultManager.ECTRangeHigh.Action_4_Condition FaultManager.ECTRangeLow.Mode FaultManager.ECTRangeLow.ID FaultManager.ECTRangeLow.Test FaultManager.ECTRangeLow.Faulty_Samples__X_ FaultManager.ECTRangeLow.Total_Samples__Y_ FaultManager.ECTRangeLow.Action_1 FaultManager.ECTRangeLow.Action_1_Condition FaultManager.ECTRangeLow.Action_2 FaultManager.ECTRangeLow.Action_2_Condition FaultManager.ECTRangeLow.Action_3 FaultManager.ECTRangeLow.Action_3_Condition FaultManager.ECTRangeLow.Action_4 FaultManager.ECTRangeLow.Action_4_Condition FaultManager.ECTSevereOverTempFault.Mode FaultManager.ECTSevereOverTempFault.ID FaultManager.ECTSevereOverTempFault.Test FaultManager.ECTSevereOverTempFault.Faulty_Samples__X_ FaultManager.ECTSevereOverTempFault.Total_Samples__Y_ FaultManager.ECTSevereOverTempFault.Action_1 FaultManager.ECTSevereOverTempFault.Action_1_Condition FaultManager.ECTSevereOverTempFault.Action_2 FaultManager.ECTSevereOverTempFault.Action_2_Condition FaultManager.ECTSevereOverTempFault.Action_3 FaultManager.ECTSevereOverTempFault.Action_3_Condition FaultManager.ECTSevereOverTempFault.Action_4 FaultManager.ECTSevereOverTempFault.Action_4_Condition FaultManager.EST1_Open.Mode FaultManager.EST1_Open.ID FaultManager.EST1_Open.Test FaultManager.EST1_Open.Faulty_Samples__X_ FaultManager.EST1_Open.Total_Samples__Y_ FaultManager.EST1_Open.Action_1 FaultManager.EST1_Open.Action_1_Condition FaultManager.EST1_Open.Action_2 FaultManager.EST1_Open.Action_2_Condition FaultManager.EST1_Open.Action_3 FaultManager.EST1_Open.Action_3_Condition FaultManager.EST1_Open.Action_4 FaultManager.EST1_Open.Action_4_Condition FaultManager.EST1_Short.Mode FaultManager.EST1_Short.ID FaultManager.EST1_Short.Test FaultManager.EST1_Short.Faulty_Samples__X_ FaultManager.EST1_Short.Total_Samples__Y_ FaultManager.EST1_Short.Action_1 FaultManager.EST1_Short.Action_1_Condition FaultManager.EST1_Short.Action_2 FaultManager.EST1_Short.Action_2_Condition FaultManager.EST1_Short.Action_3 FaultManager.EST1_Short.Action_3_Condition FaultManager.EST1_Short.Action_4 FaultManager.EST1_Short.Action_4_Condition FaultManager.EST2_Open.Mode FaultManager.EST2_Open.ID FaultManager.EST2_Open.Test FaultManager.EST2_Open.Faulty_Samples__X_ FaultManager.EST2_Open.Total_Samples__Y_ FaultManager.EST2_Open.Action_1 FaultManager.EST2_Open.Action_1_Condition FaultManager.EST2_Open.Action_2 FaultManager.EST2_Open.Action_2_Condition FaultManager.EST2_Open.Action_3 FaultManager.EST2_Open.Action_3_Condition FaultManager.EST2_Open.Action_4 FaultManager.EST2_Open.Action_4_Condition FaultManager.EST2_Short.Mode FaultManager.EST2_Short.ID FaultManager.EST2_Short.Test FaultManager.EST2_Short.Faulty_Samples__X_ FaultManager.EST2_Short.Total_Samples__Y_ FaultManager.EST2_Short.Action_1 FaultManager.EST2_Short.Action_1_Condition FaultManager.EST2_Short.Action_2 FaultManager.EST2_Short.Action_2_Condition FaultManager.EST2_Short.Action_3 FaultManager.EST2_Short.Action_3_Condition FaultManager.EST2_Short.Action_4 FaultManager.EST2_Short.Action_4_Condition FaultManager.EST3_Open.Mode FaultManager.EST3_Open.ID FaultManager.EST3_Open.Test FaultManager.EST3_Open.Faulty_Samples__X_ FaultManager.EST3_Open.Total_Samples__Y_ FaultManager.EST3_Open.Action_1 FaultManager.EST3_Open.Action_1_Condition FaultManager.EST3_Open.Action_2 FaultManager.EST3_Open.Action_2_Condition FaultManager.EST3_Open.Action_3 FaultManager.EST3_Open.Action_3_Condition FaultManager.EST3_Open.Action_4 FaultManager.EST3_Open.Action_4_Condition FaultManager.EST3_Short.Mode FaultManager.EST3_Short.ID FaultManager.EST3_Short.Test FaultManager.EST3_Short.Faulty_Samples__X_ FaultManager.EST3_Short.Total_Samples__Y_ FaultManager.EST3_Short.Action_1 FaultManager.EST3_Short.Action_1_Condition FaultManager.EST3_Short.Action_2 FaultManager.EST3_Short.Action_2_Condition FaultManager.EST3_Short.Action_3 FaultManager.EST3_Short.Action_3_Condition FaultManager.EST3_Short.Action_4 FaultManager.EST3_Short.Action_4_Condition FaultManager.EST4_Open.Mode FaultManager.EST4_Open.ID FaultManager.EST4_Open.Test FaultManager.EST4_Open.Faulty_Samples__X_ FaultManager.EST4_Open.Total_Samples__Y_ FaultManager.EST4_Open.Action_1 FaultManager.EST4_Open.Action_1_Condition FaultManager.EST4_Open.Action_2 FaultManager.EST4_Open.Action_2_Condition FaultManager.EST4_Open.Action_3 FaultManager.EST4_Open.Action_3_Condition FaultManager.EST4_Open.Action_4 FaultManager.EST4_Open.Action_4_Condition FaultManager.EST4_Short.Mode FaultManager.EST4_Short.ID FaultManager.EST4_Short.Test FaultManager.EST4_Short.Faulty_Samples__X_ FaultManager.EST4_Short.Total_Samples__Y_ FaultManager.EST4_Short.Action_1 FaultManager.EST4_Short.Action_1_Condition FaultManager.EST4_Short.Action_2 FaultManager.EST4_Short.Action_2_Condition FaultManager.EST4_Short.Action_3 FaultManager.EST4_Short.Action_3_Condition FaultManager.EST4_Short.Action_4 FaultManager.EST4_Short.Action_4_Condition FaultManager.EST5_Open.Mode FaultManager.EST5_Open.ID FaultManager.EST5_Open.Test FaultManager.EST5_Open.Faulty_Samples__X_ FaultManager.EST5_Open.Total_Samples__Y_ FaultManager.EST5_Open.Action_1 FaultManager.EST5_Open.Action_1_Condition FaultManager.EST5_Open.Action_2 FaultManager.EST5_Open.Action_2_Condition FaultManager.EST5_Open.Action_3 FaultManager.EST5_Open.Action_3_Condition FaultManager.EST5_Open.Action_4 FaultManager.EST5_Open.Action_4_Condition FaultManager.EST5_Short.Mode FaultManager.EST5_Short.ID FaultManager.EST5_Short.Test FaultManager.EST5_Short.Faulty_Samples__X_ FaultManager.EST5_Short.Total_Samples__Y_ FaultManager.EST5_Short.Action_1 FaultManager.EST5_Short.Action_1_Condition FaultManager.EST5_Short.Action_2 FaultManager.EST5_Short.Action_2_Condition FaultManager.EST5_Short.Action_3 FaultManager.EST5_Short.Action_3_Condition FaultManager.EST5_Short.Action_4 FaultManager.EST5_Short.Action_4_Condition FaultManager.EST6_Open.Mode FaultManager.EST6_Open.ID FaultManager.EST6_Open.Test FaultManager.EST6_Open.Faulty_Samples__X_ FaultManager.EST6_Open.Total_Samples__Y_ FaultManager.EST6_Open.Action_1 FaultManager.EST6_Open.Action_1_Condition FaultManager.EST6_Open.Action_2 FaultManager.EST6_Open.Action_2_Condition FaultManager.EST6_Open.Action_3 FaultManager.EST6_Open.Action_3_Condition FaultManager.EST6_Open.Action_4 FaultManager.EST6_Open.Action_4_Condition FaultManager.EST6_Short.Mode FaultManager.EST6_Short.ID FaultManager.EST6_Short.Test FaultManager.EST6_Short.Faulty_Samples__X_ FaultManager.EST6_Short.Total_Samples__Y_ FaultManager.EST6_Short.Action_1 FaultManager.EST6_Short.Action_1_Condition FaultManager.EST6_Short.Action_2 FaultManager.EST6_Short.Action_2_Condition FaultManager.EST6_Short.Action_3 FaultManager.EST6_Short.Action_3_Condition FaultManager.EST6_Short.Action_4 FaultManager.EST6_Short.Action_4_Condition FaultManager.EST7_Open.Mode FaultManager.EST7_Open.ID FaultManager.EST7_Open.Test FaultManager.EST7_Open.Faulty_Samples__X_ FaultManager.EST7_Open.Total_Samples__Y_ FaultManager.EST7_Open.Action_1 FaultManager.EST7_Open.Action_1_Condition FaultManager.EST7_Open.Action_2 FaultManager.EST7_Open.Action_2_Condition FaultManager.EST7_Open.Action_3 FaultManager.EST7_Open.Action_3_Condition FaultManager.EST7_Open.Action_4 FaultManager.EST7_Open.Action_4_Condition /end DEF_CHARACTERISTIC
 /begin OUT_MEASUREMENT FaultMarquees.FaultMarquees.Current_Suspected FaultMarquees.FaultMarquees.Current_Active FaultMarquees.FaultMarquees.Current_Occurred /end OUT_MEASUREMENT
 /begin SUB_FUNCTION Foreground Action_Reasons /end SUB_FUNCTION
/end FUNCTION
/end MODULE
/end PROJECT
