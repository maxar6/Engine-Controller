/******************************************************************************
* ASAP2 descrition file /
* Generated by Woodward ASAP2 Generator /
* This file was auto-generated on: Saturday, November 12, 2022 8:09 PM /
******************************************************************************/
ASAP2_VERSION 1 51
/begin PROJECT Project ""
/begin MODULE BaseEngin_028 ""
/begin IF_DATA VISION DEVICE_SETTING "CCP=2.1_ASAP1b" DEVICE_SETTING "DefaultCRCType=5" /end IF_DATA
/begin IF_DATA ASAP1B_CCP
 /begin SOURCE "List 1" 0 0 DISPLAY_IDENTIFIER "DAQ1"
  /begin QP_BLOB 0 LENGTH 8 CAN_ID_FIXED 0x98EF3102 RASTER 0 REDUCTION_ALLOWED FIRST_PID 0 /end QP_BLOB
 /end SOURCE
 /begin SOURCE "List 2" 0 0 DISPLAY_IDENTIFIER "DAQ2"
  /begin QP_BLOB 1 LENGTH 8 CAN_ID_FIXED 0x98EF3102 RASTER 1 REDUCTION_ALLOWED FIRST_PID 8 /end QP_BLOB
 /end SOURCE
 /begin SOURCE "List 3" 0 0 DISPLAY_IDENTIFIER "DAQ3"
  /begin QP_BLOB 2 LENGTH 8 CAN_ID_FIXED 0x98EF3102 RASTER 2 REDUCTION_ALLOWED FIRST_PID 16 /end QP_BLOB
 /end SOURCE
 /begin SOURCE "List 4" 0 0 DISPLAY_IDENTIFIER "DAQ4"
  /begin QP_BLOB 3 LENGTH 8 CAN_ID_FIXED 0x98EF3102 RASTER 3 REDUCTION_ALLOWED FIRST_PID 24 /end QP_BLOB
 /end SOURCE
 /begin SOURCE "List 5" 0 0 DISPLAY_IDENTIFIER "DAQ5"
  /begin QP_BLOB 4 LENGTH 8 CAN_ID_FIXED 0x98EF3102 RASTER 4 REDUCTION_ALLOWED FIRST_PID 32 /end QP_BLOB
 /end SOURCE
 /begin SOURCE "List 6" 0 0 DISPLAY_IDENTIFIER "DAQ6"
  /begin QP_BLOB 5 LENGTH 8 CAN_ID_FIXED 0x98EF3102 RASTER 5 REDUCTION_ALLOWED FIRST_PID 40 /end QP_BLOB
 /end SOURCE
 /begin SOURCE "List 7" 0 0 DISPLAY_IDENTIFIER "DAQ7"
  /begin QP_BLOB 6 LENGTH 8 CAN_ID_FIXED 0x98EF3102 RASTER 6 REDUCTION_ALLOWED FIRST_PID 48 /end QP_BLOB
 /end SOURCE
 /begin SOURCE "List 8" 0 0 DISPLAY_IDENTIFIER "DAQ8"
  /begin QP_BLOB 7 LENGTH 8 CAN_ID_FIXED 0x98EF3102 RASTER 7 REDUCTION_ALLOWED FIRST_PID 56 /end QP_BLOB
 /end SOURCE
 /begin SOURCE "List 9" 0 0 DISPLAY_IDENTIFIER "DAQ9"
  /begin QP_BLOB 8 LENGTH 8 CAN_ID_FIXED 0x98EF3102 RASTER 7 REDUCTION_ALLOWED FIRST_PID 64 /end QP_BLOB
 /end SOURCE
 /begin SOURCE "List 10" 0 0 DISPLAY_IDENTIFIER "DAQ10"
  /begin QP_BLOB 9 LENGTH 8 CAN_ID_FIXED 0x98EF3102 RASTER 7 REDUCTION_ALLOWED FIRST_PID 72 /end QP_BLOB
 /end SOURCE
 /begin RASTER "FGND_RTI_PERIODIC" "FGND_RTI_PERIODIC" 0 3 5 /end RASTER
 /begin RASTER "FGND_5XRTI_PERIODIC" "FGND_5XRTI_PERIODIC" 1 3 25 /end RASTER
 /begin RASTER "FGND_MID_TDC_EVENT" "FGND_MID_TDC_EVENT" 2 103 1 /end RASTER
 /begin RASTER "FGND_20XRTI_PERIODIC" "FGND_20XRTI_PERIODIC" 3 3 100 /end RASTER
 /begin RASTER "BGND_BASE_PERIODIC" "BGND_BASE_PERIODIC" 4 3 50 /end RASTER
 /begin RASTER "BGND_BASEx2_PERIODIC" "BGND_BASEx2_PERIODIC" 5 3 100 /end RASTER
 /begin RASTER "BGND_BASEx10_PERIODIC" "BGND_BASEx10_PERIODIC" 6 3 500 /end RASTER
 /begin RASTER "ONE_SECOND_EVENT" "ONE_SECOND_EVENT" 7 3 1000 /end RASTER
 /* /begin SEED_KEY */ /* DLL for CAL */ /* Uncomment and supply a value "SecurityCAL.dll" */ /* DLL for DAQ */ /* Uncomment and supply a value "SecurityDAQ.dll" */ /* DLL for PGM */ /* Uncomment and supply a value "SecurityPGM.dll" */ /* /end SEED_KEY */
 /begin TP_BLOB /* CCP version */ 0x201 /* Blob version */ 0x204 /* CAN msg ID - send */ 0x98EF0231 /* CAN msg ID - recv */ 0x98EF3102 /* Station address */ 0x31 /* byte order */ 1 BAUDRATE 500000 SAMPLE_RATE 1 SAMPLE_POINT 75 BTL_CYCLES 8 SJW 2 SYNC_EDGE SINGLE DAQ_MODE BURST CONSISTENCY ODT ADDRESS_EXTENSION DAQ
  /begin CHECKSUM_PARAM /* algorithm */ 0x8009 /* limit */ 0x1000 CHECKSUM_CALCULATION ACTIVE_PAGE /end CHECKSUM_PARAM
  /begin DEFINED_PAGES /* Memory page num */ 1 /* Page Name */ "working page" /* address ext. */ 0x00 /* base address */ 0x80000000 /* page length */ 0x000063F8 RAM /* memory page in RAM */ RAM_INIT_BY_ECU /* memory page is initialised by ECU start-up */ /end DEFINED_PAGES
  OPTIONAL_CMD 0x5 /* TEST */ OPTIONAL_CMD 0x8 /* START_STOP_ALL */ OPTIONAL_CMD 0xC /* SET_S_STATUS */ OPTIONAL_CMD 0xD /* GET_S_STATUS */ OPTIONAL_CMD 0xE /* BUILD_CHECKSUM */ OPTIONAL_CMD 0xF /* SHORT_UP */ OPTIONAL_CMD 0x12 /* GET_SEED */ OPTIONAL_CMD 0x13 /* UNLOCK */ OPTIONAL_CMD 0x23 /* DNLOAD_6 */ /end TP_BLOB
/end IF_DATA
/*~~~~~~~~~ 6.3.91 MOD_PAR ~~~~~~~~~*/
/begin MOD_PAR /* MOD_PAR Comment*/ "" ECU_CALIBRATION_OFFSET 0x00000000
 /begin MEMORY_SEGMENT CAL "" DATA FLASH INTERN 0x80000000 /* Size */ 0x000063F8 /* Offset */ -1 -1 -1 -1 -1 /end MEMORY_SEGMENT
 /begin MEMORY_SEGMENT MeasRAM "" VARIABLES RAM INTERN 0x40000000 /* Size */ 0x00000B8F /* Offset */ -1 -1 -1 -1 -1 /end MEMORY_SEGMENT
/end MOD_PAR
/begin MOD_COMMON /* MOD_COMMON Comment */ "" BYTE_ORDER MSB_FIRST ALIGNMENT_BYTE 1 ALIGNMENT_FLOAT32_IEEE 1 ALIGNMENT_FLOAT64_IEEE 1 ALIGNMENT_LONG 1 ALIGNMENT_WORD 1 /end MOD_COMMON
/*~~~~~~~~~ 6.3.86 MEASUREMENTs ~~~~~~~~~*/
/begin MEASUREMENT table_0_rev "VarDec Table0 Revision Number" UBYTE CompuMethod_1 1 0 0 255 ECU_ADDRESS 0x40000000 /end MEASUREMENT
/begin MEASUREMENT table_1_rev "VarDec Table1 Revision Number" UBYTE CompuMethod_1 1 0 0 255 ECU_ADDRESS 0x40000001 /end MEASUREMENT
/begin MEASUREMENT table_2_rev "VarDec Table2 Revision Number" UBYTE CompuMethod_1 1 0 0 255 ECU_ADDRESS 0x40000002 /end MEASUREMENT
/begin MEASUREMENT KeyRev "This is the revision for the key protocol." UBYTE CompuMethod_1 1 0 0 255 ECU_ADDRESS 0x40000003 /end MEASUREMENT
/begin MEASUREMENT EriRev "This is the revision for the ERI protocol." UBYTE CompuMethod_1 1 0 0 255 ECU_ADDRESS 0x40000004 /end MEASUREMENT
/begin MEASUREMENT table_3_rev "VarDec Table3 Revision Number" UBYTE CompuMethod_1 1 0 0 255 ECU_ADDRESS 0x40000005 /end MEASUREMENT
/begin MEASUREMENT table_4_rev "VarDec Table4 Revision Number" UBYTE CompuMethod_1 1 0 0 255 ECU_ADDRESS 0x40000006 /end MEASUREMENT
/begin MEASUREMENT table_5_rev "VarDec Table5 Revision Number" UBYTE CompuMethod_1 1 0 0 255 ECU_ADDRESS 0x40000007 /end MEASUREMENT
/begin MEASUREMENT table_6_rev "VarDec Table6 Revision Number" UBYTE CompuMethod_1 1 0 0 255 ECU_ADDRESS 0x40000008 /end MEASUREMENT
/begin MEASUREMENT table_7_rev "VarDec Table7 Revision Number" UBYTE CompuMethod_1 1 0 0 255 ECU_ADDRESS 0x40000009 /end MEASUREMENT
/begin MEASUREMENT MotProgRev "This is the revision for the MOTPROG protocol." UBYTE CompuMethod_1 1 0 0 255 ECU_ADDRESS 0x40000049 /end MEASUREMENT
/begin MEASUREMENT BootVerMaj "" UBYTE CompuMethod_1 1 0 0 255 ECU_ADDRESS 0x4000004A /end MEASUREMENT
/begin MEASUREMENT BootVerMin "" UBYTE CompuMethod_1 1 0 0 255 ECU_ADDRESS 0x4000004B /end MEASUREMENT
/begin MEASUREMENT EcuHwMaj "" UBYTE CompuMethod_1 1 0 0 255 ECU_ADDRESS 0x4000004C /end MEASUREMENT
/begin MEASUREMENT EcuHwMin "" UBYTE CompuMethod_1 1 0 0 255 ECU_ADDRESS 0x4000004D /end MEASUREMENT
/begin MEASUREMENT ApplicationCompatibilityArr "Software Format ID" UWORD CompuMethod_2 1 0 0 65535 ECU_ADDRESS 0x4000004E MATRIX_DIM 1 50 1 /end MEASUREMENT
/begin MEASUREMENT AC "Display output in engineering units" UBYTE CompuMethod_4 1 0 0 1 ECU_ADDRESS 0x40000116 /end MEASUREMENT
/begin MEASUREMENT ConfigVerMaj "" UBYTE CompuMethod_1 1 0 0 255 ECU_ADDRESS 0x40000340 /end MEASUREMENT
/begin MEASUREMENT ConfigVerMin "" UBYTE CompuMethod_1 1 0 0 255 ECU_ADDRESS 0x40000341 /end MEASUREMENT
/begin MEASUREMENT FaultMarquees.FaultMarquees.Current_Suspected "Displays a rolling marquee for suspected, active and occurred faults." UBYTE CompuMethod_109 1 0 0 255 ECU_ADDRESS 0x40000545 /end MEASUREMENT
/begin MEASUREMENT FaultMarquees.FaultMarquees.Current_Active "Displays a rolling marquee for suspected, active and occurred faults." UBYTE CompuMethod_109 1 0 0 255 ECU_ADDRESS 0x40000546 /end MEASUREMENT
/begin MEASUREMENT FaultMarquees.FaultMarquees.Current_Occurred "Displays a rolling marquee for suspected, active and occurred faults." UBYTE CompuMethod_109 1 0 0 255 ECU_ADDRESS 0x40000547 /end MEASUREMENT
/begin MEASUREMENT LinkStatus "This is the Status of the Comms link." UBYTE CompuMethod_1 1 0 0 255 ECU_ADDRESS 0x400006DC /end MEASUREMENT
/begin MEASUREMENT ModuleCapability "" UBYTE CompuMethod_149 1 0 0 255 ECU_ADDRESS 0x400007DC /end MEASUREMENT
/begin MEASUREMENT MotoHawkModelSecondsInUse "Total runtime of this MotoHawk software model" ULONG CompuMethod_150 1 0 0 4294970000 ECU_ADDRESS 0x400008CD /end MEASUREMENT
/begin MEASUREMENT SystemFrequency "The operating CPU frequency." ULONG CompuMethod_177 1 0 0 56 ECU_ADDRESS 0x40000A92 /end MEASUREMENT
/begin MEASUREMENT TPUMaskType "Describes the TPU Mask selected for use." UBYTE CompuMethod_179 1 0 0 0 ECU_ADDRESS 0x40000B18 /end MEASUREMENT
/begin MEASUREMENT TPUMaskVers "Describes the version of the TPU Mask selected." UBYTE CompuMethod_11 1 0 0 255 ECU_ADDRESS 0x40000B19 /end MEASUREMENT
/begin MEASUREMENT Unused "Unused Table Entry" UBYTE CompuMethod_1 1 0 0 255 ECU_ADDRESS 0x40000B24 /end MEASUREMENT
/*~~~~~~~~~ 6.3.27 CHARACTERISTICs ~~~~~~~~~*/
/begin CHARACTERISTIC project_id "This is the Platform ID used by the tools." VALUE 0x800063F7 RecordLayout_1 0 CompuMethod_1 0 255 /end CHARACTERISTIC
/begin CHARACTERISTIC SwIdTxt "Software Format ID" ASCII 0x4000000A RecordLayout_2 0 CompuMethod_2 0 255 NUMBER 13 MATRIX_DIM 13 1 1 READ_ONLY /end CHARACTERISTIC
/begin CHARACTERISTIC CalIdTxt "Calibration ID" ASCII 0x80000002 RecordLayout_2 0 CompuMethod_2 0 255 NUMBER 33 MATRIX_DIM 33 1 1 /end CHARACTERISTIC
/begin CHARACTERISTIC SwRevisionTxt "Software Revision ID" ASCII 0x40000017 RecordLayout_2 0 CompuMethod_2 0 255 NUMBER 50 MATRIX_DIM 50 1 1 READ_ONLY /end CHARACTERISTIC
/begin CHARACTERISTIC FriendlyName "The device's friendly name." ASCII 0x8000002C RecordLayout_2 0 CompuMethod_2 0 255 NUMBER 33 MATRIX_DIM 33 1 1 /end CHARACTERISTIC
/begin CHARACTERISTIC ProductID "Customer's ID used by the tools." VALUE 0x8000004D RecordLayout_3 0 CompuMethod_3 0 4294970000 /end CHARACTERISTIC
/begin CHARACTERISTIC SerialNumber "" ASCII 0x400000B2 RecordLayout_2 0 CompuMethod_2 0 255 NUMBER 50 MATRIX_DIM 50 1 1 READ_ONLY /end CHARACTERISTIC
/begin CHARACTERISTIC ModelNumber "" ASCII 0x400000E4 RecordLayout_2 0 CompuMethod_2 0 255 NUMBER 50 MATRIX_DIM 50 1 1 READ_ONLY /end CHARACTERISTIC
/begin CHARACTERISTIC CompilerVersion "Compiler toolchain version used for the MotoHawk build" ASCII 0x400002F0 RecordLayout_2 0 CompuMethod_2 0 255 NUMBER 80 MATRIX_DIM 80 1 1 READ_ONLY /end CHARACTERISTIC
/begin CHARACTERISTIC ControlCoreSDKRelease "ControlCoreSDK Build." ASCII 0x40000342 RecordLayout_2 0 CompuMethod_2 0 255 NUMBER 50 MATRIX_DIM 50 1 1 READ_ONLY /end CHARACTERISTIC
/begin CHARACTERISTIC FaultCommand "Select a command to control the fault manager." VALUE 0x8000297C RecordLayout_1 0 CompuMethod_110 0 255 /end CHARACTERISTIC
/begin CHARACTERISTIC FaultManager.ACChargeHigh_Fault.Mode "Fault manager configuration.  Select up to 4 actions for each fault." VALUE 0x8000297D RecordLayout_4 0 CompuMethod_111 0 65535 /end CHARACTERISTIC
/begin CHARACTERISTIC FaultManager.ACChargeHigh_Fault.ID "Fault manager configuration.  Select up to 4 actions for each fault." VALUE 0x8000297F RecordLayout_4 0 CompuMethod_1 0 65535 /end CHARACTERISTIC
/begin CHARACTERISTIC FaultManager.ACChargeHigh_Fault.Test "Fault manager configuration.  Select up to 4 actions for each fault." VALUE 0x80002981 RecordLayout_4 0 CompuMethod_112 0 65535 /end CHARACTERISTIC
/begin CHARACTERISTIC FaultManager.ACChargeHigh_Fault.Faulty_Samples__X_ "Fault manager configuration.  Select up to 4 actions for each fault." VALUE 0x80002983 RecordLayout_4 0 CompuMethod_1 0 65535 /end CHARACTERISTIC
/begin CHARACTERISTIC FaultManager.ACChargeHigh_Fault.Total_Samples__Y_ "Fault manager configuration.  Select up to 4 actions for each fault." VALUE 0x80002985 RecordLayout_4 0 CompuMethod_1 0 65535 /end CHARACTERISTIC
/begin CHARACTERISTIC FaultManager.ACChargeHigh_Fault.Action_1 "Fault manager configuration.  Select up to 4 actions for each fault." VALUE 0x80002987 RecordLayout_4 0 CompuMethod_113 0 65535 /end CHARACTERISTIC
/begin CHARACTERISTIC FaultManager.ACChargeHigh_Fault.Action_1_Condition "Fault manager configuration.  Select up to 4 actions for each fault." VALUE 0x80002989 RecordLayout_4 0 CompuMethod_114 0 65535 /end CHARACTERISTIC
/begin CHARACTERISTIC FaultManager.ACChargeHigh_Fault.Action_2 "Fault manager configuration.  Select up to 4 actions for each fault." VALUE 0x8000298B RecordLayout_4 0 CompuMethod_113 0 65535 /end CHARACTERISTIC
/begin CHARACTERISTIC FaultManager.ACChargeHigh_Fault.Action_2_Condition "Fault manager configuration.  Select up to 4 actions for each fault." VALUE 0x8000298D RecordLayout_4 0 CompuMethod_114 0 65535 /end CHARACTERISTIC
/begin CHARACTERISTIC FaultManager.ACChargeHigh_Fault.Action_3 "Fault manager configuration.  Select up to 4 actions for each fault." VALUE 0x8000298F RecordLayout_4 0 CompuMethod_113 0 65535 /end CHARACTERISTIC
/begin CHARACTERISTIC FaultManager.ACChargeHigh_Fault.Action_3_Condition "Fault manager configuration.  Select up to 4 actions for each fault." VALUE 0x80002991 RecordLayout_4 0 CompuMethod_114 0 65535 /end CHARACTERISTIC
/begin CHARACTERISTIC FaultManager.ACChargeHigh_Fault.Action_4 "Fault manager configuration.  Select up to 4 actions for each fault." VALUE 0x80002993 RecordLayout_4 0 CompuMethod_113 0 65535 /end CHARACTERISTIC
/begin CHARACTERISTIC FaultManager.ACChargeHigh_Fault.Action_4_Condition "Fault manager configuration.  Select up to 4 actions for each fault." VALUE 0x80002995 RecordLayout_4 0 CompuMethod_114 0 65535 /end CHARACTERISTIC
/begin CHARACTERISTIC FaultManager.ACChargeLow_Fault.Mode "Fault manager configuration.  Select up to 4 actions for each fault." VALUE 0x80002997 RecordLayout_4 0 CompuMethod_111 0 65535 /end CHARACTERISTIC
/begin CHARACTERISTIC FaultManager.ACChargeLow_Fault.ID "Fault manager configuration.  Select up to 4 actions for each fault." VALUE 0x80002999 RecordLayout_4 0 CompuMethod_1 0 65535 /end CHARACTERISTIC
/begin CHARACTERISTIC FaultManager.ACChargeLow_Fault.Test "Fault manager configuration.  Select up to 4 actions for each fault." VALUE 0x8000299B RecordLayout_4 0 CompuMethod_112 0 65535 /end CHARACTERISTIC
/begin CHARACTERISTIC FaultManager.ACChargeLow_Fault.Faulty_Samples__X_ "Fault manager configuration.  Select up to 4 actions for each fault." VALUE 0x8000299D RecordLayout_4 0 CompuMethod_1 0 65535 /end CHARACTERISTIC
/begin CHARACTERISTIC FaultManager.ACChargeLow_Fault.Total_Samples__Y_ "Fault manager configuration.  Select up to 4 actions for each fault." VALUE 0x8000299F RecordLayout_4 0 CompuMethod_1 0 65535 /end CHARACTERISTIC
/begin CHARACTERISTIC FaultManager.ACChargeLow_Fault.Action_1 "Fault manager configuration.  Select up to 4 actions for each fault." VALUE 0x800029A1 RecordLayout_4 0 CompuMethod_113 0 65535 /end CHARACTERISTIC
/begin CHARACTERISTIC FaultManager.ACChargeLow_Fault.Action_1_Condition "Fault manager configuration.  Select up to 4 actions for each fault." VALUE 0x800029A3 RecordLayout_4 0 CompuMethod_114 0 65535 /end CHARACTERISTIC
/begin CHARACTERISTIC FaultManager.ACChargeLow_Fault.Action_2 "Fault manager configuration.  Select up to 4 actions for each fault." VALUE 0x800029A5 RecordLayout_4 0 CompuMethod_113 0 65535 /end CHARACTERISTIC
/begin CHARACTERISTIC FaultManager.ACChargeLow_Fault.Action_2_Condition "Fault manager configuration.  Select up to 4 actions for each fault." VALUE 0x800029A7 RecordLayout_4 0 CompuMethod_114 0 65535 /end CHARACTERISTIC
/begin CHARACTERISTIC FaultManager.ACChargeLow_Fault.Action_3 "Fault manager configuration.  Select up to 4 actions for each fault." VALUE 0x800029A9 RecordLayout_4 0 CompuMethod_113 0 65535 /end CHARACTERISTIC
/begin CHARACTERISTIC FaultManager.ACChargeLow_Fault.Action_3_Condition "Fault manager configuration.  Select up to 4 actions for each fault." VALUE 0x800029AB RecordLayout_4 0 CompuMethod_114 0 65535 /end CHARACTERISTIC
/begin CHARACTERISTIC FaultManager.ACChargeLow_Fault.Action_4 "Fault manager configuration.  Select up to 4 actions for each fault." VALUE 0x800029AD RecordLayout_4 0 CompuMethod_113 0 65535 /end CHARACTERISTIC
/begin CHARACTERISTIC FaultManager.ACChargeLow_Fault.Action_4_Condition "Fault manager configuration.  Select up to 4 actions for each fault." VALUE 0x800029AF RecordLayout_4 0 CompuMethod_114 0 65535 /end CHARACTERISTIC
/begin CHARACTERISTIC FaultManager.ACPresRangeHigh.Mode "Fault manager configuration.  Select up to 4 actions for each fault." VALUE 0x800029B1 RecordLayout_4 0 CompuMethod_111 0 65535 /end CHARACTERISTIC
/begin CHARACTERISTIC FaultManager.ACPresRangeHigh.ID "Fault manager configuration.  Select up to 4 actions for each fault." VALUE 0x800029B3 RecordLayout_4 0 CompuMethod_1 0 65535 /end CHARACTERISTIC
/begin CHARACTERISTIC FaultManager.ACPresRangeHigh.Test "Fault manager configuration.  Select up to 4 actions for each fault." VALUE 0x800029B5 RecordLayout_4 0 CompuMethod_112 0 65535 /end CHARACTERISTIC
/begin CHARACTERISTIC FaultManager.ACPresRangeHigh.Faulty_Samples__X_ "Fault manager configuration.  Select up to 4 actions for each fault." VALUE 0x800029B7 RecordLayout_4 0 CompuMethod_1 0 65535 /end CHARACTERISTIC
/begin CHARACTERISTIC FaultManager.ACPresRangeHigh.Total_Samples__Y_ "Fault manager configuration.  Select up to 4 actions for each fault." VALUE 0x800029B9 RecordLayout_4 0 CompuMethod_1 0 65535 /end CHARACTERISTIC
/begin CHARACTERISTIC FaultManager.ACPresRangeHigh.Action_1 "Fault manager configuration.  Select up to 4 actions for each fault." VALUE 0x800029BB RecordLayout_4 0 CompuMethod_113 0 65535 /end CHARACTERISTIC
/begin CHARACTERISTIC FaultManager.ACPresRangeHigh.Action_1_Condition "Fault manager configuration.  Select up to 4 actions for each fault." VALUE 0x800029BD RecordLayout_4 0 CompuMethod_114 0 65535 /end CHARACTERISTIC
/begin CHARACTERISTIC FaultManager.ACPresRangeHigh.Action_2 "Fault manager configuration.  Select up to 4 actions for each fault." VALUE 0x800029BF RecordLayout_4 0 CompuMethod_113 0 65535 /end CHARACTERISTIC
/begin CHARACTERISTIC FaultManager.ACPresRangeHigh.Action_2_Condition "Fault manager configuration.  Select up to 4 actions for each fault." VALUE 0x800029C1 RecordLayout_4 0 CompuMethod_114 0 65535 /end CHARACTERISTIC
/begin CHARACTERISTIC FaultManager.ACPresRangeHigh.Action_3 "Fault manager configuration.  Select up to 4 actions for each fault." VALUE 0x800029C3 RecordLayout_4 0 CompuMethod_113 0 65535 /end CHARACTERISTIC
/begin CHARACTERISTIC FaultManager.ACPresRangeHigh.Action_3_Condition "Fault manager configuration.  Select up to 4 actions for each fault." VALUE 0x800029C5 RecordLayout_4 0 CompuMethod_114 0 65535 /end CHARACTERISTIC
/begin CHARACTERISTIC FaultManager.ACPresRangeHigh.Action_4 "Fault manager configuration.  Select up to 4 actions for each fault." VALUE 0x800029C7 RecordLayout_4 0 CompuMethod_113 0 65535 /end CHARACTERISTIC
/begin CHARACTERISTIC FaultManager.ACPresRangeHigh.Action_4_Condition "Fault manager configuration.  Select up to 4 actions for each fault." VALUE 0x800029C9 RecordLayout_4 0 CompuMethod_114 0 65535 /end CHARACTERISTIC
/begin CHARACTERISTIC FaultManager.ACPresRangeLow.Mode "Fault manager configuration.  Select up to 4 actions for each fault." VALUE 0x800029CB RecordLayout_4 0 CompuMethod_111 0 65535 /end CHARACTERISTIC
/begin CHARACTERISTIC FaultManager.ACPresRangeLow.ID "Fault manager configuration.  Select up to 4 actions for each fault." VALUE 0x800029CD RecordLayout_4 0 CompuMethod_1 0 65535 /end CHARACTERISTIC
/begin CHARACTERISTIC FaultManager.ACPresRangeLow.Test "Fault manager configuration.  Select up to 4 actions for each fault." VALUE 0x800029CF RecordLayout_4 0 CompuMethod_112 0 65535 /end CHARACTERISTIC
/begin CHARACTERISTIC FaultManager.ACPresRangeLow.Faulty_Samples__X_ "Fault manager configuration.  Select up to 4 actions for each fault." VALUE 0x800029D1 RecordLayout_4 0 CompuMethod_1 0 65535 /end CHARACTERISTIC
/begin CHARACTERISTIC FaultManager.ACPresRangeLow.Total_Samples__Y_ "Fault manager configuration.  Select up to 4 actions for each fault." VALUE 0x800029D3 RecordLayout_4 0 CompuMethod_1 0 65535 /end CHARACTERISTIC
/begin CHARACTERISTIC FaultManager.ACPresRangeLow.Action_1 "Fault manager configuration.  Select up to 4 actions for each fault." VALUE 0x800029D5 RecordLayout_4 0 CompuMethod_113 0 65535 /end CHARACTERISTIC
/begin CHARACTERISTIC FaultManager.ACPresRangeLow.Action_1_Condition "Fault manager configuration.  Select up to 4 actions for each fault." VALUE 0x800029D7 RecordLayout_4 0 CompuMethod_114 0 65535 /end CHARACTERISTIC
/begin CHARACTERISTIC FaultManager.ACPresRangeLow.Action_2 "Fault manager configuration.  Select up to 4 actions for each fault." VALUE 0x800029D9 RecordLayout_4 0 CompuMethod_113 0 65535 /end CHARACTERISTIC
/begin CHARACTERISTIC FaultManager.ACPresRangeLow.Action_2_Condition "Fault manager configuration.  Select up to 4 actions for each fault." VALUE 0x800029DB RecordLayout_4 0 CompuMethod_114 0 65535 /end CHARACTERISTIC
/begin CHARACTERISTIC FaultManager.ACPresRangeLow.Action_3 "Fault manager configuration.  Select up to 4 actions for each fault." VALUE 0x800029DD RecordLayout_4 0 CompuMethod_113 0 65535 /end CHARACTERISTIC
/begin CHARACTERISTIC FaultManager.ACPresRangeLow.Action_3_Condition "Fault manager configuration.  Select up to 4 actions for each fault." VALUE 0x800029DF RecordLayout_4 0 CompuMethod_114 0 65535 /end CHARACTERISTIC
/begin CHARACTERISTIC FaultManager.ACPresRangeLow.Action_4 "Fault manager configuration.  Select up to 4 actions for each fault." VALUE 0x800029E1 RecordLayout_4 0 CompuMethod_113 0 65535 /end CHARACTERISTIC
/begin CHARACTERISTIC FaultManager.ACPresRangeLow.Action_4_Condition "Fault manager configuration.  Select up to 4 actions for each fault." VALUE 0x800029E3 RecordLayout_4 0 CompuMethod_114 0 65535 /end CHARACTERISTIC
/begin CHARACTERISTIC FaultManager.APP1RangeHigh.Mode "Fault manager configuration.  Select up to 4 actions for each fault." VALUE 0x800029E5 RecordLayout_4 0 CompuMethod_111 0 65535 /end CHARACTERISTIC
/begin CHARACTERISTIC FaultManager.APP1RangeHigh.ID "Fault manager configuration.  Select up to 4 actions for each fault." VALUE 0x800029E7 RecordLayout_4 0 CompuMethod_1 0 65535 /end CHARACTERISTIC
/begin CHARACTERISTIC FaultManager.APP1RangeHigh.Test "Fault manager configuration.  Select up to 4 actions for each fault." VALUE 0x800029E9 RecordLayout_4 0 CompuMethod_112 0 65535 /end CHARACTERISTIC
/begin CHARACTERISTIC FaultManager.APP1RangeHigh.Faulty_Samples__X_ "Fault manager configuration.  Select up to 4 actions for each fault." VALUE 0x800029EB RecordLayout_4 0 CompuMethod_1 0 65535 /end CHARACTERISTIC
/begin CHARACTERISTIC FaultManager.APP1RangeHigh.Total_Samples__Y_ "Fault manager configuration.  Select up to 4 actions for each fault." VALUE 0x800029ED RecordLayout_4 0 CompuMethod_1 0 65535 /end CHARACTERISTIC
/begin CHARACTERISTIC FaultManager.APP1RangeHigh.Action_1 "Fault manager configuration.  Select up to 4 actions for each fault." VALUE 0x800029EF RecordLayout_4 0 CompuMethod_113 0 65535 /end CHARACTERISTIC
/begin CHARACTERISTIC FaultManager.APP1RangeHigh.Action_1_Condition "Fault manager configuration.  Select up to 4 actions for each fault." VALUE 0x800029F1 RecordLayout_4 0 CompuMethod_114 0 65535 /end CHARACTERISTIC
/begin CHARACTERISTIC FaultManager.APP1RangeHigh.Action_2 "Fault manager configuration.  Select up to 4 actions for each fault." VALUE 0x800029F3 RecordLayout_4 0 CompuMethod_113 0 65535 /end CHARACTERISTIC
/begin CHARACTERISTIC FaultManager.APP1RangeHigh.Action_2_Condition "Fault manager configuration.  Select up to 4 actions for each fault." VALUE 0x800029F5 RecordLayout_4 0 CompuMethod_114 0 65535 /end CHARACTERISTIC
/begin CHARACTERISTIC FaultManager.APP1RangeHigh.Action_3 "Fault manager configuration.  Select up to 4 actions for each fault." VALUE 0x800029F7 RecordLayout_4 0 CompuMethod_113 0 65535 /end CHARACTERISTIC
/begin CHARACTERISTIC FaultManager.APP1RangeHigh.Action_3_Condition "Fault manager configuration.  Select up to 4 actions for each fault." VALUE 0x800029F9 RecordLayout_4 0 CompuMethod_114 0 65535 /end CHARACTERISTIC
/begin CHARACTERISTIC FaultManager.APP1RangeHigh.Action_4 "Fault manager configuration.  Select up to 4 actions for each fault." VALUE 0x800029FB RecordLayout_4 0 CompuMethod_113 0 65535 /end CHARACTERISTIC
/begin CHARACTERISTIC FaultManager.APP1RangeHigh.Action_4_Condition "Fault manager configuration.  Select up to 4 actions for each fault." VALUE 0x800029FD RecordLayout_4 0 CompuMethod_114 0 65535 /end CHARACTERISTIC
/begin CHARACTERISTIC FaultManager.APP1RangeLow.Mode "Fault manager configuration.  Select up to 4 actions for each fault." VALUE 0x800029FF RecordLayout_4 0 CompuMethod_111 0 65535 /end CHARACTERISTIC
/begin CHARACTERISTIC FaultManager.APP1RangeLow.ID "Fault manager configuration.  Select up to 4 actions for each fault." VALUE 0x80002A01 RecordLayout_4 0 CompuMethod_1 0 65535 /end CHARACTERISTIC
/begin CHARACTERISTIC FaultManager.APP1RangeLow.Test "Fault manager configuration.  Select up to 4 actions for each fault." VALUE 0x80002A03 RecordLayout_4 0 CompuMethod_112 0 65535 /end CHARACTERISTIC
/begin CHARACTERISTIC FaultManager.APP1RangeLow.Faulty_Samples__X_ "Fault manager configuration.  Select up to 4 actions for each fault." VALUE 0x80002A05 RecordLayout_4 0 CompuMethod_1 0 65535 /end CHARACTERISTIC
/begin CHARACTERISTIC FaultManager.APP1RangeLow.Total_Samples__Y_ "Fault manager configuration.  Select up to 4 actions for each fault." VALUE 0x80002A07 RecordLayout_4 0 CompuMethod_1 0 65535 /end CHARACTERISTIC
/begin CHARACTERISTIC FaultManager.APP1RangeLow.Action_1 "Fault manager configuration.  Select up to 4 actions for each fault." VALUE 0x80002A09 RecordLayout_4 0 CompuMethod_113 0 65535 /end CHARACTERISTIC
/begin CHARACTERISTIC FaultManager.APP1RangeLow.Action_1_Condition "Fault manager configuration.  Select up to 4 actions for each fault." VALUE 0x80002A0B RecordLayout_4 0 CompuMethod_114 0 65535 /end CHARACTERISTIC
/begin CHARACTERISTIC FaultManager.APP1RangeLow.Action_2 "Fault manager configuration.  Select up to 4 actions for each fault." VALUE 0x80002A0D RecordLayout_4 0 CompuMethod_113 0 65535 /end CHARACTERISTIC
/begin CHARACTERISTIC FaultManager.APP1RangeLow.Action_2_Condition "Fault manager configuration.  Select up to 4 actions for each fault." VALUE 0x80002A0F RecordLayout_4 0 CompuMethod_114 0 65535 /end CHARACTERISTIC
/begin CHARACTERISTIC FaultManager.APP1RangeLow.Action_3 "Fault manager configuration.  Select up to 4 actions for each fault." VALUE 0x80002A11 RecordLayout_4 0 CompuMethod_113 0 65535 /end CHARACTERISTIC
/begin CHARACTERISTIC FaultManager.APP1RangeLow.Action_3_Condition "Fault manager configuration.  Select up to 4 actions for each fault." VALUE 0x80002A13 RecordLayout_4 0 CompuMethod_114 0 65535 /end CHARACTERISTIC
/begin CHARACTERISTIC FaultManager.APP1RangeLow.Action_4 "Fault manager configuration.  Select up to 4 actions for each fault." VALUE 0x80002A15 RecordLayout_4 0 CompuMethod_113 0 65535 /end CHARACTERISTIC
/begin CHARACTERISTIC FaultManager.APP1RangeLow.Action_4_Condition "Fault manager configuration.  Select up to 4 actions for each fault." VALUE 0x80002A17 RecordLayout_4 0 CompuMethod_114 0 65535 /end CHARACTERISTIC
/begin CHARACTERISTIC FaultManager.APP1_AdaptAdaptHiMax.Mode "Fault manager configuration.  Select up to 4 actions for each fault." VALUE 0x80002A19 RecordLayout_4 0 CompuMethod_111 0 65535 /end CHARACTERISTIC
/begin CHARACTERISTIC FaultManager.APP1_AdaptAdaptHiMax.ID "Fault manager configuration.  Select up to 4 actions for each fault." VALUE 0x80002A1B RecordLayout_4 0 CompuMethod_1 0 65535 /end CHARACTERISTIC
/begin CHARACTERISTIC FaultManager.APP1_AdaptAdaptHiMax.Test "Fault manager configuration.  Select up to 4 actions for each fault." VALUE 0x80002A1D RecordLayout_4 0 CompuMethod_112 0 65535 /end CHARACTERISTIC
/begin CHARACTERISTIC FaultManager.APP1_AdaptAdaptHiMax.Faulty_Samples__X_ "Fault manager configuration.  Select up to 4 actions for each fault." VALUE 0x80002A1F RecordLayout_4 0 CompuMethod_1 0 65535 /end CHARACTERISTIC
/begin CHARACTERISTIC FaultManager.APP1_AdaptAdaptHiMax.Total_Samples__Y_ "Fault manager configuration.  Select up to 4 actions for each fault." VALUE 0x80002A21 RecordLayout_4 0 CompuMethod_1 0 65535 /end CHARACTERISTIC
/begin CHARACTERISTIC FaultManager.APP1_AdaptAdaptHiMax.Action_1 "Fault manager configuration.  Select up to 4 actions for each fault." VALUE 0x80002A23 RecordLayout_4 0 CompuMethod_113 0 65535 /end CHARACTERISTIC
/begin CHARACTERISTIC FaultManager.APP1_AdaptAdaptHiMax.Action_1_Condition "Fault manager configuration.  Select up to 4 actions for each fault." VALUE 0x80002A25 RecordLayout_4 0 CompuMethod_114 0 65535 /end CHARACTERISTIC
/begin CHARACTERISTIC FaultManager.APP1_AdaptAdaptHiMax.Action_2 "Fault manager configuration.  Select up to 4 actions for each fault." VALUE 0x80002A27 RecordLayout_4 0 CompuMethod_113 0 65535 /end CHARACTERISTIC
/begin CHARACTERISTIC FaultManager.APP1_AdaptAdaptHiMax.Action_2_Condition "Fault manager configuration.  Select up to 4 actions for each fault." VALUE 0x80002A29 RecordLayout_4 0 CompuMethod_114 0 65535 /end CHARACTERISTIC
/begin CHARACTERISTIC FaultManager.APP1_AdaptAdaptHiMax.Action_3 "Fault manager configuration.  Select up to 4 actions for each fault." VALUE 0x80002A2B RecordLayout_4 0 CompuMethod_113 0 65535 /end CHARACTERISTIC
/begin CHARACTERISTIC FaultManager.APP1_AdaptAdaptHiMax.Action_3_Condition "Fault manager configuration.  Select up to 4 actions for each fault." VALUE 0x80002A2D RecordLayout_4 0 CompuMethod_114 0 65535 /end CHARACTERISTIC
/begin CHARACTERISTIC FaultManager.APP1_AdaptAdaptHiMax.Action_4 "Fault manager configuration.  Select up to 4 actions for each fault." VALUE 0x80002A2F RecordLayout_4 0 CompuMethod_113 0 65535 /end CHARACTERISTIC
/begin CHARACTERISTIC FaultManager.APP1_AdaptAdaptHiMax.Action_4_Condition "Fault manager configuration.  Select up to 4 actions for each fault." VALUE 0x80002A31 RecordLayout_4 0 CompuMethod_114 0 65535 /end CHARACTERISTIC
/begin CHARACTERISTIC FaultManager.APP1_AdaptAdaptHiMin.Mode "Fault manager configuration.  Select up to 4 actions for each fault." VALUE 0x80002A33 RecordLayout_4 0 CompuMethod_111 0 65535 /end CHARACTERISTIC
/begin CHARACTERISTIC FaultManager.APP1_AdaptAdaptHiMin.ID "Fault manager configuration.  Select up to 4 actions for each fault." VALUE 0x80002A35 RecordLayout_4 0 CompuMethod_1 0 65535 /end CHARACTERISTIC
/begin CHARACTERISTIC FaultManager.APP1_AdaptAdaptHiMin.Test "Fault manager configuration.  Select up to 4 actions for each fault." VALUE 0x80002A37 RecordLayout_4 0 CompuMethod_112 0 65535 /end CHARACTERISTIC
/begin CHARACTERISTIC FaultManager.APP1_AdaptAdaptHiMin.Faulty_Samples__X_ "Fault manager configuration.  Select up to 4 actions for each fault." VALUE 0x80002A39 RecordLayout_4 0 CompuMethod_1 0 65535 /end CHARACTERISTIC
/begin CHARACTERISTIC FaultManager.APP1_AdaptAdaptHiMin.Total_Samples__Y_ "Fault manager configuration.  Select up to 4 actions for each fault." VALUE 0x80002A3B RecordLayout_4 0 CompuMethod_1 0 65535 /end CHARACTERISTIC
/begin CHARACTERISTIC FaultManager.APP1_AdaptAdaptHiMin.Action_1 "Fault manager configuration.  Select up to 4 actions for each fault." VALUE 0x80002A3D RecordLayout_4 0 CompuMethod_113 0 65535 /end CHARACTERISTIC
/begin CHARACTERISTIC FaultManager.APP1_AdaptAdaptHiMin.Action_1_Condition "Fault manager configuration.  Select up to 4 actions for each fault." VALUE 0x80002A3F RecordLayout_4 0 CompuMethod_114 0 65535 /end CHARACTERISTIC
/begin CHARACTERISTIC FaultManager.APP1_AdaptAdaptHiMin.Action_2 "Fault manager configuration.  Select up to 4 actions for each fault." VALUE 0x80002A41 RecordLayout_4 0 CompuMethod_113 0 65535 /end CHARACTERISTIC
/begin CHARACTERISTIC FaultManager.APP1_AdaptAdaptHiMin.Action_2_Condition "Fault manager configuration.  Select up to 4 actions for each fault." VALUE 0x80002A43 RecordLayout_4 0 CompuMethod_114 0 65535 /end CHARACTERISTIC
/begin CHARACTERISTIC FaultManager.APP1_AdaptAdaptHiMin.Action_3 "Fault manager configuration.  Select up to 4 actions for each fault." VALUE 0x80002A45 RecordLayout_4 0 CompuMethod_113 0 65535 /end CHARACTERISTIC
/begin CHARACTERISTIC FaultManager.APP1_AdaptAdaptHiMin.Action_3_Condition "Fault manager configuration.  Select up to 4 actions for each fault." VALUE 0x80002A47 RecordLayout_4 0 CompuMethod_114 0 65535 /end CHARACTERISTIC
/begin CHARACTERISTIC FaultManager.APP1_AdaptAdaptHiMin.Action_4 "Fault manager configuration.  Select up to 4 actions for each fault." VALUE 0x80002A49 RecordLayout_4 0 CompuMethod_113 0 65535 /end CHARACTERISTIC
/begin CHARACTERISTIC FaultManager.APP1_AdaptAdaptHiMin.Action_4_Condition "Fault manager configuration.  Select up to 4 actions for each fault." VALUE 0x80002A4B RecordLayout_4 0 CompuMethod_114 0 65535 /end CHARACTERISTIC
/begin CHARACTERISTIC FaultManager.APP1_AdaptAdaptLoMax.Mode "Fault manager configuration.  Select up to 4 actions for each fault." VALUE 0x80002A4D RecordLayout_4 0 CompuMethod_111 0 65535 /end CHARACTERISTIC
/begin CHARACTERISTIC FaultManager.APP1_AdaptAdaptLoMax.ID "Fault manager configuration.  Select up to 4 actions for each fault." VALUE 0x80002A4F RecordLayout_4 0 CompuMethod_1 0 65535 /end CHARACTERISTIC
/begin CHARACTERISTIC FaultManager.APP1_AdaptAdaptLoMax.Test "Fault manager configuration.  Select up to 4 actions for each fault." VALUE 0x80002A51 RecordLayout_4 0 CompuMethod_112 0 65535 /end CHARACTERISTIC
/begin CHARACTERISTIC FaultManager.APP1_AdaptAdaptLoMax.Faulty_Samples__X_ "Fault manager configuration.  Select up to 4 actions for each fault." VALUE 0x80002A53 RecordLayout_4 0 CompuMethod_1 0 65535 /end CHARACTERISTIC
/begin CHARACTERISTIC FaultManager.APP1_AdaptAdaptLoMax.Total_Samples__Y_ "Fault manager configuration.  Select up to 4 actions for each fault." VALUE 0x80002A55 RecordLayout_4 0 CompuMethod_1 0 65535 /end CHARACTERISTIC
/begin CHARACTERISTIC FaultManager.APP1_AdaptAdaptLoMax.Action_1 "Fault manager configuration.  Select up to 4 actions for each fault." VALUE 0x80002A57 RecordLayout_4 0 CompuMethod_113 0 65535 /end CHARACTERISTIC
/begin CHARACTERISTIC FaultManager.APP1_AdaptAdaptLoMax.Action_1_Condition "Fault manager configuration.  Select up to 4 actions for each fault." VALUE 0x80002A59 RecordLayout_4 0 CompuMethod_114 0 65535 /end CHARACTERISTIC
/begin CHARACTERISTIC FaultManager.APP1_AdaptAdaptLoMax.Action_2 "Fault manager configuration.  Select up to 4 actions for each fault." VALUE 0x80002A5B RecordLayout_4 0 CompuMethod_113 0 65535 /end CHARACTERISTIC
/begin CHARACTERISTIC FaultManager.APP1_AdaptAdaptLoMax.Action_2_Condition "Fault manager configuration.  Select up to 4 actions for each fault." VALUE 0x80002A5D RecordLayout_4 0 CompuMethod_114 0 65535 /end CHARACTERISTIC
/begin CHARACTERISTIC FaultManager.APP1_AdaptAdaptLoMax.Action_3 "Fault manager configuration.  Select up to 4 actions for each fault." VALUE 0x80002A5F RecordLayout_4 0 CompuMethod_113 0 65535 /end CHARACTERISTIC
/begin CHARACTERISTIC FaultManager.APP1_AdaptAdaptLoMax.Action_3_Condition "Fault manager configuration.  Select up to 4 actions for each fault." VALUE 0x80002A61 RecordLayout_4 0 CompuMethod_114 0 65535 /end CHARACTERISTIC
/begin CHARACTERISTIC FaultManager.APP1_AdaptAdaptLoMax.Action_4 "Fault manager configuration.  Select up to 4 actions for each fault." VALUE 0x80002A63 RecordLayout_4 0 CompuMethod_113 0 65535 /end CHARACTERISTIC
/begin CHARACTERISTIC FaultManager.APP1_AdaptAdaptLoMax.Action_4_Condition "Fault manager configuration.  Select up to 4 actions for each fault." VALUE 0x80002A65 RecordLayout_4 0 CompuMethod_114 0 65535 /end CHARACTERISTIC
/begin CHARACTERISTIC FaultManager.APP1_AdaptAdaptLoMin.Mode "Fault manager configuration.  Select up to 4 actions for each fault." VALUE 0x80002A67 RecordLayout_4 0 CompuMethod_111 0 65535 /end CHARACTERISTIC
/begin CHARACTERISTIC FaultManager.APP1_AdaptAdaptLoMin.ID "Fault manager configuration.  Select up to 4 actions for each fault." VALUE 0x80002A69 RecordLayout_4 0 CompuMethod_1 0 65535 /end CHARACTERISTIC
/begin CHARACTERISTIC FaultManager.APP1_AdaptAdaptLoMin.Test "Fault manager configuration.  Select up to 4 actions for each fault." VALUE 0x80002A6B RecordLayout_4 0 CompuMethod_112 0 65535 /end CHARACTERISTIC
/begin CHARACTERISTIC FaultManager.APP1_AdaptAdaptLoMin.Faulty_Samples__X_ "Fault manager configuration.  Select up to 4 actions for each fault." VALUE 0x80002A6D RecordLayout_4 0 CompuMethod_1 0 65535 /end CHARACTERISTIC
/begin CHARACTERISTIC FaultManager.APP1_AdaptAdaptLoMin.Total_Samples__Y_ "Fault manager configuration.  Select up to 4 actions for each fault." VALUE 0x80002A6F RecordLayout_4 0 CompuMethod_1 0 65535 /end CHARACTERISTIC
/begin CHARACTERISTIC FaultManager.APP1_AdaptAdaptLoMin.Action_1 "Fault manager configuration.  Select up to 4 actions for each fault." VALUE 0x80002A71 RecordLayout_4 0 CompuMethod_113 0 65535 /end CHARACTERISTIC
/begin CHARACTERISTIC FaultManager.APP1_AdaptAdaptLoMin.Action_1_Condition "Fault manager configuration.  Select up to 4 actions for each fault." VALUE 0x80002A73 RecordLayout_4 0 CompuMethod_114 0 65535 /end CHARACTERISTIC
/begin CHARACTERISTIC FaultManager.APP1_AdaptAdaptLoMin.Action_2 "Fault manager configuration.  Select up to 4 actions for each fault." VALUE 0x80002A75 RecordLayout_4 0 CompuMethod_113 0 65535 /end CHARACTERISTIC
/begin CHARACTERISTIC FaultManager.APP1_AdaptAdaptLoMin.Action_2_Condition "Fault manager configuration.  Select up to 4 actions for each fault." VALUE 0x80002A77 RecordLayout_4 0 CompuMethod_114 0 65535 /end CHARACTERISTIC
/begin CHARACTERISTIC FaultManager.APP1_AdaptAdaptLoMin.Action_3 "Fault manager configuration.  Select up to 4 actions for each fault." VALUE 0x80002A79 RecordLayout_4 0 CompuMethod_113 0 65535 /end CHARACTERISTIC
/begin CHARACTERISTIC FaultManager.APP1_AdaptAdaptLoMin.Action_3_Condition "Fault manager configuration.  Select up to 4 actions for each fault." VALUE 0x80002A7B RecordLayout_4 0 CompuMethod_114 0 65535 /end CHARACTERISTIC
/begin CHARACTERISTIC FaultManager.APP1_AdaptAdaptLoMin.Action_4 "Fault manager configuration.  Select up to 4 actions for each fault." VALUE 0x80002A7D RecordLayout_4 0 CompuMethod_113 0 65535 /end CHARACTERISTIC
/begin CHARACTERISTIC FaultManager.APP1_AdaptAdaptLoMin.Action_4_Condition "Fault manager configuration.  Select up to 4 actions for each fault." VALUE 0x80002A7F RecordLayout_4 0 CompuMethod_114 0 65535 /end CHARACTERISTIC
/begin CHARACTERISTIC FaultManager.APP1_AdaptRangeHigh.Mode "Fault manager configuration.  Select up to 4 actions for each fault." VALUE 0x80002A81 RecordLayout_4 0 CompuMethod_111 0 65535 /end CHARACTERISTIC
/begin CHARACTERISTIC FaultManager.APP1_AdaptRangeHigh.ID "Fault manager configuration.  Select up to 4 actions for each fault." VALUE 0x80002A83 RecordLayout_4 0 CompuMethod_1 0 65535 /end CHARACTERISTIC
/begin CHARACTERISTIC FaultManager.APP1_AdaptRangeHigh.Test "Fault manager configuration.  Select up to 4 actions for each fault." VALUE 0x80002A85 RecordLayout_4 0 CompuMethod_112 0 65535 /end CHARACTERISTIC
/begin CHARACTERISTIC FaultManager.APP1_AdaptRangeHigh.Faulty_Samples__X_ "Fault manager configuration.  Select up to 4 actions for each fault." VALUE 0x80002A87 RecordLayout_4 0 CompuMethod_1 0 65535 /end CHARACTERISTIC
/begin CHARACTERISTIC FaultManager.APP1_AdaptRangeHigh.Total_Samples__Y_ "Fault manager configuration.  Select up to 4 actions for each fault." VALUE 0x80002A89 RecordLayout_4 0 CompuMethod_1 0 65535 /end CHARACTERISTIC
/begin CHARACTERISTIC FaultManager.APP1_AdaptRangeHigh.Action_1 "Fault manager configuration.  Select up to 4 actions for each fault." VALUE 0x80002A8B RecordLayout_4 0 CompuMethod_113 0 65535 /end CHARACTERISTIC
/begin CHARACTERISTIC FaultManager.APP1_AdaptRangeHigh.Action_1_Condition "Fault manager configuration.  Select up to 4 actions for each fault." VALUE 0x80002A8D RecordLayout_4 0 CompuMethod_114 0 65535 /end CHARACTERISTIC
/begin CHARACTERISTIC FaultManager.APP1_AdaptRangeHigh.Action_2 "Fault manager configuration.  Select up to 4 actions for each fault." VALUE 0x80002A8F RecordLayout_4 0 CompuMethod_113 0 65535 /end CHARACTERISTIC
/begin CHARACTERISTIC FaultManager.APP1_AdaptRangeHigh.Action_2_Condition "Fault manager configuration.  Select up to 4 actions for each fault." VALUE 0x80002A91 RecordLayout_4 0 CompuMethod_114 0 65535 /end CHARACTERISTIC
/begin CHARACTERISTIC FaultManager.APP1_AdaptRangeHigh.Action_3 "Fault manager configuration.  Select up to 4 actions for each fault." VALUE 0x80002A93 RecordLayout_4 0 CompuMethod_113 0 65535 /end CHARACTERISTIC
/begin CHARACTERISTIC FaultManager.APP1_AdaptRangeHigh.Action_3_Condition "Fault manager configuration.  Select up to 4 actions for each fault." VALUE 0x80002A95 RecordLayout_4 0 CompuMethod_114 0 65535 /end CHARACTERISTIC
/begin CHARACTERISTIC FaultManager.APP1_AdaptRangeHigh.Action_4 "Fault manager configuration.  Select up to 4 actions for each fault." VALUE 0x80002A97 RecordLayout_4 0 CompuMethod_113 0 65535 /end CHARACTERISTIC
/begin CHARACTERISTIC FaultManager.APP1_AdaptRangeHigh.Action_4_Condition "Fault manager configuration.  Select up to 4 actions for each fault." VALUE 0x80002A99 RecordLayout_4 0 CompuMethod_114 0 65535 /end CHARACTERISTIC
/begin CHARACTERISTIC FaultManager.APP1_AdaptRangeLow.Mode "Fault manager configuration.  Select up to 4 actions for each fault." VALUE 0x80002A9B RecordLayout_4 0 CompuMethod_111 0 65535 /end CHARACTERISTIC
/begin CHARACTERISTIC FaultManager.APP1_AdaptRangeLow.ID "Fault manager configuration.  Select up to 4 actions for each fault." VALUE 0x80002A9D RecordLayout_4 0 CompuMethod_1 0 65535 /end CHARACTERISTIC
/begin CHARACTERISTIC FaultManager.APP1_AdaptRangeLow.Test "Fault manager configuration.  Select up to 4 actions for each fault." VALUE 0x80002A9F RecordLayout_4 0 CompuMethod_112 0 65535 /end CHARACTERISTIC
/begin CHARACTERISTIC FaultManager.APP1_AdaptRangeLow.Faulty_Samples__X_ "Fault manager configuration.  Select up to 4 actions for each fault." VALUE 0x80002AA1 RecordLayout_4 0 CompuMethod_1 0 65535 /end CHARACTERISTIC
/begin CHARACTERISTIC FaultManager.APP1_AdaptRangeLow.Total_Samples__Y_ "Fault manager configuration.  Select up to 4 actions for each fault." VALUE 0x80002AA3 RecordLayout_4 0 CompuMethod_1 0 65535 /end CHARACTERISTIC
/begin CHARACTERISTIC FaultManager.APP1_AdaptRangeLow.Action_1 "Fault manager configuration.  Select up to 4 actions for each fault." VALUE 0x80002AA5 RecordLayout_4 0 CompuMethod_113 0 65535 /end CHARACTERISTIC
/begin CHARACTERISTIC FaultManager.APP1_AdaptRangeLow.Action_1_Condition "Fault manager configuration.  Select up to 4 actions for each fault." VALUE 0x80002AA7 RecordLayout_4 0 CompuMethod_114 0 65535 /end CHARACTERISTIC
/begin CHARACTERISTIC FaultManager.APP1_AdaptRangeLow.Action_2 "Fault manager configuration.  Select up to 4 actions for each fault." VALUE 0x80002AA9 RecordLayout_4 0 CompuMethod_113 0 65535 /end CHARACTERISTIC
/begin CHARACTERISTIC FaultManager.APP1_AdaptRangeLow.Action_2_Condition "Fault manager configuration.  Select up to 4 actions for each fault." VALUE 0x80002AAB RecordLayout_4 0 CompuMethod_114 0 65535 /end CHARACTERISTIC
/begin CHARACTERISTIC FaultManager.APP1_AdaptRangeLow.Action_3 "Fault manager configuration.  Select up to 4 actions for each fault." VALUE 0x80002AAD RecordLayout_4 0 CompuMethod_113 0 65535 /end CHARACTERISTIC
/begin CHARACTERISTIC FaultManager.APP1_AdaptRangeLow.Action_3_Condition "Fault manager configuration.  Select up to 4 actions for each fault." VALUE 0x80002AAF RecordLayout_4 0 CompuMethod_114 0 65535 /end CHARACTERISTIC
/begin CHARACTERISTIC FaultManager.APP1_AdaptRangeLow.Action_4 "Fault manager configuration.  Select up to 4 actions for each fault." VALUE 0x80002AB1 RecordLayout_4 0 CompuMethod_113 0 65535 /end CHARACTERISTIC
/begin CHARACTERISTIC FaultManager.APP1_AdaptRangeLow.Action_4_Condition "Fault manager configuration.  Select up to 4 actions for each fault." VALUE 0x80002AB3 RecordLayout_4 0 CompuMethod_114 0 65535 /end CHARACTERISTIC
/begin CHARACTERISTIC FaultManager.APP2RangeHigh.Mode "Fault manager configuration.  Select up to 4 actions for each fault." VALUE 0x80002AB5 RecordLayout_4 0 CompuMethod_111 0 65535 /end CHARACTERISTIC
/begin CHARACTERISTIC FaultManager.APP2RangeHigh.ID "Fault manager configuration.  Select up to 4 actions for each fault." VALUE 0x80002AB7 RecordLayout_4 0 CompuMethod_1 0 65535 /end CHARACTERISTIC
/begin CHARACTERISTIC FaultManager.APP2RangeHigh.Test "Fault manager configuration.  Select up to 4 actions for each fault." VALUE 0x80002AB9 RecordLayout_4 0 CompuMethod_112 0 65535 /end CHARACTERISTIC
/begin CHARACTERISTIC FaultManager.APP2RangeHigh.Faulty_Samples__X_ "Fault manager configuration.  Select up to 4 actions for each fault." VALUE 0x80002ABB RecordLayout_4 0 CompuMethod_1 0 65535 /end CHARACTERISTIC
/begin CHARACTERISTIC FaultManager.APP2RangeHigh.Total_Samples__Y_ "Fault manager configuration.  Select up to 4 actions for each fault." VALUE 0x80002ABD RecordLayout_4 0 CompuMethod_1 0 65535 /end CHARACTERISTIC
/begin CHARACTERISTIC FaultManager.APP2RangeHigh.Action_1 "Fault manager configuration.  Select up to 4 actions for each fault." VALUE 0x80002ABF RecordLayout_4 0 CompuMethod_113 0 65535 /end CHARACTERISTIC
/begin CHARACTERISTIC FaultManager.APP2RangeHigh.Action_1_Condition "Fault manager configuration.  Select up to 4 actions for each fault." VALUE 0x80002AC1 RecordLayout_4 0 CompuMethod_114 0 65535 /end CHARACTERISTIC
/begin CHARACTERISTIC FaultManager.APP2RangeHigh.Action_2 "Fault manager configuration.  Select up to 4 actions for each fault." VALUE 0x80002AC3 RecordLayout_4 0 CompuMethod_113 0 65535 /end CHARACTERISTIC
/begin CHARACTERISTIC FaultManager.APP2RangeHigh.Action_2_Condition "Fault manager configuration.  Select up to 4 actions for each fault." VALUE 0x80002AC5 RecordLayout_4 0 CompuMethod_114 0 65535 /end CHARACTERISTIC
/begin CHARACTERISTIC FaultManager.APP2RangeHigh.Action_3 "Fault manager configuration.  Select up to 4 actions for each fault." VALUE 0x80002AC7 RecordLayout_4 0 CompuMethod_113 0 65535 /end CHARACTERISTIC
/begin CHARACTERISTIC FaultManager.APP2RangeHigh.Action_3_Condition "Fault manager configuration.  Select up to 4 actions for each fault." VALUE 0x80002AC9 RecordLayout_4 0 CompuMethod_114 0 65535 /end CHARACTERISTIC
/begin CHARACTERISTIC FaultManager.APP2RangeHigh.Action_4 "Fault manager configuration.  Select up to 4 actions for each fault." VALUE 0x80002ACB RecordLayout_4 0 CompuMethod_113 0 65535 /end CHARACTERISTIC
/begin CHARACTERISTIC FaultManager.APP2RangeHigh.Action_4_Condition "Fault manager configuration.  Select up to 4 actions for each fault." VALUE 0x80002ACD RecordLayout_4 0 CompuMethod_114 0 65535 /end CHARACTERISTIC
/begin CHARACTERISTIC FaultManager.APP2RangeLow.Mode "Fault manager configuration.  Select up to 4 actions for each fault." VALUE 0x80002ACF RecordLayout_4 0 CompuMethod_111 0 65535 /end CHARACTERISTIC
/begin CHARACTERISTIC FaultManager.APP2RangeLow.ID "Fault manager configuration.  Select up to 4 actions for each fault." VALUE 0x80002AD1 RecordLayout_4 0 CompuMethod_1 0 65535 /end CHARACTERISTIC
/begin CHARACTERISTIC FaultManager.APP2RangeLow.Test "Fault manager configuration.  Select up to 4 actions for each fault." VALUE 0x80002AD3 RecordLayout_4 0 CompuMethod_112 0 65535 /end CHARACTERISTIC
/begin CHARACTERISTIC FaultManager.APP2RangeLow.Faulty_Samples__X_ "Fault manager configuration.  Select up to 4 actions for each fault." VALUE 0x80002AD5 RecordLayout_4 0 CompuMethod_1 0 65535 /end CHARACTERISTIC
/begin CHARACTERISTIC FaultManager.APP2RangeLow.Total_Samples__Y_ "Fault manager configuration.  Select up to 4 actions for each fault." VALUE 0x80002AD7 RecordLayout_4 0 CompuMethod_1 0 65535 /end CHARACTERISTIC
/begin CHARACTERISTIC FaultManager.APP2RangeLow.Action_1 "Fault manager configuration.  Select up to 4 actions for each fault." VALUE 0x80002AD9 RecordLayout_4 0 CompuMethod_113 0 65535 /end CHARACTERISTIC
/begin CHARACTERISTIC FaultManager.APP2RangeLow.Action_1_Condition "Fault manager configuration.  Select up to 4 actions for each fault." VALUE 0x80002ADB RecordLayout_4 0 CompuMethod_114 0 65535 /end CHARACTERISTIC
/begin CHARACTERISTIC FaultManager.APP2RangeLow.Action_2 "Fault manager configuration.  Select up to 4 actions for each fault." VALUE 0x80002ADD RecordLayout_4 0 CompuMethod_113 0 65535 /end CHARACTERISTIC
/begin CHARACTERISTIC FaultManager.APP2RangeLow.Action_2_Condition "Fault manager configuration.  Select up to 4 actions for each fault." VALUE 0x80002ADF RecordLayout_4 0 CompuMethod_114 0 65535 /end CHARACTERISTIC
/begin CHARACTERISTIC FaultManager.APP2RangeLow.Action_3 "Fault manager configuration.  Select up to 4 actions for each fault." VALUE 0x80002AE1 RecordLayout_4 0 CompuMethod_113 0 65535 /end CHARACTERISTIC
/begin CHARACTERISTIC FaultManager.APP2RangeLow.Action_3_Condition "Fault manager configuration.  Select up to 4 actions for each fault." VALUE 0x80002AE3 RecordLayout_4 0 CompuMethod_114 0 65535 /end CHARACTERISTIC
/begin CHARACTERISTIC FaultManager.APP2RangeLow.Action_4 "Fault manager configuration.  Select up to 4 actions for each fault." VALUE 0x80002AE5 RecordLayout_4 0 CompuMethod_113 0 65535 /end CHARACTERISTIC
/begin CHARACTERISTIC FaultManager.APP2RangeLow.Action_4_Condition "Fault manager configuration.  Select up to 4 actions for each fault." VALUE 0x80002AE7 RecordLayout_4 0 CompuMethod_114 0 65535 /end CHARACTERISTIC
/begin CHARACTERISTIC FaultManager.APP2_AdaptAdaptHiMax.Mode "Fault manager configuration.  Select up to 4 actions for each fault." VALUE 0x80002AE9 RecordLayout_4 0 CompuMethod_111 0 65535 /end CHARACTERISTIC
/begin CHARACTERISTIC FaultManager.APP2_AdaptAdaptHiMax.ID "Fault manager configuration.  Select up to 4 actions for each fault." VALUE 0x80002AEB RecordLayout_4 0 CompuMethod_1 0 65535 /end CHARACTERISTIC
/begin CHARACTERISTIC FaultManager.APP2_AdaptAdaptHiMax.Test "Fault manager configuration.  Select up to 4 actions for each fault." VALUE 0x80002AED RecordLayout_4 0 CompuMethod_112 0 65535 /end CHARACTERISTIC
/begin CHARACTERISTIC FaultManager.APP2_AdaptAdaptHiMax.Faulty_Samples__X_ "Fault manager configuration.  Select up to 4 actions for each fault." VALUE 0x80002AEF RecordLayout_4 0 CompuMethod_1 0 65535 /end CHARACTERISTIC
/begin CHARACTERISTIC FaultManager.APP2_AdaptAdaptHiMax.Total_Samples__Y_ "Fault manager configuration.  Select up to 4 actions for each fault." VALUE 0x80002AF1 RecordLayout_4 0 CompuMethod_1 0 65535 /end CHARACTERISTIC
/begin CHARACTERISTIC FaultManager.APP2_AdaptAdaptHiMax.Action_1 "Fault manager configuration.  Select up to 4 actions for each fault." VALUE 0x80002AF3 RecordLayout_4 0 CompuMethod_113 0 65535 /end CHARACTERISTIC
/begin CHARACTERISTIC FaultManager.APP2_AdaptAdaptHiMax.Action_1_Condition "Fault manager configuration.  Select up to 4 actions for each fault." VALUE 0x80002AF5 RecordLayout_4 0 CompuMethod_114 0 65535 /end CHARACTERISTIC
/begin CHARACTERISTIC FaultManager.APP2_AdaptAdaptHiMax.Action_2 "Fault manager configuration.  Select up to 4 actions for each fault." VALUE 0x80002AF7 RecordLayout_4 0 CompuMethod_113 0 65535 /end CHARACTERISTIC
/begin CHARACTERISTIC FaultManager.APP2_AdaptAdaptHiMax.Action_2_Condition "Fault manager configuration.  Select up to 4 actions for each fault." VALUE 0x80002AF9 RecordLayout_4 0 CompuMethod_114 0 65535 /end CHARACTERISTIC
/begin CHARACTERISTIC FaultManager.APP2_AdaptAdaptHiMax.Action_3 "Fault manager configuration.  Select up to 4 actions for each fault." VALUE 0x80002AFB RecordLayout_4 0 CompuMethod_113 0 65535 /end CHARACTERISTIC
/begin CHARACTERISTIC FaultManager.APP2_AdaptAdaptHiMax.Action_3_Condition "Fault manager configuration.  Select up to 4 actions for each fault." VALUE 0x80002AFD RecordLayout_4 0 CompuMethod_114 0 65535 /end CHARACTERISTIC
/begin CHARACTERISTIC FaultManager.APP2_AdaptAdaptHiMax.Action_4 "Fault manager configuration.  Select up to 4 actions for each fault." VALUE 0x80002AFF RecordLayout_4 0 CompuMethod_113 0 65535 /end CHARACTERISTIC
/begin CHARACTERISTIC FaultManager.APP2_AdaptAdaptHiMax.Action_4_Condition "Fault manager configuration.  Select up to 4 actions for each fault." VALUE 0x80002B01 RecordLayout_4 0 CompuMethod_114 0 65535 /end CHARACTERISTIC
/begin CHARACTERISTIC FaultManager.APP2_AdaptAdaptHiMin.Mode "Fault manager configuration.  Select up to 4 actions for each fault." VALUE 0x80002B03 RecordLayout_4 0 CompuMethod_111 0 65535 /end CHARACTERISTIC
/begin CHARACTERISTIC FaultManager.APP2_AdaptAdaptHiMin.ID "Fault manager configuration.  Select up to 4 actions for each fault." VALUE 0x80002B05 RecordLayout_4 0 CompuMethod_1 0 65535 /end CHARACTERISTIC
/begin CHARACTERISTIC FaultManager.APP2_AdaptAdaptHiMin.Test "Fault manager configuration.  Select up to 4 actions for each fault." VALUE 0x80002B07 RecordLayout_4 0 CompuMethod_112 0 65535 /end CHARACTERISTIC
/begin CHARACTERISTIC FaultManager.APP2_AdaptAdaptHiMin.Faulty_Samples__X_ "Fault manager configuration.  Select up to 4 actions for each fault." VALUE 0x80002B09 RecordLayout_4 0 CompuMethod_1 0 65535 /end CHARACTERISTIC
/begin CHARACTERISTIC FaultManager.APP2_AdaptAdaptHiMin.Total_Samples__Y_ "Fault manager configuration.  Select up to 4 actions for each fault." VALUE 0x80002B0B RecordLayout_4 0 CompuMethod_1 0 65535 /end CHARACTERISTIC
/begin CHARACTERISTIC FaultManager.APP2_AdaptAdaptHiMin.Action_1 "Fault manager configuration.  Select up to 4 actions for each fault." VALUE 0x80002B0D RecordLayout_4 0 CompuMethod_113 0 65535 /end CHARACTERISTIC
/begin CHARACTERISTIC FaultManager.APP2_AdaptAdaptHiMin.Action_1_Condition "Fault manager configuration.  Select up to 4 actions for each fault." VALUE 0x80002B0F RecordLayout_4 0 CompuMethod_114 0 65535 /end CHARACTERISTIC
/begin CHARACTERISTIC FaultManager.APP2_AdaptAdaptHiMin.Action_2 "Fault manager configuration.  Select up to 4 actions for each fault." VALUE 0x80002B11 RecordLayout_4 0 CompuMethod_113 0 65535 /end CHARACTERISTIC
/begin CHARACTERISTIC FaultManager.APP2_AdaptAdaptHiMin.Action_2_Condition "Fault manager configuration.  Select up to 4 actions for each fault." VALUE 0x80002B13 RecordLayout_4 0 CompuMethod_114 0 65535 /end CHARACTERISTIC
/begin CHARACTERISTIC FaultManager.APP2_AdaptAdaptHiMin.Action_3 "Fault manager configuration.  Select up to 4 actions for each fault." VALUE 0x80002B15 RecordLayout_4 0 CompuMethod_113 0 65535 /end CHARACTERISTIC
/begin CHARACTERISTIC FaultManager.APP2_AdaptAdaptHiMin.Action_3_Condition "Fault manager configuration.  Select up to 4 actions for each fault." VALUE 0x80002B17 RecordLayout_4 0 CompuMethod_114 0 65535 /end CHARACTERISTIC
/begin CHARACTERISTIC FaultManager.APP2_AdaptAdaptHiMin.Action_4 "Fault manager configuration.  Select up to 4 actions for each fault." VALUE 0x80002B19 RecordLayout_4 0 CompuMethod_113 0 65535 /end CHARACTERISTIC
/begin CHARACTERISTIC FaultManager.APP2_AdaptAdaptHiMin.Action_4_Condition "Fault manager configuration.  Select up to 4 actions for each fault." VALUE 0x80002B1B RecordLayout_4 0 CompuMethod_114 0 65535 /end CHARACTERISTIC
/begin CHARACTERISTIC FaultManager.APP2_AdaptAdaptLoMax.Mode "Fault manager configuration.  Select up to 4 actions for each fault." VALUE 0x80002B1D RecordLayout_4 0 CompuMethod_111 0 65535 /end CHARACTERISTIC
/begin CHARACTERISTIC FaultManager.APP2_AdaptAdaptLoMax.ID "Fault manager configuration.  Select up to 4 actions for each fault." VALUE 0x80002B1F RecordLayout_4 0 CompuMethod_1 0 65535 /end CHARACTERISTIC
/begin CHARACTERISTIC FaultManager.APP2_AdaptAdaptLoMax.Test "Fault manager configuration.  Select up to 4 actions for each fault." VALUE 0x80002B21 RecordLayout_4 0 CompuMethod_112 0 65535 /end CHARACTERISTIC
/begin CHARACTERISTIC FaultManager.APP2_AdaptAdaptLoMax.Faulty_Samples__X_ "Fault manager configuration.  Select up to 4 actions for each fault." VALUE 0x80002B23 RecordLayout_4 0 CompuMethod_1 0 65535 /end CHARACTERISTIC
/begin CHARACTERISTIC FaultManager.APP2_AdaptAdaptLoMax.Total_Samples__Y_ "Fault manager configuration.  Select up to 4 actions for each fault." VALUE 0x80002B25 RecordLayout_4 0 CompuMethod_1 0 65535 /end CHARACTERISTIC
/begin CHARACTERISTIC FaultManager.APP2_AdaptAdaptLoMax.Action_1 "Fault manager configuration.  Select up to 4 actions for each fault." VALUE 0x80002B27 RecordLayout_4 0 CompuMethod_113 0 65535 /end CHARACTERISTIC
/begin CHARACTERISTIC FaultManager.APP2_AdaptAdaptLoMax.Action_1_Condition "Fault manager configuration.  Select up to 4 actions for each fault." VALUE 0x80002B29 RecordLayout_4 0 CompuMethod_114 0 65535 /end CHARACTERISTIC
/begin CHARACTERISTIC FaultManager.APP2_AdaptAdaptLoMax.Action_2 "Fault manager configuration.  Select up to 4 actions for each fault." VALUE 0x80002B2B RecordLayout_4 0 CompuMethod_113 0 65535 /end CHARACTERISTIC
/begin CHARACTERISTIC FaultManager.APP2_AdaptAdaptLoMax.Action_2_Condition "Fault manager configuration.  Select up to 4 actions for each fault." VALUE 0x80002B2D RecordLayout_4 0 CompuMethod_114 0 65535 /end CHARACTERISTIC
/begin CHARACTERISTIC FaultManager.APP2_AdaptAdaptLoMax.Action_3 "Fault manager configuration.  Select up to 4 actions for each fault." VALUE 0x80002B2F RecordLayout_4 0 CompuMethod_113 0 65535 /end CHARACTERISTIC
/begin CHARACTERISTIC FaultManager.APP2_AdaptAdaptLoMax.Action_3_Condition "Fault manager configuration.  Select up to 4 actions for each fault." VALUE 0x80002B31 RecordLayout_4 0 CompuMethod_114 0 65535 /end CHARACTERISTIC
/begin CHARACTERISTIC FaultManager.APP2_AdaptAdaptLoMax.Action_4 "Fault manager configuration.  Select up to 4 actions for each fault." VALUE 0x80002B33 RecordLayout_4 0 CompuMethod_113 0 65535 /end CHARACTERISTIC
/begin CHARACTERISTIC FaultManager.APP2_AdaptAdaptLoMax.Action_4_Condition "Fault manager configuration.  Select up to 4 actions for each fault." VALUE 0x80002B35 RecordLayout_4 0 CompuMethod_114 0 65535 /end CHARACTERISTIC
/begin CHARACTERISTIC FaultManager.APP2_AdaptAdaptLoMin.Mode "Fault manager configuration.  Select up to 4 actions for each fault." VALUE 0x80002B37 RecordLayout_4 0 CompuMethod_111 0 65535 /end CHARACTERISTIC
/begin CHARACTERISTIC FaultManager.APP2_AdaptAdaptLoMin.ID "Fault manager configuration.  Select up to 4 actions for each fault." VALUE 0x80002B39 RecordLayout_4 0 CompuMethod_1 0 65535 /end CHARACTERISTIC
/begin CHARACTERISTIC FaultManager.APP2_AdaptAdaptLoMin.Test "Fault manager configuration.  Select up to 4 actions for each fault." VALUE 0x80002B3B RecordLayout_4 0 CompuMethod_112 0 65535 /end CHARACTERISTIC
/begin CHARACTERISTIC FaultManager.APP2_AdaptAdaptLoMin.Faulty_Samples__X_ "Fault manager configuration.  Select up to 4 actions for each fault." VALUE 0x80002B3D RecordLayout_4 0 CompuMethod_1 0 65535 /end CHARACTERISTIC
/begin CHARACTERISTIC FaultManager.APP2_AdaptAdaptLoMin.Total_Samples__Y_ "Fault manager configuration.  Select up to 4 actions for each fault." VALUE 0x80002B3F RecordLayout_4 0 CompuMethod_1 0 65535 /end CHARACTERISTIC
/begin CHARACTERISTIC FaultManager.APP2_AdaptAdaptLoMin.Action_1 "Fault manager configuration.  Select up to 4 actions for each fault." VALUE 0x80002B41 RecordLayout_4 0 CompuMethod_113 0 65535 /end CHARACTERISTIC
/begin CHARACTERISTIC FaultManager.APP2_AdaptAdaptLoMin.Action_1_Condition "Fault manager configuration.  Select up to 4 actions for each fault." VALUE 0x80002B43 RecordLayout_4 0 CompuMethod_114 0 65535 /end CHARACTERISTIC
/begin CHARACTERISTIC FaultManager.APP2_AdaptAdaptLoMin.Action_2 "Fault manager configuration.  Select up to 4 actions for each fault." VALUE 0x80002B45 RecordLayout_4 0 CompuMethod_113 0 65535 /end CHARACTERISTIC
/begin CHARACTERISTIC FaultManager.APP2_AdaptAdaptLoMin.Action_2_Condition "Fault manager configuration.  Select up to 4 actions for each fault." VALUE 0x80002B47 RecordLayout_4 0 CompuMethod_114 0 65535 /end CHARACTERISTIC
/begin CHARACTERISTIC FaultManager.APP2_AdaptAdaptLoMin.Action_3 "Fault manager configuration.  Select up to 4 actions for each fault." VALUE 0x80002B49 RecordLayout_4 0 CompuMethod_113 0 65535 /end CHARACTERISTIC
/begin CHARACTERISTIC FaultManager.APP2_AdaptAdaptLoMin.Action_3_Condition "Fault manager configuration.  Select up to 4 actions for each fault." VALUE 0x80002B4B RecordLayout_4 0 CompuMethod_114 0 65535 /end CHARACTERISTIC
/begin CHARACTERISTIC FaultManager.APP2_AdaptAdaptLoMin.Action_4 "Fault manager configuration.  Select up to 4 actions for each fault." VALUE 0x80002B4D RecordLayout_4 0 CompuMethod_113 0 65535 /end CHARACTERISTIC
/begin CHARACTERISTIC FaultManager.APP2_AdaptAdaptLoMin.Action_4_Condition "Fault manager configuration.  Select up to 4 actions for each fault." VALUE 0x80002B4F RecordLayout_4 0 CompuMethod_114 0 65535 /end CHARACTERISTIC
/begin CHARACTERISTIC FaultManager.APP2_AdaptRangeHigh.Mode "Fault manager configuration.  Select up to 4 actions for each fault." VALUE 0x80002B51 RecordLayout_4 0 CompuMethod_111 0 65535 /end CHARACTERISTIC
/begin CHARACTERISTIC FaultManager.APP2_AdaptRangeHigh.ID "Fault manager configuration.  Select up to 4 actions for each fault." VALUE 0x80002B53 RecordLayout_4 0 CompuMethod_1 0 65535 /end CHARACTERISTIC
/begin CHARACTERISTIC FaultManager.APP2_AdaptRangeHigh.Test "Fault manager configuration.  Select up to 4 actions for each fault." VALUE 0x80002B55 RecordLayout_4 0 CompuMethod_112 0 65535 /end CHARACTERISTIC
/begin CHARACTERISTIC FaultManager.APP2_AdaptRangeHigh.Faulty_Samples__X_ "Fault manager configuration.  Select up to 4 actions for each fault." VALUE 0x80002B57 RecordLayout_4 0 CompuMethod_1 0 65535 /end CHARACTERISTIC
/begin CHARACTERISTIC FaultManager.APP2_AdaptRangeHigh.Total_Samples__Y_ "Fault manager configuration.  Select up to 4 actions for each fault." VALUE 0x80002B59 RecordLayout_4 0 CompuMethod_1 0 65535 /end CHARACTERISTIC
/begin CHARACTERISTIC FaultManager.APP2_AdaptRangeHigh.Action_1 "Fault manager configuration.  Select up to 4 actions for each fault." VALUE 0x80002B5B RecordLayout_4 0 CompuMethod_113 0 65535 /end CHARACTERISTIC
/begin CHARACTERISTIC FaultManager.APP2_AdaptRangeHigh.Action_1_Condition "Fault manager configuration.  Select up to 4 actions for each fault." VALUE 0x80002B5D RecordLayout_4 0 CompuMethod_114 0 65535 /end CHARACTERISTIC
/begin CHARACTERISTIC FaultManager.APP2_AdaptRangeHigh.Action_2 "Fault manager configuration.  Select up to 4 actions for each fault." VALUE 0x80002B5F RecordLayout_4 0 CompuMethod_113 0 65535 /end CHARACTERISTIC
/begin CHARACTERISTIC FaultManager.APP2_AdaptRangeHigh.Action_2_Condition "Fault manager configuration.  Select up to 4 actions for each fault." VALUE 0x80002B61 RecordLayout_4 0 CompuMethod_114 0 65535 /end CHARACTERISTIC
/begin CHARACTERISTIC FaultManager.APP2_AdaptRangeHigh.Action_3 "Fault manager configuration.  Select up to 4 actions for each fault." VALUE 0x80002B63 RecordLayout_4 0 CompuMethod_113 0 65535 /end CHARACTERISTIC
/begin CHARACTERISTIC FaultManager.APP2_AdaptRangeHigh.Action_3_Condition "Fault manager configuration.  Select up to 4 actions for each fault." VALUE 0x80002B65 RecordLayout_4 0 CompuMethod_114 0 65535 /end CHARACTERISTIC
/begin CHARACTERISTIC FaultManager.APP2_AdaptRangeHigh.Action_4 "Fault manager configuration.  Select up to 4 actions for each fault." VALUE 0x80002B67 RecordLayout_4 0 CompuMethod_113 0 65535 /end CHARACTERISTIC
/begin CHARACTERISTIC FaultManager.APP2_AdaptRangeHigh.Action_4_Condition "Fault manager configuration.  Select up to 4 actions for each fault." VALUE 0x80002B69 RecordLayout_4 0 CompuMethod_114 0 65535 /end CHARACTERISTIC
/begin CHARACTERISTIC FaultManager.APP2_AdaptRangeLow.Mode "Fault manager configuration.  Select up to 4 actions for each fault." VALUE 0x80002B6B RecordLayout_4 0 CompuMethod_111 0 65535 /end CHARACTERISTIC
/begin CHARACTERISTIC FaultManager.APP2_AdaptRangeLow.ID "Fault manager configuration.  Select up to 4 actions for each fault." VALUE 0x80002B6D RecordLayout_4 0 CompuMethod_1 0 65535 /end CHARACTERISTIC
/begin CHARACTERISTIC FaultManager.APP2_AdaptRangeLow.Test "Fault manager configuration.  Select up to 4 actions for each fault." VALUE 0x80002B6F RecordLayout_4 0 CompuMethod_112 0 65535 /end CHARACTERISTIC
/begin CHARACTERISTIC FaultManager.APP2_AdaptRangeLow.Faulty_Samples__X_ "Fault manager configuration.  Select up to 4 actions for each fault." VALUE 0x80002B71 RecordLayout_4 0 CompuMethod_1 0 65535 /end CHARACTERISTIC
/begin CHARACTERISTIC FaultManager.APP2_AdaptRangeLow.Total_Samples__Y_ "Fault manager configuration.  Select up to 4 actions for each fault." VALUE 0x80002B73 RecordLayout_4 0 CompuMethod_1 0 65535 /end CHARACTERISTIC
/begin CHARACTERISTIC FaultManager.APP2_AdaptRangeLow.Action_1 "Fault manager configuration.  Select up to 4 actions for each fault." VALUE 0x80002B75 RecordLayout_4 0 CompuMethod_113 0 65535 /end CHARACTERISTIC
/begin CHARACTERISTIC FaultManager.APP2_AdaptRangeLow.Action_1_Condition "Fault manager configuration.  Select up to 4 actions for each fault." VALUE 0x80002B77 RecordLayout_4 0 CompuMethod_114 0 65535 /end CHARACTERISTIC
/begin CHARACTERISTIC FaultManager.APP2_AdaptRangeLow.Action_2 "Fault manager configuration.  Select up to 4 actions for each fault." VALUE 0x80002B79 RecordLayout_4 0 CompuMethod_113 0 65535 /end CHARACTERISTIC
/begin CHARACTERISTIC FaultManager.APP2_AdaptRangeLow.Action_2_Condition "Fault manager configuration.  Select up to 4 actions for each fault." VALUE 0x80002B7B RecordLayout_4 0 CompuMethod_114 0 65535 /end CHARACTERISTIC
/begin CHARACTERISTIC FaultManager.APP2_AdaptRangeLow.Action_3 "Fault manager configuration.  Select up to 4 actions for each fault." VALUE 0x80002B7D RecordLayout_4 0 CompuMethod_113 0 65535 /end CHARACTERISTIC
/begin CHARACTERISTIC FaultManager.APP2_AdaptRangeLow.Action_3_Condition "Fault manager configuration.  Select up to 4 actions for each fault." VALUE 0x80002B7F RecordLayout_4 0 CompuMethod_114 0 65535 /end CHARACTERISTIC
/begin CHARACTERISTIC FaultManager.APP2_AdaptRangeLow.Action_4 "Fault manager configuration.  Select up to 4 actions for each fault." VALUE 0x80002B81 RecordLayout_4 0 CompuMethod_113 0 65535 /end CHARACTERISTIC
/begin CHARACTERISTIC FaultManager.APP2_AdaptRangeLow.Action_4_Condition "Fault manager configuration.  Select up to 4 actions for each fault." VALUE 0x80002B83 RecordLayout_4 0 CompuMethod_114 0 65535 /end CHARACTERISTIC
/begin CHARACTERISTIC FaultManager.APP_Sensors_Conflict.Mode "Fault manager configuration.  Select up to 4 actions for each fault." VALUE 0x80002B85 RecordLayout_4 0 CompuMethod_111 0 65535 /end CHARACTERISTIC
/begin CHARACTERISTIC FaultManager.APP_Sensors_Conflict.ID "Fault manager configuration.  Select up to 4 actions for each fault." VALUE 0x80002B87 RecordLayout_4 0 CompuMethod_1 0 65535 /end CHARACTERISTIC
/begin CHARACTERISTIC FaultManager.APP_Sensors_Conflict.Test "Fault manager configuration.  Select up to 4 actions for each fault." VALUE 0x80002B89 RecordLayout_4 0 CompuMethod_112 0 65535 /end CHARACTERISTIC
/begin CHARACTERISTIC FaultManager.APP_Sensors_Conflict.Faulty_Samples__X_ "Fault manager configuration.  Select up to 4 actions for each fault." VALUE 0x80002B8B RecordLayout_4 0 CompuMethod_1 0 65535 /end CHARACTERISTIC
/begin CHARACTERISTIC FaultManager.APP_Sensors_Conflict.Total_Samples__Y_ "Fault manager configuration.  Select up to 4 actions for each fault." VALUE 0x80002B8D RecordLayout_4 0 CompuMethod_1 0 65535 /end CHARACTERISTIC
/begin CHARACTERISTIC FaultManager.APP_Sensors_Conflict.Action_1 "Fault manager configuration.  Select up to 4 actions for each fault." VALUE 0x80002B8F RecordLayout_4 0 CompuMethod_113 0 65535 /end CHARACTERISTIC
/begin CHARACTERISTIC FaultManager.APP_Sensors_Conflict.Action_1_Condition "Fault manager configuration.  Select up to 4 actions for each fault." VALUE 0x80002B91 RecordLayout_4 0 CompuMethod_114 0 65535 /end CHARACTERISTIC
/begin CHARACTERISTIC FaultManager.APP_Sensors_Conflict.Action_2 "Fault manager configuration.  Select up to 4 actions for each fault." VALUE 0x80002B93 RecordLayout_4 0 CompuMethod_113 0 65535 /end CHARACTERISTIC
/begin CHARACTERISTIC FaultManager.APP_Sensors_Conflict.Action_2_Condition "Fault manager configuration.  Select up to 4 actions for each fault." VALUE 0x80002B95 RecordLayout_4 0 CompuMethod_114 0 65535 /end CHARACTERISTIC
/begin CHARACTERISTIC FaultManager.APP_Sensors_Conflict.Action_3 "Fault manager configuration.  Select up to 4 actions for each fault." VALUE 0x80002B97 RecordLayout_4 0 CompuMethod_113 0 65535 /end CHARACTERISTIC
/begin CHARACTERISTIC FaultManager.APP_Sensors_Conflict.Action_3_Condition "Fault manager configuration.  Select up to 4 actions for each fault." VALUE 0x80002B99 RecordLayout_4 0 CompuMethod_114 0 65535 /end CHARACTERISTIC
/begin CHARACTERISTIC FaultManager.APP_Sensors_Conflict.Action_4 "Fault manager configuration.  Select up to 4 actions for each fault." VALUE 0x80002B9B RecordLayout_4 0 CompuMethod_113 0 65535 /end CHARACTERISTIC
/begin CHARACTERISTIC FaultManager.APP_Sensors_Conflict.Action_4_Condition "Fault manager configuration.  Select up to 4 actions for each fault." VALUE 0x80002B9D RecordLayout_4 0 CompuMethod_114 0 65535 /end CHARACTERISTIC
/begin CHARACTERISTIC FaultManager.Bank1_EquivRatioRangeHigh.Mode "Fault manager configuration.  Select up to 4 actions for each fault." VALUE 0x80002B9F RecordLayout_4 0 CompuMethod_111 0 65535 /end CHARACTERISTIC
/begin CHARACTERISTIC FaultManager.Bank1_EquivRatioRangeHigh.ID "Fault manager configuration.  Select up to 4 actions for each fault." VALUE 0x80002BA1 RecordLayout_4 0 CompuMethod_1 0 65535 /end CHARACTERISTIC
/begin CHARACTERISTIC FaultManager.Bank1_EquivRatioRangeHigh.Test "Fault manager configuration.  Select up to 4 actions for each fault." VALUE 0x80002BA3 RecordLayout_4 0 CompuMethod_112 0 65535 /end CHARACTERISTIC
/begin CHARACTERISTIC FaultManager.Bank1_EquivRatioRangeHigh.Faulty_Samples__X_ "Fault manager configuration.  Select up to 4 actions for each fault." VALUE 0x80002BA5 RecordLayout_4 0 CompuMethod_1 0 65535 /end CHARACTERISTIC
/begin CHARACTERISTIC FaultManager.Bank1_EquivRatioRangeHigh.Total_Samples__Y_ "Fault manager configuration.  Select up to 4 actions for each fault." VALUE 0x80002BA7 RecordLayout_4 0 CompuMethod_1 0 65535 /end CHARACTERISTIC
/begin CHARACTERISTIC FaultManager.Bank1_EquivRatioRangeHigh.Action_1 "Fault manager configuration.  Select up to 4 actions for each fault." VALUE 0x80002BA9 RecordLayout_4 0 CompuMethod_113 0 65535 /end CHARACTERISTIC
/begin CHARACTERISTIC FaultManager.Bank1_EquivRatioRangeHigh.Action_1_Condition "Fault manager configuration.  Select up to 4 actions for each fault." VALUE 0x80002BAB RecordLayout_4 0 CompuMethod_114 0 65535 /end CHARACTERISTIC
/begin CHARACTERISTIC FaultManager.Bank1_EquivRatioRangeHigh.Action_2 "Fault manager configuration.  Select up to 4 actions for each fault." VALUE 0x80002BAD RecordLayout_4 0 CompuMethod_113 0 65535 /end CHARACTERISTIC
/begin CHARACTERISTIC FaultManager.Bank1_EquivRatioRangeHigh.Action_2_Condition "Fault manager configuration.  Select up to 4 actions for each fault." VALUE 0x80002BAF RecordLayout_4 0 CompuMethod_114 0 65535 /end CHARACTERISTIC
/begin CHARACTERISTIC FaultManager.Bank1_EquivRatioRangeHigh.Action_3 "Fault manager configuration.  Select up to 4 actions for each fault." VALUE 0x80002BB1 RecordLayout_4 0 CompuMethod_113 0 65535 /end CHARACTERISTIC
/begin CHARACTERISTIC FaultManager.Bank1_EquivRatioRangeHigh.Action_3_Condition "Fault manager configuration.  Select up to 4 actions for each fault." VALUE 0x80002BB3 RecordLayout_4 0 CompuMethod_114 0 65535 /end CHARACTERISTIC
/begin CHARACTERISTIC FaultManager.Bank1_EquivRatioRangeHigh.Action_4 "Fault manager configuration.  Select up to 4 actions for each fault." VALUE 0x80002BB5 RecordLayout_4 0 CompuMethod_113 0 65535 /end CHARACTERISTIC
/begin CHARACTERISTIC FaultManager.Bank1_EquivRatioRangeHigh.Action_4_Condition "Fault manager configuration.  Select up to 4 actions for each fault." VALUE 0x80002BB7 RecordLayout_4 0 CompuMethod_114 0 65535 /end CHARACTERISTIC
/begin CHARACTERISTIC FaultManager.Bank1_EquivRatioRangeLow.Mode "Fault manager configuration.  Select up to 4 actions for each fault." VALUE 0x80002BB9 RecordLayout_4 0 CompuMethod_111 0 65535 /end CHARACTERISTIC
/begin CHARACTERISTIC FaultManager.Bank1_EquivRatioRangeLow.ID "Fault manager configuration.  Select up to 4 actions for each fault." VALUE 0x80002BBB RecordLayout_4 0 CompuMethod_1 0 65535 /end CHARACTERISTIC
/begin CHARACTERISTIC FaultManager.Bank1_EquivRatioRangeLow.Test "Fault manager configuration.  Select up to 4 actions for each fault." VALUE 0x80002BBD RecordLayout_4 0 CompuMethod_112 0 65535 /end CHARACTERISTIC
/begin CHARACTERISTIC FaultManager.Bank1_EquivRatioRangeLow.Faulty_Samples__X_ "Fault manager configuration.  Select up to 4 actions for each fault." VALUE 0x80002BBF RecordLayout_4 0 CompuMethod_1 0 65535 /end CHARACTERISTIC
/begin CHARACTERISTIC FaultManager.Bank1_EquivRatioRangeLow.Total_Samples__Y_ "Fault manager configuration.  Select up to 4 actions for each fault." VALUE 0x80002BC1 RecordLayout_4 0 CompuMethod_1 0 65535 /end CHARACTERISTIC
/begin CHARACTERISTIC FaultManager.Bank1_EquivRatioRangeLow.Action_1 "Fault manager configuration.  Select up to 4 actions for each fault." VALUE 0x80002BC3 RecordLayout_4 0 CompuMethod_113 0 65535 /end CHARACTERISTIC
/begin CHARACTERISTIC FaultManager.Bank1_EquivRatioRangeLow.Action_1_Condition "Fault manager configuration.  Select up to 4 actions for each fault." VALUE 0x80002BC5 RecordLayout_4 0 CompuMethod_114 0 65535 /end CHARACTERISTIC
/begin CHARACTERISTIC FaultManager.Bank1_EquivRatioRangeLow.Action_2 "Fault manager configuration.  Select up to 4 actions for each fault." VALUE 0x80002BC7 RecordLayout_4 0 CompuMethod_113 0 65535 /end CHARACTERISTIC
/begin CHARACTERISTIC FaultManager.Bank1_EquivRatioRangeLow.Action_2_Condition "Fault manager configuration.  Select up to 4 actions for each fault." VALUE 0x80002BC9 RecordLayout_4 0 CompuMethod_114 0 65535 /end CHARACTERISTIC
/begin CHARACTERISTIC FaultManager.Bank1_EquivRatioRangeLow.Action_3 "Fault manager configuration.  Select up to 4 actions for each fault." VALUE 0x80002BCB RecordLayout_4 0 CompuMethod_113 0 65535 /end CHARACTERISTIC
/begin CHARACTERISTIC FaultManager.Bank1_EquivRatioRangeLow.Action_3_Condition "Fault manager configuration.  Select up to 4 actions for each fault." VALUE 0x80002BCD RecordLayout_4 0 CompuMethod_114 0 65535 /end CHARACTERISTIC
/begin CHARACTERISTIC FaultManager.Bank1_EquivRatioRangeLow.Action_4 "Fault manager configuration.  Select up to 4 actions for each fault." VALUE 0x80002BCF RecordLayout_4 0 CompuMethod_113 0 65535 /end CHARACTERISTIC
/begin CHARACTERISTIC FaultManager.Bank1_EquivRatioRangeLow.Action_4_Condition "Fault manager configuration.  Select up to 4 actions for each fault." VALUE 0x80002BD1 RecordLayout_4 0 CompuMethod_114 0 65535 /end CHARACTERISTIC
/begin CHARACTERISTIC FaultManager.Bank2_EquivRatioRangeHigh.Mode "Fault manager configuration.  Select up to 4 actions for each fault." VALUE 0x80002BD3 RecordLayout_4 0 CompuMethod_111 0 65535 /end CHARACTERISTIC
/begin CHARACTERISTIC FaultManager.Bank2_EquivRatioRangeHigh.ID "Fault manager configuration.  Select up to 4 actions for each fault." VALUE 0x80002BD5 RecordLayout_4 0 CompuMethod_1 0 65535 /end CHARACTERISTIC
/begin CHARACTERISTIC FaultManager.Bank2_EquivRatioRangeHigh.Test "Fault manager configuration.  Select up to 4 actions for each fault." VALUE 0x80002BD7 RecordLayout_4 0 CompuMethod_112 0 65535 /end CHARACTERISTIC
/begin CHARACTERISTIC FaultManager.Bank2_EquivRatioRangeHigh.Faulty_Samples__X_ "Fault manager configuration.  Select up to 4 actions for each fault." VALUE 0x80002BD9 RecordLayout_4 0 CompuMethod_1 0 65535 /end CHARACTERISTIC
/begin CHARACTERISTIC FaultManager.Bank2_EquivRatioRangeHigh.Total_Samples__Y_ "Fault manager configuration.  Select up to 4 actions for each fault." VALUE 0x80002BDB RecordLayout_4 0 CompuMethod_1 0 65535 /end CHARACTERISTIC
/begin CHARACTERISTIC FaultManager.Bank2_EquivRatioRangeHigh.Action_1 "Fault manager configuration.  Select up to 4 actions for each fault." VALUE 0x80002BDD RecordLayout_4 0 CompuMethod_113 0 65535 /end CHARACTERISTIC
/begin CHARACTERISTIC FaultManager.Bank2_EquivRatioRangeHigh.Action_1_Condition "Fault manager configuration.  Select up to 4 actions for each fault." VALUE 0x80002BDF RecordLayout_4 0 CompuMethod_114 0 65535 /end CHARACTERISTIC
/begin CHARACTERISTIC FaultManager.Bank2_EquivRatioRangeHigh.Action_2 "Fault manager configuration.  Select up to 4 actions for each fault." VALUE 0x80002BE1 RecordLayout_4 0 CompuMethod_113 0 65535 /end CHARACTERISTIC
/begin CHARACTERISTIC FaultManager.Bank2_EquivRatioRangeHigh.Action_2_Condition "Fault manager configuration.  Select up to 4 actions for each fault." VALUE 0x80002BE3 RecordLayout_4 0 CompuMethod_114 0 65535 /end CHARACTERISTIC
/begin CHARACTERISTIC FaultManager.Bank2_EquivRatioRangeHigh.Action_3 "Fault manager configuration.  Select up to 4 actions for each fault." VALUE 0x80002BE5 RecordLayout_4 0 CompuMethod_113 0 65535 /end CHARACTERISTIC
/begin CHARACTERISTIC FaultManager.Bank2_EquivRatioRangeHigh.Action_3_Condition "Fault manager configuration.  Select up to 4 actions for each fault." VALUE 0x80002BE7 RecordLayout_4 0 CompuMethod_114 0 65535 /end CHARACTERISTIC
/begin CHARACTERISTIC FaultManager.Bank2_EquivRatioRangeHigh.Action_4 "Fault manager configuration.  Select up to 4 actions for each fault." VALUE 0x80002BE9 RecordLayout_4 0 CompuMethod_113 0 65535 /end CHARACTERISTIC
/begin CHARACTERISTIC FaultManager.Bank2_EquivRatioRangeHigh.Action_4_Condition "Fault manager configuration.  Select up to 4 actions for each fault." VALUE 0x80002BEB RecordLayout_4 0 CompuMethod_114 0 65535 /end CHARACTERISTIC
/begin CHARACTERISTIC FaultManager.Bank2_EquivRatioRangeLow.Mode "Fault manager configuration.  Select up to 4 actions for each fault." VALUE 0x80002BED RecordLayout_4 0 CompuMethod_111 0 65535 /end CHARACTERISTIC
/begin CHARACTERISTIC FaultManager.Bank2_EquivRatioRangeLow.ID "Fault manager configuration.  Select up to 4 actions for each fault." VALUE 0x80002BEF RecordLayout_4 0 CompuMethod_1 0 65535 /end CHARACTERISTIC
/begin CHARACTERISTIC FaultManager.Bank2_EquivRatioRangeLow.Test "Fault manager configuration.  Select up to 4 actions for each fault." VALUE 0x80002BF1 RecordLayout_4 0 CompuMethod_112 0 65535 /end CHARACTERISTIC
/begin CHARACTERISTIC FaultManager.Bank2_EquivRatioRangeLow.Faulty_Samples__X_ "Fault manager configuration.  Select up to 4 actions for each fault." VALUE 0x80002BF3 RecordLayout_4 0 CompuMethod_1 0 65535 /end CHARACTERISTIC
/begin CHARACTERISTIC FaultManager.Bank2_EquivRatioRangeLow.Total_Samples__Y_ "Fault manager configuration.  Select up to 4 actions for each fault." VALUE 0x80002BF5 RecordLayout_4 0 CompuMethod_1 0 65535 /end CHARACTERISTIC
/begin CHARACTERISTIC FaultManager.Bank2_EquivRatioRangeLow.Action_1 "Fault manager configuration.  Select up to 4 actions for each fault." VALUE 0x80002BF7 RecordLayout_4 0 CompuMethod_113 0 65535 /end CHARACTERISTIC
/begin CHARACTERISTIC FaultManager.Bank2_EquivRatioRangeLow.Action_1_Condition "Fault manager configuration.  Select up to 4 actions for each fault." VALUE 0x80002BF9 RecordLayout_4 0 CompuMethod_114 0 65535 /end CHARACTERISTIC
/begin CHARACTERISTIC FaultManager.Bank2_EquivRatioRangeLow.Action_2 "Fault manager configuration.  Select up to 4 actions for each fault." VALUE 0x80002BFB RecordLayout_4 0 CompuMethod_113 0 65535 /end CHARACTERISTIC
/begin CHARACTERISTIC FaultManager.Bank2_EquivRatioRangeLow.Action_2_Condition "Fault manager configuration.  Select up to 4 actions for each fault." VALUE 0x80002BFD RecordLayout_4 0 CompuMethod_114 0 65535 /end CHARACTERISTIC
/begin CHARACTERISTIC FaultManager.Bank2_EquivRatioRangeLow.Action_3 "Fault manager configuration.  Select up to 4 actions for each fault." VALUE 0x80002BFF RecordLayout_4 0 CompuMethod_113 0 65535 /end CHARACTERISTIC
/begin CHARACTERISTIC FaultManager.Bank2_EquivRatioRangeLow.Action_3_Condition "Fault manager configuration.  Select up to 4 actions for each fault." VALUE 0x80002C01 RecordLayout_4 0 CompuMethod_114 0 65535 /end CHARACTERISTIC
/begin CHARACTERISTIC FaultManager.Bank2_EquivRatioRangeLow.Action_4 "Fault manager configuration.  Select up to 4 actions for each fault." VALUE 0x80002C03 RecordLayout_4 0 CompuMethod_113 0 65535 /end CHARACTERISTIC
/begin CHARACTERISTIC FaultManager.Bank2_EquivRatioRangeLow.Action_4_Condition "Fault manager configuration.  Select up to 4 actions for each fault." VALUE 0x80002C05 RecordLayout_4 0 CompuMethod_114 0 65535 /end CHARACTERISTIC
/begin CHARACTERISTIC FaultManager.CATRangeHigh.Mode "Fault manager configuration.  Select up to 4 actions for each fault." VALUE 0x80002C07 RecordLayout_4 0 CompuMethod_111 0 65535 /end CHARACTERISTIC
/begin CHARACTERISTIC FaultManager.CATRangeHigh.ID "Fault manager configuration.  Select up to 4 actions for each fault." VALUE 0x80002C09 RecordLayout_4 0 CompuMethod_1 0 65535 /end CHARACTERISTIC
/begin CHARACTERISTIC FaultManager.CATRangeHigh.Test "Fault manager configuration.  Select up to 4 actions for each fault." VALUE 0x80002C0B RecordLayout_4 0 CompuMethod_112 0 65535 /end CHARACTERISTIC
/begin CHARACTERISTIC FaultManager.CATRangeHigh.Faulty_Samples__X_ "Fault manager configuration.  Select up to 4 actions for each fault." VALUE 0x80002C0D RecordLayout_4 0 CompuMethod_1 0 65535 /end CHARACTERISTIC
/begin CHARACTERISTIC FaultManager.CATRangeHigh.Total_Samples__Y_ "Fault manager configuration.  Select up to 4 actions for each fault." VALUE 0x80002C0F RecordLayout_4 0 CompuMethod_1 0 65535 /end CHARACTERISTIC
/begin CHARACTERISTIC FaultManager.CATRangeHigh.Action_1 "Fault manager configuration.  Select up to 4 actions for each fault." VALUE 0x80002C11 RecordLayout_4 0 CompuMethod_113 0 65535 /end CHARACTERISTIC
/begin CHARACTERISTIC FaultManager.CATRangeHigh.Action_1_Condition "Fault manager configuration.  Select up to 4 actions for each fault." VALUE 0x80002C13 RecordLayout_4 0 CompuMethod_114 0 65535 /end CHARACTERISTIC
/begin CHARACTERISTIC FaultManager.CATRangeHigh.Action_2 "Fault manager configuration.  Select up to 4 actions for each fault." VALUE 0x80002C15 RecordLayout_4 0 CompuMethod_113 0 65535 /end CHARACTERISTIC
/begin CHARACTERISTIC FaultManager.CATRangeHigh.Action_2_Condition "Fault manager configuration.  Select up to 4 actions for each fault." VALUE 0x80002C17 RecordLayout_4 0 CompuMethod_114 0 65535 /end CHARACTERISTIC
/begin CHARACTERISTIC FaultManager.CATRangeHigh.Action_3 "Fault manager configuration.  Select up to 4 actions for each fault." VALUE 0x80002C19 RecordLayout_4 0 CompuMethod_113 0 65535 /end CHARACTERISTIC
/begin CHARACTERISTIC FaultManager.CATRangeHigh.Action_3_Condition "Fault manager configuration.  Select up to 4 actions for each fault." VALUE 0x80002C1B RecordLayout_4 0 CompuMethod_114 0 65535 /end CHARACTERISTIC
/begin CHARACTERISTIC FaultManager.CATRangeHigh.Action_4 "Fault manager configuration.  Select up to 4 actions for each fault." VALUE 0x80002C1D RecordLayout_4 0 CompuMethod_113 0 65535 /end CHARACTERISTIC
/begin CHARACTERISTIC FaultManager.CATRangeHigh.Action_4_Condition "Fault manager configuration.  Select up to 4 actions for each fault." VALUE 0x80002C1F RecordLayout_4 0 CompuMethod_114 0 65535 /end CHARACTERISTIC
/begin CHARACTERISTIC FaultManager.CATRangeLow.Mode "Fault manager configuration.  Select up to 4 actions for each fault." VALUE 0x80002C21 RecordLayout_4 0 CompuMethod_111 0 65535 /end CHARACTERISTIC
/begin CHARACTERISTIC FaultManager.CATRangeLow.ID "Fault manager configuration.  Select up to 4 actions for each fault." VALUE 0x80002C23 RecordLayout_4 0 CompuMethod_1 0 65535 /end CHARACTERISTIC
/begin CHARACTERISTIC FaultManager.CATRangeLow.Test "Fault manager configuration.  Select up to 4 actions for each fault." VALUE 0x80002C25 RecordLayout_4 0 CompuMethod_112 0 65535 /end CHARACTERISTIC
/begin CHARACTERISTIC FaultManager.CATRangeLow.Faulty_Samples__X_ "Fault manager configuration.  Select up to 4 actions for each fault." VALUE 0x80002C27 RecordLayout_4 0 CompuMethod_1 0 65535 /end CHARACTERISTIC
/begin CHARACTERISTIC FaultManager.CATRangeLow.Total_Samples__Y_ "Fault manager configuration.  Select up to 4 actions for each fault." VALUE 0x80002C29 RecordLayout_4 0 CompuMethod_1 0 65535 /end CHARACTERISTIC
/begin CHARACTERISTIC FaultManager.CATRangeLow.Action_1 "Fault manager configuration.  Select up to 4 actions for each fault." VALUE 0x80002C2B RecordLayout_4 0 CompuMethod_113 0 65535 /end CHARACTERISTIC
/begin CHARACTERISTIC FaultManager.CATRangeLow.Action_1_Condition "Fault manager configuration.  Select up to 4 actions for each fault." VALUE 0x80002C2D RecordLayout_4 0 CompuMethod_114 0 65535 /end CHARACTERISTIC
/begin CHARACTERISTIC FaultManager.CATRangeLow.Action_2 "Fault manager configuration.  Select up to 4 actions for each fault." VALUE 0x80002C2F RecordLayout_4 0 CompuMethod_113 0 65535 /end CHARACTERISTIC
/begin CHARACTERISTIC FaultManager.CATRangeLow.Action_2_Condition "Fault manager configuration.  Select up to 4 actions for each fault." VALUE 0x80002C31 RecordLayout_4 0 CompuMethod_114 0 65535 /end CHARACTERISTIC
/begin CHARACTERISTIC FaultManager.CATRangeLow.Action_3 "Fault manager configuration.  Select up to 4 actions for each fault." VALUE 0x80002C33 RecordLayout_4 0 CompuMethod_113 0 65535 /end CHARACTERISTIC
/begin CHARACTERISTIC FaultManager.CATRangeLow.Action_3_Condition "Fault manager configuration.  Select up to 4 actions for each fault." VALUE 0x80002C35 RecordLayout_4 0 CompuMethod_114 0 65535 /end CHARACTERISTIC
/begin CHARACTERISTIC FaultManager.CATRangeLow.Action_4 "Fault manager configuration.  Select up to 4 actions for each fault." VALUE 0x80002C37 RecordLayout_4 0 CompuMethod_113 0 65535 /end CHARACTERISTIC
/begin CHARACTERISTIC FaultManager.CATRangeLow.Action_4_Condition "Fault manager configuration.  Select up to 4 actions for each fault." VALUE 0x80002C39 RecordLayout_4 0 CompuMethod_114 0 65535 /end CHARACTERISTIC
/begin CHARACTERISTIC FaultManager.CamEdgesFault.Mode "Fault manager configuration.  Select up to 4 actions for each fault." VALUE 0x80002C3B RecordLayout_4 0 CompuMethod_111 0 65535 /end CHARACTERISTIC
/begin CHARACTERISTIC FaultManager.CamEdgesFault.ID "Fault manager configuration.  Select up to 4 actions for each fault." VALUE 0x80002C3D RecordLayout_4 0 CompuMethod_1 0 65535 /end CHARACTERISTIC
/begin CHARACTERISTIC FaultManager.CamEdgesFault.Test "Fault manager configuration.  Select up to 4 actions for each fault." VALUE 0x80002C3F RecordLayout_4 0 CompuMethod_112 0 65535 /end CHARACTERISTIC
/begin CHARACTERISTIC FaultManager.CamEdgesFault.Faulty_Samples__X_ "Fault manager configuration.  Select up to 4 actions for each fault." VALUE 0x80002C41 RecordLayout_4 0 CompuMethod_1 0 65535 /end CHARACTERISTIC
/begin CHARACTERISTIC FaultManager.CamEdgesFault.Total_Samples__Y_ "Fault manager configuration.  Select up to 4 actions for each fault." VALUE 0x80002C43 RecordLayout_4 0 CompuMethod_1 0 65535 /end CHARACTERISTIC
/begin CHARACTERISTIC FaultManager.CamEdgesFault.Action_1 "Fault manager configuration.  Select up to 4 actions for each fault." VALUE 0x80002C45 RecordLayout_4 0 CompuMethod_113 0 65535 /end CHARACTERISTIC
/begin CHARACTERISTIC FaultManager.CamEdgesFault.Action_1_Condition "Fault manager configuration.  Select up to 4 actions for each fault." VALUE 0x80002C47 RecordLayout_4 0 CompuMethod_114 0 65535 /end CHARACTERISTIC
/begin CHARACTERISTIC FaultManager.CamEdgesFault.Action_2 "Fault manager configuration.  Select up to 4 actions for each fault." VALUE 0x80002C49 RecordLayout_4 0 CompuMethod_113 0 65535 /end CHARACTERISTIC
/begin CHARACTERISTIC FaultManager.CamEdgesFault.Action_2_Condition "Fault manager configuration.  Select up to 4 actions for each fault." VALUE 0x80002C4B RecordLayout_4 0 CompuMethod_114 0 65535 /end CHARACTERISTIC
/begin CHARACTERISTIC FaultManager.CamEdgesFault.Action_3 "Fault manager configuration.  Select up to 4 actions for each fault." VALUE 0x80002C4D RecordLayout_4 0 CompuMethod_113 0 65535 /end CHARACTERISTIC
/begin CHARACTERISTIC FaultManager.CamEdgesFault.Action_3_Condition "Fault manager configuration.  Select up to 4 actions for each fault." VALUE 0x80002C4F RecordLayout_4 0 CompuMethod_114 0 65535 /end CHARACTERISTIC
/begin CHARACTERISTIC FaultManager.CamEdgesFault.Action_4 "Fault manager configuration.  Select up to 4 actions for each fault." VALUE 0x80002C51 RecordLayout_4 0 CompuMethod_113 0 65535 /end CHARACTERISTIC
/begin CHARACTERISTIC FaultManager.CamEdgesFault.Action_4_Condition "Fault manager configuration.  Select up to 4 actions for each fault." VALUE 0x80002C53 RecordLayout_4 0 CompuMethod_114 0 65535 /end CHARACTERISTIC
/begin CHARACTERISTIC FaultManager.CamSyncFault.Mode "Fault manager configuration.  Select up to 4 actions for each fault." VALUE 0x80002C55 RecordLayout_4 0 CompuMethod_111 0 65535 /end CHARACTERISTIC
/begin CHARACTERISTIC FaultManager.CamSyncFault.ID "Fault manager configuration.  Select up to 4 actions for each fault." VALUE 0x80002C57 RecordLayout_4 0 CompuMethod_1 0 65535 /end CHARACTERISTIC
/begin CHARACTERISTIC FaultManager.CamSyncFault.Test "Fault manager configuration.  Select up to 4 actions for each fault." VALUE 0x80002C59 RecordLayout_4 0 CompuMethod_112 0 65535 /end CHARACTERISTIC
/begin CHARACTERISTIC FaultManager.CamSyncFault.Faulty_Samples__X_ "Fault manager configuration.  Select up to 4 actions for each fault." VALUE 0x80002C5B RecordLayout_4 0 CompuMethod_1 0 65535 /end CHARACTERISTIC
/begin CHARACTERISTIC FaultManager.CamSyncFault.Total_Samples__Y_ "Fault manager configuration.  Select up to 4 actions for each fault." VALUE 0x80002C5D RecordLayout_4 0 CompuMethod_1 0 65535 /end CHARACTERISTIC
/begin CHARACTERISTIC FaultManager.CamSyncFault.Action_1 "Fault manager configuration.  Select up to 4 actions for each fault." VALUE 0x80002C5F RecordLayout_4 0 CompuMethod_113 0 65535 /end CHARACTERISTIC
/begin CHARACTERISTIC FaultManager.CamSyncFault.Action_1_Condition "Fault manager configuration.  Select up to 4 actions for each fault." VALUE 0x80002C61 RecordLayout_4 0 CompuMethod_114 0 65535 /end CHARACTERISTIC
/begin CHARACTERISTIC FaultManager.CamSyncFault.Action_2 "Fault manager configuration.  Select up to 4 actions for each fault." VALUE 0x80002C63 RecordLayout_4 0 CompuMethod_113 0 65535 /end CHARACTERISTIC
/begin CHARACTERISTIC FaultManager.CamSyncFault.Action_2_Condition "Fault manager configuration.  Select up to 4 actions for each fault." VALUE 0x80002C65 RecordLayout_4 0 CompuMethod_114 0 65535 /end CHARACTERISTIC
/begin CHARACTERISTIC FaultManager.CamSyncFault.Action_3 "Fault manager configuration.  Select up to 4 actions for each fault." VALUE 0x80002C67 RecordLayout_4 0 CompuMethod_113 0 65535 /end CHARACTERISTIC
/begin CHARACTERISTIC FaultManager.CamSyncFault.Action_3_Condition "Fault manager configuration.  Select up to 4 actions for each fault." VALUE 0x80002C69 RecordLayout_4 0 CompuMethod_114 0 65535 /end CHARACTERISTIC
/begin CHARACTERISTIC FaultManager.CamSyncFault.Action_4 "Fault manager configuration.  Select up to 4 actions for each fault." VALUE 0x80002C6B RecordLayout_4 0 CompuMethod_113 0 65535 /end CHARACTERISTIC
/begin CHARACTERISTIC FaultManager.CamSyncFault.Action_4_Condition "Fault manager configuration.  Select up to 4 actions for each fault." VALUE 0x80002C6D RecordLayout_4 0 CompuMethod_114 0 65535 /end CHARACTERISTIC
/begin CHARACTERISTIC FaultManager.CrankEdgesFault.Mode "Fault manager configuration.  Select up to 4 actions for each fault." VALUE 0x80002C6F RecordLayout_4 0 CompuMethod_111 0 65535 /end CHARACTERISTIC
/begin CHARACTERISTIC FaultManager.CrankEdgesFault.ID "Fault manager configuration.  Select up to 4 actions for each fault." VALUE 0x80002C71 RecordLayout_4 0 CompuMethod_1 0 65535 /end CHARACTERISTIC
/begin CHARACTERISTIC FaultManager.CrankEdgesFault.Test "Fault manager configuration.  Select up to 4 actions for each fault." VALUE 0x80002C73 RecordLayout_4 0 CompuMethod_112 0 65535 /end CHARACTERISTIC
/begin CHARACTERISTIC FaultManager.CrankEdgesFault.Faulty_Samples__X_ "Fault manager configuration.  Select up to 4 actions for each fault." VALUE 0x80002C75 RecordLayout_4 0 CompuMethod_1 0 65535 /end CHARACTERISTIC
/begin CHARACTERISTIC FaultManager.CrankEdgesFault.Total_Samples__Y_ "Fault manager configuration.  Select up to 4 actions for each fault." VALUE 0x80002C77 RecordLayout_4 0 CompuMethod_1 0 65535 /end CHARACTERISTIC
/begin CHARACTERISTIC FaultManager.CrankEdgesFault.Action_1 "Fault manager configuration.  Select up to 4 actions for each fault." VALUE 0x80002C79 RecordLayout_4 0 CompuMethod_113 0 65535 /end CHARACTERISTIC
/begin CHARACTERISTIC FaultManager.CrankEdgesFault.Action_1_Condition "Fault manager configuration.  Select up to 4 actions for each fault." VALUE 0x80002C7B RecordLayout_4 0 CompuMethod_114 0 65535 /end CHARACTERISTIC
/begin CHARACTERISTIC FaultManager.CrankEdgesFault.Action_2 "Fault manager configuration.  Select up to 4 actions for each fault." VALUE 0x80002C7D RecordLayout_4 0 CompuMethod_113 0 65535 /end CHARACTERISTIC
/begin CHARACTERISTIC FaultManager.CrankEdgesFault.Action_2_Condition "Fault manager configuration.  Select up to 4 actions for each fault." VALUE 0x80002C7F RecordLayout_4 0 CompuMethod_114 0 65535 /end CHARACTERISTIC
/begin CHARACTERISTIC FaultManager.CrankEdgesFault.Action_3 "Fault manager configuration.  Select up to 4 actions for each fault." VALUE 0x80002C81 RecordLayout_4 0 CompuMethod_113 0 65535 /end CHARACTERISTIC
/begin CHARACTERISTIC FaultManager.CrankEdgesFault.Action_3_Condition "Fault manager configuration.  Select up to 4 actions for each fault." VALUE 0x80002C83 RecordLayout_4 0 CompuMethod_114 0 65535 /end CHARACTERISTIC
/begin CHARACTERISTIC FaultManager.CrankEdgesFault.Action_4 "Fault manager configuration.  Select up to 4 actions for each fault." VALUE 0x80002C85 RecordLayout_4 0 CompuMethod_113 0 65535 /end CHARACTERISTIC
/begin CHARACTERISTIC FaultManager.CrankEdgesFault.Action_4_Condition "Fault manager configuration.  Select up to 4 actions for each fault." VALUE 0x80002C87 RecordLayout_4 0 CompuMethod_114 0 65535 /end CHARACTERISTIC
/begin CHARACTERISTIC FaultManager.CrankSyncFault.Mode "Fault manager configuration.  Select up to 4 actions for each fault." VALUE 0x80002C89 RecordLayout_4 0 CompuMethod_111 0 65535 /end CHARACTERISTIC
/begin CHARACTERISTIC FaultManager.CrankSyncFault.ID "Fault manager configuration.  Select up to 4 actions for each fault." VALUE 0x80002C8B RecordLayout_4 0 CompuMethod_1 0 65535 /end CHARACTERISTIC
/begin CHARACTERISTIC FaultManager.CrankSyncFault.Test "Fault manager configuration.  Select up to 4 actions for each fault." VALUE 0x80002C8D RecordLayout_4 0 CompuMethod_112 0 65535 /end CHARACTERISTIC
/begin CHARACTERISTIC FaultManager.CrankSyncFault.Faulty_Samples__X_ "Fault manager configuration.  Select up to 4 actions for each fault." VALUE 0x80002C8F RecordLayout_4 0 CompuMethod_1 0 65535 /end CHARACTERISTIC
/begin CHARACTERISTIC FaultManager.CrankSyncFault.Total_Samples__Y_ "Fault manager configuration.  Select up to 4 actions for each fault." VALUE 0x80002C91 RecordLayout_4 0 CompuMethod_1 0 65535 /end CHARACTERISTIC
/begin CHARACTERISTIC FaultManager.CrankSyncFault.Action_1 "Fault manager configuration.  Select up to 4 actions for each fault." VALUE 0x80002C93 RecordLayout_4 0 CompuMethod_113 0 65535 /end CHARACTERISTIC
/begin CHARACTERISTIC FaultManager.CrankSyncFault.Action_1_Condition "Fault manager configuration.  Select up to 4 actions for each fault." VALUE 0x80002C95 RecordLayout_4 0 CompuMethod_114 0 65535 /end CHARACTERISTIC
/begin CHARACTERISTIC FaultManager.CrankSyncFault.Action_2 "Fault manager configuration.  Select up to 4 actions for each fault." VALUE 0x80002C97 RecordLayout_4 0 CompuMethod_113 0 65535 /end CHARACTERISTIC
/begin CHARACTERISTIC FaultManager.CrankSyncFault.Action_2_Condition "Fault manager configuration.  Select up to 4 actions for each fault." VALUE 0x80002C99 RecordLayout_4 0 CompuMethod_114 0 65535 /end CHARACTERISTIC
/begin CHARACTERISTIC FaultManager.CrankSyncFault.Action_3 "Fault manager configuration.  Select up to 4 actions for each fault." VALUE 0x80002C9B RecordLayout_4 0 CompuMethod_113 0 65535 /end CHARACTERISTIC
/begin CHARACTERISTIC FaultManager.CrankSyncFault.Action_3_Condition "Fault manager configuration.  Select up to 4 actions for each fault." VALUE 0x80002C9D RecordLayout_4 0 CompuMethod_114 0 65535 /end CHARACTERISTIC
/begin CHARACTERISTIC FaultManager.CrankSyncFault.Action_4 "Fault manager configuration.  Select up to 4 actions for each fault." VALUE 0x80002C9F RecordLayout_4 0 CompuMethod_113 0 65535 /end CHARACTERISTIC
/begin CHARACTERISTIC FaultManager.CrankSyncFault.Action_4_Condition "Fault manager configuration.  Select up to 4 actions for each fault." VALUE 0x80002CA1 RecordLayout_4 0 CompuMethod_114 0 65535 /end CHARACTERISTIC
/begin CHARACTERISTIC FaultManager.ECTOverTempFault.Mode "Fault manager configuration.  Select up to 4 actions for each fault." VALUE 0x80002CA3 RecordLayout_4 0 CompuMethod_111 0 65535 /end CHARACTERISTIC
/begin CHARACTERISTIC FaultManager.ECTOverTempFault.ID "Fault manager configuration.  Select up to 4 actions for each fault." VALUE 0x80002CA5 RecordLayout_4 0 CompuMethod_1 0 65535 /end CHARACTERISTIC
/begin CHARACTERISTIC FaultManager.ECTOverTempFault.Test "Fault manager configuration.  Select up to 4 actions for each fault." VALUE 0x80002CA7 RecordLayout_4 0 CompuMethod_112 0 65535 /end CHARACTERISTIC
/begin CHARACTERISTIC FaultManager.ECTOverTempFault.Faulty_Samples__X_ "Fault manager configuration.  Select up to 4 actions for each fault." VALUE 0x80002CA9 RecordLayout_4 0 CompuMethod_1 0 65535 /end CHARACTERISTIC
/begin CHARACTERISTIC FaultManager.ECTOverTempFault.Total_Samples__Y_ "Fault manager configuration.  Select up to 4 actions for each fault." VALUE 0x80002CAB RecordLayout_4 0 CompuMethod_1 0 65535 /end CHARACTERISTIC
/begin CHARACTERISTIC FaultManager.ECTOverTempFault.Action_1 "Fault manager configuration.  Select up to 4 actions for each fault." VALUE 0x80002CAD RecordLayout_4 0 CompuMethod_113 0 65535 /end CHARACTERISTIC
/begin CHARACTERISTIC FaultManager.ECTOverTempFault.Action_1_Condition "Fault manager configuration.  Select up to 4 actions for each fault." VALUE 0x80002CAF RecordLayout_4 0 CompuMethod_114 0 65535 /end CHARACTERISTIC
/begin CHARACTERISTIC FaultManager.ECTOverTempFault.Action_2 "Fault manager configuration.  Select up to 4 actions for each fault." VALUE 0x80002CB1 RecordLayout_4 0 CompuMethod_113 0 65535 /end CHARACTERISTIC
/begin CHARACTERISTIC FaultManager.ECTOverTempFault.Action_2_Condition "Fault manager configuration.  Select up to 4 actions for each fault." VALUE 0x80002CB3 RecordLayout_4 0 CompuMethod_114 0 65535 /end CHARACTERISTIC
/begin CHARACTERISTIC FaultManager.ECTOverTempFault.Action_3 "Fault manager configuration.  Select up to 4 actions for each fault." VALUE 0x80002CB5 RecordLayout_4 0 CompuMethod_113 0 65535 /end CHARACTERISTIC
/begin CHARACTERISTIC FaultManager.ECTOverTempFault.Action_3_Condition "Fault manager configuration.  Select up to 4 actions for each fault." VALUE 0x80002CB7 RecordLayout_4 0 CompuMethod_114 0 65535 /end CHARACTERISTIC
/begin CHARACTERISTIC FaultManager.ECTOverTempFault.Action_4 "Fault manager configuration.  Select up to 4 actions for each fault." VALUE 0x80002CB9 RecordLayout_4 0 CompuMethod_113 0 65535 /end CHARACTERISTIC
/begin CHARACTERISTIC FaultManager.ECTOverTempFault.Action_4_Condition "Fault manager configuration.  Select up to 4 actions for each fault." VALUE 0x80002CBB RecordLayout_4 0 CompuMethod_114 0 65535 /end CHARACTERISTIC
/begin CHARACTERISTIC FaultManager.ECTRangeHigh.Mode "Fault manager configuration.  Select up to 4 actions for each fault." VALUE 0x80002CBD RecordLayout_4 0 CompuMethod_111 0 65535 /end CHARACTERISTIC
/begin CHARACTERISTIC FaultManager.ECTRangeHigh.ID "Fault manager configuration.  Select up to 4 actions for each fault." VALUE 0x80002CBF RecordLayout_4 0 CompuMethod_1 0 65535 /end CHARACTERISTIC
/begin CHARACTERISTIC FaultManager.ECTRangeHigh.Test "Fault manager configuration.  Select up to 4 actions for each fault." VALUE 0x80002CC1 RecordLayout_4 0 CompuMethod_112 0 65535 /end CHARACTERISTIC
/begin CHARACTERISTIC FaultManager.ECTRangeHigh.Faulty_Samples__X_ "Fault manager configuration.  Select up to 4 actions for each fault." VALUE 0x80002CC3 RecordLayout_4 0 CompuMethod_1 0 65535 /end CHARACTERISTIC
/begin CHARACTERISTIC FaultManager.ECTRangeHigh.Total_Samples__Y_ "Fault manager configuration.  Select up to 4 actions for each fault." VALUE 0x80002CC5 RecordLayout_4 0 CompuMethod_1 0 65535 /end CHARACTERISTIC
/begin CHARACTERISTIC FaultManager.ECTRangeHigh.Action_1 "Fault manager configuration.  Select up to 4 actions for each fault." VALUE 0x80002CC7 RecordLayout_4 0 CompuMethod_113 0 65535 /end CHARACTERISTIC
/begin CHARACTERISTIC FaultManager.ECTRangeHigh.Action_1_Condition "Fault manager configuration.  Select up to 4 actions for each fault." VALUE 0x80002CC9 RecordLayout_4 0 CompuMethod_114 0 65535 /end CHARACTERISTIC
/begin CHARACTERISTIC FaultManager.ECTRangeHigh.Action_2 "Fault manager configuration.  Select up to 4 actions for each fault." VALUE 0x80002CCB RecordLayout_4 0 CompuMethod_113 0 65535 /end CHARACTERISTIC
/begin CHARACTERISTIC FaultManager.ECTRangeHigh.Action_2_Condition "Fault manager configuration.  Select up to 4 actions for each fault." VALUE 0x80002CCD RecordLayout_4 0 CompuMethod_114 0 65535 /end CHARACTERISTIC
/begin CHARACTERISTIC FaultManager.ECTRangeHigh.Action_3 "Fault manager configuration.  Select up to 4 actions for each fault." VALUE 0x80002CCF RecordLayout_4 0 CompuMethod_113 0 65535 /end CHARACTERISTIC
/begin CHARACTERISTIC FaultManager.ECTRangeHigh.Action_3_Condition "Fault manager configuration.  Select up to 4 actions for each fault." VALUE 0x80002CD1 RecordLayout_4 0 CompuMethod_114 0 65535 /end CHARACTERISTIC
/begin CHARACTERISTIC FaultManager.ECTRangeHigh.Action_4 "Fault manager configuration.  Select up to 4 actions for each fault." VALUE 0x80002CD3 RecordLayout_4 0 CompuMethod_113 0 65535 /end CHARACTERISTIC
/begin CHARACTERISTIC FaultManager.ECTRangeHigh.Action_4_Condition "Fault manager configuration.  Select up to 4 actions for each fault." VALUE 0x80002CD5 RecordLayout_4 0 CompuMethod_114 0 65535 /end CHARACTERISTIC
/begin CHARACTERISTIC FaultManager.ECTRangeLow.Mode "Fault manager configuration.  Select up to 4 actions for each fault." VALUE 0x80002CD7 RecordLayout_4 0 CompuMethod_111 0 65535 /end CHARACTERISTIC
/begin CHARACTERISTIC FaultManager.ECTRangeLow.ID "Fault manager configuration.  Select up to 4 actions for each fault." VALUE 0x80002CD9 RecordLayout_4 0 CompuMethod_1 0 65535 /end CHARACTERISTIC
/begin CHARACTERISTIC FaultManager.ECTRangeLow.Test "Fault manager configuration.  Select up to 4 actions for each fault." VALUE 0x80002CDB RecordLayout_4 0 CompuMethod_112 0 65535 /end CHARACTERISTIC
/begin CHARACTERISTIC FaultManager.ECTRangeLow.Faulty_Samples__X_ "Fault manager configuration.  Select up to 4 actions for each fault." VALUE 0x80002CDD RecordLayout_4 0 CompuMethod_1 0 65535 /end CHARACTERISTIC
/begin CHARACTERISTIC FaultManager.ECTRangeLow.Total_Samples__Y_ "Fault manager configuration.  Select up to 4 actions for each fault." VALUE 0x80002CDF RecordLayout_4 0 CompuMethod_1 0 65535 /end CHARACTERISTIC
/begin CHARACTERISTIC FaultManager.ECTRangeLow.Action_1 "Fault manager configuration.  Select up to 4 actions for each fault." VALUE 0x80002CE1 RecordLayout_4 0 CompuMethod_113 0 65535 /end CHARACTERISTIC
/begin CHARACTERISTIC FaultManager.ECTRangeLow.Action_1_Condition "Fault manager configuration.  Select up to 4 actions for each fault." VALUE 0x80002CE3 RecordLayout_4 0 CompuMethod_114 0 65535 /end CHARACTERISTIC
/begin CHARACTERISTIC FaultManager.ECTRangeLow.Action_2 "Fault manager configuration.  Select up to 4 actions for each fault." VALUE 0x80002CE5 RecordLayout_4 0 CompuMethod_113 0 65535 /end CHARACTERISTIC
/begin CHARACTERISTIC FaultManager.ECTRangeLow.Action_2_Condition "Fault manager configuration.  Select up to 4 actions for each fault." VALUE 0x80002CE7 RecordLayout_4 0 CompuMethod_114 0 65535 /end CHARACTERISTIC
/begin CHARACTERISTIC FaultManager.ECTRangeLow.Action_3 "Fault manager configuration.  Select up to 4 actions for each fault." VALUE 0x80002CE9 RecordLayout_4 0 CompuMethod_113 0 65535 /end CHARACTERISTIC
/begin CHARACTERISTIC FaultManager.ECTRangeLow.Action_3_Condition "Fault manager configuration.  Select up to 4 actions for each fault." VALUE 0x80002CEB RecordLayout_4 0 CompuMethod_114 0 65535 /end CHARACTERISTIC
/begin CHARACTERISTIC FaultManager.ECTRangeLow.Action_4 "Fault manager configuration.  Select up to 4 actions for each fault." VALUE 0x80002CED RecordLayout_4 0 CompuMethod_113 0 65535 /end CHARACTERISTIC
/begin CHARACTERISTIC FaultManager.ECTRangeLow.Action_4_Condition "Fault manager configuration.  Select up to 4 actions for each fault." VALUE 0x80002CEF RecordLayout_4 0 CompuMethod_114 0 65535 /end CHARACTERISTIC
/begin CHARACTERISTIC FaultManager.ECTSevereOverTempFault.Mode "Fault manager configuration.  Select up to 4 actions for each fault." VALUE 0x80002CF1 RecordLayout_4 0 CompuMethod_111 0 65535 /end CHARACTERISTIC
/begin CHARACTERISTIC FaultManager.ECTSevereOverTempFault.ID "Fault manager configuration.  Select up to 4 actions for each fault." VALUE 0x80002CF3 RecordLayout_4 0 CompuMethod_1 0 65535 /end CHARACTERISTIC
/begin CHARACTERISTIC FaultManager.ECTSevereOverTempFault.Test "Fault manager configuration.  Select up to 4 actions for each fault." VALUE 0x80002CF5 RecordLayout_4 0 CompuMethod_112 0 65535 /end CHARACTERISTIC
/begin CHARACTERISTIC FaultManager.ECTSevereOverTempFault.Faulty_Samples__X_ "Fault manager configuration.  Select up to 4 actions for each fault." VALUE 0x80002CF7 RecordLayout_4 0 CompuMethod_1 0 65535 /end CHARACTERISTIC
/begin CHARACTERISTIC FaultManager.ECTSevereOverTempFault.Total_Samples__Y_ "Fault manager configuration.  Select up to 4 actions for each fault." VALUE 0x80002CF9 RecordLayout_4 0 CompuMethod_1 0 65535 /end CHARACTERISTIC
/begin CHARACTERISTIC FaultManager.ECTSevereOverTempFault.Action_1 "Fault manager configuration.  Select up to 4 actions for each fault." VALUE 0x80002CFB RecordLayout_4 0 CompuMethod_113 0 65535 /end CHARACTERISTIC
/begin CHARACTERISTIC FaultManager.ECTSevereOverTempFault.Action_1_Condition "Fault manager configuration.  Select up to 4 actions for each fault." VALUE 0x80002CFD RecordLayout_4 0 CompuMethod_114 0 65535 /end CHARACTERISTIC
/begin CHARACTERISTIC FaultManager.ECTSevereOverTempFault.Action_2 "Fault manager configuration.  Select up to 4 actions for each fault." VALUE 0x80002CFF RecordLayout_4 0 CompuMethod_113 0 65535 /end CHARACTERISTIC
/begin CHARACTERISTIC FaultManager.ECTSevereOverTempFault.Action_2_Condition "Fault manager configuration.  Select up to 4 actions for each fault." VALUE 0x80002D01 RecordLayout_4 0 CompuMethod_114 0 65535 /end CHARACTERISTIC
/begin CHARACTERISTIC FaultManager.ECTSevereOverTempFault.Action_3 "Fault manager configuration.  Select up to 4 actions for each fault." VALUE 0x80002D03 RecordLayout_4 0 CompuMethod_113 0 65535 /end CHARACTERISTIC
/begin CHARACTERISTIC FaultManager.ECTSevereOverTempFault.Action_3_Condition "Fault manager configuration.  Select up to 4 actions for each fault." VALUE 0x80002D05 RecordLayout_4 0 CompuMethod_114 0 65535 /end CHARACTERISTIC
/begin CHARACTERISTIC FaultManager.ECTSevereOverTempFault.Action_4 "Fault manager configuration.  Select up to 4 actions for each fault." VALUE 0x80002D07 RecordLayout_4 0 CompuMethod_113 0 65535 /end CHARACTERISTIC
/begin CHARACTERISTIC FaultManager.ECTSevereOverTempFault.Action_4_Condition "Fault manager configuration.  Select up to 4 actions for each fault." VALUE 0x80002D09 RecordLayout_4 0 CompuMethod_114 0 65535 /end CHARACTERISTIC
/begin CHARACTERISTIC FaultManager.EST1_Open.Mode "Fault manager configuration.  Select up to 4 actions for each fault." VALUE 0x80002D0B RecordLayout_4 0 CompuMethod_111 0 65535 /end CHARACTERISTIC
/begin CHARACTERISTIC FaultManager.EST1_Open.ID "Fault manager configuration.  Select up to 4 actions for each fault." VALUE 0x80002D0D RecordLayout_4 0 CompuMethod_1 0 65535 /end CHARACTERISTIC
/begin CHARACTERISTIC FaultManager.EST1_Open.Test "Fault manager configuration.  Select up to 4 actions for each fault." VALUE 0x80002D0F RecordLayout_4 0 CompuMethod_112 0 65535 /end CHARACTERISTIC
/begin CHARACTERISTIC FaultManager.EST1_Open.Faulty_Samples__X_ "Fault manager configuration.  Select up to 4 actions for each fault." VALUE 0x80002D11 RecordLayout_4 0 CompuMethod_1 0 65535 /end CHARACTERISTIC
/begin CHARACTERISTIC FaultManager.EST1_Open.Total_Samples__Y_ "Fault manager configuration.  Select up to 4 actions for each fault." VALUE 0x80002D13 RecordLayout_4 0 CompuMethod_1 0 65535 /end CHARACTERISTIC
/begin CHARACTERISTIC FaultManager.EST1_Open.Action_1 "Fault manager configuration.  Select up to 4 actions for each fault." VALUE 0x80002D15 RecordLayout_4 0 CompuMethod_113 0 65535 /end CHARACTERISTIC
/begin CHARACTERISTIC FaultManager.EST1_Open.Action_1_Condition "Fault manager configuration.  Select up to 4 actions for each fault." VALUE 0x80002D17 RecordLayout_4 0 CompuMethod_114 0 65535 /end CHARACTERISTIC
/begin CHARACTERISTIC FaultManager.EST1_Open.Action_2 "Fault manager configuration.  Select up to 4 actions for each fault." VALUE 0x80002D19 RecordLayout_4 0 CompuMethod_113 0 65535 /end CHARACTERISTIC
/begin CHARACTERISTIC FaultManager.EST1_Open.Action_2_Condition "Fault manager configuration.  Select up to 4 actions for each fault." VALUE 0x80002D1B RecordLayout_4 0 CompuMethod_114 0 65535 /end CHARACTERISTIC
/begin CHARACTERISTIC FaultManager.EST1_Open.Action_3 "Fault manager configuration.  Select up to 4 actions for each fault." VALUE 0x80002D1D RecordLayout_4 0 CompuMethod_113 0 65535 /end CHARACTERISTIC
/begin CHARACTERISTIC FaultManager.EST1_Open.Action_3_Condition "Fault manager configuration.  Select up to 4 actions for each fault." VALUE 0x80002D1F RecordLayout_4 0 CompuMethod_114 0 65535 /end CHARACTERISTIC
/begin CHARACTERISTIC FaultManager.EST1_Open.Action_4 "Fault manager configuration.  Select up to 4 actions for each fault." VALUE 0x80002D21 RecordLayout_4 0 CompuMethod_113 0 65535 /end CHARACTERISTIC
/begin CHARACTERISTIC FaultManager.EST1_Open.Action_4_Condition "Fault manager configuration.  Select up to 4 actions for each fault." VALUE 0x80002D23 RecordLayout_4 0 CompuMethod_114 0 65535 /end CHARACTERISTIC
/begin CHARACTERISTIC FaultManager.EST1_Short.Mode "Fault manager configuration.  Select up to 4 actions for each fault." VALUE 0x80002D25 RecordLayout_4 0 CompuMethod_111 0 65535 /end CHARACTERISTIC
/begin CHARACTERISTIC FaultManager.EST1_Short.ID "Fault manager configuration.  Select up to 4 actions for each fault." VALUE 0x80002D27 RecordLayout_4 0 CompuMethod_1 0 65535 /end CHARACTERISTIC
/begin CHARACTERISTIC FaultManager.EST1_Short.Test "Fault manager configuration.  Select up to 4 actions for each fault." VALUE 0x80002D29 RecordLayout_4 0 CompuMethod_112 0 65535 /end CHARACTERISTIC
/begin CHARACTERISTIC FaultManager.EST1_Short.Faulty_Samples__X_ "Fault manager configuration.  Select up to 4 actions for each fault." VALUE 0x80002D2B RecordLayout_4 0 CompuMethod_1 0 65535 /end CHARACTERISTIC
/begin CHARACTERISTIC FaultManager.EST1_Short.Total_Samples__Y_ "Fault manager configuration.  Select up to 4 actions for each fault." VALUE 0x80002D2D RecordLayout_4 0 CompuMethod_1 0 65535 /end CHARACTERISTIC
/begin CHARACTERISTIC FaultManager.EST1_Short.Action_1 "Fault manager configuration.  Select up to 4 actions for each fault." VALUE 0x80002D2F RecordLayout_4 0 CompuMethod_113 0 65535 /end CHARACTERISTIC
/begin CHARACTERISTIC FaultManager.EST1_Short.Action_1_Condition "Fault manager configuration.  Select up to 4 actions for each fault." VALUE 0x80002D31 RecordLayout_4 0 CompuMethod_114 0 65535 /end CHARACTERISTIC
/begin CHARACTERISTIC FaultManager.EST1_Short.Action_2 "Fault manager configuration.  Select up to 4 actions for each fault." VALUE 0x80002D33 RecordLayout_4 0 CompuMethod_113 0 65535 /end CHARACTERISTIC
/begin CHARACTERISTIC FaultManager.EST1_Short.Action_2_Condition "Fault manager configuration.  Select up to 4 actions for each fault." VALUE 0x80002D35 RecordLayout_4 0 CompuMethod_114 0 65535 /end CHARACTERISTIC
/begin CHARACTERISTIC FaultManager.EST1_Short.Action_3 "Fault manager configuration.  Select up to 4 actions for each fault." VALUE 0x80002D37 RecordLayout_4 0 CompuMethod_113 0 65535 /end CHARACTERISTIC
/begin CHARACTERISTIC FaultManager.EST1_Short.Action_3_Condition "Fault manager configuration.  Select up to 4 actions for each fault." VALUE 0x80002D39 RecordLayout_4 0 CompuMethod_114 0 65535 /end CHARACTERISTIC
/begin CHARACTERISTIC FaultManager.EST1_Short.Action_4 "Fault manager configuration.  Select up to 4 actions for each fault." VALUE 0x80002D3B RecordLayout_4 0 CompuMethod_113 0 65535 /end CHARACTERISTIC
/begin CHARACTERISTIC FaultManager.EST1_Short.Action_4_Condition "Fault manager configuration.  Select up to 4 actions for each fault." VALUE 0x80002D3D RecordLayout_4 0 CompuMethod_114 0 65535 /end CHARACTERISTIC
/begin CHARACTERISTIC FaultManager.EST2_Open.Mode "Fault manager configuration.  Select up to 4 actions for each fault." VALUE 0x80002D3F RecordLayout_4 0 CompuMethod_111 0 65535 /end CHARACTERISTIC
/begin CHARACTERISTIC FaultManager.EST2_Open.ID "Fault manager configuration.  Select up to 4 actions for each fault." VALUE 0x80002D41 RecordLayout_4 0 CompuMethod_1 0 65535 /end CHARACTERISTIC
/begin CHARACTERISTIC FaultManager.EST2_Open.Test "Fault manager configuration.  Select up to 4 actions for each fault." VALUE 0x80002D43 RecordLayout_4 0 CompuMethod_112 0 65535 /end CHARACTERISTIC
/begin CHARACTERISTIC FaultManager.EST2_Open.Faulty_Samples__X_ "Fault manager configuration.  Select up to 4 actions for each fault." VALUE 0x80002D45 RecordLayout_4 0 CompuMethod_1 0 65535 /end CHARACTERISTIC
/begin CHARACTERISTIC FaultManager.EST2_Open.Total_Samples__Y_ "Fault manager configuration.  Select up to 4 actions for each fault." VALUE 0x80002D47 RecordLayout_4 0 CompuMethod_1 0 65535 /end CHARACTERISTIC
/begin CHARACTERISTIC FaultManager.EST2_Open.Action_1 "Fault manager configuration.  Select up to 4 actions for each fault." VALUE 0x80002D49 RecordLayout_4 0 CompuMethod_113 0 65535 /end CHARACTERISTIC
/begin CHARACTERISTIC FaultManager.EST2_Open.Action_1_Condition "Fault manager configuration.  Select up to 4 actions for each fault." VALUE 0x80002D4B RecordLayout_4 0 CompuMethod_114 0 65535 /end CHARACTERISTIC
/begin CHARACTERISTIC FaultManager.EST2_Open.Action_2 "Fault manager configuration.  Select up to 4 actions for each fault." VALUE 0x80002D4D RecordLayout_4 0 CompuMethod_113 0 65535 /end CHARACTERISTIC
/begin CHARACTERISTIC FaultManager.EST2_Open.Action_2_Condition "Fault manager configuration.  Select up to 4 actions for each fault." VALUE 0x80002D4F RecordLayout_4 0 CompuMethod_114 0 65535 /end CHARACTERISTIC
/begin CHARACTERISTIC FaultManager.EST2_Open.Action_3 "Fault manager configuration.  Select up to 4 actions for each fault." VALUE 0x80002D51 RecordLayout_4 0 CompuMethod_113 0 65535 /end CHARACTERISTIC
/begin CHARACTERISTIC FaultManager.EST2_Open.Action_3_Condition "Fault manager configuration.  Select up to 4 actions for each fault." VALUE 0x80002D53 RecordLayout_4 0 CompuMethod_114 0 65535 /end CHARACTERISTIC
/begin CHARACTERISTIC FaultManager.EST2_Open.Action_4 "Fault manager configuration.  Select up to 4 actions for each fault." VALUE 0x80002D55 RecordLayout_4 0 CompuMethod_113 0 65535 /end CHARACTERISTIC
/begin CHARACTERISTIC FaultManager.EST2_Open.Action_4_Condition "Fault manager configuration.  Select up to 4 actions for each fault." VALUE 0x80002D57 RecordLayout_4 0 CompuMethod_114 0 65535 /end CHARACTERISTIC
/begin CHARACTERISTIC FaultManager.EST2_Short.Mode "Fault manager configuration.  Select up to 4 actions for each fault." VALUE 0x80002D59 RecordLayout_4 0 CompuMethod_111 0 65535 /end CHARACTERISTIC
/begin CHARACTERISTIC FaultManager.EST2_Short.ID "Fault manager configuration.  Select up to 4 actions for each fault." VALUE 0x80002D5B RecordLayout_4 0 CompuMethod_1 0 65535 /end CHARACTERISTIC
/begin CHARACTERISTIC FaultManager.EST2_Short.Test "Fault manager configuration.  Select up to 4 actions for each fault." VALUE 0x80002D5D RecordLayout_4 0 CompuMethod_112 0 65535 /end CHARACTERISTIC
/begin CHARACTERISTIC FaultManager.EST2_Short.Faulty_Samples__X_ "Fault manager configuration.  Select up to 4 actions for each fault." VALUE 0x80002D5F RecordLayout_4 0 CompuMethod_1 0 65535 /end CHARACTERISTIC
/begin CHARACTERISTIC FaultManager.EST2_Short.Total_Samples__Y_ "Fault manager configuration.  Select up to 4 actions for each fault." VALUE 0x80002D61 RecordLayout_4 0 CompuMethod_1 0 65535 /end CHARACTERISTIC
/begin CHARACTERISTIC FaultManager.EST2_Short.Action_1 "Fault manager configuration.  Select up to 4 actions for each fault." VALUE 0x80002D63 RecordLayout_4 0 CompuMethod_113 0 65535 /end CHARACTERISTIC
/begin CHARACTERISTIC FaultManager.EST2_Short.Action_1_Condition "Fault manager configuration.  Select up to 4 actions for each fault." VALUE 0x80002D65 RecordLayout_4 0 CompuMethod_114 0 65535 /end CHARACTERISTIC
/begin CHARACTERISTIC FaultManager.EST2_Short.Action_2 "Fault manager configuration.  Select up to 4 actions for each fault." VALUE 0x80002D67 RecordLayout_4 0 CompuMethod_113 0 65535 /end CHARACTERISTIC
/begin CHARACTERISTIC FaultManager.EST2_Short.Action_2_Condition "Fault manager configuration.  Select up to 4 actions for each fault." VALUE 0x80002D69 RecordLayout_4 0 CompuMethod_114 0 65535 /end CHARACTERISTIC
/begin CHARACTERISTIC FaultManager.EST2_Short.Action_3 "Fault manager configuration.  Select up to 4 actions for each fault." VALUE 0x80002D6B RecordLayout_4 0 CompuMethod_113 0 65535 /end CHARACTERISTIC
/begin CHARACTERISTIC FaultManager.EST2_Short.Action_3_Condition "Fault manager configuration.  Select up to 4 actions for each fault." VALUE 0x80002D6D RecordLayout_4 0 CompuMethod_114 0 65535 /end CHARACTERISTIC
/begin CHARACTERISTIC FaultManager.EST2_Short.Action_4 "Fault manager configuration.  Select up to 4 actions for each fault." VALUE 0x80002D6F RecordLayout_4 0 CompuMethod_113 0 65535 /end CHARACTERISTIC
/begin CHARACTERISTIC FaultManager.EST2_Short.Action_4_Condition "Fault manager configuration.  Select up to 4 actions for each fault." VALUE 0x80002D71 RecordLayout_4 0 CompuMethod_114 0 65535 /end CHARACTERISTIC
/begin CHARACTERISTIC FaultManager.EST3_Open.Mode "Fault manager configuration.  Select up to 4 actions for each fault." VALUE 0x80002D73 RecordLayout_4 0 CompuMethod_111 0 65535 /end CHARACTERISTIC
/begin CHARACTERISTIC FaultManager.EST3_Open.ID "Fault manager configuration.  Select up to 4 actions for each fault." VALUE 0x80002D75 RecordLayout_4 0 CompuMethod_1 0 65535 /end CHARACTERISTIC
/begin CHARACTERISTIC FaultManager.EST3_Open.Test "Fault manager configuration.  Select up to 4 actions for each fault." VALUE 0x80002D77 RecordLayout_4 0 CompuMethod_112 0 65535 /end CHARACTERISTIC
/begin CHARACTERISTIC FaultManager.EST3_Open.Faulty_Samples__X_ "Fault manager configuration.  Select up to 4 actions for each fault." VALUE 0x80002D79 RecordLayout_4 0 CompuMethod_1 0 65535 /end CHARACTERISTIC
/begin CHARACTERISTIC FaultManager.EST3_Open.Total_Samples__Y_ "Fault manager configuration.  Select up to 4 actions for each fault." VALUE 0x80002D7B RecordLayout_4 0 CompuMethod_1 0 65535 /end CHARACTERISTIC
/begin CHARACTERISTIC FaultManager.EST3_Open.Action_1 "Fault manager configuration.  Select up to 4 actions for each fault." VALUE 0x80002D7D RecordLayout_4 0 CompuMethod_113 0 65535 /end CHARACTERISTIC
/begin CHARACTERISTIC FaultManager.EST3_Open.Action_1_Condition "Fault manager configuration.  Select up to 4 actions for each fault." VALUE 0x80002D7F RecordLayout_4 0 CompuMethod_114 0 65535 /end CHARACTERISTIC
/begin CHARACTERISTIC FaultManager.EST3_Open.Action_2 "Fault manager configuration.  Select up to 4 actions for each fault." VALUE 0x80002D81 RecordLayout_4 0 CompuMethod_113 0 65535 /end CHARACTERISTIC
/begin CHARACTERISTIC FaultManager.EST3_Open.Action_2_Condition "Fault manager configuration.  Select up to 4 actions for each fault." VALUE 0x80002D83 RecordLayout_4 0 CompuMethod_114 0 65535 /end CHARACTERISTIC
/begin CHARACTERISTIC FaultManager.EST3_Open.Action_3 "Fault manager configuration.  Select up to 4 actions for each fault." VALUE 0x80002D85 RecordLayout_4 0 CompuMethod_113 0 65535 /end CHARACTERISTIC
/begin CHARACTERISTIC FaultManager.EST3_Open.Action_3_Condition "Fault manager configuration.  Select up to 4 actions for each fault." VALUE 0x80002D87 RecordLayout_4 0 CompuMethod_114 0 65535 /end CHARACTERISTIC
/begin CHARACTERISTIC FaultManager.EST3_Open.Action_4 "Fault manager configuration.  Select up to 4 actions for each fault." VALUE 0x80002D89 RecordLayout_4 0 CompuMethod_113 0 65535 /end CHARACTERISTIC
/begin CHARACTERISTIC FaultManager.EST3_Open.Action_4_Condition "Fault manager configuration.  Select up to 4 actions for each fault." VALUE 0x80002D8B RecordLayout_4 0 CompuMethod_114 0 65535 /end CHARACTERISTIC
/begin CHARACTERISTIC FaultManager.EST3_Short.Mode "Fault manager configuration.  Select up to 4 actions for each fault." VALUE 0x80002D8D RecordLayout_4 0 CompuMethod_111 0 65535 /end CHARACTERISTIC
/begin CHARACTERISTIC FaultManager.EST3_Short.ID "Fault manager configuration.  Select up to 4 actions for each fault." VALUE 0x80002D8F RecordLayout_4 0 CompuMethod_1 0 65535 /end CHARACTERISTIC
/begin CHARACTERISTIC FaultManager.EST3_Short.Test "Fault manager configuration.  Select up to 4 actions for each fault." VALUE 0x80002D91 RecordLayout_4 0 CompuMethod_112 0 65535 /end CHARACTERISTIC
/begin CHARACTERISTIC FaultManager.EST3_Short.Faulty_Samples__X_ "Fault manager configuration.  Select up to 4 actions for each fault." VALUE 0x80002D93 RecordLayout_4 0 CompuMethod_1 0 65535 /end CHARACTERISTIC
/begin CHARACTERISTIC FaultManager.EST3_Short.Total_Samples__Y_ "Fault manager configuration.  Select up to 4 actions for each fault." VALUE 0x80002D95 RecordLayout_4 0 CompuMethod_1 0 65535 /end CHARACTERISTIC
/begin CHARACTERISTIC FaultManager.EST3_Short.Action_1 "Fault manager configuration.  Select up to 4 actions for each fault." VALUE 0x80002D97 RecordLayout_4 0 CompuMethod_113 0 65535 /end CHARACTERISTIC
/begin CHARACTERISTIC FaultManager.EST3_Short.Action_1_Condition "Fault manager configuration.  Select up to 4 actions for each fault." VALUE 0x80002D99 RecordLayout_4 0 CompuMethod_114 0 65535 /end CHARACTERISTIC
/begin CHARACTERISTIC FaultManager.EST3_Short.Action_2 "Fault manager configuration.  Select up to 4 actions for each fault." VALUE 0x80002D9B RecordLayout_4 0 CompuMethod_113 0 65535 /end CHARACTERISTIC
/begin CHARACTERISTIC FaultManager.EST3_Short.Action_2_Condition "Fault manager configuration.  Select up to 4 actions for each fault." VALUE 0x80002D9D RecordLayout_4 0 CompuMethod_114 0 65535 /end CHARACTERISTIC
/begin CHARACTERISTIC FaultManager.EST3_Short.Action_3 "Fault manager configuration.  Select up to 4 actions for each fault." VALUE 0x80002D9F RecordLayout_4 0 CompuMethod_113 0 65535 /end CHARACTERISTIC
/begin CHARACTERISTIC FaultManager.EST3_Short.Action_3_Condition "Fault manager configuration.  Select up to 4 actions for each fault." VALUE 0x80002DA1 RecordLayout_4 0 CompuMethod_114 0 65535 /end CHARACTERISTIC
/begin CHARACTERISTIC FaultManager.EST3_Short.Action_4 "Fault manager configuration.  Select up to 4 actions for each fault." VALUE 0x80002DA3 RecordLayout_4 0 CompuMethod_113 0 65535 /end CHARACTERISTIC
/begin CHARACTERISTIC FaultManager.EST3_Short.Action_4_Condition "Fault manager configuration.  Select up to 4 actions for each fault." VALUE 0x80002DA5 RecordLayout_4 0 CompuMethod_114 0 65535 /end CHARACTERISTIC
/begin CHARACTERISTIC FaultManager.EST4_Open.Mode "Fault manager configuration.  Select up to 4 actions for each fault." VALUE 0x80002DA7 RecordLayout_4 0 CompuMethod_111 0 65535 /end CHARACTERISTIC
/begin CHARACTERISTIC FaultManager.EST4_Open.ID "Fault manager configuration.  Select up to 4 actions for each fault." VALUE 0x80002DA9 RecordLayout_4 0 CompuMethod_1 0 65535 /end CHARACTERISTIC
/begin CHARACTERISTIC FaultManager.EST4_Open.Test "Fault manager configuration.  Select up to 4 actions for each fault." VALUE 0x80002DAB RecordLayout_4 0 CompuMethod_112 0 65535 /end CHARACTERISTIC
/begin CHARACTERISTIC FaultManager.EST4_Open.Faulty_Samples__X_ "Fault manager configuration.  Select up to 4 actions for each fault." VALUE 0x80002DAD RecordLayout_4 0 CompuMethod_1 0 65535 /end CHARACTERISTIC
/begin CHARACTERISTIC FaultManager.EST4_Open.Total_Samples__Y_ "Fault manager configuration.  Select up to 4 actions for each fault." VALUE 0x80002DAF RecordLayout_4 0 CompuMethod_1 0 65535 /end CHARACTERISTIC
/begin CHARACTERISTIC FaultManager.EST4_Open.Action_1 "Fault manager configuration.  Select up to 4 actions for each fault." VALUE 0x80002DB1 RecordLayout_4 0 CompuMethod_113 0 65535 /end CHARACTERISTIC
/begin CHARACTERISTIC FaultManager.EST4_Open.Action_1_Condition "Fault manager configuration.  Select up to 4 actions for each fault." VALUE 0x80002DB3 RecordLayout_4 0 CompuMethod_114 0 65535 /end CHARACTERISTIC
/begin CHARACTERISTIC FaultManager.EST4_Open.Action_2 "Fault manager configuration.  Select up to 4 actions for each fault." VALUE 0x80002DB5 RecordLayout_4 0 CompuMethod_113 0 65535 /end CHARACTERISTIC
/begin CHARACTERISTIC FaultManager.EST4_Open.Action_2_Condition "Fault manager configuration.  Select up to 4 actions for each fault." VALUE 0x80002DB7 RecordLayout_4 0 CompuMethod_114 0 65535 /end CHARACTERISTIC
/begin CHARACTERISTIC FaultManager.EST4_Open.Action_3 "Fault manager configuration.  Select up to 4 actions for each fault." VALUE 0x80002DB9 RecordLayout_4 0 CompuMethod_113 0 65535 /end CHARACTERISTIC
/begin CHARACTERISTIC FaultManager.EST4_Open.Action_3_Condition "Fault manager configuration.  Select up to 4 actions for each fault." VALUE 0x80002DBB RecordLayout_4 0 CompuMethod_114 0 65535 /end CHARACTERISTIC
/begin CHARACTERISTIC FaultManager.EST4_Open.Action_4 "Fault manager configuration.  Select up to 4 actions for each fault." VALUE 0x80002DBD RecordLayout_4 0 CompuMethod_113 0 65535 /end CHARACTERISTIC
/begin CHARACTERISTIC FaultManager.EST4_Open.Action_4_Condition "Fault manager configuration.  Select up to 4 actions for each fault." VALUE 0x80002DBF RecordLayout_4 0 CompuMethod_114 0 65535 /end CHARACTERISTIC
/begin CHARACTERISTIC FaultManager.EST4_Short.Mode "Fault manager configuration.  Select up to 4 actions for each fault." VALUE 0x80002DC1 RecordLayout_4 0 CompuMethod_111 0 65535 /end CHARACTERISTIC
/begin CHARACTERISTIC FaultManager.EST4_Short.ID "Fault manager configuration.  Select up to 4 actions for each fault." VALUE 0x80002DC3 RecordLayout_4 0 CompuMethod_1 0 65535 /end CHARACTERISTIC
/begin CHARACTERISTIC FaultManager.EST4_Short.Test "Fault manager configuration.  Select up to 4 actions for each fault." VALUE 0x80002DC5 RecordLayout_4 0 CompuMethod_112 0 65535 /end CHARACTERISTIC
/begin CHARACTERISTIC FaultManager.EST4_Short.Faulty_Samples__X_ "Fault manager configuration.  Select up to 4 actions for each fault." VALUE 0x80002DC7 RecordLayout_4 0 CompuMethod_1 0 65535 /end CHARACTERISTIC
/begin CHARACTERISTIC FaultManager.EST4_Short.Total_Samples__Y_ "Fault manager configuration.  Select up to 4 actions for each fault." VALUE 0x80002DC9 RecordLayout_4 0 CompuMethod_1 0 65535 /end CHARACTERISTIC
/begin CHARACTERISTIC FaultManager.EST4_Short.Action_1 "Fault manager configuration.  Select up to 4 actions for each fault." VALUE 0x80002DCB RecordLayout_4 0 CompuMethod_113 0 65535 /end CHARACTERISTIC
/begin CHARACTERISTIC FaultManager.EST4_Short.Action_1_Condition "Fault manager configuration.  Select up to 4 actions for each fault." VALUE 0x80002DCD RecordLayout_4 0 CompuMethod_114 0 65535 /end CHARACTERISTIC
/begin CHARACTERISTIC FaultManager.EST4_Short.Action_2 "Fault manager configuration.  Select up to 4 actions for each fault." VALUE 0x80002DCF RecordLayout_4 0 CompuMethod_113 0 65535 /end CHARACTERISTIC
/begin CHARACTERISTIC FaultManager.EST4_Short.Action_2_Condition "Fault manager configuration.  Select up to 4 actions for each fault." VALUE 0x80002DD1 RecordLayout_4 0 CompuMethod_114 0 65535 /end CHARACTERISTIC
/begin CHARACTERISTIC FaultManager.EST4_Short.Action_3 "Fault manager configuration.  Select up to 4 actions for each fault." VALUE 0x80002DD3 RecordLayout_4 0 CompuMethod_113 0 65535 /end CHARACTERISTIC
/begin CHARACTERISTIC FaultManager.EST4_Short.Action_3_Condition "Fault manager configuration.  Select up to 4 actions for each fault." VALUE 0x80002DD5 RecordLayout_4 0 CompuMethod_114 0 65535 /end CHARACTERISTIC
/begin CHARACTERISTIC FaultManager.EST4_Short.Action_4 "Fault manager configuration.  Select up to 4 actions for each fault." VALUE 0x80002DD7 RecordLayout_4 0 CompuMethod_113 0 65535 /end CHARACTERISTIC
/begin CHARACTERISTIC FaultManager.EST4_Short.Action_4_Condition "Fault manager configuration.  Select up to 4 actions for each fault." VALUE 0x80002DD9 RecordLayout_4 0 CompuMethod_114 0 65535 /end CHARACTERISTIC
/begin CHARACTERISTIC FaultManager.EST5_Open.Mode "Fault manager configuration.  Select up to 4 actions for each fault." VALUE 0x80002DDB RecordLayout_4 0 CompuMethod_111 0 65535 /end CHARACTERISTIC
/begin CHARACTERISTIC FaultManager.EST5_Open.ID "Fault manager configuration.  Select up to 4 actions for each fault." VALUE 0x80002DDD RecordLayout_4 0 CompuMethod_1 0 65535 /end CHARACTERISTIC
/begin CHARACTERISTIC FaultManager.EST5_Open.Test "Fault manager configuration.  Select up to 4 actions for each fault." VALUE 0x80002DDF RecordLayout_4 0 CompuMethod_112 0 65535 /end CHARACTERISTIC
/begin CHARACTERISTIC FaultManager.EST5_Open.Faulty_Samples__X_ "Fault manager configuration.  Select up to 4 actions for each fault." VALUE 0x80002DE1 RecordLayout_4 0 CompuMethod_1 0 65535 /end CHARACTERISTIC
/begin CHARACTERISTIC FaultManager.EST5_Open.Total_Samples__Y_ "Fault manager configuration.  Select up to 4 actions for each fault." VALUE 0x80002DE3 RecordLayout_4 0 CompuMethod_1 0 65535 /end CHARACTERISTIC
/begin CHARACTERISTIC FaultManager.EST5_Open.Action_1 "Fault manager configuration.  Select up to 4 actions for each fault." VALUE 0x80002DE5 RecordLayout_4 0 CompuMethod_113 0 65535 /end CHARACTERISTIC
/begin CHARACTERISTIC FaultManager.EST5_Open.Action_1_Condition "Fault manager configuration.  Select up to 4 actions for each fault." VALUE 0x80002DE7 RecordLayout_4 0 CompuMethod_114 0 65535 /end CHARACTERISTIC
/begin CHARACTERISTIC FaultManager.EST5_Open.Action_2 "Fault manager configuration.  Select up to 4 actions for each fault." VALUE 0x80002DE9 RecordLayout_4 0 CompuMethod_113 0 65535 /end CHARACTERISTIC
/begin CHARACTERISTIC FaultManager.EST5_Open.Action_2_Condition "Fault manager configuration.  Select up to 4 actions for each fault." VALUE 0x80002DEB RecordLayout_4 0 CompuMethod_114 0 65535 /end CHARACTERISTIC
/begin CHARACTERISTIC FaultManager.EST5_Open.Action_3 "Fault manager configuration.  Select up to 4 actions for each fault." VALUE 0x80002DED RecordLayout_4 0 CompuMethod_113 0 65535 /end CHARACTERISTIC
/begin CHARACTERISTIC FaultManager.EST5_Open.Action_3_Condition "Fault manager configuration.  Select up to 4 actions for each fault." VALUE 0x80002DEF RecordLayout_4 0 CompuMethod_114 0 65535 /end CHARACTERISTIC
/begin CHARACTERISTIC FaultManager.EST5_Open.Action_4 "Fault manager configuration.  Select up to 4 actions for each fault." VALUE 0x80002DF1 RecordLayout_4 0 CompuMethod_113 0 65535 /end CHARACTERISTIC
/begin CHARACTERISTIC FaultManager.EST5_Open.Action_4_Condition "Fault manager configuration.  Select up to 4 actions for each fault." VALUE 0x80002DF3 RecordLayout_4 0 CompuMethod_114 0 65535 /end CHARACTERISTIC
/begin CHARACTERISTIC FaultManager.EST5_Short.Mode "Fault manager configuration.  Select up to 4 actions for each fault." VALUE 0x80002DF5 RecordLayout_4 0 CompuMethod_111 0 65535 /end CHARACTERISTIC
/begin CHARACTERISTIC FaultManager.EST5_Short.ID "Fault manager configuration.  Select up to 4 actions for each fault." VALUE 0x80002DF7 RecordLayout_4 0 CompuMethod_1 0 65535 /end CHARACTERISTIC
/begin CHARACTERISTIC FaultManager.EST5_Short.Test "Fault manager configuration.  Select up to 4 actions for each fault." VALUE 0x80002DF9 RecordLayout_4 0 CompuMethod_112 0 65535 /end CHARACTERISTIC
/begin CHARACTERISTIC FaultManager.EST5_Short.Faulty_Samples__X_ "Fault manager configuration.  Select up to 4 actions for each fault." VALUE 0x80002DFB RecordLayout_4 0 CompuMethod_1 0 65535 /end CHARACTERISTIC
/begin CHARACTERISTIC FaultManager.EST5_Short.Total_Samples__Y_ "Fault manager configuration.  Select up to 4 actions for each fault." VALUE 0x80002DFD RecordLayout_4 0 CompuMethod_1 0 65535 /end CHARACTERISTIC
/begin CHARACTERISTIC FaultManager.EST5_Short.Action_1 "Fault manager configuration.  Select up to 4 actions for each fault." VALUE 0x80002DFF RecordLayout_4 0 CompuMethod_113 0 65535 /end CHARACTERISTIC
/begin CHARACTERISTIC FaultManager.EST5_Short.Action_1_Condition "Fault manager configuration.  Select up to 4 actions for each fault." VALUE 0x80002E01 RecordLayout_4 0 CompuMethod_114 0 65535 /end CHARACTERISTIC
/begin CHARACTERISTIC FaultManager.EST5_Short.Action_2 "Fault manager configuration.  Select up to 4 actions for each fault." VALUE 0x80002E03 RecordLayout_4 0 CompuMethod_113 0 65535 /end CHARACTERISTIC
/begin CHARACTERISTIC FaultManager.EST5_Short.Action_2_Condition "Fault manager configuration.  Select up to 4 actions for each fault." VALUE 0x80002E05 RecordLayout_4 0 CompuMethod_114 0 65535 /end CHARACTERISTIC
/begin CHARACTERISTIC FaultManager.EST5_Short.Action_3 "Fault manager configuration.  Select up to 4 actions for each fault." VALUE 0x80002E07 RecordLayout_4 0 CompuMethod_113 0 65535 /end CHARACTERISTIC
/begin CHARACTERISTIC FaultManager.EST5_Short.Action_3_Condition "Fault manager configuration.  Select up to 4 actions for each fault." VALUE 0x80002E09 RecordLayout_4 0 CompuMethod_114 0 65535 /end CHARACTERISTIC
/begin CHARACTERISTIC FaultManager.EST5_Short.Action_4 "Fault manager configuration.  Select up to 4 actions for each fault." VALUE 0x80002E0B RecordLayout_4 0 CompuMethod_113 0 65535 /end CHARACTERISTIC
/begin CHARACTERISTIC FaultManager.EST5_Short.Action_4_Condition "Fault manager configuration.  Select up to 4 actions for each fault." VALUE 0x80002E0D RecordLayout_4 0 CompuMethod_114 0 65535 /end CHARACTERISTIC
/begin CHARACTERISTIC FaultManager.EST6_Open.Mode "Fault manager configuration.  Select up to 4 actions for each fault." VALUE 0x80002E0F RecordLayout_4 0 CompuMethod_111 0 65535 /end CHARACTERISTIC
/begin CHARACTERISTIC FaultManager.EST6_Open.ID "Fault manager configuration.  Select up to 4 actions for each fault." VALUE 0x80002E11 RecordLayout_4 0 CompuMethod_1 0 65535 /end CHARACTERISTIC
/begin CHARACTERISTIC FaultManager.EST6_Open.Test "Fault manager configuration.  Select up to 4 actions for each fault." VALUE 0x80002E13 RecordLayout_4 0 CompuMethod_112 0 65535 /end CHARACTERISTIC
/begin CHARACTERISTIC FaultManager.EST6_Open.Faulty_Samples__X_ "Fault manager configuration.  Select up to 4 actions for each fault." VALUE 0x80002E15 RecordLayout_4 0 CompuMethod_1 0 65535 /end CHARACTERISTIC
/begin CHARACTERISTIC FaultManager.EST6_Open.Total_Samples__Y_ "Fault manager configuration.  Select up to 4 actions for each fault." VALUE 0x80002E17 RecordLayout_4 0 CompuMethod_1 0 65535 /end CHARACTERISTIC
/begin CHARACTERISTIC FaultManager.EST6_Open.Action_1 "Fault manager configuration.  Select up to 4 actions for each fault." VALUE 0x80002E19 RecordLayout_4 0 CompuMethod_113 0 65535 /end CHARACTERISTIC
/begin CHARACTERISTIC FaultManager.EST6_Open.Action_1_Condition "Fault manager configuration.  Select up to 4 actions for each fault." VALUE 0x80002E1B RecordLayout_4 0 CompuMethod_114 0 65535 /end CHARACTERISTIC
/begin CHARACTERISTIC FaultManager.EST6_Open.Action_2 "Fault manager configuration.  Select up to 4 actions for each fault." VALUE 0x80002E1D RecordLayout_4 0 CompuMethod_113 0 65535 /end CHARACTERISTIC
/begin CHARACTERISTIC FaultManager.EST6_Open.Action_2_Condition "Fault manager configuration.  Select up to 4 actions for each fault." VALUE 0x80002E1F RecordLayout_4 0 CompuMethod_114 0 65535 /end CHARACTERISTIC
/begin CHARACTERISTIC FaultManager.EST6_Open.Action_3 "Fault manager configuration.  Select up to 4 actions for each fault." VALUE 0x80002E21 RecordLayout_4 0 CompuMethod_113 0 65535 /end CHARACTERISTIC
/begin CHARACTERISTIC FaultManager.EST6_Open.Action_3_Condition "Fault manager configuration.  Select up to 4 actions for each fault." VALUE 0x80002E23 RecordLayout_4 0 CompuMethod_114 0 65535 /end CHARACTERISTIC
/begin CHARACTERISTIC FaultManager.EST6_Open.Action_4 "Fault manager configuration.  Select up to 4 actions for each fault." VALUE 0x80002E25 RecordLayout_4 0 CompuMethod_113 0 65535 /end CHARACTERISTIC
/begin CHARACTERISTIC FaultManager.EST6_Open.Action_4_Condition "Fault manager configuration.  Select up to 4 actions for each fault." VALUE 0x80002E27 RecordLayout_4 0 CompuMethod_114 0 65535 /end CHARACTERISTIC
/begin CHARACTERISTIC FaultManager.EST6_Short.Mode "Fault manager configuration.  Select up to 4 actions for each fault." VALUE 0x80002E29 RecordLayout_4 0 CompuMethod_111 0 65535 /end CHARACTERISTIC
/begin CHARACTERISTIC FaultManager.EST6_Short.ID "Fault manager configuration.  Select up to 4 actions for each fault." VALUE 0x80002E2B RecordLayout_4 0 CompuMethod_1 0 65535 /end CHARACTERISTIC
/begin CHARACTERISTIC FaultManager.EST6_Short.Test "Fault manager configuration.  Select up to 4 actions for each fault." VALUE 0x80002E2D RecordLayout_4 0 CompuMethod_112 0 65535 /end CHARACTERISTIC
/begin CHARACTERISTIC FaultManager.EST6_Short.Faulty_Samples__X_ "Fault manager configuration.  Select up to 4 actions for each fault." VALUE 0x80002E2F RecordLayout_4 0 CompuMethod_1 0 65535 /end CHARACTERISTIC
/begin CHARACTERISTIC FaultManager.EST6_Short.Total_Samples__Y_ "Fault manager configuration.  Select up to 4 actions for each fault." VALUE 0x80002E31 RecordLayout_4 0 CompuMethod_1 0 65535 /end CHARACTERISTIC
/begin CHARACTERISTIC FaultManager.EST6_Short.Action_1 "Fault manager configuration.  Select up to 4 actions for each fault." VALUE 0x80002E33 RecordLayout_4 0 CompuMethod_113 0 65535 /end CHARACTERISTIC
/begin CHARACTERISTIC FaultManager.EST6_Short.Action_1_Condition "Fault manager configuration.  Select up to 4 actions for each fault." VALUE 0x80002E35 RecordLayout_4 0 CompuMethod_114 0 65535 /end CHARACTERISTIC
/begin CHARACTERISTIC FaultManager.EST6_Short.Action_2 "Fault manager configuration.  Select up to 4 actions for each fault." VALUE 0x80002E37 RecordLayout_4 0 CompuMethod_113 0 65535 /end CHARACTERISTIC
/begin CHARACTERISTIC FaultManager.EST6_Short.Action_2_Condition "Fault manager configuration.  Select up to 4 actions for each fault." VALUE 0x80002E39 RecordLayout_4 0 CompuMethod_114 0 65535 /end CHARACTERISTIC
/begin CHARACTERISTIC FaultManager.EST6_Short.Action_3 "Fault manager configuration.  Select up to 4 actions for each fault." VALUE 0x80002E3B RecordLayout_4 0 CompuMethod_113 0 65535 /end CHARACTERISTIC
/begin CHARACTERISTIC FaultManager.EST6_Short.Action_3_Condition "Fault manager configuration.  Select up to 4 actions for each fault." VALUE 0x80002E3D RecordLayout_4 0 CompuMethod_114 0 65535 /end CHARACTERISTIC
/begin CHARACTERISTIC FaultManager.EST6_Short.Action_4 "Fault manager configuration.  Select up to 4 actions for each fault." VALUE 0x80002E3F RecordLayout_4 0 CompuMethod_113 0 65535 /end CHARACTERISTIC
/begin CHARACTERISTIC FaultManager.EST6_Short.Action_4_Condition "Fault manager configuration.  Select up to 4 actions for each fault." VALUE 0x80002E41 RecordLayout_4 0 CompuMethod_114 0 65535 /end CHARACTERISTIC
/begin CHARACTERISTIC FaultManager.EST7_Open.Mode "Fault manager configuration.  Select up to 4 actions for each fault." VALUE 0x80002E43 RecordLayout_4 0 CompuMethod_111 0 65535 /end CHARACTERISTIC
/begin CHARACTERISTIC FaultManager.EST7_Open.ID "Fault manager configuration.  Select up to 4 actions for each fault." VALUE 0x80002E45 RecordLayout_4 0 CompuMethod_1 0 65535 /end CHARACTERISTIC
/begin CHARACTERISTIC FaultManager.EST7_Open.Test "Fault manager configuration.  Select up to 4 actions for each fault." VALUE 0x80002E47 RecordLayout_4 0 CompuMethod_112 0 65535 /end CHARACTERISTIC
/begin CHARACTERISTIC FaultManager.EST7_Open.Faulty_Samples__X_ "Fault manager configuration.  Select up to 4 actions for each fault." VALUE 0x80002E49 RecordLayout_4 0 CompuMethod_1 0 65535 /end CHARACTERISTIC
/begin CHARACTERISTIC FaultManager.EST7_Open.Total_Samples__Y_ "Fault manager configuration.  Select up to 4 actions for each fault." VALUE 0x80002E4B RecordLayout_4 0 CompuMethod_1 0 65535 /end CHARACTERISTIC
/begin CHARACTERISTIC MatlabVersionTxt "MATLAB version used to build the application." ASCII 0x40000737 RecordLayout_2 0 CompuMethod_2 0 255 NUMBER 80 MATRIX_DIM 80 1 1 READ_ONLY /end CHARACTERISTIC
/begin CHARACTERISTIC MotoHawkBuildGUID "GUID identifying the MotoHawk build session" ASCII 0x400007DD RecordLayout_2 0 CompuMethod_2 0 255 NUMBER 80 MATRIX_DIM 80 1 1 READ_ONLY /end CHARACTERISTIC
/begin CHARACTERISTIC MotoHawkModelGUID "GUID identifying the MotoHawk model" ASCII 0x4000082D RecordLayout_2 0 CompuMethod_2 0 255 NUMBER 80 MATRIX_DIM 80 1 1 READ_ONLY /end CHARACTERISTIC
/begin CHARACTERISTIC MotoHawkModelName "Simulink model name used for the MotoHawk build" ASCII 0x4000087D RecordLayout_2 0 CompuMethod_2 0 255 NUMBER 80 MATRIX_DIM 80 1 1 READ_ONLY /end CHARACTERISTIC
/begin CHARACTERISTIC MotoHawkTokenGUID "GUID identifying the token inserted during the build.  May be empty if no token was available" ASCII 0x400008D1 RecordLayout_2 0 CompuMethod_2 0 255 NUMBER 80 MATRIX_DIM 80 1 1 READ_ONLY /end CHARACTERISTIC
/begin CHARACTERISTIC MotoHawkVersionTxt "MotoHawk version used to build the application." ASCII 0x40000921 RecordLayout_2 0 CompuMethod_2 0 255 NUMBER 50 MATRIX_DIM 50 1 1 READ_ONLY /end CHARACTERISTIC
/begin CHARACTERISTIC PartNumber "" ASCII 0x400009AF RecordLayout_2 0 CompuMethod_2 0 255 NUMBER 40 MATRIX_DIM 40 1 1 READ_ONLY /end CHARACTERISTIC
/begin CHARACTERISTIC PasswordTxt "Password protection for this calibration" ASCII 0x80004906 RecordLayout_2 0 CompuMethod_2 0 255 NUMBER 33 MATRIX_DIM 33 1 1 /end CHARACTERISTIC
/*~~~~~~~~~ 6.3.106 RECORD_LAYOUTs ~~~~~~~~~*/
/begin RECORD_LAYOUT RecordLayout_1 FNC_VALUES 1 UBYTE ROW_DIR DIRECT /end RECORD_LAYOUT
/begin RECORD_LAYOUT RecordLayout_2 FNC_VALUES 1 UBYTE ROW_DIR DIRECT /end RECORD_LAYOUT
/begin RECORD_LAYOUT RecordLayout_3 FNC_VALUES 1 ULONG ROW_DIR DIRECT /end RECORD_LAYOUT
/begin RECORD_LAYOUT RecordLayout_4 FNC_VALUES 1 UWORD ROW_DIR DIRECT /end RECORD_LAYOUT
/*~~~~~~~~~ 6.3.31 COMPU_METHODs ~~~~~~~~~*/
/begin COMPU_METHOD CompuMethod_1 "" RAT_FUNC "%3.0" "" COEFFS 0 1 0 0 0 1 /end COMPU_METHOD
/begin COMPU_METHOD CompuMethod_2 "" RAT_FUNC "%6.2" "" COEFFS 0 1 0 0 0 1 /end COMPU_METHOD
/begin COMPU_METHOD CompuMethod_3 "" RAT_FUNC "%6.2" "ID" COEFFS 0 1 0 0 0 1 /end COMPU_METHOD
/begin COMPU_METHOD CompuMethod_4 "" RAT_FUNC "%1.0" "bool" COEFFS 0 1 0 0 0 1 /end COMPU_METHOD
/begin COMPU_METHOD CompuMethod_11 "" RAT_FUNC "%1.0" "" COEFFS 0 1 0 0 0 1 /end COMPU_METHOD
/begin COMPU_METHOD CompuMethod_109 "" TAB_VERB "%3.0" "" COMPU_TAB_REF CompuVtab_30 /end COMPU_METHOD
/begin COMPU_METHOD CompuMethod_110 "" TAB_VERB "%3.0" "" COMPU_TAB_REF CompuVtab_31 /end COMPU_METHOD
/begin COMPU_METHOD CompuMethod_111 "" TAB_VERB "%3.0" "" COMPU_TAB_REF CompuVtab_32 /end COMPU_METHOD
/begin COMPU_METHOD CompuMethod_112 "" TAB_VERB "%3.0" "" COMPU_TAB_REF CompuVtab_33 /end COMPU_METHOD
/begin COMPU_METHOD CompuMethod_113 "" TAB_VERB "%3.0" "" COMPU_TAB_REF CompuVtab_34 /end COMPU_METHOD
/begin COMPU_METHOD CompuMethod_114 "" TAB_VERB "%3.0" "" COMPU_TAB_REF CompuVtab_35 /end COMPU_METHOD
/begin COMPU_METHOD CompuMethod_149 "" TAB_VERB "%3.0" "" COMPU_TAB_REF CompuVtab_52 /end COMPU_METHOD
/begin COMPU_METHOD CompuMethod_150 "" RAT_FUNC "%8.0" "seconds" COEFFS 0 1 0 0 0 1 /end COMPU_METHOD
/begin COMPU_METHOD CompuMethod_177 "" RAT_FUNC "%5.0" "MHz" COEFFS 0 1 0 0 0 1E-06 /end COMPU_METHOD
/begin COMPU_METHOD CompuMethod_179 "" TAB_VERB "%1.0" "" COMPU_TAB_REF CompuVtab_66 /end COMPU_METHOD
/begin COMPU_VTAB CompuVtab_30 "" TAB_VERB 126 0 "ACChargeHigh_Fault" 1 "ACChargeLow_Fault" 2 "ACPresRangeHigh" 3 "ACPresRangeLow" 4 "APP1RangeHigh" 5 "APP1RangeLow" 6 "APP1_AdaptAdaptHiMax" 7 "APP1_AdaptAdaptHiMin" 8 "APP1_AdaptAdaptLoMax" 9 "APP1_AdaptAdaptLoMin" 10 "APP1_AdaptRangeHigh" 11 "APP1_AdaptRangeLow" 12 "APP2RangeHigh" 13 "APP2RangeLow" 14 "APP2_AdaptAdaptHiMax" 15 "APP2_AdaptAdaptHiMin" 16 "APP2_AdaptAdaptLoMax" 17 "APP2_AdaptAdaptLoMin" 18 "APP2_AdaptRangeHigh" 19 "APP2_AdaptRangeLow" 20 "APP_Sensors_Conflict" 21 "Bank1_EquivRatioRangeHigh" 22 "Bank1_EquivRatioRangeLow" 23 "Bank2_EquivRatioRangeHigh" 24 "Bank2_EquivRatioRangeLow" 25 "CATRangeHigh" 26 "CATRangeLow" 27 "CamEdgesFault" 28 "CamSyncFault" 29 "CrankEdgesFault" 30 "CrankSyncFault" 31 "ECTOverTempFault" 32 "ECTRangeHigh" 33 "ECTRangeLow" 34 "ECTSevereOverTempFault" 35 "EST1_Open" 36 "EST1_Short" 37 "EST2_Open" 38 "EST2_Short" 39 "EST3_Open" 40 "EST3_Short" 41 "EST4_Open" 42 "EST4_Short" 43 "EST5_Open" 44 "EST5_Short" 45 "EST6_Open" 46 "EST6_Short" 47 "EST7_Open" 48 "EST7_Short" 49 "EST8_Open" 50 "EST8_Short" 51 "ETCSpringTest" 52 "ETC_Open_Fault" 53 "ETC_Sticking" 54 "EVAPRangeHigh" 55 "EVAPRangeLow" 56 "FuelAdaptRangeHi" 57 "FuelAdaptRangeLow" 58 "FuelPresHigh_Fault" 59 "FuelPresLow_Fault" 60 "FuelPresRangeHigh" 61 "FuelPresRangeLow" 62 "FuelSensRangeHigh" 63 "FuelSensRangeLow" 64 "Fuel_LvlRangeHigh" 65 "Fuel_LvlRangeLow" 66 "GPS_DateTime_Timeout" 67 "GPS_LatLong_Timeout" 68 "GPS_NotReady" 69 "GPS_SpeedDir_Timeout" 70 "HardOverBoost_Fault" 71 "HardOverspeed" 72 "IATRangeHigh" 73 "IATRangeLow" 74 "Inj1Open" 75 "Inj2Open" 76 "Inj3Open" 77 "Inj4Open" 78 "Inj5Open" 79 "Inj6Open" 80 "Inj7Open" 81 "Inj8Open" 82 "Lambda_1_NotReady" 83 "Lambda_1_Timeout" 84 "Lambda_2_NotReady" 85 "Lambda_2_Timeout" 86 "LeanProtect_Fault" 87 "MAFRangeHigh" 88 "MAFRangeLow" 89 "MAPRangeHigh" 90 "MAPRangeLow" 91 "MAPTimeRangeHigh" 92 "MAPTimeRangeLow" 93 "MAP_IR_HI" 94 "MAP_IR_LO" 95 "MAP_STICKING" 96 "MediumOverspeed" 97 "NoOil_Fault" 98 "O2FailedLean" 99 "O2FailedRich" 100 "O2NotActive" 101 "OilPresRangeHigh" 102 "OilPresRangeLow" 103 "SensVoltRangeHigh" 104 "SensVoltRangeLow" 105 "SoftOverBoost_Fault" 106 "SoftOverspeed" 107 "SysVoltRangeHigh" 108 "SysVoltRangeLow" 109 "TPS1AdaptHiMax" 110 "TPS1AdaptHiMin" 111 "TPS1AdaptLoMax" 112 "TPS1AdaptLoMin" 113 "TPS1RangeHigh" 114 "TPS1RangeLow" 115 "TPS2AdaptHiMax" 116 "TPS2AdaptHiMin" 117 "TPS2AdaptLoMax" 118 "TPS2AdaptLoMin" 119 "TPS2RangeHigh" 120 "TPS2RangeLow" 121 "TPS_Sensors_Conflict" 122 "VSPDRangeHigh" 123 "VSPDRangeLow" 124 "Wastegate_Fault" 125 "(None)" /end COMPU_VTAB
/begin COMPU_VTAB CompuVtab_31 "" TAB_VERB 2 0 "-" 1 "Clear All Faults" /end COMPU_VTAB
/begin COMPU_VTAB CompuVtab_32 "" TAB_VERB 6 0 "Disabled" 1 "Enabled" 2 "Sticky" 3 "Enabled - Persistent" 4 "Sticky - Persistent" 5 "Save Occurred" /end COMPU_VTAB
/begin COMPU_VTAB CompuVtab_33 "" TAB_VERB 2 0 "-" 1 "Test" /end COMPU_VTAB
/begin COMPU_VTAB CompuVtab_34 "" TAB_VERB 14 0 "CutThrottle" 1 "DFCODisable" 2 "DelayedEngineShutdown" 3 "DisableAC" 4 "DisableO2Ctrl" 5 "DisableVEAdapt" 6 "DisableWastegate" 7 "EngineProtectLED" 8 "EngineShutdown" 9 "HardRevLimit" 10 "MIL_LED" 11 "MediumRevLimit" 12 "SoftRevLimit" 13 "(None)" /end COMPU_VTAB
/begin COMPU_VTAB CompuVtab_35 "" TAB_VERB 8 0 "(None)" 1 "Suspected" 2 "Active" 3 "Suspected or Active" 4 "Occurred" 5 "Suspected or Occurred" 6 "Active or Occurred" 7 "Suspected or Active or Occurred" /end COMPU_VTAB
/begin COMPU_VTAB CompuVtab_52 "" TAB_VERB 6 0 "Calibratable Development Module" 1 "Non-Calibratable Production Module" 2 "Software Dev Module (with RAM overlay only)" 3 "Software Dev Module (with Trace Pod & RAM)" 4 "Calibratable Development Module with Censorship disabled" 5 "Non-Calibratable Production Module with Censorship disabled" /end COMPU_VTAB
/begin COMPU_VTAB CompuVtab_66 "" TAB_VERB 40 0 "TPU Mask Undefined" 1 "60-6" 2 "GM24Xe" 3 "GM24Xe on Cam" 4 "N-1/N-2 [Half Moon Cam]" 5 "NX Encoder" 6 "NX Encoder on Cam" 7 "30-5 on Cnk" 8 "Hyundai 60" 9 "X Plus 1 on Cnk with ToothCam" 10 "X Shift 1 on Cnk" 11 "N Encoder" 12 "N-1/N-2 [Tooth Cam]" 13 "ISDL" 14 "X Pulse Width on Cam" 15 "X Pulse Width on Cnk" 16 "1 Pulse on Cnk" 17 "1 Pulse on Cam" 18 "N-1/N-2 Dual Redundancy" 19 "N-1/N-2 Variable Cam" 20 "N-1/N-2 [Duramax CAM] [Multiplexed EST (1,2, or 4,5,6,7,8) (9,10,11 or 13,14,15)]" 21 "X Plus 1 on Cnk + MuxPSP on EST > 9" 22 "NX Encoder with Hyundai 4 Tooth CAM with one wide" 23 "NX Encoder with 360Deg CAM Providing Crank Sync" 24 "NissanZ 36-6 Encoder, sync on custom CAM" 25 "36-1 Encoder, sync on custom Coyote CAM" 26 "N Groups of 4 teeth - 2, sync on CAM" 27 "NissanZ 36-6 Encoder, sync on 6Tooth 2Missing Plus2 Variable CAM" 28 "EVO9 2X Encoder with 1X_PLUS1 CAM on Exhaust and 4X Variable CAM on Intake" 29 "N-1/N-2 Variable Cam with Windowed Sync" 30 "36M4 (2x18 teeth sectors with 2 missing) and Kohki Cam" 31 "N-3/N-4 [ToothCam]" 32 "N-3/N-4 [Plus1Cam (X+1)]" 33 "Hyundai 60 with EncoderSynthesizer variant on TPUC" 34 "N-1/N-2 [Half Moon Cam]" 35 "X Plus 1 on Cnk with X Plus 1 Cam" 36 "X Plus 1 on Cnk with X Plus 1 Cam with Encoder Synthesizer" 37 "N-1/N-2 [XPlus1 Cam]" 38 "X Shift 1 Retarded [ToothCam]" 39 "N-1/N-2 [Tooth Cam] with MuxPSP" /end COMPU_VTAB
/*~~~~~~~~~ 6.3.65 FUNCTIONs ~~~~~~~~~*/
/begin FUNCTION Project_Config "" /begin DEF_CHARACTERISTIC project_id ProductID /end DEF_CHARACTERISTIC /end FUNCTION
/begin FUNCTION System_Config "" /begin DEF_CHARACTERISTIC FriendlyName PasswordTxt /end DEF_CHARACTERISTIC /begin SUB_FUNCTION Project_Config Trigger_Config Communication_Config /end SUB_FUNCTION /end FUNCTION
/begin FUNCTION System ""
 /begin SUB_FUNCTION System_Config Version Status I_O_Pins Debug CCP Performance Main_Power_Relay NonVolatile_Storage /end SUB_FUNCTION
/end FUNCTION
/begin FUNCTION Version ""
 /begin DEF_CHARACTERISTIC SwIdTxt CalIdTxt SwRevisionTxt CompilerVersion ControlCoreSDKRelease MatlabVersionTxt MotoHawkBuildGUID MotoHawkModelGUID MotoHawkModelName MotoHawkTokenGUID MotoHawkVersionTxt /end DEF_CHARACTERISTIC
 /begin OUT_MEASUREMENT table_0_rev table_1_rev table_2_rev KeyRev EriRev table_3_rev table_4_rev table_5_rev table_6_rev table_7_rev MotProgRev ApplicationCompatibilityArr LinkStatus MotoHawkModelSecondsInUse SystemFrequency TPUMaskType TPUMaskVers Unused /end OUT_MEASUREMENT
/end FUNCTION
/begin FUNCTION Module_Config "" /begin DEF_CHARACTERISTIC SerialNumber ModelNumber PartNumber /end DEF_CHARACTERISTIC
 /begin OUT_MEASUREMENT BootVerMaj BootVerMin EcuHwMaj EcuHwMin ConfigVerMaj ConfigVerMin ModuleCapability /end OUT_MEASUREMENT
/end FUNCTION
/begin FUNCTION Status "" /begin SUB_FUNCTION Module_Config OS Framework /end SUB_FUNCTION /end FUNCTION
/begin FUNCTION AC "" /begin OUT_MEASUREMENT AC /end OUT_MEASUREMENT /begin SUB_FUNCTION AC_Override AC_Config /end SUB_FUNCTION /end FUNCTION
/begin FUNCTION AC_Control "" /begin SUB_FUNCTION AC /end SUB_FUNCTION /end FUNCTION
/begin FUNCTION Outputs ""
 /begin SUB_FUNCTION AC_Control AEM_Infinity_Dash Coil_Control Injector_Control HBridge ETC_CutPower FAN_Control_2 FuelPump IAC_Control WASTEGATE_Control /end SUB_FUNCTION
/end FUNCTION
/begin FUNCTION Foreground "" /begin SUB_FUNCTION Outputs Control Inputs /end SUB_FUNCTION /end FUNCTION
/begin FUNCTION BaseEngineController_LS ""
 /begin DEF_CHARACTERISTIC FaultCommand FaultManager.ACChargeHigh_Fault.Mode FaultManager.ACChargeHigh_Fault.ID FaultManager.ACChargeHigh_Fault.Test FaultManager.ACChargeHigh_Fault.Faulty_Samples__X_ FaultManager.ACChargeHigh_Fault.Total_Samples__Y_ FaultManager.ACChargeHigh_Fault.Action_1 FaultManager.ACChargeHigh_Fault.Action_1_Condition FaultManager.ACChargeHigh_Fault.Action_2 FaultManager.ACChargeHigh_Fault.Action_2_Condition FaultManager.ACChargeHigh_Fault.Action_3 FaultManager.ACChargeHigh_Fault.Action_3_Condition FaultManager.ACChargeHigh_Fault.Action_4 FaultManager.ACChargeHigh_Fault.Action_4_Condition FaultManager.ACChargeLow_Fault.Mode FaultManager.ACChargeLow_Fault.ID FaultManager.ACChargeLow_Fault.Test FaultManager.ACChargeLow_Fault.Faulty_Samples__X_ FaultManager.ACChargeLow_Fault.Total_Samples__Y_ FaultManager.ACChargeLow_Fault.Action_1 FaultManager.ACChargeLow_Fault.Action_1_Condition FaultManager.ACChargeLow_Fault.Action_2 FaultManager.ACChargeLow_Fault.Action_2_Condition FaultManager.ACChargeLow_Fault.Action_3 FaultManager.ACChargeLow_Fault.Action_3_Condition FaultManager.ACChargeLow_Fault.Action_4 FaultManager.ACChargeLow_Fault.Action_4_Condition FaultManager.ACPresRangeHigh.Mode FaultManager.ACPresRangeHigh.ID FaultManager.ACPresRangeHigh.Test FaultManager.ACPresRangeHigh.Faulty_Samples__X_ FaultManager.ACPresRangeHigh.Total_Samples__Y_ FaultManager.ACPresRangeHigh.Action_1 FaultManager.ACPresRangeHigh.Action_1_Condition FaultManager.ACPresRangeHigh.Action_2 FaultManager.ACPresRangeHigh.Action_2_Condition FaultManager.ACPresRangeHigh.Action_3 FaultManager.ACPresRangeHigh.Action_3_Condition FaultManager.ACPresRangeHigh.Action_4 FaultManager.ACPresRangeHigh.Action_4_Condition FaultManager.ACPresRangeLow.Mode FaultManager.ACPresRangeLow.ID FaultManager.ACPresRangeLow.Test FaultManager.ACPresRangeLow.Faulty_Samples__X_ FaultManager.ACPresRangeLow.Total_Samples__Y_ FaultManager.ACPresRangeLow.Action_1 FaultManager.ACPresRangeLow.Action_1_Condition FaultManager.ACPresRangeLow.Action_2 FaultManager.ACPresRangeLow.Action_2_Condition FaultManager.ACPresRangeLow.Action_3 FaultManager.ACPresRangeLow.Action_3_Condition FaultManager.ACPresRangeLow.Action_4 FaultManager.ACPresRangeLow.Action_4_Condition FaultManager.APP1RangeHigh.Mode FaultManager.APP1RangeHigh.ID FaultManager.APP1RangeHigh.Test FaultManager.APP1RangeHigh.Faulty_Samples__X_ FaultManager.APP1RangeHigh.Total_Samples__Y_ FaultManager.APP1RangeHigh.Action_1 FaultManager.APP1RangeHigh.Action_1_Condition FaultManager.APP1RangeHigh.Action_2 FaultManager.APP1RangeHigh.Action_2_Condition FaultManager.APP1RangeHigh.Action_3 FaultManager.APP1RangeHigh.Action_3_Condition FaultManager.APP1RangeHigh.Action_4 FaultManager.APP1RangeHigh.Action_4_Condition FaultManager.APP1RangeLow.Mode FaultManager.APP1RangeLow.ID FaultManager.APP1RangeLow.Test FaultManager.APP1RangeLow.Faulty_Samples__X_ FaultManager.APP1RangeLow.Total_Samples__Y_ FaultManager.APP1RangeLow.Action_1 FaultManager.APP1RangeLow.Action_1_Condition FaultManager.APP1RangeLow.Action_2 FaultManager.APP1RangeLow.Action_2_Condition FaultManager.APP1RangeLow.Action_3 FaultManager.APP1RangeLow.Action_3_Condition FaultManager.APP1RangeLow.Action_4 FaultManager.APP1RangeLow.Action_4_Condition FaultManager.APP1_AdaptAdaptHiMax.Mode FaultManager.APP1_AdaptAdaptHiMax.ID FaultManager.APP1_AdaptAdaptHiMax.Test FaultManager.APP1_AdaptAdaptHiMax.Faulty_Samples__X_ FaultManager.APP1_AdaptAdaptHiMax.Total_Samples__Y_ FaultManager.APP1_AdaptAdaptHiMax.Action_1 FaultManager.APP1_AdaptAdaptHiMax.Action_1_Condition FaultManager.APP1_AdaptAdaptHiMax.Action_2 FaultManager.APP1_AdaptAdaptHiMax.Action_2_Condition FaultManager.APP1_AdaptAdaptHiMax.Action_3 FaultManager.APP1_AdaptAdaptHiMax.Action_3_Condition FaultManager.APP1_AdaptAdaptHiMax.Action_4 FaultManager.APP1_AdaptAdaptHiMax.Action_4_Condition FaultManager.APP1_AdaptAdaptHiMin.Mode FaultManager.APP1_AdaptAdaptHiMin.ID FaultManager.APP1_AdaptAdaptHiMin.Test FaultManager.APP1_AdaptAdaptHiMin.Faulty_Samples__X_ FaultManager.APP1_AdaptAdaptHiMin.Total_Samples__Y_ FaultManager.APP1_AdaptAdaptHiMin.Action_1 FaultManager.APP1_AdaptAdaptHiMin.Action_1_Condition FaultManager.APP1_AdaptAdaptHiMin.Action_2 FaultManager.APP1_AdaptAdaptHiMin.Action_2_Condition FaultManager.APP1_AdaptAdaptHiMin.Action_3 FaultManager.APP1_AdaptAdaptHiMin.Action_3_Condition FaultManager.APP1_AdaptAdaptHiMin.Action_4 FaultManager.APP1_AdaptAdaptHiMin.Action_4_Condition FaultManager.APP1_AdaptAdaptLoMax.Mode FaultManager.APP1_AdaptAdaptLoMax.ID FaultManager.APP1_AdaptAdaptLoMax.Test FaultManager.APP1_AdaptAdaptLoMax.Faulty_Samples__X_ FaultManager.APP1_AdaptAdaptLoMax.Total_Samples__Y_ FaultManager.APP1_AdaptAdaptLoMax.Action_1 FaultManager.APP1_AdaptAdaptLoMax.Action_1_Condition FaultManager.APP1_AdaptAdaptLoMax.Action_2 FaultManager.APP1_AdaptAdaptLoMax.Action_2_Condition FaultManager.APP1_AdaptAdaptLoMax.Action_3 FaultManager.APP1_AdaptAdaptLoMax.Action_3_Condition FaultManager.APP1_AdaptAdaptLoMax.Action_4 FaultManager.APP1_AdaptAdaptLoMax.Action_4_Condition FaultManager.APP1_AdaptAdaptLoMin.Mode FaultManager.APP1_AdaptAdaptLoMin.ID FaultManager.APP1_AdaptAdaptLoMin.Test FaultManager.APP1_AdaptAdaptLoMin.Faulty_Samples__X_ FaultManager.APP1_AdaptAdaptLoMin.Total_Samples__Y_ FaultManager.APP1_AdaptAdaptLoMin.Action_1 FaultManager.APP1_AdaptAdaptLoMin.Action_1_Condition FaultManager.APP1_AdaptAdaptLoMin.Action_2 FaultManager.APP1_AdaptAdaptLoMin.Action_2_Condition FaultManager.APP1_AdaptAdaptLoMin.Action_3 FaultManager.APP1_AdaptAdaptLoMin.Action_3_Condition FaultManager.APP1_AdaptAdaptLoMin.Action_4 FaultManager.APP1_AdaptAdaptLoMin.Action_4_Condition FaultManager.APP1_AdaptRangeHigh.Mode FaultManager.APP1_AdaptRangeHigh.ID FaultManager.APP1_AdaptRangeHigh.Test FaultManager.APP1_AdaptRangeHigh.Faulty_Samples__X_ FaultManager.APP1_AdaptRangeHigh.Total_Samples__Y_ FaultManager.APP1_AdaptRangeHigh.Action_1 FaultManager.APP1_AdaptRangeHigh.Action_1_Condition FaultManager.APP1_AdaptRangeHigh.Action_2 FaultManager.APP1_AdaptRangeHigh.Action_2_Condition FaultManager.APP1_AdaptRangeHigh.Action_3 FaultManager.APP1_AdaptRangeHigh.Action_3_Condition FaultManager.APP1_AdaptRangeHigh.Action_4 FaultManager.APP1_AdaptRangeHigh.Action_4_Condition FaultManager.APP1_AdaptRangeLow.Mode FaultManager.APP1_AdaptRangeLow.ID FaultManager.APP1_AdaptRangeLow.Test FaultManager.APP1_AdaptRangeLow.Faulty_Samples__X_ FaultManager.APP1_AdaptRangeLow.Total_Samples__Y_ FaultManager.APP1_AdaptRangeLow.Action_1 FaultManager.APP1_AdaptRangeLow.Action_1_Condition FaultManager.APP1_AdaptRangeLow.Action_2 FaultManager.APP1_AdaptRangeLow.Action_2_Condition FaultManager.APP1_AdaptRangeLow.Action_3 FaultManager.APP1_AdaptRangeLow.Action_3_Condition FaultManager.APP1_AdaptRangeLow.Action_4 FaultManager.APP1_AdaptRangeLow.Action_4_Condition FaultManager.APP2RangeHigh.Mode FaultManager.APP2RangeHigh.ID FaultManager.APP2RangeHigh.Test FaultManager.APP2RangeHigh.Faulty_Samples__X_ FaultManager.APP2RangeHigh.Total_Samples__Y_ FaultManager.APP2RangeHigh.Action_1 FaultManager.APP2RangeHigh.Action_1_Condition FaultManager.APP2RangeHigh.Action_2 FaultManager.APP2RangeHigh.Action_2_Condition FaultManager.APP2RangeHigh.Action_3 FaultManager.APP2RangeHigh.Action_3_Condition FaultManager.APP2RangeHigh.Action_4 FaultManager.APP2RangeHigh.Action_4_Condition FaultManager.APP2RangeLow.Mode FaultManager.APP2RangeLow.ID FaultManager.APP2RangeLow.Test FaultManager.APP2RangeLow.Faulty_Samples__X_ FaultManager.APP2RangeLow.Total_Samples__Y_ FaultManager.APP2RangeLow.Action_1 FaultManager.APP2RangeLow.Action_1_Condition FaultManager.APP2RangeLow.Action_2 FaultManager.APP2RangeLow.Action_2_Condition FaultManager.APP2RangeLow.Action_3 FaultManager.APP2RangeLow.Action_3_Condition FaultManager.APP2RangeLow.Action_4 FaultManager.APP2RangeLow.Action_4_Condition FaultManager.APP2_AdaptAdaptHiMax.Mode FaultManager.APP2_AdaptAdaptHiMax.ID FaultManager.APP2_AdaptAdaptHiMax.Test FaultManager.APP2_AdaptAdaptHiMax.Faulty_Samples__X_ FaultManager.APP2_AdaptAdaptHiMax.Total_Samples__Y_ FaultManager.APP2_AdaptAdaptHiMax.Action_1 FaultManager.APP2_AdaptAdaptHiMax.Action_1_Condition FaultManager.APP2_AdaptAdaptHiMax.Action_2 FaultManager.APP2_AdaptAdaptHiMax.Action_2_Condition FaultManager.APP2_AdaptAdaptHiMax.Action_3 FaultManager.APP2_AdaptAdaptHiMax.Action_3_Condition FaultManager.APP2_AdaptAdaptHiMax.Action_4 FaultManager.APP2_AdaptAdaptHiMax.Action_4_Condition FaultManager.APP2_AdaptAdaptHiMin.Mode FaultManager.APP2_AdaptAdaptHiMin.ID FaultManager.APP2_AdaptAdaptHiMin.Test FaultManager.APP2_AdaptAdaptHiMin.Faulty_Samples__X_ FaultManager.APP2_AdaptAdaptHiMin.Total_Samples__Y_ FaultManager.APP2_AdaptAdaptHiMin.Action_1 FaultManager.APP2_AdaptAdaptHiMin.Action_1_Condition FaultManager.APP2_AdaptAdaptHiMin.Action_2 FaultManager.APP2_AdaptAdaptHiMin.Action_2_Condition FaultManager.APP2_AdaptAdaptHiMin.Action_3 FaultManager.APP2_AdaptAdaptHiMin.Action_3_Condition FaultManager.APP2_AdaptAdaptHiMin.Action_4 FaultManager.APP2_AdaptAdaptHiMin.Action_4_Condition FaultManager.APP2_AdaptAdaptLoMax.Mode FaultManager.APP2_AdaptAdaptLoMax.ID FaultManager.APP2_AdaptAdaptLoMax.Test FaultManager.APP2_AdaptAdaptLoMax.Faulty_Samples__X_ FaultManager.APP2_AdaptAdaptLoMax.Total_Samples__Y_ FaultManager.APP2_AdaptAdaptLoMax.Action_1 FaultManager.APP2_AdaptAdaptLoMax.Action_1_Condition FaultManager.APP2_AdaptAdaptLoMax.Action_2 FaultManager.APP2_AdaptAdaptLoMax.Action_2_Condition FaultManager.APP2_AdaptAdaptLoMax.Action_3 FaultManager.APP2_AdaptAdaptLoMax.Action_3_Condition FaultManager.APP2_AdaptAdaptLoMax.Action_4 FaultManager.APP2_AdaptAdaptLoMax.Action_4_Condition FaultManager.APP2_AdaptAdaptLoMin.Mode FaultManager.APP2_AdaptAdaptLoMin.ID FaultManager.APP2_AdaptAdaptLoMin.Test FaultManager.APP2_AdaptAdaptLoMin.Faulty_Samples__X_ FaultManager.APP2_AdaptAdaptLoMin.Total_Samples__Y_ FaultManager.APP2_AdaptAdaptLoMin.Action_1 FaultManager.APP2_AdaptAdaptLoMin.Action_1_Condition FaultManager.APP2_AdaptAdaptLoMin.Action_2 FaultManager.APP2_AdaptAdaptLoMin.Action_2_Condition FaultManager.APP2_AdaptAdaptLoMin.Action_3 FaultManager.APP2_AdaptAdaptLoMin.Action_3_Condition FaultManager.APP2_AdaptAdaptLoMin.Action_4 FaultManager.APP2_AdaptAdaptLoMin.Action_4_Condition FaultManager.APP2_AdaptRangeHigh.Mode FaultManager.APP2_AdaptRangeHigh.ID FaultManager.APP2_AdaptRangeHigh.Test FaultManager.APP2_AdaptRangeHigh.Faulty_Samples__X_ FaultManager.APP2_AdaptRangeHigh.Total_Samples__Y_ FaultManager.APP2_AdaptRangeHigh.Action_1 FaultManager.APP2_AdaptRangeHigh.Action_1_Condition FaultManager.APP2_AdaptRangeHigh.Action_2 FaultManager.APP2_AdaptRangeHigh.Action_2_Condition FaultManager.APP2_AdaptRangeHigh.Action_3 FaultManager.APP2_AdaptRangeHigh.Action_3_Condition FaultManager.APP2_AdaptRangeHigh.Action_4 FaultManager.APP2_AdaptRangeHigh.Action_4_Condition FaultManager.APP2_AdaptRangeLow.Mode FaultManager.APP2_AdaptRangeLow.ID FaultManager.APP2_AdaptRangeLow.Test FaultManager.APP2_AdaptRangeLow.Faulty_Samples__X_ FaultManager.APP2_AdaptRangeLow.Total_Samples__Y_ FaultManager.APP2_AdaptRangeLow.Action_1 FaultManager.APP2_AdaptRangeLow.Action_1_Condition FaultManager.APP2_AdaptRangeLow.Action_2 FaultManager.APP2_AdaptRangeLow.Action_2_Condition FaultManager.APP2_AdaptRangeLow.Action_3 FaultManager.APP2_AdaptRangeLow.Action_3_Condition FaultManager.APP2_AdaptRangeLow.Action_4 FaultManager.APP2_AdaptRangeLow.Action_4_Condition FaultManager.APP_Sensors_Conflict.Mode FaultManager.APP_Sensors_Conflict.ID FaultManager.APP_Sensors_Conflict.Test FaultManager.APP_Sensors_Conflict.Faulty_Samples__X_ FaultManager.APP_Sensors_Conflict.Total_Samples__Y_ FaultManager.APP_Sensors_Conflict.Action_1 FaultManager.APP_Sensors_Conflict.Action_1_Condition FaultManager.APP_Sensors_Conflict.Action_2 FaultManager.APP_Sensors_Conflict.Action_2_Condition FaultManager.APP_Sensors_Conflict.Action_3 FaultManager.APP_Sensors_Conflict.Action_3_Condition FaultManager.APP_Sensors_Conflict.Action_4 FaultManager.APP_Sensors_Conflict.Action_4_Condition FaultManager.Bank1_EquivRatioRangeHigh.Mode FaultManager.Bank1_EquivRatioRangeHigh.ID FaultManager.Bank1_EquivRatioRangeHigh.Test FaultManager.Bank1_EquivRatioRangeHigh.Faulty_Samples__X_ FaultManager.Bank1_EquivRatioRangeHigh.Total_Samples__Y_ FaultManager.Bank1_EquivRatioRangeHigh.Action_1 FaultManager.Bank1_EquivRatioRangeHigh.Action_1_Condition FaultManager.Bank1_EquivRatioRangeHigh.Action_2 FaultManager.Bank1_EquivRatioRangeHigh.Action_2_Condition FaultManager.Bank1_EquivRatioRangeHigh.Action_3 FaultManager.Bank1_EquivRatioRangeHigh.Action_3_Condition FaultManager.Bank1_EquivRatioRangeHigh.Action_4 FaultManager.Bank1_EquivRatioRangeHigh.Action_4_Condition FaultManager.Bank1_EquivRatioRangeLow.Mode FaultManager.Bank1_EquivRatioRangeLow.ID FaultManager.Bank1_EquivRatioRangeLow.Test FaultManager.Bank1_EquivRatioRangeLow.Faulty_Samples__X_ FaultManager.Bank1_EquivRatioRangeLow.Total_Samples__Y_ FaultManager.Bank1_EquivRatioRangeLow.Action_1 FaultManager.Bank1_EquivRatioRangeLow.Action_1_Condition FaultManager.Bank1_EquivRatioRangeLow.Action_2 FaultManager.Bank1_EquivRatioRangeLow.Action_2_Condition FaultManager.Bank1_EquivRatioRangeLow.Action_3 FaultManager.Bank1_EquivRatioRangeLow.Action_3_Condition FaultManager.Bank1_EquivRatioRangeLow.Action_4 FaultManager.Bank1_EquivRatioRangeLow.Action_4_Condition FaultManager.Bank2_EquivRatioRangeHigh.Mode FaultManager.Bank2_EquivRatioRangeHigh.ID FaultManager.Bank2_EquivRatioRangeHigh.Test FaultManager.Bank2_EquivRatioRangeHigh.Faulty_Samples__X_ FaultManager.Bank2_EquivRatioRangeHigh.Total_Samples__Y_ FaultManager.Bank2_EquivRatioRangeHigh.Action_1 FaultManager.Bank2_EquivRatioRangeHigh.Action_1_Condition FaultManager.Bank2_EquivRatioRangeHigh.Action_2 FaultManager.Bank2_EquivRatioRangeHigh.Action_2_Condition FaultManager.Bank2_EquivRatioRangeHigh.Action_3 FaultManager.Bank2_EquivRatioRangeHigh.Action_3_Condition FaultManager.Bank2_EquivRatioRangeHigh.Action_4 FaultManager.Bank2_EquivRatioRangeHigh.Action_4_Condition FaultManager.Bank2_EquivRatioRangeLow.Mode FaultManager.Bank2_EquivRatioRangeLow.ID FaultManager.Bank2_EquivRatioRangeLow.Test FaultManager.Bank2_EquivRatioRangeLow.Faulty_Samples__X_ FaultManager.Bank2_EquivRatioRangeLow.Total_Samples__Y_ FaultManager.Bank2_EquivRatioRangeLow.Action_1 FaultManager.Bank2_EquivRatioRangeLow.Action_1_Condition FaultManager.Bank2_EquivRatioRangeLow.Action_2 FaultManager.Bank2_EquivRatioRangeLow.Action_2_Condition FaultManager.Bank2_EquivRatioRangeLow.Action_3 FaultManager.Bank2_EquivRatioRangeLow.Action_3_Condition FaultManager.Bank2_EquivRatioRangeLow.Action_4 FaultManager.Bank2_EquivRatioRangeLow.Action_4_Condition FaultManager.CATRangeHigh.Mode FaultManager.CATRangeHigh.ID FaultManager.CATRangeHigh.Test FaultManager.CATRangeHigh.Faulty_Samples__X_ FaultManager.CATRangeHigh.Total_Samples__Y_ FaultManager.CATRangeHigh.Action_1 FaultManager.CATRangeHigh.Action_1_Condition FaultManager.CATRangeHigh.Action_2 FaultManager.CATRangeHigh.Action_2_Condition FaultManager.CATRangeHigh.Action_3 FaultManager.CATRangeHigh.Action_3_Condition FaultManager.CATRangeHigh.Action_4 FaultManager.CATRangeHigh.Action_4_Condition FaultManager.CATRangeLow.Mode FaultManager.CATRangeLow.ID FaultManager.CATRangeLow.Test FaultManager.CATRangeLow.Faulty_Samples__X_ FaultManager.CATRangeLow.Total_Samples__Y_ FaultManager.CATRangeLow.Action_1 FaultManager.CATRangeLow.Action_1_Condition FaultManager.CATRangeLow.Action_2 FaultManager.CATRangeLow.Action_2_Condition FaultManager.CATRangeLow.Action_3 FaultManager.CATRangeLow.Action_3_Condition FaultManager.CATRangeLow.Action_4 FaultManager.CATRangeLow.Action_4_Condition FaultManager.CamEdgesFault.Mode FaultManager.CamEdgesFault.ID FaultManager.CamEdgesFault.Test FaultManager.CamEdgesFault.Faulty_Samples__X_ FaultManager.CamEdgesFault.Total_Samples__Y_ FaultManager.CamEdgesFault.Action_1 FaultManager.CamEdgesFault.Action_1_Condition FaultManager.CamEdgesFault.Action_2 FaultManager.CamEdgesFault.Action_2_Condition FaultManager.CamEdgesFault.Action_3 FaultManager.CamEdgesFault.Action_3_Condition FaultManager.CamEdgesFault.Action_4 FaultManager.CamEdgesFault.Action_4_Condition FaultManager.CamSyncFault.Mode FaultManager.CamSyncFault.ID FaultManager.CamSyncFault.Test FaultManager.CamSyncFault.Faulty_Samples__X_ FaultManager.CamSyncFault.Total_Samples__Y_ FaultManager.CamSyncFault.Action_1 FaultManager.CamSyncFault.Action_1_Condition FaultManager.CamSyncFault.Action_2 FaultManager.CamSyncFault.Action_2_Condition FaultManager.CamSyncFault.Action_3 FaultManager.CamSyncFault.Action_3_Condition FaultManager.CamSyncFault.Action_4 FaultManager.CamSyncFault.Action_4_Condition FaultManager.CrankEdgesFault.Mode FaultManager.CrankEdgesFault.ID FaultManager.CrankEdgesFault.Test FaultManager.CrankEdgesFault.Faulty_Samples__X_ FaultManager.CrankEdgesFault.Total_Samples__Y_ FaultManager.CrankEdgesFault.Action_1 FaultManager.CrankEdgesFault.Action_1_Condition FaultManager.CrankEdgesFault.Action_2 FaultManager.CrankEdgesFault.Action_2_Condition FaultManager.CrankEdgesFault.Action_3 FaultManager.CrankEdgesFault.Action_3_Condition FaultManager.CrankEdgesFault.Action_4 FaultManager.CrankEdgesFault.Action_4_Condition FaultManager.CrankSyncFault.Mode FaultManager.CrankSyncFault.ID FaultManager.CrankSyncFault.Test FaultManager.CrankSyncFault.Faulty_Samples__X_ FaultManager.CrankSyncFault.Total_Samples__Y_ FaultManager.CrankSyncFault.Action_1 FaultManager.CrankSyncFault.Action_1_Condition FaultManager.CrankSyncFault.Action_2 FaultManager.CrankSyncFault.Action_2_Condition FaultManager.CrankSyncFault.Action_3 FaultManager.CrankSyncFault.Action_3_Condition FaultManager.CrankSyncFault.Action_4 FaultManager.CrankSyncFault.Action_4_Condition FaultManager.ECTOverTempFault.Mode FaultManager.ECTOverTempFault.ID FaultManager.ECTOverTempFault.Test FaultManager.ECTOverTempFault.Faulty_Samples__X_ FaultManager.ECTOverTempFault.Total_Samples__Y_ FaultManager.ECTOverTempFault.Action_1 FaultManager.ECTOverTempFault.Action_1_Condition FaultManager.ECTOverTempFault.Action_2 FaultManager.ECTOverTempFault.Action_2_Condition FaultManager.ECTOverTempFault.Action_3 FaultManager.ECTOverTempFault.Action_3_Condition FaultManager.ECTOverTempFault.Action_4 FaultManager.ECTOverTempFault.Action_4_Condition FaultManager.ECTRangeHigh.Mode FaultManager.ECTRangeHigh.ID FaultManager.ECTRangeHigh.Test FaultManager.ECTRangeHigh.Faulty_Samples__X_ FaultManager.ECTRangeHigh.Total_Samples__Y_ FaultManager.ECTRangeHigh.Action_1 FaultManager.ECTRangeHigh.Action_1_Condition FaultManager.ECTRangeHigh.Action_2 FaultManager.ECTRangeHigh.Action_2_Condition FaultManager.ECTRangeHigh.Action_3 FaultManager.ECTRangeHigh.Action_3_Condition FaultManager.ECTRangeHigh.Action_4 FaultManager.ECTRangeHigh.Action_4_Condition FaultManager.ECTRangeLow.Mode FaultManager.ECTRangeLow.ID FaultManager.ECTRangeLow.Test FaultManager.ECTRangeLow.Faulty_Samples__X_ FaultManager.ECTRangeLow.Total_Samples__Y_ FaultManager.ECTRangeLow.Action_1 FaultManager.ECTRangeLow.Action_1_Condition FaultManager.ECTRangeLow.Action_2 FaultManager.ECTRangeLow.Action_2_Condition FaultManager.ECTRangeLow.Action_3 FaultManager.ECTRangeLow.Action_3_Condition FaultManager.ECTRangeLow.Action_4 FaultManager.ECTRangeLow.Action_4_Condition FaultManager.ECTSevereOverTempFault.Mode FaultManager.ECTSevereOverTempFault.ID FaultManager.ECTSevereOverTempFault.Test FaultManager.ECTSevereOverTempFault.Faulty_Samples__X_ FaultManager.ECTSevereOverTempFault.Total_Samples__Y_ FaultManager.ECTSevereOverTempFault.Action_1 FaultManager.ECTSevereOverTempFault.Action_1_Condition FaultManager.ECTSevereOverTempFault.Action_2 FaultManager.ECTSevereOverTempFault.Action_2_Condition FaultManager.ECTSevereOverTempFault.Action_3 FaultManager.ECTSevereOverTempFault.Action_3_Condition FaultManager.ECTSevereOverTempFault.Action_4 FaultManager.ECTSevereOverTempFault.Action_4_Condition FaultManager.EST1_Open.Mode FaultManager.EST1_Open.ID FaultManager.EST1_Open.Test FaultManager.EST1_Open.Faulty_Samples__X_ FaultManager.EST1_Open.Total_Samples__Y_ FaultManager.EST1_Open.Action_1 FaultManager.EST1_Open.Action_1_Condition FaultManager.EST1_Open.Action_2 FaultManager.EST1_Open.Action_2_Condition FaultManager.EST1_Open.Action_3 FaultManager.EST1_Open.Action_3_Condition FaultManager.EST1_Open.Action_4 FaultManager.EST1_Open.Action_4_Condition FaultManager.EST1_Short.Mode FaultManager.EST1_Short.ID FaultManager.EST1_Short.Test FaultManager.EST1_Short.Faulty_Samples__X_ FaultManager.EST1_Short.Total_Samples__Y_ FaultManager.EST1_Short.Action_1 FaultManager.EST1_Short.Action_1_Condition FaultManager.EST1_Short.Action_2 FaultManager.EST1_Short.Action_2_Condition FaultManager.EST1_Short.Action_3 FaultManager.EST1_Short.Action_3_Condition FaultManager.EST1_Short.Action_4 FaultManager.EST1_Short.Action_4_Condition FaultManager.EST2_Open.Mode FaultManager.EST2_Open.ID FaultManager.EST2_Open.Test FaultManager.EST2_Open.Faulty_Samples__X_ FaultManager.EST2_Open.Total_Samples__Y_ FaultManager.EST2_Open.Action_1 FaultManager.EST2_Open.Action_1_Condition FaultManager.EST2_Open.Action_2 FaultManager.EST2_Open.Action_2_Condition FaultManager.EST2_Open.Action_3 FaultManager.EST2_Open.Action_3_Condition FaultManager.EST2_Open.Action_4 FaultManager.EST2_Open.Action_4_Condition FaultManager.EST2_Short.Mode FaultManager.EST2_Short.ID FaultManager.EST2_Short.Test FaultManager.EST2_Short.Faulty_Samples__X_ FaultManager.EST2_Short.Total_Samples__Y_ FaultManager.EST2_Short.Action_1 FaultManager.EST2_Short.Action_1_Condition FaultManager.EST2_Short.Action_2 FaultManager.EST2_Short.Action_2_Condition FaultManager.EST2_Short.Action_3 FaultManager.EST2_Short.Action_3_Condition FaultManager.EST2_Short.Action_4 FaultManager.EST2_Short.Action_4_Condition FaultManager.EST3_Open.Mode FaultManager.EST3_Open.ID FaultManager.EST3_Open.Test FaultManager.EST3_Open.Faulty_Samples__X_ FaultManager.EST3_Open.Total_Samples__Y_ FaultManager.EST3_Open.Action_1 FaultManager.EST3_Open.Action_1_Condition FaultManager.EST3_Open.Action_2 FaultManager.EST3_Open.Action_2_Condition FaultManager.EST3_Open.Action_3 FaultManager.EST3_Open.Action_3_Condition FaultManager.EST3_Open.Action_4 FaultManager.EST3_Open.Action_4_Condition FaultManager.EST3_Short.Mode FaultManager.EST3_Short.ID FaultManager.EST3_Short.Test FaultManager.EST3_Short.Faulty_Samples__X_ FaultManager.EST3_Short.Total_Samples__Y_ FaultManager.EST3_Short.Action_1 FaultManager.EST3_Short.Action_1_Condition FaultManager.EST3_Short.Action_2 FaultManager.EST3_Short.Action_2_Condition FaultManager.EST3_Short.Action_3 FaultManager.EST3_Short.Action_3_Condition FaultManager.EST3_Short.Action_4 FaultManager.EST3_Short.Action_4_Condition FaultManager.EST4_Open.Mode FaultManager.EST4_Open.ID FaultManager.EST4_Open.Test FaultManager.EST4_Open.Faulty_Samples__X_ FaultManager.EST4_Open.Total_Samples__Y_ FaultManager.EST4_Open.Action_1 FaultManager.EST4_Open.Action_1_Condition FaultManager.EST4_Open.Action_2 FaultManager.EST4_Open.Action_2_Condition FaultManager.EST4_Open.Action_3 FaultManager.EST4_Open.Action_3_Condition FaultManager.EST4_Open.Action_4 FaultManager.EST4_Open.Action_4_Condition FaultManager.EST4_Short.Mode FaultManager.EST4_Short.ID FaultManager.EST4_Short.Test FaultManager.EST4_Short.Faulty_Samples__X_ FaultManager.EST4_Short.Total_Samples__Y_ FaultManager.EST4_Short.Action_1 FaultManager.EST4_Short.Action_1_Condition FaultManager.EST4_Short.Action_2 FaultManager.EST4_Short.Action_2_Condition FaultManager.EST4_Short.Action_3 FaultManager.EST4_Short.Action_3_Condition FaultManager.EST4_Short.Action_4 FaultManager.EST4_Short.Action_4_Condition FaultManager.EST5_Open.Mode FaultManager.EST5_Open.ID FaultManager.EST5_Open.Test FaultManager.EST5_Open.Faulty_Samples__X_ FaultManager.EST5_Open.Total_Samples__Y_ FaultManager.EST5_Open.Action_1 FaultManager.EST5_Open.Action_1_Condition FaultManager.EST5_Open.Action_2 FaultManager.EST5_Open.Action_2_Condition FaultManager.EST5_Open.Action_3 FaultManager.EST5_Open.Action_3_Condition FaultManager.EST5_Open.Action_4 FaultManager.EST5_Open.Action_4_Condition FaultManager.EST5_Short.Mode FaultManager.EST5_Short.ID FaultManager.EST5_Short.Test FaultManager.EST5_Short.Faulty_Samples__X_ FaultManager.EST5_Short.Total_Samples__Y_ FaultManager.EST5_Short.Action_1 FaultManager.EST5_Short.Action_1_Condition FaultManager.EST5_Short.Action_2 FaultManager.EST5_Short.Action_2_Condition FaultManager.EST5_Short.Action_3 FaultManager.EST5_Short.Action_3_Condition FaultManager.EST5_Short.Action_4 FaultManager.EST5_Short.Action_4_Condition FaultManager.EST6_Open.Mode FaultManager.EST6_Open.ID FaultManager.EST6_Open.Test FaultManager.EST6_Open.Faulty_Samples__X_ FaultManager.EST6_Open.Total_Samples__Y_ FaultManager.EST6_Open.Action_1 FaultManager.EST6_Open.Action_1_Condition FaultManager.EST6_Open.Action_2 FaultManager.EST6_Open.Action_2_Condition FaultManager.EST6_Open.Action_3 FaultManager.EST6_Open.Action_3_Condition FaultManager.EST6_Open.Action_4 FaultManager.EST6_Open.Action_4_Condition FaultManager.EST6_Short.Mode FaultManager.EST6_Short.ID FaultManager.EST6_Short.Test FaultManager.EST6_Short.Faulty_Samples__X_ FaultManager.EST6_Short.Total_Samples__Y_ FaultManager.EST6_Short.Action_1 FaultManager.EST6_Short.Action_1_Condition FaultManager.EST6_Short.Action_2 FaultManager.EST6_Short.Action_2_Condition FaultManager.EST6_Short.Action_3 FaultManager.EST6_Short.Action_3_Condition FaultManager.EST6_Short.Action_4 FaultManager.EST6_Short.Action_4_Condition FaultManager.EST7_Open.Mode FaultManager.EST7_Open.ID FaultManager.EST7_Open.Test FaultManager.EST7_Open.Faulty_Samples__X_ FaultManager.EST7_Open.Total_Samples__Y_ /end DEF_CHARACTERISTIC
 /begin OUT_MEASUREMENT FaultMarquees.FaultMarquees.Current_Suspected FaultMarquees.FaultMarquees.Current_Active FaultMarquees.FaultMarquees.Current_Occurred /end OUT_MEASUREMENT
 /begin SUB_FUNCTION Foreground Action_Reasons /end SUB_FUNCTION
/end FUNCTION
/end MODULE
/end PROJECT
