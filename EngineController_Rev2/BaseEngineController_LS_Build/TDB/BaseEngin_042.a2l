/******************************************************************************
* ASAP2 descrition file /
* Generated by Woodward ASAP2 Generator /
* This file was auto-generated on: Sunday, March 19, 2023 10:35 PM /
******************************************************************************/
ASAP2_VERSION 1 51
/begin PROJECT Project ""
/begin MODULE BaseEngin_042 ""
/begin IF_DATA VISION DEVICE_SETTING "CCP=2.1_ASAP1b" DEVICE_SETTING "DefaultCRCType=5" /end IF_DATA
/begin IF_DATA ASAP1B_CCP
 /begin SOURCE "List 1" 0 0 DISPLAY_IDENTIFIER "DAQ1"
  /begin QP_BLOB 0 LENGTH 8 CAN_ID_FIXED 0x98EF3102 RASTER 0 REDUCTION_ALLOWED FIRST_PID 0 /end QP_BLOB
 /end SOURCE
 /begin SOURCE "List 2" 0 0 DISPLAY_IDENTIFIER "DAQ2"
  /begin QP_BLOB 1 LENGTH 8 CAN_ID_FIXED 0x98EF3102 RASTER 1 REDUCTION_ALLOWED FIRST_PID 8 /end QP_BLOB
 /end SOURCE
 /begin SOURCE "List 3" 0 0 DISPLAY_IDENTIFIER "DAQ3"
  /begin QP_BLOB 2 LENGTH 8 CAN_ID_FIXED 0x98EF3102 RASTER 2 REDUCTION_ALLOWED FIRST_PID 16 /end QP_BLOB
 /end SOURCE
 /begin SOURCE "List 4" 0 0 DISPLAY_IDENTIFIER "DAQ4"
  /begin QP_BLOB 3 LENGTH 8 CAN_ID_FIXED 0x98EF3102 RASTER 3 REDUCTION_ALLOWED FIRST_PID 24 /end QP_BLOB
 /end SOURCE
 /begin SOURCE "List 5" 0 0 DISPLAY_IDENTIFIER "DAQ5"
  /begin QP_BLOB 4 LENGTH 8 CAN_ID_FIXED 0x98EF3102 RASTER 4 REDUCTION_ALLOWED FIRST_PID 32 /end QP_BLOB
 /end SOURCE
 /begin SOURCE "List 6" 0 0 DISPLAY_IDENTIFIER "DAQ6"
  /begin QP_BLOB 5 LENGTH 8 CAN_ID_FIXED 0x98EF3102 RASTER 5 REDUCTION_ALLOWED FIRST_PID 40 /end QP_BLOB
 /end SOURCE
 /begin SOURCE "List 7" 0 0 DISPLAY_IDENTIFIER "DAQ7"
  /begin QP_BLOB 6 LENGTH 8 CAN_ID_FIXED 0x98EF3102 RASTER 6 REDUCTION_ALLOWED FIRST_PID 48 /end QP_BLOB
 /end SOURCE
 /begin SOURCE "List 8" 0 0 DISPLAY_IDENTIFIER "DAQ8"
  /begin QP_BLOB 7 LENGTH 8 CAN_ID_FIXED 0x98EF3102 RASTER 7 REDUCTION_ALLOWED FIRST_PID 56 /end QP_BLOB
 /end SOURCE
 /begin SOURCE "List 9" 0 0 DISPLAY_IDENTIFIER "DAQ9"
  /begin QP_BLOB 8 LENGTH 8 CAN_ID_FIXED 0x98EF3102 RASTER 7 REDUCTION_ALLOWED FIRST_PID 64 /end QP_BLOB
 /end SOURCE
 /begin SOURCE "List 10" 0 0 DISPLAY_IDENTIFIER "DAQ10"
  /begin QP_BLOB 9 LENGTH 8 CAN_ID_FIXED 0x98EF3102 RASTER 7 REDUCTION_ALLOWED FIRST_PID 72 /end QP_BLOB
 /end SOURCE
 /begin RASTER "FGND_RTI_PERIODIC" "FGND_RTI_PERIODIC" 0 3 5 /end RASTER
 /begin RASTER "FGND_5XRTI_PERIODIC" "FGND_5XRTI_PERIODIC" 1 3 25 /end RASTER
 /begin RASTER "FGND_MID_TDC_EVENT" "FGND_MID_TDC_EVENT" 2 103 1 /end RASTER
 /begin RASTER "FGND_20XRTI_PERIODIC" "FGND_20XRTI_PERIODIC" 3 3 100 /end RASTER
 /begin RASTER "BGND_BASE_PERIODIC" "BGND_BASE_PERIODIC" 4 3 50 /end RASTER
 /begin RASTER "BGND_BASEx2_PERIODIC" "BGND_BASEx2_PERIODIC" 5 3 100 /end RASTER
 /begin RASTER "BGND_BASEx10_PERIODIC" "BGND_BASEx10_PERIODIC" 6 3 500 /end RASTER
 /begin RASTER "ONE_SECOND_EVENT" "ONE_SECOND_EVENT" 7 3 1000 /end RASTER
 /* /begin SEED_KEY */ /* DLL for CAL */ /* Uncomment and supply a value "SecurityCAL.dll" */ /* DLL for DAQ */ /* Uncomment and supply a value "SecurityDAQ.dll" */ /* DLL for PGM */ /* Uncomment and supply a value "SecurityPGM.dll" */ /* /end SEED_KEY */
 /begin TP_BLOB /* CCP version */ 0x201 /* Blob version */ 0x204 /* CAN msg ID - send */ 0x98EF0231 /* CAN msg ID - recv */ 0x98EF3102 /* Station address */ 0x31 /* byte order */ 1 BAUDRATE 500000 SAMPLE_RATE 1 SAMPLE_POINT 75 BTL_CYCLES 8 SJW 2 SYNC_EDGE SINGLE DAQ_MODE BURST CONSISTENCY ODT ADDRESS_EXTENSION DAQ
  /begin CHECKSUM_PARAM /* algorithm */ 0x8009 /* limit */ 0x1000 CHECKSUM_CALCULATION ACTIVE_PAGE /end CHECKSUM_PARAM
  /begin DEFINED_PAGES /* Memory page num */ 1 /* Page Name */ "working page" /* address ext. */ 0x00 /* base address */ 0x80000000 /* page length */ 0x0000625C RAM /* memory page in RAM */ RAM_INIT_BY_ECU /* memory page is initialised by ECU start-up */ /end DEFINED_PAGES
  OPTIONAL_CMD 0x5 /* TEST */ OPTIONAL_CMD 0x8 /* START_STOP_ALL */ OPTIONAL_CMD 0xC /* SET_S_STATUS */ OPTIONAL_CMD 0xD /* GET_S_STATUS */ OPTIONAL_CMD 0xE /* BUILD_CHECKSUM */ OPTIONAL_CMD 0xF /* SHORT_UP */ OPTIONAL_CMD 0x12 /* GET_SEED */ OPTIONAL_CMD 0x13 /* UNLOCK */ OPTIONAL_CMD 0x23 /* DNLOAD_6 */ /end TP_BLOB
/end IF_DATA
/*~~~~~~~~~ 6.3.91 MOD_PAR ~~~~~~~~~*/
/begin MOD_PAR /* MOD_PAR Comment*/ "" ECU_CALIBRATION_OFFSET 0x00000000
 /begin MEMORY_SEGMENT CAL "" DATA FLASH INTERN 0x80000000 /* Size */ 0x0000625C /* Offset */ -1 -1 -1 -1 -1 /end MEMORY_SEGMENT
 /begin MEMORY_SEGMENT MeasRAM "" VARIABLES RAM INTERN 0x40000000 /* Size */ 0x00000B45 /* Offset */ -1 -1 -1 -1 -1 /end MEMORY_SEGMENT
/end MOD_PAR
/begin MOD_COMMON /* MOD_COMMON Comment */ "" BYTE_ORDER MSB_FIRST ALIGNMENT_BYTE 1 ALIGNMENT_FLOAT32_IEEE 1 ALIGNMENT_FLOAT64_IEEE 1 ALIGNMENT_LONG 1 ALIGNMENT_WORD 1 /end MOD_COMMON
/*~~~~~~~~~ 6.3.86 MEASUREMENTs ~~~~~~~~~*/
/begin MEASUREMENT table_0_rev "VarDec Table0 Revision Number" UBYTE CompuMethod_1 1 0 0 255 ECU_ADDRESS 0x40000000 /end MEASUREMENT
/begin MEASUREMENT table_1_rev "VarDec Table1 Revision Number" UBYTE CompuMethod_1 1 0 0 255 ECU_ADDRESS 0x40000001 /end MEASUREMENT
/begin MEASUREMENT table_2_rev "VarDec Table2 Revision Number" UBYTE CompuMethod_1 1 0 0 255 ECU_ADDRESS 0x40000002 /end MEASUREMENT
/begin MEASUREMENT KeyRev "This is the revision for the key protocol." UBYTE CompuMethod_1 1 0 0 255 ECU_ADDRESS 0x40000003 /end MEASUREMENT
/begin MEASUREMENT EriRev "This is the revision for the ERI protocol." UBYTE CompuMethod_1 1 0 0 255 ECU_ADDRESS 0x40000004 /end MEASUREMENT
/begin MEASUREMENT table_3_rev "VarDec Table3 Revision Number" UBYTE CompuMethod_1 1 0 0 255 ECU_ADDRESS 0x40000005 /end MEASUREMENT
/begin MEASUREMENT table_4_rev "VarDec Table4 Revision Number" UBYTE CompuMethod_1 1 0 0 255 ECU_ADDRESS 0x40000006 /end MEASUREMENT
/begin MEASUREMENT table_5_rev "VarDec Table5 Revision Number" UBYTE CompuMethod_1 1 0 0 255 ECU_ADDRESS 0x40000007 /end MEASUREMENT
/begin MEASUREMENT table_6_rev "VarDec Table6 Revision Number" UBYTE CompuMethod_1 1 0 0 255 ECU_ADDRESS 0x40000008 /end MEASUREMENT
/begin MEASUREMENT table_7_rev "VarDec Table7 Revision Number" UBYTE CompuMethod_1 1 0 0 255 ECU_ADDRESS 0x40000009 /end MEASUREMENT
/begin MEASUREMENT MotProgRev "This is the revision for the MOTPROG protocol." UBYTE CompuMethod_1 1 0 0 255 ECU_ADDRESS 0x40000049 /end MEASUREMENT
/begin MEASUREMENT BootVerMaj "" UBYTE CompuMethod_1 1 0 0 255 ECU_ADDRESS 0x4000004A /end MEASUREMENT
/begin MEASUREMENT BootVerMin "" UBYTE CompuMethod_1 1 0 0 255 ECU_ADDRESS 0x4000004B /end MEASUREMENT
/begin MEASUREMENT EcuHwMaj "" UBYTE CompuMethod_1 1 0 0 255 ECU_ADDRESS 0x4000004C /end MEASUREMENT
/begin MEASUREMENT EcuHwMin "" UBYTE CompuMethod_1 1 0 0 255 ECU_ADDRESS 0x4000004D /end MEASUREMENT
/begin MEASUREMENT ApplicationCompatibilityArr "Software Format ID" UWORD CompuMethod_2 1 0 0 65535 ECU_ADDRESS 0x4000004E MATRIX_DIM 1 50 1 /end MEASUREMENT
/begin MEASUREMENT AC "Display output in engineering units" UBYTE CompuMethod_4 1 0 0 1 ECU_ADDRESS 0x40000116 /end MEASUREMENT
/begin MEASUREMENT ConfigVerMaj "" UBYTE CompuMethod_1 1 0 0 255 ECU_ADDRESS 0x400002DA /end MEASUREMENT
/begin MEASUREMENT ConfigVerMin "" UBYTE CompuMethod_1 1 0 0 255 ECU_ADDRESS 0x400002DB /end MEASUREMENT
/begin MEASUREMENT FaultMarquees.FaultMarquees.Current_Suspected "Displays a rolling marquee for suspected, active and occurred faults." UBYTE CompuMethod_106 1 0 0 255 ECU_ADDRESS 0x400004C1 /end MEASUREMENT
/begin MEASUREMENT FaultMarquees.FaultMarquees.Current_Active "Displays a rolling marquee for suspected, active and occurred faults." UBYTE CompuMethod_106 1 0 0 255 ECU_ADDRESS 0x400004C2 /end MEASUREMENT
/begin MEASUREMENT FaultMarquees.FaultMarquees.Current_Occurred "Displays a rolling marquee for suspected, active and occurred faults." UBYTE CompuMethod_106 1 0 0 255 ECU_ADDRESS 0x400004C3 /end MEASUREMENT
/begin MEASUREMENT LinkStatus "This is the Status of the Comms link." UBYTE CompuMethod_1 1 0 0 255 ECU_ADDRESS 0x4000065C /end MEASUREMENT
/begin MEASUREMENT ModuleCapability "" UBYTE CompuMethod_144 1 0 0 255 ECU_ADDRESS 0x40000774 /end MEASUREMENT
/begin MEASUREMENT MotoHawkModelSecondsInUse "Total runtime of this MotoHawk software model" ULONG CompuMethod_145 1 0 0 4294970000 ECU_ADDRESS 0x40000865 /end MEASUREMENT
/begin MEASUREMENT SystemFrequency "The operating CPU frequency." ULONG CompuMethod_172 1 0 0 56 ECU_ADDRESS 0x40000A4E /end MEASUREMENT
/begin MEASUREMENT TPUMaskType "Describes the TPU Mask selected for use." UBYTE CompuMethod_175 1 0 0 0 ECU_ADDRESS 0x40000AD4 /end MEASUREMENT
/begin MEASUREMENT TPUMaskVers "Describes the version of the TPU Mask selected." UBYTE CompuMethod_11 1 0 0 255 ECU_ADDRESS 0x40000AD5 /end MEASUREMENT
/begin MEASUREMENT Unused "Unused Table Entry" UBYTE CompuMethod_1 1 0 0 255 ECU_ADDRESS 0x40000ADE /end MEASUREMENT
/*~~~~~~~~~ 6.3.27 CHARACTERISTICs ~~~~~~~~~*/
/begin CHARACTERISTIC project_id "This is the Platform ID used by the tools." VALUE 0x8000625B RecordLayout_1 0 CompuMethod_1 0 255 /end CHARACTERISTIC
/begin CHARACTERISTIC SwIdTxt "Software Format ID" ASCII 0x4000000A RecordLayout_2 0 CompuMethod_2 0 255 NUMBER 13 MATRIX_DIM 13 1 1 READ_ONLY /end CHARACTERISTIC
/begin CHARACTERISTIC CalIdTxt "Calibration ID" ASCII 0x80000002 RecordLayout_2 0 CompuMethod_2 0 255 NUMBER 33 MATRIX_DIM 33 1 1 /end CHARACTERISTIC
/begin CHARACTERISTIC SwRevisionTxt "Software Revision ID" ASCII 0x40000017 RecordLayout_2 0 CompuMethod_2 0 255 NUMBER 50 MATRIX_DIM 50 1 1 READ_ONLY /end CHARACTERISTIC
/begin CHARACTERISTIC FriendlyName "The device's friendly name." ASCII 0x8000002C RecordLayout_2 0 CompuMethod_2 0 255 NUMBER 33 MATRIX_DIM 33 1 1 /end CHARACTERISTIC
/begin CHARACTERISTIC ProductID "Customer's ID used by the tools." VALUE 0x8000004D RecordLayout_3 0 CompuMethod_3 0 4294970000 /end CHARACTERISTIC
/begin CHARACTERISTIC SerialNumber "" ASCII 0x400000B2 RecordLayout_2 0 CompuMethod_2 0 255 NUMBER 50 MATRIX_DIM 50 1 1 READ_ONLY /end CHARACTERISTIC
/begin CHARACTERISTIC ModelNumber "" ASCII 0x400000E4 RecordLayout_2 0 CompuMethod_2 0 255 NUMBER 50 MATRIX_DIM 50 1 1 READ_ONLY /end CHARACTERISTIC
/begin CHARACTERISTIC CompilerVersion "Compiler toolchain version used for the MotoHawk build" ASCII 0x4000028A RecordLayout_2 0 CompuMethod_2 0 255 NUMBER 80 MATRIX_DIM 80 1 1 READ_ONLY /end CHARACTERISTIC
/begin CHARACTERISTIC ControlCoreSDKRelease "ControlCoreSDK Build." ASCII 0x400002DC RecordLayout_2 0 CompuMethod_2 0 255 NUMBER 50 MATRIX_DIM 50 1 1 READ_ONLY /end CHARACTERISTIC
/begin CHARACTERISTIC FaultCommand "Select a command to control the fault manager." VALUE 0x80002336 RecordLayout_1 0 CompuMethod_107 0 255 /end CHARACTERISTIC
/begin CHARACTERISTIC FaultManager.ACChargeHigh_Fault.Mode "Fault manager configuration.  Select up to 4 actions for each fault." VALUE 0x80002337 RecordLayout_4 0 CompuMethod_108 0 65535 /end CHARACTERISTIC
/begin CHARACTERISTIC FaultManager.ACChargeHigh_Fault.ID "Fault manager configuration.  Select up to 4 actions for each fault." VALUE 0x80002339 RecordLayout_4 0 CompuMethod_1 0 65535 /end CHARACTERISTIC
/begin CHARACTERISTIC FaultManager.ACChargeHigh_Fault.Test "Fault manager configuration.  Select up to 4 actions for each fault." VALUE 0x8000233B RecordLayout_4 0 CompuMethod_109 0 65535 /end CHARACTERISTIC
/begin CHARACTERISTIC FaultManager.ACChargeHigh_Fault.Faulty_Samples__X_ "Fault manager configuration.  Select up to 4 actions for each fault." VALUE 0x8000233D RecordLayout_4 0 CompuMethod_1 0 65535 /end CHARACTERISTIC
/begin CHARACTERISTIC FaultManager.ACChargeHigh_Fault.Total_Samples__Y_ "Fault manager configuration.  Select up to 4 actions for each fault." VALUE 0x8000233F RecordLayout_4 0 CompuMethod_1 0 65535 /end CHARACTERISTIC
/begin CHARACTERISTIC FaultManager.ACChargeHigh_Fault.Action_1 "Fault manager configuration.  Select up to 4 actions for each fault." VALUE 0x80002341 RecordLayout_4 0 CompuMethod_110 0 65535 /end CHARACTERISTIC
/begin CHARACTERISTIC FaultManager.ACChargeHigh_Fault.Action_1_Condition "Fault manager configuration.  Select up to 4 actions for each fault." VALUE 0x80002343 RecordLayout_4 0 CompuMethod_111 0 65535 /end CHARACTERISTIC
/begin CHARACTERISTIC FaultManager.ACChargeHigh_Fault.Action_2 "Fault manager configuration.  Select up to 4 actions for each fault." VALUE 0x80002345 RecordLayout_4 0 CompuMethod_110 0 65535 /end CHARACTERISTIC
/begin CHARACTERISTIC FaultManager.ACChargeHigh_Fault.Action_2_Condition "Fault manager configuration.  Select up to 4 actions for each fault." VALUE 0x80002347 RecordLayout_4 0 CompuMethod_111 0 65535 /end CHARACTERISTIC
/begin CHARACTERISTIC FaultManager.ACChargeHigh_Fault.Action_3 "Fault manager configuration.  Select up to 4 actions for each fault." VALUE 0x80002349 RecordLayout_4 0 CompuMethod_110 0 65535 /end CHARACTERISTIC
/begin CHARACTERISTIC FaultManager.ACChargeHigh_Fault.Action_3_Condition "Fault manager configuration.  Select up to 4 actions for each fault." VALUE 0x8000234B RecordLayout_4 0 CompuMethod_111 0 65535 /end CHARACTERISTIC
/begin CHARACTERISTIC FaultManager.ACChargeHigh_Fault.Action_4 "Fault manager configuration.  Select up to 4 actions for each fault." VALUE 0x8000234D RecordLayout_4 0 CompuMethod_110 0 65535 /end CHARACTERISTIC
/begin CHARACTERISTIC FaultManager.ACChargeHigh_Fault.Action_4_Condition "Fault manager configuration.  Select up to 4 actions for each fault." VALUE 0x8000234F RecordLayout_4 0 CompuMethod_111 0 65535 /end CHARACTERISTIC
/begin CHARACTERISTIC FaultManager.ACChargeLow_Fault.Mode "Fault manager configuration.  Select up to 4 actions for each fault." VALUE 0x80002351 RecordLayout_4 0 CompuMethod_108 0 65535 /end CHARACTERISTIC
/begin CHARACTERISTIC FaultManager.ACChargeLow_Fault.ID "Fault manager configuration.  Select up to 4 actions for each fault." VALUE 0x80002353 RecordLayout_4 0 CompuMethod_1 0 65535 /end CHARACTERISTIC
/begin CHARACTERISTIC FaultManager.ACChargeLow_Fault.Test "Fault manager configuration.  Select up to 4 actions for each fault." VALUE 0x80002355 RecordLayout_4 0 CompuMethod_109 0 65535 /end CHARACTERISTIC
/begin CHARACTERISTIC FaultManager.ACChargeLow_Fault.Faulty_Samples__X_ "Fault manager configuration.  Select up to 4 actions for each fault." VALUE 0x80002357 RecordLayout_4 0 CompuMethod_1 0 65535 /end CHARACTERISTIC
/begin CHARACTERISTIC FaultManager.ACChargeLow_Fault.Total_Samples__Y_ "Fault manager configuration.  Select up to 4 actions for each fault." VALUE 0x80002359 RecordLayout_4 0 CompuMethod_1 0 65535 /end CHARACTERISTIC
/begin CHARACTERISTIC FaultManager.ACChargeLow_Fault.Action_1 "Fault manager configuration.  Select up to 4 actions for each fault." VALUE 0x8000235B RecordLayout_4 0 CompuMethod_110 0 65535 /end CHARACTERISTIC
/begin CHARACTERISTIC FaultManager.ACChargeLow_Fault.Action_1_Condition "Fault manager configuration.  Select up to 4 actions for each fault." VALUE 0x8000235D RecordLayout_4 0 CompuMethod_111 0 65535 /end CHARACTERISTIC
/begin CHARACTERISTIC FaultManager.ACChargeLow_Fault.Action_2 "Fault manager configuration.  Select up to 4 actions for each fault." VALUE 0x8000235F RecordLayout_4 0 CompuMethod_110 0 65535 /end CHARACTERISTIC
/begin CHARACTERISTIC FaultManager.ACChargeLow_Fault.Action_2_Condition "Fault manager configuration.  Select up to 4 actions for each fault." VALUE 0x80002361 RecordLayout_4 0 CompuMethod_111 0 65535 /end CHARACTERISTIC
/begin CHARACTERISTIC FaultManager.ACChargeLow_Fault.Action_3 "Fault manager configuration.  Select up to 4 actions for each fault." VALUE 0x80002363 RecordLayout_4 0 CompuMethod_110 0 65535 /end CHARACTERISTIC
/begin CHARACTERISTIC FaultManager.ACChargeLow_Fault.Action_3_Condition "Fault manager configuration.  Select up to 4 actions for each fault." VALUE 0x80002365 RecordLayout_4 0 CompuMethod_111 0 65535 /end CHARACTERISTIC
/begin CHARACTERISTIC FaultManager.ACChargeLow_Fault.Action_4 "Fault manager configuration.  Select up to 4 actions for each fault." VALUE 0x80002367 RecordLayout_4 0 CompuMethod_110 0 65535 /end CHARACTERISTIC
/begin CHARACTERISTIC FaultManager.ACChargeLow_Fault.Action_4_Condition "Fault manager configuration.  Select up to 4 actions for each fault." VALUE 0x80002369 RecordLayout_4 0 CompuMethod_111 0 65535 /end CHARACTERISTIC
/begin CHARACTERISTIC FaultManager.ACPresRangeHigh.Mode "Fault manager configuration.  Select up to 4 actions for each fault." VALUE 0x8000236B RecordLayout_4 0 CompuMethod_108 0 65535 /end CHARACTERISTIC
/begin CHARACTERISTIC FaultManager.ACPresRangeHigh.ID "Fault manager configuration.  Select up to 4 actions for each fault." VALUE 0x8000236D RecordLayout_4 0 CompuMethod_1 0 65535 /end CHARACTERISTIC
/begin CHARACTERISTIC FaultManager.ACPresRangeHigh.Test "Fault manager configuration.  Select up to 4 actions for each fault." VALUE 0x8000236F RecordLayout_4 0 CompuMethod_109 0 65535 /end CHARACTERISTIC
/begin CHARACTERISTIC FaultManager.ACPresRangeHigh.Faulty_Samples__X_ "Fault manager configuration.  Select up to 4 actions for each fault." VALUE 0x80002371 RecordLayout_4 0 CompuMethod_1 0 65535 /end CHARACTERISTIC
/begin CHARACTERISTIC FaultManager.ACPresRangeHigh.Total_Samples__Y_ "Fault manager configuration.  Select up to 4 actions for each fault." VALUE 0x80002373 RecordLayout_4 0 CompuMethod_1 0 65535 /end CHARACTERISTIC
/begin CHARACTERISTIC FaultManager.ACPresRangeHigh.Action_1 "Fault manager configuration.  Select up to 4 actions for each fault." VALUE 0x80002375 RecordLayout_4 0 CompuMethod_110 0 65535 /end CHARACTERISTIC
/begin CHARACTERISTIC FaultManager.ACPresRangeHigh.Action_1_Condition "Fault manager configuration.  Select up to 4 actions for each fault." VALUE 0x80002377 RecordLayout_4 0 CompuMethod_111 0 65535 /end CHARACTERISTIC
/begin CHARACTERISTIC FaultManager.ACPresRangeHigh.Action_2 "Fault manager configuration.  Select up to 4 actions for each fault." VALUE 0x80002379 RecordLayout_4 0 CompuMethod_110 0 65535 /end CHARACTERISTIC
/begin CHARACTERISTIC FaultManager.ACPresRangeHigh.Action_2_Condition "Fault manager configuration.  Select up to 4 actions for each fault." VALUE 0x8000237B RecordLayout_4 0 CompuMethod_111 0 65535 /end CHARACTERISTIC
/begin CHARACTERISTIC FaultManager.ACPresRangeHigh.Action_3 "Fault manager configuration.  Select up to 4 actions for each fault." VALUE 0x8000237D RecordLayout_4 0 CompuMethod_110 0 65535 /end CHARACTERISTIC
/begin CHARACTERISTIC FaultManager.ACPresRangeHigh.Action_3_Condition "Fault manager configuration.  Select up to 4 actions for each fault." VALUE 0x8000237F RecordLayout_4 0 CompuMethod_111 0 65535 /end CHARACTERISTIC
/begin CHARACTERISTIC FaultManager.ACPresRangeHigh.Action_4 "Fault manager configuration.  Select up to 4 actions for each fault." VALUE 0x80002381 RecordLayout_4 0 CompuMethod_110 0 65535 /end CHARACTERISTIC
/begin CHARACTERISTIC FaultManager.ACPresRangeHigh.Action_4_Condition "Fault manager configuration.  Select up to 4 actions for each fault." VALUE 0x80002383 RecordLayout_4 0 CompuMethod_111 0 65535 /end CHARACTERISTIC
/begin CHARACTERISTIC FaultManager.ACPresRangeLow.Mode "Fault manager configuration.  Select up to 4 actions for each fault." VALUE 0x80002385 RecordLayout_4 0 CompuMethod_108 0 65535 /end CHARACTERISTIC
/begin CHARACTERISTIC FaultManager.ACPresRangeLow.ID "Fault manager configuration.  Select up to 4 actions for each fault." VALUE 0x80002387 RecordLayout_4 0 CompuMethod_1 0 65535 /end CHARACTERISTIC
/begin CHARACTERISTIC FaultManager.ACPresRangeLow.Test "Fault manager configuration.  Select up to 4 actions for each fault." VALUE 0x80002389 RecordLayout_4 0 CompuMethod_109 0 65535 /end CHARACTERISTIC
/begin CHARACTERISTIC FaultManager.ACPresRangeLow.Faulty_Samples__X_ "Fault manager configuration.  Select up to 4 actions for each fault." VALUE 0x8000238B RecordLayout_4 0 CompuMethod_1 0 65535 /end CHARACTERISTIC
/begin CHARACTERISTIC FaultManager.ACPresRangeLow.Total_Samples__Y_ "Fault manager configuration.  Select up to 4 actions for each fault." VALUE 0x8000238D RecordLayout_4 0 CompuMethod_1 0 65535 /end CHARACTERISTIC
/begin CHARACTERISTIC FaultManager.ACPresRangeLow.Action_1 "Fault manager configuration.  Select up to 4 actions for each fault." VALUE 0x8000238F RecordLayout_4 0 CompuMethod_110 0 65535 /end CHARACTERISTIC
/begin CHARACTERISTIC FaultManager.ACPresRangeLow.Action_1_Condition "Fault manager configuration.  Select up to 4 actions for each fault." VALUE 0x80002391 RecordLayout_4 0 CompuMethod_111 0 65535 /end CHARACTERISTIC
/begin CHARACTERISTIC FaultManager.ACPresRangeLow.Action_2 "Fault manager configuration.  Select up to 4 actions for each fault." VALUE 0x80002393 RecordLayout_4 0 CompuMethod_110 0 65535 /end CHARACTERISTIC
/begin CHARACTERISTIC FaultManager.ACPresRangeLow.Action_2_Condition "Fault manager configuration.  Select up to 4 actions for each fault." VALUE 0x80002395 RecordLayout_4 0 CompuMethod_111 0 65535 /end CHARACTERISTIC
/begin CHARACTERISTIC FaultManager.ACPresRangeLow.Action_3 "Fault manager configuration.  Select up to 4 actions for each fault." VALUE 0x80002397 RecordLayout_4 0 CompuMethod_110 0 65535 /end CHARACTERISTIC
/begin CHARACTERISTIC FaultManager.ACPresRangeLow.Action_3_Condition "Fault manager configuration.  Select up to 4 actions for each fault." VALUE 0x80002399 RecordLayout_4 0 CompuMethod_111 0 65535 /end CHARACTERISTIC
/begin CHARACTERISTIC FaultManager.ACPresRangeLow.Action_4 "Fault manager configuration.  Select up to 4 actions for each fault." VALUE 0x8000239B RecordLayout_4 0 CompuMethod_110 0 65535 /end CHARACTERISTIC
/begin CHARACTERISTIC FaultManager.ACPresRangeLow.Action_4_Condition "Fault manager configuration.  Select up to 4 actions for each fault." VALUE 0x8000239D RecordLayout_4 0 CompuMethod_111 0 65535 /end CHARACTERISTIC
/begin CHARACTERISTIC FaultManager.APP1_AdaptAdaptHiMax.Mode "Fault manager configuration.  Select up to 4 actions for each fault." VALUE 0x8000239F RecordLayout_4 0 CompuMethod_108 0 65535 /end CHARACTERISTIC
/begin CHARACTERISTIC FaultManager.APP1_AdaptAdaptHiMax.ID "Fault manager configuration.  Select up to 4 actions for each fault." VALUE 0x800023A1 RecordLayout_4 0 CompuMethod_1 0 65535 /end CHARACTERISTIC
/begin CHARACTERISTIC FaultManager.APP1_AdaptAdaptHiMax.Test "Fault manager configuration.  Select up to 4 actions for each fault." VALUE 0x800023A3 RecordLayout_4 0 CompuMethod_109 0 65535 /end CHARACTERISTIC
/begin CHARACTERISTIC FaultManager.APP1_AdaptAdaptHiMax.Faulty_Samples__X_ "Fault manager configuration.  Select up to 4 actions for each fault." VALUE 0x800023A5 RecordLayout_4 0 CompuMethod_1 0 65535 /end CHARACTERISTIC
/begin CHARACTERISTIC FaultManager.APP1_AdaptAdaptHiMax.Total_Samples__Y_ "Fault manager configuration.  Select up to 4 actions for each fault." VALUE 0x800023A7 RecordLayout_4 0 CompuMethod_1 0 65535 /end CHARACTERISTIC
/begin CHARACTERISTIC FaultManager.APP1_AdaptAdaptHiMax.Action_1 "Fault manager configuration.  Select up to 4 actions for each fault." VALUE 0x800023A9 RecordLayout_4 0 CompuMethod_110 0 65535 /end CHARACTERISTIC
/begin CHARACTERISTIC FaultManager.APP1_AdaptAdaptHiMax.Action_1_Condition "Fault manager configuration.  Select up to 4 actions for each fault." VALUE 0x800023AB RecordLayout_4 0 CompuMethod_111 0 65535 /end CHARACTERISTIC
/begin CHARACTERISTIC FaultManager.APP1_AdaptAdaptHiMax.Action_2 "Fault manager configuration.  Select up to 4 actions for each fault." VALUE 0x800023AD RecordLayout_4 0 CompuMethod_110 0 65535 /end CHARACTERISTIC
/begin CHARACTERISTIC FaultManager.APP1_AdaptAdaptHiMax.Action_2_Condition "Fault manager configuration.  Select up to 4 actions for each fault." VALUE 0x800023AF RecordLayout_4 0 CompuMethod_111 0 65535 /end CHARACTERISTIC
/begin CHARACTERISTIC FaultManager.APP1_AdaptAdaptHiMax.Action_3 "Fault manager configuration.  Select up to 4 actions for each fault." VALUE 0x800023B1 RecordLayout_4 0 CompuMethod_110 0 65535 /end CHARACTERISTIC
/begin CHARACTERISTIC FaultManager.APP1_AdaptAdaptHiMax.Action_3_Condition "Fault manager configuration.  Select up to 4 actions for each fault." VALUE 0x800023B3 RecordLayout_4 0 CompuMethod_111 0 65535 /end CHARACTERISTIC
/begin CHARACTERISTIC FaultManager.APP1_AdaptAdaptHiMax.Action_4 "Fault manager configuration.  Select up to 4 actions for each fault." VALUE 0x800023B5 RecordLayout_4 0 CompuMethod_110 0 65535 /end CHARACTERISTIC
/begin CHARACTERISTIC FaultManager.APP1_AdaptAdaptHiMax.Action_4_Condition "Fault manager configuration.  Select up to 4 actions for each fault." VALUE 0x800023B7 RecordLayout_4 0 CompuMethod_111 0 65535 /end CHARACTERISTIC
/begin CHARACTERISTIC FaultManager.APP1_AdaptAdaptHiMin.Mode "Fault manager configuration.  Select up to 4 actions for each fault." VALUE 0x800023B9 RecordLayout_4 0 CompuMethod_108 0 65535 /end CHARACTERISTIC
/begin CHARACTERISTIC FaultManager.APP1_AdaptAdaptHiMin.ID "Fault manager configuration.  Select up to 4 actions for each fault." VALUE 0x800023BB RecordLayout_4 0 CompuMethod_1 0 65535 /end CHARACTERISTIC
/begin CHARACTERISTIC FaultManager.APP1_AdaptAdaptHiMin.Test "Fault manager configuration.  Select up to 4 actions for each fault." VALUE 0x800023BD RecordLayout_4 0 CompuMethod_109 0 65535 /end CHARACTERISTIC
/begin CHARACTERISTIC FaultManager.APP1_AdaptAdaptHiMin.Faulty_Samples__X_ "Fault manager configuration.  Select up to 4 actions for each fault." VALUE 0x800023BF RecordLayout_4 0 CompuMethod_1 0 65535 /end CHARACTERISTIC
/begin CHARACTERISTIC FaultManager.APP1_AdaptAdaptHiMin.Total_Samples__Y_ "Fault manager configuration.  Select up to 4 actions for each fault." VALUE 0x800023C1 RecordLayout_4 0 CompuMethod_1 0 65535 /end CHARACTERISTIC
/begin CHARACTERISTIC FaultManager.APP1_AdaptAdaptHiMin.Action_1 "Fault manager configuration.  Select up to 4 actions for each fault." VALUE 0x800023C3 RecordLayout_4 0 CompuMethod_110 0 65535 /end CHARACTERISTIC
/begin CHARACTERISTIC FaultManager.APP1_AdaptAdaptHiMin.Action_1_Condition "Fault manager configuration.  Select up to 4 actions for each fault." VALUE 0x800023C5 RecordLayout_4 0 CompuMethod_111 0 65535 /end CHARACTERISTIC
/begin CHARACTERISTIC FaultManager.APP1_AdaptAdaptHiMin.Action_2 "Fault manager configuration.  Select up to 4 actions for each fault." VALUE 0x800023C7 RecordLayout_4 0 CompuMethod_110 0 65535 /end CHARACTERISTIC
/begin CHARACTERISTIC FaultManager.APP1_AdaptAdaptHiMin.Action_2_Condition "Fault manager configuration.  Select up to 4 actions for each fault." VALUE 0x800023C9 RecordLayout_4 0 CompuMethod_111 0 65535 /end CHARACTERISTIC
/begin CHARACTERISTIC FaultManager.APP1_AdaptAdaptHiMin.Action_3 "Fault manager configuration.  Select up to 4 actions for each fault." VALUE 0x800023CB RecordLayout_4 0 CompuMethod_110 0 65535 /end CHARACTERISTIC
/begin CHARACTERISTIC FaultManager.APP1_AdaptAdaptHiMin.Action_3_Condition "Fault manager configuration.  Select up to 4 actions for each fault." VALUE 0x800023CD RecordLayout_4 0 CompuMethod_111 0 65535 /end CHARACTERISTIC
/begin CHARACTERISTIC FaultManager.APP1_AdaptAdaptHiMin.Action_4 "Fault manager configuration.  Select up to 4 actions for each fault." VALUE 0x800023CF RecordLayout_4 0 CompuMethod_110 0 65535 /end CHARACTERISTIC
/begin CHARACTERISTIC FaultManager.APP1_AdaptAdaptHiMin.Action_4_Condition "Fault manager configuration.  Select up to 4 actions for each fault." VALUE 0x800023D1 RecordLayout_4 0 CompuMethod_111 0 65535 /end CHARACTERISTIC
/begin CHARACTERISTIC FaultManager.APP1_AdaptAdaptLoMax.Mode "Fault manager configuration.  Select up to 4 actions for each fault." VALUE 0x800023D3 RecordLayout_4 0 CompuMethod_108 0 65535 /end CHARACTERISTIC
/begin CHARACTERISTIC FaultManager.APP1_AdaptAdaptLoMax.ID "Fault manager configuration.  Select up to 4 actions for each fault." VALUE 0x800023D5 RecordLayout_4 0 CompuMethod_1 0 65535 /end CHARACTERISTIC
/begin CHARACTERISTIC FaultManager.APP1_AdaptAdaptLoMax.Test "Fault manager configuration.  Select up to 4 actions for each fault." VALUE 0x800023D7 RecordLayout_4 0 CompuMethod_109 0 65535 /end CHARACTERISTIC
/begin CHARACTERISTIC FaultManager.APP1_AdaptAdaptLoMax.Faulty_Samples__X_ "Fault manager configuration.  Select up to 4 actions for each fault." VALUE 0x800023D9 RecordLayout_4 0 CompuMethod_1 0 65535 /end CHARACTERISTIC
/begin CHARACTERISTIC FaultManager.APP1_AdaptAdaptLoMax.Total_Samples__Y_ "Fault manager configuration.  Select up to 4 actions for each fault." VALUE 0x800023DB RecordLayout_4 0 CompuMethod_1 0 65535 /end CHARACTERISTIC
/begin CHARACTERISTIC FaultManager.APP1_AdaptAdaptLoMax.Action_1 "Fault manager configuration.  Select up to 4 actions for each fault." VALUE 0x800023DD RecordLayout_4 0 CompuMethod_110 0 65535 /end CHARACTERISTIC
/begin CHARACTERISTIC FaultManager.APP1_AdaptAdaptLoMax.Action_1_Condition "Fault manager configuration.  Select up to 4 actions for each fault." VALUE 0x800023DF RecordLayout_4 0 CompuMethod_111 0 65535 /end CHARACTERISTIC
/begin CHARACTERISTIC FaultManager.APP1_AdaptAdaptLoMax.Action_2 "Fault manager configuration.  Select up to 4 actions for each fault." VALUE 0x800023E1 RecordLayout_4 0 CompuMethod_110 0 65535 /end CHARACTERISTIC
/begin CHARACTERISTIC FaultManager.APP1_AdaptAdaptLoMax.Action_2_Condition "Fault manager configuration.  Select up to 4 actions for each fault." VALUE 0x800023E3 RecordLayout_4 0 CompuMethod_111 0 65535 /end CHARACTERISTIC
/begin CHARACTERISTIC FaultManager.APP1_AdaptAdaptLoMax.Action_3 "Fault manager configuration.  Select up to 4 actions for each fault." VALUE 0x800023E5 RecordLayout_4 0 CompuMethod_110 0 65535 /end CHARACTERISTIC
/begin CHARACTERISTIC FaultManager.APP1_AdaptAdaptLoMax.Action_3_Condition "Fault manager configuration.  Select up to 4 actions for each fault." VALUE 0x800023E7 RecordLayout_4 0 CompuMethod_111 0 65535 /end CHARACTERISTIC
/begin CHARACTERISTIC FaultManager.APP1_AdaptAdaptLoMax.Action_4 "Fault manager configuration.  Select up to 4 actions for each fault." VALUE 0x800023E9 RecordLayout_4 0 CompuMethod_110 0 65535 /end CHARACTERISTIC
/begin CHARACTERISTIC FaultManager.APP1_AdaptAdaptLoMax.Action_4_Condition "Fault manager configuration.  Select up to 4 actions for each fault." VALUE 0x800023EB RecordLayout_4 0 CompuMethod_111 0 65535 /end CHARACTERISTIC
/begin CHARACTERISTIC FaultManager.APP1_AdaptAdaptLoMin.Mode "Fault manager configuration.  Select up to 4 actions for each fault." VALUE 0x800023ED RecordLayout_4 0 CompuMethod_108 0 65535 /end CHARACTERISTIC
/begin CHARACTERISTIC FaultManager.APP1_AdaptAdaptLoMin.ID "Fault manager configuration.  Select up to 4 actions for each fault." VALUE 0x800023EF RecordLayout_4 0 CompuMethod_1 0 65535 /end CHARACTERISTIC
/begin CHARACTERISTIC FaultManager.APP1_AdaptAdaptLoMin.Test "Fault manager configuration.  Select up to 4 actions for each fault." VALUE 0x800023F1 RecordLayout_4 0 CompuMethod_109 0 65535 /end CHARACTERISTIC
/begin CHARACTERISTIC FaultManager.APP1_AdaptAdaptLoMin.Faulty_Samples__X_ "Fault manager configuration.  Select up to 4 actions for each fault." VALUE 0x800023F3 RecordLayout_4 0 CompuMethod_1 0 65535 /end CHARACTERISTIC
/begin CHARACTERISTIC FaultManager.APP1_AdaptAdaptLoMin.Total_Samples__Y_ "Fault manager configuration.  Select up to 4 actions for each fault." VALUE 0x800023F5 RecordLayout_4 0 CompuMethod_1 0 65535 /end CHARACTERISTIC
/begin CHARACTERISTIC FaultManager.APP1_AdaptAdaptLoMin.Action_1 "Fault manager configuration.  Select up to 4 actions for each fault." VALUE 0x800023F7 RecordLayout_4 0 CompuMethod_110 0 65535 /end CHARACTERISTIC
/begin CHARACTERISTIC FaultManager.APP1_AdaptAdaptLoMin.Action_1_Condition "Fault manager configuration.  Select up to 4 actions for each fault." VALUE 0x800023F9 RecordLayout_4 0 CompuMethod_111 0 65535 /end CHARACTERISTIC
/begin CHARACTERISTIC FaultManager.APP1_AdaptAdaptLoMin.Action_2 "Fault manager configuration.  Select up to 4 actions for each fault." VALUE 0x800023FB RecordLayout_4 0 CompuMethod_110 0 65535 /end CHARACTERISTIC
/begin CHARACTERISTIC FaultManager.APP1_AdaptAdaptLoMin.Action_2_Condition "Fault manager configuration.  Select up to 4 actions for each fault." VALUE 0x800023FD RecordLayout_4 0 CompuMethod_111 0 65535 /end CHARACTERISTIC
/begin CHARACTERISTIC FaultManager.APP1_AdaptAdaptLoMin.Action_3 "Fault manager configuration.  Select up to 4 actions for each fault." VALUE 0x800023FF RecordLayout_4 0 CompuMethod_110 0 65535 /end CHARACTERISTIC
/begin CHARACTERISTIC FaultManager.APP1_AdaptAdaptLoMin.Action_3_Condition "Fault manager configuration.  Select up to 4 actions for each fault." VALUE 0x80002401 RecordLayout_4 0 CompuMethod_111 0 65535 /end CHARACTERISTIC
/begin CHARACTERISTIC FaultManager.APP1_AdaptAdaptLoMin.Action_4 "Fault manager configuration.  Select up to 4 actions for each fault." VALUE 0x80002403 RecordLayout_4 0 CompuMethod_110 0 65535 /end CHARACTERISTIC
/begin CHARACTERISTIC FaultManager.APP1_AdaptAdaptLoMin.Action_4_Condition "Fault manager configuration.  Select up to 4 actions for each fault." VALUE 0x80002405 RecordLayout_4 0 CompuMethod_111 0 65535 /end CHARACTERISTIC
/begin CHARACTERISTIC FaultManager.APP1_AdaptRangeHigh.Mode "Fault manager configuration.  Select up to 4 actions for each fault." VALUE 0x80002407 RecordLayout_4 0 CompuMethod_108 0 65535 /end CHARACTERISTIC
/begin CHARACTERISTIC FaultManager.APP1_AdaptRangeHigh.ID "Fault manager configuration.  Select up to 4 actions for each fault." VALUE 0x80002409 RecordLayout_4 0 CompuMethod_1 0 65535 /end CHARACTERISTIC
/begin CHARACTERISTIC FaultManager.APP1_AdaptRangeHigh.Test "Fault manager configuration.  Select up to 4 actions for each fault." VALUE 0x8000240B RecordLayout_4 0 CompuMethod_109 0 65535 /end CHARACTERISTIC
/begin CHARACTERISTIC FaultManager.APP1_AdaptRangeHigh.Faulty_Samples__X_ "Fault manager configuration.  Select up to 4 actions for each fault." VALUE 0x8000240D RecordLayout_4 0 CompuMethod_1 0 65535 /end CHARACTERISTIC
/begin CHARACTERISTIC FaultManager.APP1_AdaptRangeHigh.Total_Samples__Y_ "Fault manager configuration.  Select up to 4 actions for each fault." VALUE 0x8000240F RecordLayout_4 0 CompuMethod_1 0 65535 /end CHARACTERISTIC
/begin CHARACTERISTIC FaultManager.APP1_AdaptRangeHigh.Action_1 "Fault manager configuration.  Select up to 4 actions for each fault." VALUE 0x80002411 RecordLayout_4 0 CompuMethod_110 0 65535 /end CHARACTERISTIC
/begin CHARACTERISTIC FaultManager.APP1_AdaptRangeHigh.Action_1_Condition "Fault manager configuration.  Select up to 4 actions for each fault." VALUE 0x80002413 RecordLayout_4 0 CompuMethod_111 0 65535 /end CHARACTERISTIC
/begin CHARACTERISTIC FaultManager.APP1_AdaptRangeHigh.Action_2 "Fault manager configuration.  Select up to 4 actions for each fault." VALUE 0x80002415 RecordLayout_4 0 CompuMethod_110 0 65535 /end CHARACTERISTIC
/begin CHARACTERISTIC FaultManager.APP1_AdaptRangeHigh.Action_2_Condition "Fault manager configuration.  Select up to 4 actions for each fault." VALUE 0x80002417 RecordLayout_4 0 CompuMethod_111 0 65535 /end CHARACTERISTIC
/begin CHARACTERISTIC FaultManager.APP1_AdaptRangeHigh.Action_3 "Fault manager configuration.  Select up to 4 actions for each fault." VALUE 0x80002419 RecordLayout_4 0 CompuMethod_110 0 65535 /end CHARACTERISTIC
/begin CHARACTERISTIC FaultManager.APP1_AdaptRangeHigh.Action_3_Condition "Fault manager configuration.  Select up to 4 actions for each fault." VALUE 0x8000241B RecordLayout_4 0 CompuMethod_111 0 65535 /end CHARACTERISTIC
/begin CHARACTERISTIC FaultManager.APP1_AdaptRangeHigh.Action_4 "Fault manager configuration.  Select up to 4 actions for each fault." VALUE 0x8000241D RecordLayout_4 0 CompuMethod_110 0 65535 /end CHARACTERISTIC
/begin CHARACTERISTIC FaultManager.APP1_AdaptRangeHigh.Action_4_Condition "Fault manager configuration.  Select up to 4 actions for each fault." VALUE 0x8000241F RecordLayout_4 0 CompuMethod_111 0 65535 /end CHARACTERISTIC
/begin CHARACTERISTIC FaultManager.APP1_AdaptRangeLow.Mode "Fault manager configuration.  Select up to 4 actions for each fault." VALUE 0x80002421 RecordLayout_4 0 CompuMethod_108 0 65535 /end CHARACTERISTIC
/begin CHARACTERISTIC FaultManager.APP1_AdaptRangeLow.ID "Fault manager configuration.  Select up to 4 actions for each fault." VALUE 0x80002423 RecordLayout_4 0 CompuMethod_1 0 65535 /end CHARACTERISTIC
/begin CHARACTERISTIC FaultManager.APP1_AdaptRangeLow.Test "Fault manager configuration.  Select up to 4 actions for each fault." VALUE 0x80002425 RecordLayout_4 0 CompuMethod_109 0 65535 /end CHARACTERISTIC
/begin CHARACTERISTIC FaultManager.APP1_AdaptRangeLow.Faulty_Samples__X_ "Fault manager configuration.  Select up to 4 actions for each fault." VALUE 0x80002427 RecordLayout_4 0 CompuMethod_1 0 65535 /end CHARACTERISTIC
/begin CHARACTERISTIC FaultManager.APP1_AdaptRangeLow.Total_Samples__Y_ "Fault manager configuration.  Select up to 4 actions for each fault." VALUE 0x80002429 RecordLayout_4 0 CompuMethod_1 0 65535 /end CHARACTERISTIC
/begin CHARACTERISTIC FaultManager.APP1_AdaptRangeLow.Action_1 "Fault manager configuration.  Select up to 4 actions for each fault." VALUE 0x8000242B RecordLayout_4 0 CompuMethod_110 0 65535 /end CHARACTERISTIC
/begin CHARACTERISTIC FaultManager.APP1_AdaptRangeLow.Action_1_Condition "Fault manager configuration.  Select up to 4 actions for each fault." VALUE 0x8000242D RecordLayout_4 0 CompuMethod_111 0 65535 /end CHARACTERISTIC
/begin CHARACTERISTIC FaultManager.APP1_AdaptRangeLow.Action_2 "Fault manager configuration.  Select up to 4 actions for each fault." VALUE 0x8000242F RecordLayout_4 0 CompuMethod_110 0 65535 /end CHARACTERISTIC
/begin CHARACTERISTIC FaultManager.APP1_AdaptRangeLow.Action_2_Condition "Fault manager configuration.  Select up to 4 actions for each fault." VALUE 0x80002431 RecordLayout_4 0 CompuMethod_111 0 65535 /end CHARACTERISTIC
/begin CHARACTERISTIC FaultManager.APP1_AdaptRangeLow.Action_3 "Fault manager configuration.  Select up to 4 actions for each fault." VALUE 0x80002433 RecordLayout_4 0 CompuMethod_110 0 65535 /end CHARACTERISTIC
/begin CHARACTERISTIC FaultManager.APP1_AdaptRangeLow.Action_3_Condition "Fault manager configuration.  Select up to 4 actions for each fault." VALUE 0x80002435 RecordLayout_4 0 CompuMethod_111 0 65535 /end CHARACTERISTIC
/begin CHARACTERISTIC FaultManager.APP1_AdaptRangeLow.Action_4 "Fault manager configuration.  Select up to 4 actions for each fault." VALUE 0x80002437 RecordLayout_4 0 CompuMethod_110 0 65535 /end CHARACTERISTIC
/begin CHARACTERISTIC FaultManager.APP1_AdaptRangeLow.Action_4_Condition "Fault manager configuration.  Select up to 4 actions for each fault." VALUE 0x80002439 RecordLayout_4 0 CompuMethod_111 0 65535 /end CHARACTERISTIC
/begin CHARACTERISTIC FaultManager.APP2_AdaptAdaptHiMax.Mode "Fault manager configuration.  Select up to 4 actions for each fault." VALUE 0x8000243B RecordLayout_4 0 CompuMethod_108 0 65535 /end CHARACTERISTIC
/begin CHARACTERISTIC FaultManager.APP2_AdaptAdaptHiMax.ID "Fault manager configuration.  Select up to 4 actions for each fault." VALUE 0x8000243D RecordLayout_4 0 CompuMethod_1 0 65535 /end CHARACTERISTIC
/begin CHARACTERISTIC FaultManager.APP2_AdaptAdaptHiMax.Test "Fault manager configuration.  Select up to 4 actions for each fault." VALUE 0x8000243F RecordLayout_4 0 CompuMethod_109 0 65535 /end CHARACTERISTIC
/begin CHARACTERISTIC FaultManager.APP2_AdaptAdaptHiMax.Faulty_Samples__X_ "Fault manager configuration.  Select up to 4 actions for each fault." VALUE 0x80002441 RecordLayout_4 0 CompuMethod_1 0 65535 /end CHARACTERISTIC
/begin CHARACTERISTIC FaultManager.APP2_AdaptAdaptHiMax.Total_Samples__Y_ "Fault manager configuration.  Select up to 4 actions for each fault." VALUE 0x80002443 RecordLayout_4 0 CompuMethod_1 0 65535 /end CHARACTERISTIC
/begin CHARACTERISTIC FaultManager.APP2_AdaptAdaptHiMax.Action_1 "Fault manager configuration.  Select up to 4 actions for each fault." VALUE 0x80002445 RecordLayout_4 0 CompuMethod_110 0 65535 /end CHARACTERISTIC
/begin CHARACTERISTIC FaultManager.APP2_AdaptAdaptHiMax.Action_1_Condition "Fault manager configuration.  Select up to 4 actions for each fault." VALUE 0x80002447 RecordLayout_4 0 CompuMethod_111 0 65535 /end CHARACTERISTIC
/begin CHARACTERISTIC FaultManager.APP2_AdaptAdaptHiMax.Action_2 "Fault manager configuration.  Select up to 4 actions for each fault." VALUE 0x80002449 RecordLayout_4 0 CompuMethod_110 0 65535 /end CHARACTERISTIC
/begin CHARACTERISTIC FaultManager.APP2_AdaptAdaptHiMax.Action_2_Condition "Fault manager configuration.  Select up to 4 actions for each fault." VALUE 0x8000244B RecordLayout_4 0 CompuMethod_111 0 65535 /end CHARACTERISTIC
/begin CHARACTERISTIC FaultManager.APP2_AdaptAdaptHiMax.Action_3 "Fault manager configuration.  Select up to 4 actions for each fault." VALUE 0x8000244D RecordLayout_4 0 CompuMethod_110 0 65535 /end CHARACTERISTIC
/begin CHARACTERISTIC FaultManager.APP2_AdaptAdaptHiMax.Action_3_Condition "Fault manager configuration.  Select up to 4 actions for each fault." VALUE 0x8000244F RecordLayout_4 0 CompuMethod_111 0 65535 /end CHARACTERISTIC
/begin CHARACTERISTIC FaultManager.APP2_AdaptAdaptHiMax.Action_4 "Fault manager configuration.  Select up to 4 actions for each fault." VALUE 0x80002451 RecordLayout_4 0 CompuMethod_110 0 65535 /end CHARACTERISTIC
/begin CHARACTERISTIC FaultManager.APP2_AdaptAdaptHiMax.Action_4_Condition "Fault manager configuration.  Select up to 4 actions for each fault." VALUE 0x80002453 RecordLayout_4 0 CompuMethod_111 0 65535 /end CHARACTERISTIC
/begin CHARACTERISTIC FaultManager.APP2_AdaptAdaptHiMin.Mode "Fault manager configuration.  Select up to 4 actions for each fault." VALUE 0x80002455 RecordLayout_4 0 CompuMethod_108 0 65535 /end CHARACTERISTIC
/begin CHARACTERISTIC FaultManager.APP2_AdaptAdaptHiMin.ID "Fault manager configuration.  Select up to 4 actions for each fault." VALUE 0x80002457 RecordLayout_4 0 CompuMethod_1 0 65535 /end CHARACTERISTIC
/begin CHARACTERISTIC FaultManager.APP2_AdaptAdaptHiMin.Test "Fault manager configuration.  Select up to 4 actions for each fault." VALUE 0x80002459 RecordLayout_4 0 CompuMethod_109 0 65535 /end CHARACTERISTIC
/begin CHARACTERISTIC FaultManager.APP2_AdaptAdaptHiMin.Faulty_Samples__X_ "Fault manager configuration.  Select up to 4 actions for each fault." VALUE 0x8000245B RecordLayout_4 0 CompuMethod_1 0 65535 /end CHARACTERISTIC
/begin CHARACTERISTIC FaultManager.APP2_AdaptAdaptHiMin.Total_Samples__Y_ "Fault manager configuration.  Select up to 4 actions for each fault." VALUE 0x8000245D RecordLayout_4 0 CompuMethod_1 0 65535 /end CHARACTERISTIC
/begin CHARACTERISTIC FaultManager.APP2_AdaptAdaptHiMin.Action_1 "Fault manager configuration.  Select up to 4 actions for each fault." VALUE 0x8000245F RecordLayout_4 0 CompuMethod_110 0 65535 /end CHARACTERISTIC
/begin CHARACTERISTIC FaultManager.APP2_AdaptAdaptHiMin.Action_1_Condition "Fault manager configuration.  Select up to 4 actions for each fault." VALUE 0x80002461 RecordLayout_4 0 CompuMethod_111 0 65535 /end CHARACTERISTIC
/begin CHARACTERISTIC FaultManager.APP2_AdaptAdaptHiMin.Action_2 "Fault manager configuration.  Select up to 4 actions for each fault." VALUE 0x80002463 RecordLayout_4 0 CompuMethod_110 0 65535 /end CHARACTERISTIC
/begin CHARACTERISTIC FaultManager.APP2_AdaptAdaptHiMin.Action_2_Condition "Fault manager configuration.  Select up to 4 actions for each fault." VALUE 0x80002465 RecordLayout_4 0 CompuMethod_111 0 65535 /end CHARACTERISTIC
/begin CHARACTERISTIC FaultManager.APP2_AdaptAdaptHiMin.Action_3 "Fault manager configuration.  Select up to 4 actions for each fault." VALUE 0x80002467 RecordLayout_4 0 CompuMethod_110 0 65535 /end CHARACTERISTIC
/begin CHARACTERISTIC FaultManager.APP2_AdaptAdaptHiMin.Action_3_Condition "Fault manager configuration.  Select up to 4 actions for each fault." VALUE 0x80002469 RecordLayout_4 0 CompuMethod_111 0 65535 /end CHARACTERISTIC
/begin CHARACTERISTIC FaultManager.APP2_AdaptAdaptHiMin.Action_4 "Fault manager configuration.  Select up to 4 actions for each fault." VALUE 0x8000246B RecordLayout_4 0 CompuMethod_110 0 65535 /end CHARACTERISTIC
/begin CHARACTERISTIC FaultManager.APP2_AdaptAdaptHiMin.Action_4_Condition "Fault manager configuration.  Select up to 4 actions for each fault." VALUE 0x8000246D RecordLayout_4 0 CompuMethod_111 0 65535 /end CHARACTERISTIC
/begin CHARACTERISTIC FaultManager.APP2_AdaptAdaptLoMax.Mode "Fault manager configuration.  Select up to 4 actions for each fault." VALUE 0x8000246F RecordLayout_4 0 CompuMethod_108 0 65535 /end CHARACTERISTIC
/begin CHARACTERISTIC FaultManager.APP2_AdaptAdaptLoMax.ID "Fault manager configuration.  Select up to 4 actions for each fault." VALUE 0x80002471 RecordLayout_4 0 CompuMethod_1 0 65535 /end CHARACTERISTIC
/begin CHARACTERISTIC FaultManager.APP2_AdaptAdaptLoMax.Test "Fault manager configuration.  Select up to 4 actions for each fault." VALUE 0x80002473 RecordLayout_4 0 CompuMethod_109 0 65535 /end CHARACTERISTIC
/begin CHARACTERISTIC FaultManager.APP2_AdaptAdaptLoMax.Faulty_Samples__X_ "Fault manager configuration.  Select up to 4 actions for each fault." VALUE 0x80002475 RecordLayout_4 0 CompuMethod_1 0 65535 /end CHARACTERISTIC
/begin CHARACTERISTIC FaultManager.APP2_AdaptAdaptLoMax.Total_Samples__Y_ "Fault manager configuration.  Select up to 4 actions for each fault." VALUE 0x80002477 RecordLayout_4 0 CompuMethod_1 0 65535 /end CHARACTERISTIC
/begin CHARACTERISTIC FaultManager.APP2_AdaptAdaptLoMax.Action_1 "Fault manager configuration.  Select up to 4 actions for each fault." VALUE 0x80002479 RecordLayout_4 0 CompuMethod_110 0 65535 /end CHARACTERISTIC
/begin CHARACTERISTIC FaultManager.APP2_AdaptAdaptLoMax.Action_1_Condition "Fault manager configuration.  Select up to 4 actions for each fault." VALUE 0x8000247B RecordLayout_4 0 CompuMethod_111 0 65535 /end CHARACTERISTIC
/begin CHARACTERISTIC FaultManager.APP2_AdaptAdaptLoMax.Action_2 "Fault manager configuration.  Select up to 4 actions for each fault." VALUE 0x8000247D RecordLayout_4 0 CompuMethod_110 0 65535 /end CHARACTERISTIC
/begin CHARACTERISTIC FaultManager.APP2_AdaptAdaptLoMax.Action_2_Condition "Fault manager configuration.  Select up to 4 actions for each fault." VALUE 0x8000247F RecordLayout_4 0 CompuMethod_111 0 65535 /end CHARACTERISTIC
/begin CHARACTERISTIC FaultManager.APP2_AdaptAdaptLoMax.Action_3 "Fault manager configuration.  Select up to 4 actions for each fault." VALUE 0x80002481 RecordLayout_4 0 CompuMethod_110 0 65535 /end CHARACTERISTIC
/begin CHARACTERISTIC FaultManager.APP2_AdaptAdaptLoMax.Action_3_Condition "Fault manager configuration.  Select up to 4 actions for each fault." VALUE 0x80002483 RecordLayout_4 0 CompuMethod_111 0 65535 /end CHARACTERISTIC
/begin CHARACTERISTIC FaultManager.APP2_AdaptAdaptLoMax.Action_4 "Fault manager configuration.  Select up to 4 actions for each fault." VALUE 0x80002485 RecordLayout_4 0 CompuMethod_110 0 65535 /end CHARACTERISTIC
/begin CHARACTERISTIC FaultManager.APP2_AdaptAdaptLoMax.Action_4_Condition "Fault manager configuration.  Select up to 4 actions for each fault." VALUE 0x80002487 RecordLayout_4 0 CompuMethod_111 0 65535 /end CHARACTERISTIC
/begin CHARACTERISTIC FaultManager.APP2_AdaptAdaptLoMin.Mode "Fault manager configuration.  Select up to 4 actions for each fault." VALUE 0x80002489 RecordLayout_4 0 CompuMethod_108 0 65535 /end CHARACTERISTIC
/begin CHARACTERISTIC FaultManager.APP2_AdaptAdaptLoMin.ID "Fault manager configuration.  Select up to 4 actions for each fault." VALUE 0x8000248B RecordLayout_4 0 CompuMethod_1 0 65535 /end CHARACTERISTIC
/begin CHARACTERISTIC FaultManager.APP2_AdaptAdaptLoMin.Test "Fault manager configuration.  Select up to 4 actions for each fault." VALUE 0x8000248D RecordLayout_4 0 CompuMethod_109 0 65535 /end CHARACTERISTIC
/begin CHARACTERISTIC FaultManager.APP2_AdaptAdaptLoMin.Faulty_Samples__X_ "Fault manager configuration.  Select up to 4 actions for each fault." VALUE 0x8000248F RecordLayout_4 0 CompuMethod_1 0 65535 /end CHARACTERISTIC
/begin CHARACTERISTIC FaultManager.APP2_AdaptAdaptLoMin.Total_Samples__Y_ "Fault manager configuration.  Select up to 4 actions for each fault." VALUE 0x80002491 RecordLayout_4 0 CompuMethod_1 0 65535 /end CHARACTERISTIC
/begin CHARACTERISTIC FaultManager.APP2_AdaptAdaptLoMin.Action_1 "Fault manager configuration.  Select up to 4 actions for each fault." VALUE 0x80002493 RecordLayout_4 0 CompuMethod_110 0 65535 /end CHARACTERISTIC
/begin CHARACTERISTIC FaultManager.APP2_AdaptAdaptLoMin.Action_1_Condition "Fault manager configuration.  Select up to 4 actions for each fault." VALUE 0x80002495 RecordLayout_4 0 CompuMethod_111 0 65535 /end CHARACTERISTIC
/begin CHARACTERISTIC FaultManager.APP2_AdaptAdaptLoMin.Action_2 "Fault manager configuration.  Select up to 4 actions for each fault." VALUE 0x80002497 RecordLayout_4 0 CompuMethod_110 0 65535 /end CHARACTERISTIC
/begin CHARACTERISTIC FaultManager.APP2_AdaptAdaptLoMin.Action_2_Condition "Fault manager configuration.  Select up to 4 actions for each fault." VALUE 0x80002499 RecordLayout_4 0 CompuMethod_111 0 65535 /end CHARACTERISTIC
/begin CHARACTERISTIC FaultManager.APP2_AdaptAdaptLoMin.Action_3 "Fault manager configuration.  Select up to 4 actions for each fault." VALUE 0x8000249B RecordLayout_4 0 CompuMethod_110 0 65535 /end CHARACTERISTIC
/begin CHARACTERISTIC FaultManager.APP2_AdaptAdaptLoMin.Action_3_Condition "Fault manager configuration.  Select up to 4 actions for each fault." VALUE 0x8000249D RecordLayout_4 0 CompuMethod_111 0 65535 /end CHARACTERISTIC
/begin CHARACTERISTIC FaultManager.APP2_AdaptAdaptLoMin.Action_4 "Fault manager configuration.  Select up to 4 actions for each fault." VALUE 0x8000249F RecordLayout_4 0 CompuMethod_110 0 65535 /end CHARACTERISTIC
/begin CHARACTERISTIC FaultManager.APP2_AdaptAdaptLoMin.Action_4_Condition "Fault manager configuration.  Select up to 4 actions for each fault." VALUE 0x800024A1 RecordLayout_4 0 CompuMethod_111 0 65535 /end CHARACTERISTIC
/begin CHARACTERISTIC FaultManager.APP2_AdaptRangeHigh.Mode "Fault manager configuration.  Select up to 4 actions for each fault." VALUE 0x800024A3 RecordLayout_4 0 CompuMethod_108 0 65535 /end CHARACTERISTIC
/begin CHARACTERISTIC FaultManager.APP2_AdaptRangeHigh.ID "Fault manager configuration.  Select up to 4 actions for each fault." VALUE 0x800024A5 RecordLayout_4 0 CompuMethod_1 0 65535 /end CHARACTERISTIC
/begin CHARACTERISTIC FaultManager.APP2_AdaptRangeHigh.Test "Fault manager configuration.  Select up to 4 actions for each fault." VALUE 0x800024A7 RecordLayout_4 0 CompuMethod_109 0 65535 /end CHARACTERISTIC
/begin CHARACTERISTIC FaultManager.APP2_AdaptRangeHigh.Faulty_Samples__X_ "Fault manager configuration.  Select up to 4 actions for each fault." VALUE 0x800024A9 RecordLayout_4 0 CompuMethod_1 0 65535 /end CHARACTERISTIC
/begin CHARACTERISTIC FaultManager.APP2_AdaptRangeHigh.Total_Samples__Y_ "Fault manager configuration.  Select up to 4 actions for each fault." VALUE 0x800024AB RecordLayout_4 0 CompuMethod_1 0 65535 /end CHARACTERISTIC
/begin CHARACTERISTIC FaultManager.APP2_AdaptRangeHigh.Action_1 "Fault manager configuration.  Select up to 4 actions for each fault." VALUE 0x800024AD RecordLayout_4 0 CompuMethod_110 0 65535 /end CHARACTERISTIC
/begin CHARACTERISTIC FaultManager.APP2_AdaptRangeHigh.Action_1_Condition "Fault manager configuration.  Select up to 4 actions for each fault." VALUE 0x800024AF RecordLayout_4 0 CompuMethod_111 0 65535 /end CHARACTERISTIC
/begin CHARACTERISTIC FaultManager.APP2_AdaptRangeHigh.Action_2 "Fault manager configuration.  Select up to 4 actions for each fault." VALUE 0x800024B1 RecordLayout_4 0 CompuMethod_110 0 65535 /end CHARACTERISTIC
/begin CHARACTERISTIC FaultManager.APP2_AdaptRangeHigh.Action_2_Condition "Fault manager configuration.  Select up to 4 actions for each fault." VALUE 0x800024B3 RecordLayout_4 0 CompuMethod_111 0 65535 /end CHARACTERISTIC
/begin CHARACTERISTIC FaultManager.APP2_AdaptRangeHigh.Action_3 "Fault manager configuration.  Select up to 4 actions for each fault." VALUE 0x800024B5 RecordLayout_4 0 CompuMethod_110 0 65535 /end CHARACTERISTIC
/begin CHARACTERISTIC FaultManager.APP2_AdaptRangeHigh.Action_3_Condition "Fault manager configuration.  Select up to 4 actions for each fault." VALUE 0x800024B7 RecordLayout_4 0 CompuMethod_111 0 65535 /end CHARACTERISTIC
/begin CHARACTERISTIC FaultManager.APP2_AdaptRangeHigh.Action_4 "Fault manager configuration.  Select up to 4 actions for each fault." VALUE 0x800024B9 RecordLayout_4 0 CompuMethod_110 0 65535 /end CHARACTERISTIC
/begin CHARACTERISTIC FaultManager.APP2_AdaptRangeHigh.Action_4_Condition "Fault manager configuration.  Select up to 4 actions for each fault." VALUE 0x800024BB RecordLayout_4 0 CompuMethod_111 0 65535 /end CHARACTERISTIC
/begin CHARACTERISTIC FaultManager.APP2_AdaptRangeLow.Mode "Fault manager configuration.  Select up to 4 actions for each fault." VALUE 0x800024BD RecordLayout_4 0 CompuMethod_108 0 65535 /end CHARACTERISTIC
/begin CHARACTERISTIC FaultManager.APP2_AdaptRangeLow.ID "Fault manager configuration.  Select up to 4 actions for each fault." VALUE 0x800024BF RecordLayout_4 0 CompuMethod_1 0 65535 /end CHARACTERISTIC
/begin CHARACTERISTIC FaultManager.APP2_AdaptRangeLow.Test "Fault manager configuration.  Select up to 4 actions for each fault." VALUE 0x800024C1 RecordLayout_4 0 CompuMethod_109 0 65535 /end CHARACTERISTIC
/begin CHARACTERISTIC FaultManager.APP2_AdaptRangeLow.Faulty_Samples__X_ "Fault manager configuration.  Select up to 4 actions for each fault." VALUE 0x800024C3 RecordLayout_4 0 CompuMethod_1 0 65535 /end CHARACTERISTIC
/begin CHARACTERISTIC FaultManager.APP2_AdaptRangeLow.Total_Samples__Y_ "Fault manager configuration.  Select up to 4 actions for each fault." VALUE 0x800024C5 RecordLayout_4 0 CompuMethod_1 0 65535 /end CHARACTERISTIC
/begin CHARACTERISTIC FaultManager.APP2_AdaptRangeLow.Action_1 "Fault manager configuration.  Select up to 4 actions for each fault." VALUE 0x800024C7 RecordLayout_4 0 CompuMethod_110 0 65535 /end CHARACTERISTIC
/begin CHARACTERISTIC FaultManager.APP2_AdaptRangeLow.Action_1_Condition "Fault manager configuration.  Select up to 4 actions for each fault." VALUE 0x800024C9 RecordLayout_4 0 CompuMethod_111 0 65535 /end CHARACTERISTIC
/begin CHARACTERISTIC FaultManager.APP2_AdaptRangeLow.Action_2 "Fault manager configuration.  Select up to 4 actions for each fault." VALUE 0x800024CB RecordLayout_4 0 CompuMethod_110 0 65535 /end CHARACTERISTIC
/begin CHARACTERISTIC FaultManager.APP2_AdaptRangeLow.Action_2_Condition "Fault manager configuration.  Select up to 4 actions for each fault." VALUE 0x800024CD RecordLayout_4 0 CompuMethod_111 0 65535 /end CHARACTERISTIC
/begin CHARACTERISTIC FaultManager.APP2_AdaptRangeLow.Action_3 "Fault manager configuration.  Select up to 4 actions for each fault." VALUE 0x800024CF RecordLayout_4 0 CompuMethod_110 0 65535 /end CHARACTERISTIC
/begin CHARACTERISTIC FaultManager.APP2_AdaptRangeLow.Action_3_Condition "Fault manager configuration.  Select up to 4 actions for each fault." VALUE 0x800024D1 RecordLayout_4 0 CompuMethod_111 0 65535 /end CHARACTERISTIC
/begin CHARACTERISTIC FaultManager.APP2_AdaptRangeLow.Action_4 "Fault manager configuration.  Select up to 4 actions for each fault." VALUE 0x800024D3 RecordLayout_4 0 CompuMethod_110 0 65535 /end CHARACTERISTIC
/begin CHARACTERISTIC FaultManager.APP2_AdaptRangeLow.Action_4_Condition "Fault manager configuration.  Select up to 4 actions for each fault." VALUE 0x800024D5 RecordLayout_4 0 CompuMethod_111 0 65535 /end CHARACTERISTIC
/begin CHARACTERISTIC FaultManager.APP_Sensors_Conflict.Mode "Fault manager configuration.  Select up to 4 actions for each fault." VALUE 0x800024D7 RecordLayout_4 0 CompuMethod_108 0 65535 /end CHARACTERISTIC
/begin CHARACTERISTIC FaultManager.APP_Sensors_Conflict.ID "Fault manager configuration.  Select up to 4 actions for each fault." VALUE 0x800024D9 RecordLayout_4 0 CompuMethod_1 0 65535 /end CHARACTERISTIC
/begin CHARACTERISTIC FaultManager.APP_Sensors_Conflict.Test "Fault manager configuration.  Select up to 4 actions for each fault." VALUE 0x800024DB RecordLayout_4 0 CompuMethod_109 0 65535 /end CHARACTERISTIC
/begin CHARACTERISTIC FaultManager.APP_Sensors_Conflict.Faulty_Samples__X_ "Fault manager configuration.  Select up to 4 actions for each fault." VALUE 0x800024DD RecordLayout_4 0 CompuMethod_1 0 65535 /end CHARACTERISTIC
/begin CHARACTERISTIC FaultManager.APP_Sensors_Conflict.Total_Samples__Y_ "Fault manager configuration.  Select up to 4 actions for each fault." VALUE 0x800024DF RecordLayout_4 0 CompuMethod_1 0 65535 /end CHARACTERISTIC
/begin CHARACTERISTIC FaultManager.APP_Sensors_Conflict.Action_1 "Fault manager configuration.  Select up to 4 actions for each fault." VALUE 0x800024E1 RecordLayout_4 0 CompuMethod_110 0 65535 /end CHARACTERISTIC
/begin CHARACTERISTIC FaultManager.APP_Sensors_Conflict.Action_1_Condition "Fault manager configuration.  Select up to 4 actions for each fault." VALUE 0x800024E3 RecordLayout_4 0 CompuMethod_111 0 65535 /end CHARACTERISTIC
/begin CHARACTERISTIC FaultManager.APP_Sensors_Conflict.Action_2 "Fault manager configuration.  Select up to 4 actions for each fault." VALUE 0x800024E5 RecordLayout_4 0 CompuMethod_110 0 65535 /end CHARACTERISTIC
/begin CHARACTERISTIC FaultManager.APP_Sensors_Conflict.Action_2_Condition "Fault manager configuration.  Select up to 4 actions for each fault." VALUE 0x800024E7 RecordLayout_4 0 CompuMethod_111 0 65535 /end CHARACTERISTIC
/begin CHARACTERISTIC FaultManager.APP_Sensors_Conflict.Action_3 "Fault manager configuration.  Select up to 4 actions for each fault." VALUE 0x800024E9 RecordLayout_4 0 CompuMethod_110 0 65535 /end CHARACTERISTIC
/begin CHARACTERISTIC FaultManager.APP_Sensors_Conflict.Action_3_Condition "Fault manager configuration.  Select up to 4 actions for each fault." VALUE 0x800024EB RecordLayout_4 0 CompuMethod_111 0 65535 /end CHARACTERISTIC
/begin CHARACTERISTIC FaultManager.APP_Sensors_Conflict.Action_4 "Fault manager configuration.  Select up to 4 actions for each fault." VALUE 0x800024ED RecordLayout_4 0 CompuMethod_110 0 65535 /end CHARACTERISTIC
/begin CHARACTERISTIC FaultManager.APP_Sensors_Conflict.Action_4_Condition "Fault manager configuration.  Select up to 4 actions for each fault." VALUE 0x800024EF RecordLayout_4 0 CompuMethod_111 0 65535 /end CHARACTERISTIC
/begin CHARACTERISTIC FaultManager.AirflowMismatch_Fault.Mode "Fault manager configuration.  Select up to 4 actions for each fault." VALUE 0x800024F1 RecordLayout_4 0 CompuMethod_108 0 65535 /end CHARACTERISTIC
/begin CHARACTERISTIC FaultManager.AirflowMismatch_Fault.ID "Fault manager configuration.  Select up to 4 actions for each fault." VALUE 0x800024F3 RecordLayout_4 0 CompuMethod_1 0 65535 /end CHARACTERISTIC
/begin CHARACTERISTIC FaultManager.AirflowMismatch_Fault.Test "Fault manager configuration.  Select up to 4 actions for each fault." VALUE 0x800024F5 RecordLayout_4 0 CompuMethod_109 0 65535 /end CHARACTERISTIC
/begin CHARACTERISTIC FaultManager.AirflowMismatch_Fault.Faulty_Samples__X_ "Fault manager configuration.  Select up to 4 actions for each fault." VALUE 0x800024F7 RecordLayout_4 0 CompuMethod_1 0 65535 /end CHARACTERISTIC
/begin CHARACTERISTIC FaultManager.AirflowMismatch_Fault.Total_Samples__Y_ "Fault manager configuration.  Select up to 4 actions for each fault." VALUE 0x800024F9 RecordLayout_4 0 CompuMethod_1 0 65535 /end CHARACTERISTIC
/begin CHARACTERISTIC FaultManager.AirflowMismatch_Fault.Action_1 "Fault manager configuration.  Select up to 4 actions for each fault." VALUE 0x800024FB RecordLayout_4 0 CompuMethod_110 0 65535 /end CHARACTERISTIC
/begin CHARACTERISTIC FaultManager.AirflowMismatch_Fault.Action_1_Condition "Fault manager configuration.  Select up to 4 actions for each fault." VALUE 0x800024FD RecordLayout_4 0 CompuMethod_111 0 65535 /end CHARACTERISTIC
/begin CHARACTERISTIC FaultManager.AirflowMismatch_Fault.Action_2 "Fault manager configuration.  Select up to 4 actions for each fault." VALUE 0x800024FF RecordLayout_4 0 CompuMethod_110 0 65535 /end CHARACTERISTIC
/begin CHARACTERISTIC FaultManager.AirflowMismatch_Fault.Action_2_Condition "Fault manager configuration.  Select up to 4 actions for each fault." VALUE 0x80002501 RecordLayout_4 0 CompuMethod_111 0 65535 /end CHARACTERISTIC
/begin CHARACTERISTIC FaultManager.AirflowMismatch_Fault.Action_3 "Fault manager configuration.  Select up to 4 actions for each fault." VALUE 0x80002503 RecordLayout_4 0 CompuMethod_110 0 65535 /end CHARACTERISTIC
/begin CHARACTERISTIC FaultManager.AirflowMismatch_Fault.Action_3_Condition "Fault manager configuration.  Select up to 4 actions for each fault." VALUE 0x80002505 RecordLayout_4 0 CompuMethod_111 0 65535 /end CHARACTERISTIC
/begin CHARACTERISTIC FaultManager.AirflowMismatch_Fault.Action_4 "Fault manager configuration.  Select up to 4 actions for each fault." VALUE 0x80002507 RecordLayout_4 0 CompuMethod_110 0 65535 /end CHARACTERISTIC
/begin CHARACTERISTIC FaultManager.AirflowMismatch_Fault.Action_4_Condition "Fault manager configuration.  Select up to 4 actions for each fault." VALUE 0x80002509 RecordLayout_4 0 CompuMethod_111 0 65535 /end CHARACTERISTIC
/begin CHARACTERISTIC FaultManager.AltInop_Fault.Mode "Fault manager configuration.  Select up to 4 actions for each fault." VALUE 0x8000250B RecordLayout_4 0 CompuMethod_108 0 65535 /end CHARACTERISTIC
/begin CHARACTERISTIC FaultManager.AltInop_Fault.ID "Fault manager configuration.  Select up to 4 actions for each fault." VALUE 0x8000250D RecordLayout_4 0 CompuMethod_1 0 65535 /end CHARACTERISTIC
/begin CHARACTERISTIC FaultManager.AltInop_Fault.Test "Fault manager configuration.  Select up to 4 actions for each fault." VALUE 0x8000250F RecordLayout_4 0 CompuMethod_109 0 65535 /end CHARACTERISTIC
/begin CHARACTERISTIC FaultManager.AltInop_Fault.Faulty_Samples__X_ "Fault manager configuration.  Select up to 4 actions for each fault." VALUE 0x80002511 RecordLayout_4 0 CompuMethod_1 0 65535 /end CHARACTERISTIC
/begin CHARACTERISTIC FaultManager.AltInop_Fault.Total_Samples__Y_ "Fault manager configuration.  Select up to 4 actions for each fault." VALUE 0x80002513 RecordLayout_4 0 CompuMethod_1 0 65535 /end CHARACTERISTIC
/begin CHARACTERISTIC FaultManager.AltInop_Fault.Action_1 "Fault manager configuration.  Select up to 4 actions for each fault." VALUE 0x80002515 RecordLayout_4 0 CompuMethod_110 0 65535 /end CHARACTERISTIC
/begin CHARACTERISTIC FaultManager.AltInop_Fault.Action_1_Condition "Fault manager configuration.  Select up to 4 actions for each fault." VALUE 0x80002517 RecordLayout_4 0 CompuMethod_111 0 65535 /end CHARACTERISTIC
/begin CHARACTERISTIC FaultManager.AltInop_Fault.Action_2 "Fault manager configuration.  Select up to 4 actions for each fault." VALUE 0x80002519 RecordLayout_4 0 CompuMethod_110 0 65535 /end CHARACTERISTIC
/begin CHARACTERISTIC FaultManager.AltInop_Fault.Action_2_Condition "Fault manager configuration.  Select up to 4 actions for each fault." VALUE 0x8000251B RecordLayout_4 0 CompuMethod_111 0 65535 /end CHARACTERISTIC
/begin CHARACTERISTIC FaultManager.AltInop_Fault.Action_3 "Fault manager configuration.  Select up to 4 actions for each fault." VALUE 0x8000251D RecordLayout_4 0 CompuMethod_110 0 65535 /end CHARACTERISTIC
/begin CHARACTERISTIC FaultManager.AltInop_Fault.Action_3_Condition "Fault manager configuration.  Select up to 4 actions for each fault." VALUE 0x8000251F RecordLayout_4 0 CompuMethod_111 0 65535 /end CHARACTERISTIC
/begin CHARACTERISTIC FaultManager.AltInop_Fault.Action_4 "Fault manager configuration.  Select up to 4 actions for each fault." VALUE 0x80002521 RecordLayout_4 0 CompuMethod_110 0 65535 /end CHARACTERISTIC
/begin CHARACTERISTIC FaultManager.AltInop_Fault.Action_4_Condition "Fault manager configuration.  Select up to 4 actions for each fault." VALUE 0x80002523 RecordLayout_4 0 CompuMethod_111 0 65535 /end CHARACTERISTIC
/begin CHARACTERISTIC FaultManager.Bank1_EquivRatioRangeHigh.Mode "Fault manager configuration.  Select up to 4 actions for each fault." VALUE 0x80002525 RecordLayout_4 0 CompuMethod_108 0 65535 /end CHARACTERISTIC
/begin CHARACTERISTIC FaultManager.Bank1_EquivRatioRangeHigh.ID "Fault manager configuration.  Select up to 4 actions for each fault." VALUE 0x80002527 RecordLayout_4 0 CompuMethod_1 0 65535 /end CHARACTERISTIC
/begin CHARACTERISTIC FaultManager.Bank1_EquivRatioRangeHigh.Test "Fault manager configuration.  Select up to 4 actions for each fault." VALUE 0x80002529 RecordLayout_4 0 CompuMethod_109 0 65535 /end CHARACTERISTIC
/begin CHARACTERISTIC FaultManager.Bank1_EquivRatioRangeHigh.Faulty_Samples__X_ "Fault manager configuration.  Select up to 4 actions for each fault." VALUE 0x8000252B RecordLayout_4 0 CompuMethod_1 0 65535 /end CHARACTERISTIC
/begin CHARACTERISTIC FaultManager.Bank1_EquivRatioRangeHigh.Total_Samples__Y_ "Fault manager configuration.  Select up to 4 actions for each fault." VALUE 0x8000252D RecordLayout_4 0 CompuMethod_1 0 65535 /end CHARACTERISTIC
/begin CHARACTERISTIC FaultManager.Bank1_EquivRatioRangeHigh.Action_1 "Fault manager configuration.  Select up to 4 actions for each fault." VALUE 0x8000252F RecordLayout_4 0 CompuMethod_110 0 65535 /end CHARACTERISTIC
/begin CHARACTERISTIC FaultManager.Bank1_EquivRatioRangeHigh.Action_1_Condition "Fault manager configuration.  Select up to 4 actions for each fault." VALUE 0x80002531 RecordLayout_4 0 CompuMethod_111 0 65535 /end CHARACTERISTIC
/begin CHARACTERISTIC FaultManager.Bank1_EquivRatioRangeHigh.Action_2 "Fault manager configuration.  Select up to 4 actions for each fault." VALUE 0x80002533 RecordLayout_4 0 CompuMethod_110 0 65535 /end CHARACTERISTIC
/begin CHARACTERISTIC FaultManager.Bank1_EquivRatioRangeHigh.Action_2_Condition "Fault manager configuration.  Select up to 4 actions for each fault." VALUE 0x80002535 RecordLayout_4 0 CompuMethod_111 0 65535 /end CHARACTERISTIC
/begin CHARACTERISTIC FaultManager.Bank1_EquivRatioRangeHigh.Action_3 "Fault manager configuration.  Select up to 4 actions for each fault." VALUE 0x80002537 RecordLayout_4 0 CompuMethod_110 0 65535 /end CHARACTERISTIC
/begin CHARACTERISTIC FaultManager.Bank1_EquivRatioRangeHigh.Action_3_Condition "Fault manager configuration.  Select up to 4 actions for each fault." VALUE 0x80002539 RecordLayout_4 0 CompuMethod_111 0 65535 /end CHARACTERISTIC
/begin CHARACTERISTIC FaultManager.Bank1_EquivRatioRangeHigh.Action_4 "Fault manager configuration.  Select up to 4 actions for each fault." VALUE 0x8000253B RecordLayout_4 0 CompuMethod_110 0 65535 /end CHARACTERISTIC
/begin CHARACTERISTIC FaultManager.Bank1_EquivRatioRangeHigh.Action_4_Condition "Fault manager configuration.  Select up to 4 actions for each fault." VALUE 0x8000253D RecordLayout_4 0 CompuMethod_111 0 65535 /end CHARACTERISTIC
/begin CHARACTERISTIC FaultManager.Bank1_EquivRatioRangeLow.Mode "Fault manager configuration.  Select up to 4 actions for each fault." VALUE 0x8000253F RecordLayout_4 0 CompuMethod_108 0 65535 /end CHARACTERISTIC
/begin CHARACTERISTIC FaultManager.Bank1_EquivRatioRangeLow.ID "Fault manager configuration.  Select up to 4 actions for each fault." VALUE 0x80002541 RecordLayout_4 0 CompuMethod_1 0 65535 /end CHARACTERISTIC
/begin CHARACTERISTIC FaultManager.Bank1_EquivRatioRangeLow.Test "Fault manager configuration.  Select up to 4 actions for each fault." VALUE 0x80002543 RecordLayout_4 0 CompuMethod_109 0 65535 /end CHARACTERISTIC
/begin CHARACTERISTIC FaultManager.Bank1_EquivRatioRangeLow.Faulty_Samples__X_ "Fault manager configuration.  Select up to 4 actions for each fault." VALUE 0x80002545 RecordLayout_4 0 CompuMethod_1 0 65535 /end CHARACTERISTIC
/begin CHARACTERISTIC FaultManager.Bank1_EquivRatioRangeLow.Total_Samples__Y_ "Fault manager configuration.  Select up to 4 actions for each fault." VALUE 0x80002547 RecordLayout_4 0 CompuMethod_1 0 65535 /end CHARACTERISTIC
/begin CHARACTERISTIC FaultManager.Bank1_EquivRatioRangeLow.Action_1 "Fault manager configuration.  Select up to 4 actions for each fault." VALUE 0x80002549 RecordLayout_4 0 CompuMethod_110 0 65535 /end CHARACTERISTIC
/begin CHARACTERISTIC FaultManager.Bank1_EquivRatioRangeLow.Action_1_Condition "Fault manager configuration.  Select up to 4 actions for each fault." VALUE 0x8000254B RecordLayout_4 0 CompuMethod_111 0 65535 /end CHARACTERISTIC
/begin CHARACTERISTIC FaultManager.Bank1_EquivRatioRangeLow.Action_2 "Fault manager configuration.  Select up to 4 actions for each fault." VALUE 0x8000254D RecordLayout_4 0 CompuMethod_110 0 65535 /end CHARACTERISTIC
/begin CHARACTERISTIC FaultManager.Bank1_EquivRatioRangeLow.Action_2_Condition "Fault manager configuration.  Select up to 4 actions for each fault." VALUE 0x8000254F RecordLayout_4 0 CompuMethod_111 0 65535 /end CHARACTERISTIC
/begin CHARACTERISTIC FaultManager.Bank1_EquivRatioRangeLow.Action_3 "Fault manager configuration.  Select up to 4 actions for each fault." VALUE 0x80002551 RecordLayout_4 0 CompuMethod_110 0 65535 /end CHARACTERISTIC
/begin CHARACTERISTIC FaultManager.Bank1_EquivRatioRangeLow.Action_3_Condition "Fault manager configuration.  Select up to 4 actions for each fault." VALUE 0x80002553 RecordLayout_4 0 CompuMethod_111 0 65535 /end CHARACTERISTIC
/begin CHARACTERISTIC FaultManager.Bank1_EquivRatioRangeLow.Action_4 "Fault manager configuration.  Select up to 4 actions for each fault." VALUE 0x80002555 RecordLayout_4 0 CompuMethod_110 0 65535 /end CHARACTERISTIC
/begin CHARACTERISTIC FaultManager.Bank1_EquivRatioRangeLow.Action_4_Condition "Fault manager configuration.  Select up to 4 actions for each fault." VALUE 0x80002557 RecordLayout_4 0 CompuMethod_111 0 65535 /end CHARACTERISTIC
/begin CHARACTERISTIC FaultManager.Bank2_EquivRatioRangeHigh.Mode "Fault manager configuration.  Select up to 4 actions for each fault." VALUE 0x80002559 RecordLayout_4 0 CompuMethod_108 0 65535 /end CHARACTERISTIC
/begin CHARACTERISTIC FaultManager.Bank2_EquivRatioRangeHigh.ID "Fault manager configuration.  Select up to 4 actions for each fault." VALUE 0x8000255B RecordLayout_4 0 CompuMethod_1 0 65535 /end CHARACTERISTIC
/begin CHARACTERISTIC FaultManager.Bank2_EquivRatioRangeHigh.Test "Fault manager configuration.  Select up to 4 actions for each fault." VALUE 0x8000255D RecordLayout_4 0 CompuMethod_109 0 65535 /end CHARACTERISTIC
/begin CHARACTERISTIC FaultManager.Bank2_EquivRatioRangeHigh.Faulty_Samples__X_ "Fault manager configuration.  Select up to 4 actions for each fault." VALUE 0x8000255F RecordLayout_4 0 CompuMethod_1 0 65535 /end CHARACTERISTIC
/begin CHARACTERISTIC FaultManager.Bank2_EquivRatioRangeHigh.Total_Samples__Y_ "Fault manager configuration.  Select up to 4 actions for each fault." VALUE 0x80002561 RecordLayout_4 0 CompuMethod_1 0 65535 /end CHARACTERISTIC
/begin CHARACTERISTIC FaultManager.Bank2_EquivRatioRangeHigh.Action_1 "Fault manager configuration.  Select up to 4 actions for each fault." VALUE 0x80002563 RecordLayout_4 0 CompuMethod_110 0 65535 /end CHARACTERISTIC
/begin CHARACTERISTIC FaultManager.Bank2_EquivRatioRangeHigh.Action_1_Condition "Fault manager configuration.  Select up to 4 actions for each fault." VALUE 0x80002565 RecordLayout_4 0 CompuMethod_111 0 65535 /end CHARACTERISTIC
/begin CHARACTERISTIC FaultManager.Bank2_EquivRatioRangeHigh.Action_2 "Fault manager configuration.  Select up to 4 actions for each fault." VALUE 0x80002567 RecordLayout_4 0 CompuMethod_110 0 65535 /end CHARACTERISTIC
/begin CHARACTERISTIC FaultManager.Bank2_EquivRatioRangeHigh.Action_2_Condition "Fault manager configuration.  Select up to 4 actions for each fault." VALUE 0x80002569 RecordLayout_4 0 CompuMethod_111 0 65535 /end CHARACTERISTIC
/begin CHARACTERISTIC FaultManager.Bank2_EquivRatioRangeHigh.Action_3 "Fault manager configuration.  Select up to 4 actions for each fault." VALUE 0x8000256B RecordLayout_4 0 CompuMethod_110 0 65535 /end CHARACTERISTIC
/begin CHARACTERISTIC FaultManager.Bank2_EquivRatioRangeHigh.Action_3_Condition "Fault manager configuration.  Select up to 4 actions for each fault." VALUE 0x8000256D RecordLayout_4 0 CompuMethod_111 0 65535 /end CHARACTERISTIC
/begin CHARACTERISTIC FaultManager.Bank2_EquivRatioRangeHigh.Action_4 "Fault manager configuration.  Select up to 4 actions for each fault." VALUE 0x8000256F RecordLayout_4 0 CompuMethod_110 0 65535 /end CHARACTERISTIC
/begin CHARACTERISTIC FaultManager.Bank2_EquivRatioRangeHigh.Action_4_Condition "Fault manager configuration.  Select up to 4 actions for each fault." VALUE 0x80002571 RecordLayout_4 0 CompuMethod_111 0 65535 /end CHARACTERISTIC
/begin CHARACTERISTIC FaultManager.Bank2_EquivRatioRangeLow.Mode "Fault manager configuration.  Select up to 4 actions for each fault." VALUE 0x80002573 RecordLayout_4 0 CompuMethod_108 0 65535 /end CHARACTERISTIC
/begin CHARACTERISTIC FaultManager.Bank2_EquivRatioRangeLow.ID "Fault manager configuration.  Select up to 4 actions for each fault." VALUE 0x80002575 RecordLayout_4 0 CompuMethod_1 0 65535 /end CHARACTERISTIC
/begin CHARACTERISTIC FaultManager.Bank2_EquivRatioRangeLow.Test "Fault manager configuration.  Select up to 4 actions for each fault." VALUE 0x80002577 RecordLayout_4 0 CompuMethod_109 0 65535 /end CHARACTERISTIC
/begin CHARACTERISTIC FaultManager.Bank2_EquivRatioRangeLow.Faulty_Samples__X_ "Fault manager configuration.  Select up to 4 actions for each fault." VALUE 0x80002579 RecordLayout_4 0 CompuMethod_1 0 65535 /end CHARACTERISTIC
/begin CHARACTERISTIC FaultManager.Bank2_EquivRatioRangeLow.Total_Samples__Y_ "Fault manager configuration.  Select up to 4 actions for each fault." VALUE 0x8000257B RecordLayout_4 0 CompuMethod_1 0 65535 /end CHARACTERISTIC
/begin CHARACTERISTIC FaultManager.Bank2_EquivRatioRangeLow.Action_1 "Fault manager configuration.  Select up to 4 actions for each fault." VALUE 0x8000257D RecordLayout_4 0 CompuMethod_110 0 65535 /end CHARACTERISTIC
/begin CHARACTERISTIC FaultManager.Bank2_EquivRatioRangeLow.Action_1_Condition "Fault manager configuration.  Select up to 4 actions for each fault." VALUE 0x8000257F RecordLayout_4 0 CompuMethod_111 0 65535 /end CHARACTERISTIC
/begin CHARACTERISTIC FaultManager.Bank2_EquivRatioRangeLow.Action_2 "Fault manager configuration.  Select up to 4 actions for each fault." VALUE 0x80002581 RecordLayout_4 0 CompuMethod_110 0 65535 /end CHARACTERISTIC
/begin CHARACTERISTIC FaultManager.Bank2_EquivRatioRangeLow.Action_2_Condition "Fault manager configuration.  Select up to 4 actions for each fault." VALUE 0x80002583 RecordLayout_4 0 CompuMethod_111 0 65535 /end CHARACTERISTIC
/begin CHARACTERISTIC FaultManager.Bank2_EquivRatioRangeLow.Action_3 "Fault manager configuration.  Select up to 4 actions for each fault." VALUE 0x80002585 RecordLayout_4 0 CompuMethod_110 0 65535 /end CHARACTERISTIC
/begin CHARACTERISTIC FaultManager.Bank2_EquivRatioRangeLow.Action_3_Condition "Fault manager configuration.  Select up to 4 actions for each fault." VALUE 0x80002587 RecordLayout_4 0 CompuMethod_111 0 65535 /end CHARACTERISTIC
/begin CHARACTERISTIC FaultManager.Bank2_EquivRatioRangeLow.Action_4 "Fault manager configuration.  Select up to 4 actions for each fault." VALUE 0x80002589 RecordLayout_4 0 CompuMethod_110 0 65535 /end CHARACTERISTIC
/begin CHARACTERISTIC FaultManager.Bank2_EquivRatioRangeLow.Action_4_Condition "Fault manager configuration.  Select up to 4 actions for each fault." VALUE 0x8000258B RecordLayout_4 0 CompuMethod_111 0 65535 /end CHARACTERISTIC
/begin CHARACTERISTIC FaultManager.CamEdgesFault.Mode "Fault manager configuration.  Select up to 4 actions for each fault." VALUE 0x8000258D RecordLayout_4 0 CompuMethod_108 0 65535 /end CHARACTERISTIC
/begin CHARACTERISTIC FaultManager.CamEdgesFault.ID "Fault manager configuration.  Select up to 4 actions for each fault." VALUE 0x8000258F RecordLayout_4 0 CompuMethod_1 0 65535 /end CHARACTERISTIC
/begin CHARACTERISTIC FaultManager.CamEdgesFault.Test "Fault manager configuration.  Select up to 4 actions for each fault." VALUE 0x80002591 RecordLayout_4 0 CompuMethod_109 0 65535 /end CHARACTERISTIC
/begin CHARACTERISTIC FaultManager.CamEdgesFault.Faulty_Samples__X_ "Fault manager configuration.  Select up to 4 actions for each fault." VALUE 0x80002593 RecordLayout_4 0 CompuMethod_1 0 65535 /end CHARACTERISTIC
/begin CHARACTERISTIC FaultManager.CamEdgesFault.Total_Samples__Y_ "Fault manager configuration.  Select up to 4 actions for each fault." VALUE 0x80002595 RecordLayout_4 0 CompuMethod_1 0 65535 /end CHARACTERISTIC
/begin CHARACTERISTIC FaultManager.CamEdgesFault.Action_1 "Fault manager configuration.  Select up to 4 actions for each fault." VALUE 0x80002597 RecordLayout_4 0 CompuMethod_110 0 65535 /end CHARACTERISTIC
/begin CHARACTERISTIC FaultManager.CamEdgesFault.Action_1_Condition "Fault manager configuration.  Select up to 4 actions for each fault." VALUE 0x80002599 RecordLayout_4 0 CompuMethod_111 0 65535 /end CHARACTERISTIC
/begin CHARACTERISTIC FaultManager.CamEdgesFault.Action_2 "Fault manager configuration.  Select up to 4 actions for each fault." VALUE 0x8000259B RecordLayout_4 0 CompuMethod_110 0 65535 /end CHARACTERISTIC
/begin CHARACTERISTIC FaultManager.CamEdgesFault.Action_2_Condition "Fault manager configuration.  Select up to 4 actions for each fault." VALUE 0x8000259D RecordLayout_4 0 CompuMethod_111 0 65535 /end CHARACTERISTIC
/begin CHARACTERISTIC FaultManager.CamEdgesFault.Action_3 "Fault manager configuration.  Select up to 4 actions for each fault." VALUE 0x8000259F RecordLayout_4 0 CompuMethod_110 0 65535 /end CHARACTERISTIC
/begin CHARACTERISTIC FaultManager.CamEdgesFault.Action_3_Condition "Fault manager configuration.  Select up to 4 actions for each fault." VALUE 0x800025A1 RecordLayout_4 0 CompuMethod_111 0 65535 /end CHARACTERISTIC
/begin CHARACTERISTIC FaultManager.CamEdgesFault.Action_4 "Fault manager configuration.  Select up to 4 actions for each fault." VALUE 0x800025A3 RecordLayout_4 0 CompuMethod_110 0 65535 /end CHARACTERISTIC
/begin CHARACTERISTIC FaultManager.CamEdgesFault.Action_4_Condition "Fault manager configuration.  Select up to 4 actions for each fault." VALUE 0x800025A5 RecordLayout_4 0 CompuMethod_111 0 65535 /end CHARACTERISTIC
/begin CHARACTERISTIC FaultManager.CamSyncFault.Mode "Fault manager configuration.  Select up to 4 actions for each fault." VALUE 0x800025A7 RecordLayout_4 0 CompuMethod_108 0 65535 /end CHARACTERISTIC
/begin CHARACTERISTIC FaultManager.CamSyncFault.ID "Fault manager configuration.  Select up to 4 actions for each fault." VALUE 0x800025A9 RecordLayout_4 0 CompuMethod_1 0 65535 /end CHARACTERISTIC
/begin CHARACTERISTIC FaultManager.CamSyncFault.Test "Fault manager configuration.  Select up to 4 actions for each fault." VALUE 0x800025AB RecordLayout_4 0 CompuMethod_109 0 65535 /end CHARACTERISTIC
/begin CHARACTERISTIC FaultManager.CamSyncFault.Faulty_Samples__X_ "Fault manager configuration.  Select up to 4 actions for each fault." VALUE 0x800025AD RecordLayout_4 0 CompuMethod_1 0 65535 /end CHARACTERISTIC
/begin CHARACTERISTIC FaultManager.CamSyncFault.Total_Samples__Y_ "Fault manager configuration.  Select up to 4 actions for each fault." VALUE 0x800025AF RecordLayout_4 0 CompuMethod_1 0 65535 /end CHARACTERISTIC
/begin CHARACTERISTIC FaultManager.CamSyncFault.Action_1 "Fault manager configuration.  Select up to 4 actions for each fault." VALUE 0x800025B1 RecordLayout_4 0 CompuMethod_110 0 65535 /end CHARACTERISTIC
/begin CHARACTERISTIC FaultManager.CamSyncFault.Action_1_Condition "Fault manager configuration.  Select up to 4 actions for each fault." VALUE 0x800025B3 RecordLayout_4 0 CompuMethod_111 0 65535 /end CHARACTERISTIC
/begin CHARACTERISTIC FaultManager.CamSyncFault.Action_2 "Fault manager configuration.  Select up to 4 actions for each fault." VALUE 0x800025B5 RecordLayout_4 0 CompuMethod_110 0 65535 /end CHARACTERISTIC
/begin CHARACTERISTIC FaultManager.CamSyncFault.Action_2_Condition "Fault manager configuration.  Select up to 4 actions for each fault." VALUE 0x800025B7 RecordLayout_4 0 CompuMethod_111 0 65535 /end CHARACTERISTIC
/begin CHARACTERISTIC FaultManager.CamSyncFault.Action_3 "Fault manager configuration.  Select up to 4 actions for each fault." VALUE 0x800025B9 RecordLayout_4 0 CompuMethod_110 0 65535 /end CHARACTERISTIC
/begin CHARACTERISTIC FaultManager.CamSyncFault.Action_3_Condition "Fault manager configuration.  Select up to 4 actions for each fault." VALUE 0x800025BB RecordLayout_4 0 CompuMethod_111 0 65535 /end CHARACTERISTIC
/begin CHARACTERISTIC FaultManager.CamSyncFault.Action_4 "Fault manager configuration.  Select up to 4 actions for each fault." VALUE 0x800025BD RecordLayout_4 0 CompuMethod_110 0 65535 /end CHARACTERISTIC
/begin CHARACTERISTIC FaultManager.CamSyncFault.Action_4_Condition "Fault manager configuration.  Select up to 4 actions for each fault." VALUE 0x800025BF RecordLayout_4 0 CompuMethod_111 0 65535 /end CHARACTERISTIC
/begin CHARACTERISTIC FaultManager.ClutchStuckHigh_Fault.Mode "Fault manager configuration.  Select up to 4 actions for each fault." VALUE 0x800025C1 RecordLayout_4 0 CompuMethod_108 0 65535 /end CHARACTERISTIC
/begin CHARACTERISTIC FaultManager.ClutchStuckHigh_Fault.ID "Fault manager configuration.  Select up to 4 actions for each fault." VALUE 0x800025C3 RecordLayout_4 0 CompuMethod_1 0 65535 /end CHARACTERISTIC
/begin CHARACTERISTIC FaultManager.ClutchStuckHigh_Fault.Test "Fault manager configuration.  Select up to 4 actions for each fault." VALUE 0x800025C5 RecordLayout_4 0 CompuMethod_109 0 65535 /end CHARACTERISTIC
/begin CHARACTERISTIC FaultManager.ClutchStuckHigh_Fault.Faulty_Samples__X_ "Fault manager configuration.  Select up to 4 actions for each fault." VALUE 0x800025C7 RecordLayout_4 0 CompuMethod_1 0 65535 /end CHARACTERISTIC
/begin CHARACTERISTIC FaultManager.ClutchStuckHigh_Fault.Total_Samples__Y_ "Fault manager configuration.  Select up to 4 actions for each fault." VALUE 0x800025C9 RecordLayout_4 0 CompuMethod_1 0 65535 /end CHARACTERISTIC
/begin CHARACTERISTIC FaultManager.ClutchStuckHigh_Fault.Action_1 "Fault manager configuration.  Select up to 4 actions for each fault." VALUE 0x800025CB RecordLayout_4 0 CompuMethod_110 0 65535 /end CHARACTERISTIC
/begin CHARACTERISTIC FaultManager.ClutchStuckHigh_Fault.Action_1_Condition "Fault manager configuration.  Select up to 4 actions for each fault." VALUE 0x800025CD RecordLayout_4 0 CompuMethod_111 0 65535 /end CHARACTERISTIC
/begin CHARACTERISTIC FaultManager.ClutchStuckHigh_Fault.Action_2 "Fault manager configuration.  Select up to 4 actions for each fault." VALUE 0x800025CF RecordLayout_4 0 CompuMethod_110 0 65535 /end CHARACTERISTIC
/begin CHARACTERISTIC FaultManager.ClutchStuckHigh_Fault.Action_2_Condition "Fault manager configuration.  Select up to 4 actions for each fault." VALUE 0x800025D1 RecordLayout_4 0 CompuMethod_111 0 65535 /end CHARACTERISTIC
/begin CHARACTERISTIC FaultManager.ClutchStuckHigh_Fault.Action_3 "Fault manager configuration.  Select up to 4 actions for each fault." VALUE 0x800025D3 RecordLayout_4 0 CompuMethod_110 0 65535 /end CHARACTERISTIC
/begin CHARACTERISTIC FaultManager.ClutchStuckHigh_Fault.Action_3_Condition "Fault manager configuration.  Select up to 4 actions for each fault." VALUE 0x800025D5 RecordLayout_4 0 CompuMethod_111 0 65535 /end CHARACTERISTIC
/begin CHARACTERISTIC FaultManager.ClutchStuckHigh_Fault.Action_4 "Fault manager configuration.  Select up to 4 actions for each fault." VALUE 0x800025D7 RecordLayout_4 0 CompuMethod_110 0 65535 /end CHARACTERISTIC
/begin CHARACTERISTIC FaultManager.ClutchStuckHigh_Fault.Action_4_Condition "Fault manager configuration.  Select up to 4 actions for each fault." VALUE 0x800025D9 RecordLayout_4 0 CompuMethod_111 0 65535 /end CHARACTERISTIC
/begin CHARACTERISTIC FaultManager.CrankEdgesFault.Mode "Fault manager configuration.  Select up to 4 actions for each fault." VALUE 0x800025DB RecordLayout_4 0 CompuMethod_108 0 65535 /end CHARACTERISTIC
/begin CHARACTERISTIC FaultManager.CrankEdgesFault.ID "Fault manager configuration.  Select up to 4 actions for each fault." VALUE 0x800025DD RecordLayout_4 0 CompuMethod_1 0 65535 /end CHARACTERISTIC
/begin CHARACTERISTIC FaultManager.CrankEdgesFault.Test "Fault manager configuration.  Select up to 4 actions for each fault." VALUE 0x800025DF RecordLayout_4 0 CompuMethod_109 0 65535 /end CHARACTERISTIC
/begin CHARACTERISTIC FaultManager.CrankEdgesFault.Faulty_Samples__X_ "Fault manager configuration.  Select up to 4 actions for each fault." VALUE 0x800025E1 RecordLayout_4 0 CompuMethod_1 0 65535 /end CHARACTERISTIC
/begin CHARACTERISTIC FaultManager.CrankEdgesFault.Total_Samples__Y_ "Fault manager configuration.  Select up to 4 actions for each fault." VALUE 0x800025E3 RecordLayout_4 0 CompuMethod_1 0 65535 /end CHARACTERISTIC
/begin CHARACTERISTIC FaultManager.CrankEdgesFault.Action_1 "Fault manager configuration.  Select up to 4 actions for each fault." VALUE 0x800025E5 RecordLayout_4 0 CompuMethod_110 0 65535 /end CHARACTERISTIC
/begin CHARACTERISTIC FaultManager.CrankEdgesFault.Action_1_Condition "Fault manager configuration.  Select up to 4 actions for each fault." VALUE 0x800025E7 RecordLayout_4 0 CompuMethod_111 0 65535 /end CHARACTERISTIC
/begin CHARACTERISTIC FaultManager.CrankEdgesFault.Action_2 "Fault manager configuration.  Select up to 4 actions for each fault." VALUE 0x800025E9 RecordLayout_4 0 CompuMethod_110 0 65535 /end CHARACTERISTIC
/begin CHARACTERISTIC FaultManager.CrankEdgesFault.Action_2_Condition "Fault manager configuration.  Select up to 4 actions for each fault." VALUE 0x800025EB RecordLayout_4 0 CompuMethod_111 0 65535 /end CHARACTERISTIC
/begin CHARACTERISTIC FaultManager.CrankEdgesFault.Action_3 "Fault manager configuration.  Select up to 4 actions for each fault." VALUE 0x800025ED RecordLayout_4 0 CompuMethod_110 0 65535 /end CHARACTERISTIC
/begin CHARACTERISTIC FaultManager.CrankEdgesFault.Action_3_Condition "Fault manager configuration.  Select up to 4 actions for each fault." VALUE 0x800025EF RecordLayout_4 0 CompuMethod_111 0 65535 /end CHARACTERISTIC
/begin CHARACTERISTIC FaultManager.CrankEdgesFault.Action_4 "Fault manager configuration.  Select up to 4 actions for each fault." VALUE 0x800025F1 RecordLayout_4 0 CompuMethod_110 0 65535 /end CHARACTERISTIC
/begin CHARACTERISTIC FaultManager.CrankEdgesFault.Action_4_Condition "Fault manager configuration.  Select up to 4 actions for each fault." VALUE 0x800025F3 RecordLayout_4 0 CompuMethod_111 0 65535 /end CHARACTERISTIC
/begin CHARACTERISTIC FaultManager.CrankSyncFault.Mode "Fault manager configuration.  Select up to 4 actions for each fault." VALUE 0x800025F5 RecordLayout_4 0 CompuMethod_108 0 65535 /end CHARACTERISTIC
/begin CHARACTERISTIC FaultManager.CrankSyncFault.ID "Fault manager configuration.  Select up to 4 actions for each fault." VALUE 0x800025F7 RecordLayout_4 0 CompuMethod_1 0 65535 /end CHARACTERISTIC
/begin CHARACTERISTIC FaultManager.CrankSyncFault.Test "Fault manager configuration.  Select up to 4 actions for each fault." VALUE 0x800025F9 RecordLayout_4 0 CompuMethod_109 0 65535 /end CHARACTERISTIC
/begin CHARACTERISTIC FaultManager.CrankSyncFault.Faulty_Samples__X_ "Fault manager configuration.  Select up to 4 actions for each fault." VALUE 0x800025FB RecordLayout_4 0 CompuMethod_1 0 65535 /end CHARACTERISTIC
/begin CHARACTERISTIC FaultManager.CrankSyncFault.Total_Samples__Y_ "Fault manager configuration.  Select up to 4 actions for each fault." VALUE 0x800025FD RecordLayout_4 0 CompuMethod_1 0 65535 /end CHARACTERISTIC
/begin CHARACTERISTIC FaultManager.CrankSyncFault.Action_1 "Fault manager configuration.  Select up to 4 actions for each fault." VALUE 0x800025FF RecordLayout_4 0 CompuMethod_110 0 65535 /end CHARACTERISTIC
/begin CHARACTERISTIC FaultManager.CrankSyncFault.Action_1_Condition "Fault manager configuration.  Select up to 4 actions for each fault." VALUE 0x80002601 RecordLayout_4 0 CompuMethod_111 0 65535 /end CHARACTERISTIC
/begin CHARACTERISTIC FaultManager.CrankSyncFault.Action_2 "Fault manager configuration.  Select up to 4 actions for each fault." VALUE 0x80002603 RecordLayout_4 0 CompuMethod_110 0 65535 /end CHARACTERISTIC
/begin CHARACTERISTIC FaultManager.CrankSyncFault.Action_2_Condition "Fault manager configuration.  Select up to 4 actions for each fault." VALUE 0x80002605 RecordLayout_4 0 CompuMethod_111 0 65535 /end CHARACTERISTIC
/begin CHARACTERISTIC FaultManager.CrankSyncFault.Action_3 "Fault manager configuration.  Select up to 4 actions for each fault." VALUE 0x80002607 RecordLayout_4 0 CompuMethod_110 0 65535 /end CHARACTERISTIC
/begin CHARACTERISTIC FaultManager.CrankSyncFault.Action_3_Condition "Fault manager configuration.  Select up to 4 actions for each fault." VALUE 0x80002609 RecordLayout_4 0 CompuMethod_111 0 65535 /end CHARACTERISTIC
/begin CHARACTERISTIC FaultManager.CrankSyncFault.Action_4 "Fault manager configuration.  Select up to 4 actions for each fault." VALUE 0x8000260B RecordLayout_4 0 CompuMethod_110 0 65535 /end CHARACTERISTIC
/begin CHARACTERISTIC FaultManager.CrankSyncFault.Action_4_Condition "Fault manager configuration.  Select up to 4 actions for each fault." VALUE 0x8000260D RecordLayout_4 0 CompuMethod_111 0 65535 /end CHARACTERISTIC
/begin CHARACTERISTIC FaultManager.Cylinder1_HardMisfire.Mode "Fault manager configuration.  Select up to 4 actions for each fault." VALUE 0x8000260F RecordLayout_4 0 CompuMethod_108 0 65535 /end CHARACTERISTIC
/begin CHARACTERISTIC FaultManager.Cylinder1_HardMisfire.ID "Fault manager configuration.  Select up to 4 actions for each fault." VALUE 0x80002611 RecordLayout_4 0 CompuMethod_1 0 65535 /end CHARACTERISTIC
/begin CHARACTERISTIC FaultManager.Cylinder1_HardMisfire.Test "Fault manager configuration.  Select up to 4 actions for each fault." VALUE 0x80002613 RecordLayout_4 0 CompuMethod_109 0 65535 /end CHARACTERISTIC
/begin CHARACTERISTIC FaultManager.Cylinder1_HardMisfire.Faulty_Samples__X_ "Fault manager configuration.  Select up to 4 actions for each fault." VALUE 0x80002615 RecordLayout_4 0 CompuMethod_1 0 65535 /end CHARACTERISTIC
/begin CHARACTERISTIC FaultManager.Cylinder1_HardMisfire.Total_Samples__Y_ "Fault manager configuration.  Select up to 4 actions for each fault." VALUE 0x80002617 RecordLayout_4 0 CompuMethod_1 0 65535 /end CHARACTERISTIC
/begin CHARACTERISTIC FaultManager.Cylinder1_HardMisfire.Action_1 "Fault manager configuration.  Select up to 4 actions for each fault." VALUE 0x80002619 RecordLayout_4 0 CompuMethod_110 0 65535 /end CHARACTERISTIC
/begin CHARACTERISTIC FaultManager.Cylinder1_HardMisfire.Action_1_Condition "Fault manager configuration.  Select up to 4 actions for each fault." VALUE 0x8000261B RecordLayout_4 0 CompuMethod_111 0 65535 /end CHARACTERISTIC
/begin CHARACTERISTIC FaultManager.Cylinder1_HardMisfire.Action_2 "Fault manager configuration.  Select up to 4 actions for each fault." VALUE 0x8000261D RecordLayout_4 0 CompuMethod_110 0 65535 /end CHARACTERISTIC
/begin CHARACTERISTIC FaultManager.Cylinder1_HardMisfire.Action_2_Condition "Fault manager configuration.  Select up to 4 actions for each fault." VALUE 0x8000261F RecordLayout_4 0 CompuMethod_111 0 65535 /end CHARACTERISTIC
/begin CHARACTERISTIC FaultManager.Cylinder1_HardMisfire.Action_3 "Fault manager configuration.  Select up to 4 actions for each fault." VALUE 0x80002621 RecordLayout_4 0 CompuMethod_110 0 65535 /end CHARACTERISTIC
/begin CHARACTERISTIC FaultManager.Cylinder1_HardMisfire.Action_3_Condition "Fault manager configuration.  Select up to 4 actions for each fault." VALUE 0x80002623 RecordLayout_4 0 CompuMethod_111 0 65535 /end CHARACTERISTIC
/begin CHARACTERISTIC FaultManager.Cylinder1_HardMisfire.Action_4 "Fault manager configuration.  Select up to 4 actions for each fault." VALUE 0x80002625 RecordLayout_4 0 CompuMethod_110 0 65535 /end CHARACTERISTIC
/begin CHARACTERISTIC FaultManager.Cylinder1_HardMisfire.Action_4_Condition "Fault manager configuration.  Select up to 4 actions for each fault." VALUE 0x80002627 RecordLayout_4 0 CompuMethod_111 0 65535 /end CHARACTERISTIC
/begin CHARACTERISTIC FaultManager.Cylinder2_HardMisfire.Mode "Fault manager configuration.  Select up to 4 actions for each fault." VALUE 0x80002629 RecordLayout_4 0 CompuMethod_108 0 65535 /end CHARACTERISTIC
/begin CHARACTERISTIC FaultManager.Cylinder2_HardMisfire.ID "Fault manager configuration.  Select up to 4 actions for each fault." VALUE 0x8000262B RecordLayout_4 0 CompuMethod_1 0 65535 /end CHARACTERISTIC
/begin CHARACTERISTIC FaultManager.Cylinder2_HardMisfire.Test "Fault manager configuration.  Select up to 4 actions for each fault." VALUE 0x8000262D RecordLayout_4 0 CompuMethod_109 0 65535 /end CHARACTERISTIC
/begin CHARACTERISTIC FaultManager.Cylinder2_HardMisfire.Faulty_Samples__X_ "Fault manager configuration.  Select up to 4 actions for each fault." VALUE 0x8000262F RecordLayout_4 0 CompuMethod_1 0 65535 /end CHARACTERISTIC
/begin CHARACTERISTIC FaultManager.Cylinder2_HardMisfire.Total_Samples__Y_ "Fault manager configuration.  Select up to 4 actions for each fault." VALUE 0x80002631 RecordLayout_4 0 CompuMethod_1 0 65535 /end CHARACTERISTIC
/begin CHARACTERISTIC FaultManager.Cylinder2_HardMisfire.Action_1 "Fault manager configuration.  Select up to 4 actions for each fault." VALUE 0x80002633 RecordLayout_4 0 CompuMethod_110 0 65535 /end CHARACTERISTIC
/begin CHARACTERISTIC FaultManager.Cylinder2_HardMisfire.Action_1_Condition "Fault manager configuration.  Select up to 4 actions for each fault." VALUE 0x80002635 RecordLayout_4 0 CompuMethod_111 0 65535 /end CHARACTERISTIC
/begin CHARACTERISTIC FaultManager.Cylinder2_HardMisfire.Action_2 "Fault manager configuration.  Select up to 4 actions for each fault." VALUE 0x80002637 RecordLayout_4 0 CompuMethod_110 0 65535 /end CHARACTERISTIC
/begin CHARACTERISTIC FaultManager.Cylinder2_HardMisfire.Action_2_Condition "Fault manager configuration.  Select up to 4 actions for each fault." VALUE 0x80002639 RecordLayout_4 0 CompuMethod_111 0 65535 /end CHARACTERISTIC
/begin CHARACTERISTIC FaultManager.Cylinder2_HardMisfire.Action_3 "Fault manager configuration.  Select up to 4 actions for each fault." VALUE 0x8000263B RecordLayout_4 0 CompuMethod_110 0 65535 /end CHARACTERISTIC
/begin CHARACTERISTIC FaultManager.Cylinder2_HardMisfire.Action_3_Condition "Fault manager configuration.  Select up to 4 actions for each fault." VALUE 0x8000263D RecordLayout_4 0 CompuMethod_111 0 65535 /end CHARACTERISTIC
/begin CHARACTERISTIC FaultManager.Cylinder2_HardMisfire.Action_4 "Fault manager configuration.  Select up to 4 actions for each fault." VALUE 0x8000263F RecordLayout_4 0 CompuMethod_110 0 65535 /end CHARACTERISTIC
/begin CHARACTERISTIC FaultManager.Cylinder2_HardMisfire.Action_4_Condition "Fault manager configuration.  Select up to 4 actions for each fault." VALUE 0x80002641 RecordLayout_4 0 CompuMethod_111 0 65535 /end CHARACTERISTIC
/begin CHARACTERISTIC FaultManager.Cylinder3_HardMisfire.Mode "Fault manager configuration.  Select up to 4 actions for each fault." VALUE 0x80002643 RecordLayout_4 0 CompuMethod_108 0 65535 /end CHARACTERISTIC
/begin CHARACTERISTIC FaultManager.Cylinder3_HardMisfire.ID "Fault manager configuration.  Select up to 4 actions for each fault." VALUE 0x80002645 RecordLayout_4 0 CompuMethod_1 0 65535 /end CHARACTERISTIC
/begin CHARACTERISTIC FaultManager.Cylinder3_HardMisfire.Test "Fault manager configuration.  Select up to 4 actions for each fault." VALUE 0x80002647 RecordLayout_4 0 CompuMethod_109 0 65535 /end CHARACTERISTIC
/begin CHARACTERISTIC FaultManager.Cylinder3_HardMisfire.Faulty_Samples__X_ "Fault manager configuration.  Select up to 4 actions for each fault." VALUE 0x80002649 RecordLayout_4 0 CompuMethod_1 0 65535 /end CHARACTERISTIC
/begin CHARACTERISTIC FaultManager.Cylinder3_HardMisfire.Total_Samples__Y_ "Fault manager configuration.  Select up to 4 actions for each fault." VALUE 0x8000264B RecordLayout_4 0 CompuMethod_1 0 65535 /end CHARACTERISTIC
/begin CHARACTERISTIC FaultManager.Cylinder3_HardMisfire.Action_1 "Fault manager configuration.  Select up to 4 actions for each fault." VALUE 0x8000264D RecordLayout_4 0 CompuMethod_110 0 65535 /end CHARACTERISTIC
/begin CHARACTERISTIC FaultManager.Cylinder3_HardMisfire.Action_1_Condition "Fault manager configuration.  Select up to 4 actions for each fault." VALUE 0x8000264F RecordLayout_4 0 CompuMethod_111 0 65535 /end CHARACTERISTIC
/begin CHARACTERISTIC FaultManager.Cylinder3_HardMisfire.Action_2 "Fault manager configuration.  Select up to 4 actions for each fault." VALUE 0x80002651 RecordLayout_4 0 CompuMethod_110 0 65535 /end CHARACTERISTIC
/begin CHARACTERISTIC FaultManager.Cylinder3_HardMisfire.Action_2_Condition "Fault manager configuration.  Select up to 4 actions for each fault." VALUE 0x80002653 RecordLayout_4 0 CompuMethod_111 0 65535 /end CHARACTERISTIC
/begin CHARACTERISTIC FaultManager.Cylinder3_HardMisfire.Action_3 "Fault manager configuration.  Select up to 4 actions for each fault." VALUE 0x80002655 RecordLayout_4 0 CompuMethod_110 0 65535 /end CHARACTERISTIC
/begin CHARACTERISTIC FaultManager.Cylinder3_HardMisfire.Action_3_Condition "Fault manager configuration.  Select up to 4 actions for each fault." VALUE 0x80002657 RecordLayout_4 0 CompuMethod_111 0 65535 /end CHARACTERISTIC
/begin CHARACTERISTIC FaultManager.Cylinder3_HardMisfire.Action_4 "Fault manager configuration.  Select up to 4 actions for each fault." VALUE 0x80002659 RecordLayout_4 0 CompuMethod_110 0 65535 /end CHARACTERISTIC
/begin CHARACTERISTIC FaultManager.Cylinder3_HardMisfire.Action_4_Condition "Fault manager configuration.  Select up to 4 actions for each fault." VALUE 0x8000265B RecordLayout_4 0 CompuMethod_111 0 65535 /end CHARACTERISTIC
/begin CHARACTERISTIC FaultManager.Cylinder4_HardMisfire.Mode "Fault manager configuration.  Select up to 4 actions for each fault." VALUE 0x8000265D RecordLayout_4 0 CompuMethod_108 0 65535 /end CHARACTERISTIC
/begin CHARACTERISTIC FaultManager.Cylinder4_HardMisfire.ID "Fault manager configuration.  Select up to 4 actions for each fault." VALUE 0x8000265F RecordLayout_4 0 CompuMethod_1 0 65535 /end CHARACTERISTIC
/begin CHARACTERISTIC FaultManager.Cylinder4_HardMisfire.Test "Fault manager configuration.  Select up to 4 actions for each fault." VALUE 0x80002661 RecordLayout_4 0 CompuMethod_109 0 65535 /end CHARACTERISTIC
/begin CHARACTERISTIC FaultManager.Cylinder4_HardMisfire.Faulty_Samples__X_ "Fault manager configuration.  Select up to 4 actions for each fault." VALUE 0x80002663 RecordLayout_4 0 CompuMethod_1 0 65535 /end CHARACTERISTIC
/begin CHARACTERISTIC FaultManager.Cylinder4_HardMisfire.Total_Samples__Y_ "Fault manager configuration.  Select up to 4 actions for each fault." VALUE 0x80002665 RecordLayout_4 0 CompuMethod_1 0 65535 /end CHARACTERISTIC
/begin CHARACTERISTIC FaultManager.Cylinder4_HardMisfire.Action_1 "Fault manager configuration.  Select up to 4 actions for each fault." VALUE 0x80002667 RecordLayout_4 0 CompuMethod_110 0 65535 /end CHARACTERISTIC
/begin CHARACTERISTIC FaultManager.Cylinder4_HardMisfire.Action_1_Condition "Fault manager configuration.  Select up to 4 actions for each fault." VALUE 0x80002669 RecordLayout_4 0 CompuMethod_111 0 65535 /end CHARACTERISTIC
/begin CHARACTERISTIC FaultManager.Cylinder4_HardMisfire.Action_2 "Fault manager configuration.  Select up to 4 actions for each fault." VALUE 0x8000266B RecordLayout_4 0 CompuMethod_110 0 65535 /end CHARACTERISTIC
/begin CHARACTERISTIC FaultManager.Cylinder4_HardMisfire.Action_2_Condition "Fault manager configuration.  Select up to 4 actions for each fault." VALUE 0x8000266D RecordLayout_4 0 CompuMethod_111 0 65535 /end CHARACTERISTIC
/begin CHARACTERISTIC FaultManager.Cylinder4_HardMisfire.Action_3 "Fault manager configuration.  Select up to 4 actions for each fault." VALUE 0x8000266F RecordLayout_4 0 CompuMethod_110 0 65535 /end CHARACTERISTIC
/begin CHARACTERISTIC FaultManager.Cylinder4_HardMisfire.Action_3_Condition "Fault manager configuration.  Select up to 4 actions for each fault." VALUE 0x80002671 RecordLayout_4 0 CompuMethod_111 0 65535 /end CHARACTERISTIC
/begin CHARACTERISTIC FaultManager.Cylinder4_HardMisfire.Action_4 "Fault manager configuration.  Select up to 4 actions for each fault." VALUE 0x80002673 RecordLayout_4 0 CompuMethod_110 0 65535 /end CHARACTERISTIC
/begin CHARACTERISTIC FaultManager.Cylinder4_HardMisfire.Action_4_Condition "Fault manager configuration.  Select up to 4 actions for each fault." VALUE 0x80002675 RecordLayout_4 0 CompuMethod_111 0 65535 /end CHARACTERISTIC
/begin CHARACTERISTIC FaultManager.Cylinder5_HardMisfire.Mode "Fault manager configuration.  Select up to 4 actions for each fault." VALUE 0x80002677 RecordLayout_4 0 CompuMethod_108 0 65535 /end CHARACTERISTIC
/begin CHARACTERISTIC FaultManager.Cylinder5_HardMisfire.ID "Fault manager configuration.  Select up to 4 actions for each fault." VALUE 0x80002679 RecordLayout_4 0 CompuMethod_1 0 65535 /end CHARACTERISTIC
/begin CHARACTERISTIC FaultManager.Cylinder5_HardMisfire.Test "Fault manager configuration.  Select up to 4 actions for each fault." VALUE 0x8000267B RecordLayout_4 0 CompuMethod_109 0 65535 /end CHARACTERISTIC
/begin CHARACTERISTIC FaultManager.Cylinder5_HardMisfire.Faulty_Samples__X_ "Fault manager configuration.  Select up to 4 actions for each fault." VALUE 0x8000267D RecordLayout_4 0 CompuMethod_1 0 65535 /end CHARACTERISTIC
/begin CHARACTERISTIC FaultManager.Cylinder5_HardMisfire.Total_Samples__Y_ "Fault manager configuration.  Select up to 4 actions for each fault." VALUE 0x8000267F RecordLayout_4 0 CompuMethod_1 0 65535 /end CHARACTERISTIC
/begin CHARACTERISTIC FaultManager.Cylinder5_HardMisfire.Action_1 "Fault manager configuration.  Select up to 4 actions for each fault." VALUE 0x80002681 RecordLayout_4 0 CompuMethod_110 0 65535 /end CHARACTERISTIC
/begin CHARACTERISTIC FaultManager.Cylinder5_HardMisfire.Action_1_Condition "Fault manager configuration.  Select up to 4 actions for each fault." VALUE 0x80002683 RecordLayout_4 0 CompuMethod_111 0 65535 /end CHARACTERISTIC
/begin CHARACTERISTIC FaultManager.Cylinder5_HardMisfire.Action_2 "Fault manager configuration.  Select up to 4 actions for each fault." VALUE 0x80002685 RecordLayout_4 0 CompuMethod_110 0 65535 /end CHARACTERISTIC
/begin CHARACTERISTIC FaultManager.Cylinder5_HardMisfire.Action_2_Condition "Fault manager configuration.  Select up to 4 actions for each fault." VALUE 0x80002687 RecordLayout_4 0 CompuMethod_111 0 65535 /end CHARACTERISTIC
/begin CHARACTERISTIC FaultManager.Cylinder5_HardMisfire.Action_3 "Fault manager configuration.  Select up to 4 actions for each fault." VALUE 0x80002689 RecordLayout_4 0 CompuMethod_110 0 65535 /end CHARACTERISTIC
/begin CHARACTERISTIC FaultManager.Cylinder5_HardMisfire.Action_3_Condition "Fault manager configuration.  Select up to 4 actions for each fault." VALUE 0x8000268B RecordLayout_4 0 CompuMethod_111 0 65535 /end CHARACTERISTIC
/begin CHARACTERISTIC FaultManager.Cylinder5_HardMisfire.Action_4 "Fault manager configuration.  Select up to 4 actions for each fault." VALUE 0x8000268D RecordLayout_4 0 CompuMethod_110 0 65535 /end CHARACTERISTIC
/begin CHARACTERISTIC FaultManager.Cylinder5_HardMisfire.Action_4_Condition "Fault manager configuration.  Select up to 4 actions for each fault." VALUE 0x8000268F RecordLayout_4 0 CompuMethod_111 0 65535 /end CHARACTERISTIC
/begin CHARACTERISTIC FaultManager.Cylinder6_HardMisfire.Mode "Fault manager configuration.  Select up to 4 actions for each fault." VALUE 0x80002691 RecordLayout_4 0 CompuMethod_108 0 65535 /end CHARACTERISTIC
/begin CHARACTERISTIC FaultManager.Cylinder6_HardMisfire.ID "Fault manager configuration.  Select up to 4 actions for each fault." VALUE 0x80002693 RecordLayout_4 0 CompuMethod_1 0 65535 /end CHARACTERISTIC
/begin CHARACTERISTIC FaultManager.Cylinder6_HardMisfire.Test "Fault manager configuration.  Select up to 4 actions for each fault." VALUE 0x80002695 RecordLayout_4 0 CompuMethod_109 0 65535 /end CHARACTERISTIC
/begin CHARACTERISTIC FaultManager.Cylinder6_HardMisfire.Faulty_Samples__X_ "Fault manager configuration.  Select up to 4 actions for each fault." VALUE 0x80002697 RecordLayout_4 0 CompuMethod_1 0 65535 /end CHARACTERISTIC
/begin CHARACTERISTIC FaultManager.Cylinder6_HardMisfire.Total_Samples__Y_ "Fault manager configuration.  Select up to 4 actions for each fault." VALUE 0x80002699 RecordLayout_4 0 CompuMethod_1 0 65535 /end CHARACTERISTIC
/begin CHARACTERISTIC FaultManager.Cylinder6_HardMisfire.Action_1 "Fault manager configuration.  Select up to 4 actions for each fault." VALUE 0x8000269B RecordLayout_4 0 CompuMethod_110 0 65535 /end CHARACTERISTIC
/begin CHARACTERISTIC FaultManager.Cylinder6_HardMisfire.Action_1_Condition "Fault manager configuration.  Select up to 4 actions for each fault." VALUE 0x8000269D RecordLayout_4 0 CompuMethod_111 0 65535 /end CHARACTERISTIC
/begin CHARACTERISTIC FaultManager.Cylinder6_HardMisfire.Action_2 "Fault manager configuration.  Select up to 4 actions for each fault." VALUE 0x8000269F RecordLayout_4 0 CompuMethod_110 0 65535 /end CHARACTERISTIC
/begin CHARACTERISTIC FaultManager.Cylinder6_HardMisfire.Action_2_Condition "Fault manager configuration.  Select up to 4 actions for each fault." VALUE 0x800026A1 RecordLayout_4 0 CompuMethod_111 0 65535 /end CHARACTERISTIC
/begin CHARACTERISTIC FaultManager.Cylinder6_HardMisfire.Action_3 "Fault manager configuration.  Select up to 4 actions for each fault." VALUE 0x800026A3 RecordLayout_4 0 CompuMethod_110 0 65535 /end CHARACTERISTIC
/begin CHARACTERISTIC FaultManager.Cylinder6_HardMisfire.Action_3_Condition "Fault manager configuration.  Select up to 4 actions for each fault." VALUE 0x800026A5 RecordLayout_4 0 CompuMethod_111 0 65535 /end CHARACTERISTIC
/begin CHARACTERISTIC FaultManager.Cylinder6_HardMisfire.Action_4 "Fault manager configuration.  Select up to 4 actions for each fault." VALUE 0x800026A7 RecordLayout_4 0 CompuMethod_110 0 65535 /end CHARACTERISTIC
/begin CHARACTERISTIC FaultManager.Cylinder6_HardMisfire.Action_4_Condition "Fault manager configuration.  Select up to 4 actions for each fault." VALUE 0x800026A9 RecordLayout_4 0 CompuMethod_111 0 65535 /end CHARACTERISTIC
/begin CHARACTERISTIC FaultManager.Cylinder7_HardMisfire.Mode "Fault manager configuration.  Select up to 4 actions for each fault." VALUE 0x800026AB RecordLayout_4 0 CompuMethod_108 0 65535 /end CHARACTERISTIC
/begin CHARACTERISTIC FaultManager.Cylinder7_HardMisfire.ID "Fault manager configuration.  Select up to 4 actions for each fault." VALUE 0x800026AD RecordLayout_4 0 CompuMethod_1 0 65535 /end CHARACTERISTIC
/begin CHARACTERISTIC FaultManager.Cylinder7_HardMisfire.Test "Fault manager configuration.  Select up to 4 actions for each fault." VALUE 0x800026AF RecordLayout_4 0 CompuMethod_109 0 65535 /end CHARACTERISTIC
/begin CHARACTERISTIC FaultManager.Cylinder7_HardMisfire.Faulty_Samples__X_ "Fault manager configuration.  Select up to 4 actions for each fault." VALUE 0x800026B1 RecordLayout_4 0 CompuMethod_1 0 65535 /end CHARACTERISTIC
/begin CHARACTERISTIC FaultManager.Cylinder7_HardMisfire.Total_Samples__Y_ "Fault manager configuration.  Select up to 4 actions for each fault." VALUE 0x800026B3 RecordLayout_4 0 CompuMethod_1 0 65535 /end CHARACTERISTIC
/begin CHARACTERISTIC FaultManager.Cylinder7_HardMisfire.Action_1 "Fault manager configuration.  Select up to 4 actions for each fault." VALUE 0x800026B5 RecordLayout_4 0 CompuMethod_110 0 65535 /end CHARACTERISTIC
/begin CHARACTERISTIC FaultManager.Cylinder7_HardMisfire.Action_1_Condition "Fault manager configuration.  Select up to 4 actions for each fault." VALUE 0x800026B7 RecordLayout_4 0 CompuMethod_111 0 65535 /end CHARACTERISTIC
/begin CHARACTERISTIC FaultManager.Cylinder7_HardMisfire.Action_2 "Fault manager configuration.  Select up to 4 actions for each fault." VALUE 0x800026B9 RecordLayout_4 0 CompuMethod_110 0 65535 /end CHARACTERISTIC
/begin CHARACTERISTIC FaultManager.Cylinder7_HardMisfire.Action_2_Condition "Fault manager configuration.  Select up to 4 actions for each fault." VALUE 0x800026BB RecordLayout_4 0 CompuMethod_111 0 65535 /end CHARACTERISTIC
/begin CHARACTERISTIC FaultManager.Cylinder7_HardMisfire.Action_3 "Fault manager configuration.  Select up to 4 actions for each fault." VALUE 0x800026BD RecordLayout_4 0 CompuMethod_110 0 65535 /end CHARACTERISTIC
/begin CHARACTERISTIC FaultManager.Cylinder7_HardMisfire.Action_3_Condition "Fault manager configuration.  Select up to 4 actions for each fault." VALUE 0x800026BF RecordLayout_4 0 CompuMethod_111 0 65535 /end CHARACTERISTIC
/begin CHARACTERISTIC FaultManager.Cylinder7_HardMisfire.Action_4 "Fault manager configuration.  Select up to 4 actions for each fault." VALUE 0x800026C1 RecordLayout_4 0 CompuMethod_110 0 65535 /end CHARACTERISTIC
/begin CHARACTERISTIC FaultManager.Cylinder7_HardMisfire.Action_4_Condition "Fault manager configuration.  Select up to 4 actions for each fault." VALUE 0x800026C3 RecordLayout_4 0 CompuMethod_111 0 65535 /end CHARACTERISTIC
/begin CHARACTERISTIC FaultManager.Cylinder8_HardMisfire.Mode "Fault manager configuration.  Select up to 4 actions for each fault." VALUE 0x800026C5 RecordLayout_4 0 CompuMethod_108 0 65535 /end CHARACTERISTIC
/begin CHARACTERISTIC FaultManager.Cylinder8_HardMisfire.ID "Fault manager configuration.  Select up to 4 actions for each fault." VALUE 0x800026C7 RecordLayout_4 0 CompuMethod_1 0 65535 /end CHARACTERISTIC
/begin CHARACTERISTIC FaultManager.Cylinder8_HardMisfire.Test "Fault manager configuration.  Select up to 4 actions for each fault." VALUE 0x800026C9 RecordLayout_4 0 CompuMethod_109 0 65535 /end CHARACTERISTIC
/begin CHARACTERISTIC FaultManager.Cylinder8_HardMisfire.Faulty_Samples__X_ "Fault manager configuration.  Select up to 4 actions for each fault." VALUE 0x800026CB RecordLayout_4 0 CompuMethod_1 0 65535 /end CHARACTERISTIC
/begin CHARACTERISTIC FaultManager.Cylinder8_HardMisfire.Total_Samples__Y_ "Fault manager configuration.  Select up to 4 actions for each fault." VALUE 0x800026CD RecordLayout_4 0 CompuMethod_1 0 65535 /end CHARACTERISTIC
/begin CHARACTERISTIC FaultManager.Cylinder8_HardMisfire.Action_1 "Fault manager configuration.  Select up to 4 actions for each fault." VALUE 0x800026CF RecordLayout_4 0 CompuMethod_110 0 65535 /end CHARACTERISTIC
/begin CHARACTERISTIC FaultManager.Cylinder8_HardMisfire.Action_1_Condition "Fault manager configuration.  Select up to 4 actions for each fault." VALUE 0x800026D1 RecordLayout_4 0 CompuMethod_111 0 65535 /end CHARACTERISTIC
/begin CHARACTERISTIC FaultManager.Cylinder8_HardMisfire.Action_2 "Fault manager configuration.  Select up to 4 actions for each fault." VALUE 0x800026D3 RecordLayout_4 0 CompuMethod_110 0 65535 /end CHARACTERISTIC
/begin CHARACTERISTIC FaultManager.Cylinder8_HardMisfire.Action_2_Condition "Fault manager configuration.  Select up to 4 actions for each fault." VALUE 0x800026D5 RecordLayout_4 0 CompuMethod_111 0 65535 /end CHARACTERISTIC
/begin CHARACTERISTIC FaultManager.Cylinder8_HardMisfire.Action_3 "Fault manager configuration.  Select up to 4 actions for each fault." VALUE 0x800026D7 RecordLayout_4 0 CompuMethod_110 0 65535 /end CHARACTERISTIC
/begin CHARACTERISTIC FaultManager.Cylinder8_HardMisfire.Action_3_Condition "Fault manager configuration.  Select up to 4 actions for each fault." VALUE 0x800026D9 RecordLayout_4 0 CompuMethod_111 0 65535 /end CHARACTERISTIC
/begin CHARACTERISTIC FaultManager.Cylinder8_HardMisfire.Action_4 "Fault manager configuration.  Select up to 4 actions for each fault." VALUE 0x800026DB RecordLayout_4 0 CompuMethod_110 0 65535 /end CHARACTERISTIC
/begin CHARACTERISTIC FaultManager.Cylinder8_HardMisfire.Action_4_Condition "Fault manager configuration.  Select up to 4 actions for each fault." VALUE 0x800026DD RecordLayout_4 0 CompuMethod_111 0 65535 /end CHARACTERISTIC
/begin CHARACTERISTIC FaultManager.ECTOverTempFault.Mode "Fault manager configuration.  Select up to 4 actions for each fault." VALUE 0x800026DF RecordLayout_4 0 CompuMethod_108 0 65535 /end CHARACTERISTIC
/begin CHARACTERISTIC FaultManager.ECTOverTempFault.ID "Fault manager configuration.  Select up to 4 actions for each fault." VALUE 0x800026E1 RecordLayout_4 0 CompuMethod_1 0 65535 /end CHARACTERISTIC
/begin CHARACTERISTIC FaultManager.ECTOverTempFault.Test "Fault manager configuration.  Select up to 4 actions for each fault." VALUE 0x800026E3 RecordLayout_4 0 CompuMethod_109 0 65535 /end CHARACTERISTIC
/begin CHARACTERISTIC FaultManager.ECTOverTempFault.Faulty_Samples__X_ "Fault manager configuration.  Select up to 4 actions for each fault." VALUE 0x800026E5 RecordLayout_4 0 CompuMethod_1 0 65535 /end CHARACTERISTIC
/begin CHARACTERISTIC FaultManager.ECTOverTempFault.Total_Samples__Y_ "Fault manager configuration.  Select up to 4 actions for each fault." VALUE 0x800026E7 RecordLayout_4 0 CompuMethod_1 0 65535 /end CHARACTERISTIC
/begin CHARACTERISTIC FaultManager.ECTOverTempFault.Action_1 "Fault manager configuration.  Select up to 4 actions for each fault." VALUE 0x800026E9 RecordLayout_4 0 CompuMethod_110 0 65535 /end CHARACTERISTIC
/begin CHARACTERISTIC FaultManager.ECTOverTempFault.Action_1_Condition "Fault manager configuration.  Select up to 4 actions for each fault." VALUE 0x800026EB RecordLayout_4 0 CompuMethod_111 0 65535 /end CHARACTERISTIC
/begin CHARACTERISTIC FaultManager.ECTOverTempFault.Action_2 "Fault manager configuration.  Select up to 4 actions for each fault." VALUE 0x800026ED RecordLayout_4 0 CompuMethod_110 0 65535 /end CHARACTERISTIC
/begin CHARACTERISTIC FaultManager.ECTOverTempFault.Action_2_Condition "Fault manager configuration.  Select up to 4 actions for each fault." VALUE 0x800026EF RecordLayout_4 0 CompuMethod_111 0 65535 /end CHARACTERISTIC
/begin CHARACTERISTIC FaultManager.ECTOverTempFault.Action_3 "Fault manager configuration.  Select up to 4 actions for each fault." VALUE 0x800026F1 RecordLayout_4 0 CompuMethod_110 0 65535 /end CHARACTERISTIC
/begin CHARACTERISTIC FaultManager.ECTOverTempFault.Action_3_Condition "Fault manager configuration.  Select up to 4 actions for each fault." VALUE 0x800026F3 RecordLayout_4 0 CompuMethod_111 0 65535 /end CHARACTERISTIC
/begin CHARACTERISTIC FaultManager.ECTOverTempFault.Action_4 "Fault manager configuration.  Select up to 4 actions for each fault." VALUE 0x800026F5 RecordLayout_4 0 CompuMethod_110 0 65535 /end CHARACTERISTIC
/begin CHARACTERISTIC FaultManager.ECTOverTempFault.Action_4_Condition "Fault manager configuration.  Select up to 4 actions for each fault." VALUE 0x800026F7 RecordLayout_4 0 CompuMethod_111 0 65535 /end CHARACTERISTIC
/begin CHARACTERISTIC FaultManager.ECTRangeHigh.Mode "Fault manager configuration.  Select up to 4 actions for each fault." VALUE 0x800026F9 RecordLayout_4 0 CompuMethod_108 0 65535 /end CHARACTERISTIC
/begin CHARACTERISTIC FaultManager.ECTRangeHigh.ID "Fault manager configuration.  Select up to 4 actions for each fault." VALUE 0x800026FB RecordLayout_4 0 CompuMethod_1 0 65535 /end CHARACTERISTIC
/begin CHARACTERISTIC FaultManager.ECTRangeHigh.Test "Fault manager configuration.  Select up to 4 actions for each fault." VALUE 0x800026FD RecordLayout_4 0 CompuMethod_109 0 65535 /end CHARACTERISTIC
/begin CHARACTERISTIC FaultManager.ECTRangeHigh.Faulty_Samples__X_ "Fault manager configuration.  Select up to 4 actions for each fault." VALUE 0x800026FF RecordLayout_4 0 CompuMethod_1 0 65535 /end CHARACTERISTIC
/begin CHARACTERISTIC FaultManager.ECTRangeHigh.Total_Samples__Y_ "Fault manager configuration.  Select up to 4 actions for each fault." VALUE 0x80002701 RecordLayout_4 0 CompuMethod_1 0 65535 /end CHARACTERISTIC
/begin CHARACTERISTIC FaultManager.ECTRangeHigh.Action_1 "Fault manager configuration.  Select up to 4 actions for each fault." VALUE 0x80002703 RecordLayout_4 0 CompuMethod_110 0 65535 /end CHARACTERISTIC
/begin CHARACTERISTIC FaultManager.ECTRangeHigh.Action_1_Condition "Fault manager configuration.  Select up to 4 actions for each fault." VALUE 0x80002705 RecordLayout_4 0 CompuMethod_111 0 65535 /end CHARACTERISTIC
/begin CHARACTERISTIC FaultManager.ECTRangeHigh.Action_2 "Fault manager configuration.  Select up to 4 actions for each fault." VALUE 0x80002707 RecordLayout_4 0 CompuMethod_110 0 65535 /end CHARACTERISTIC
/begin CHARACTERISTIC FaultManager.ECTRangeHigh.Action_2_Condition "Fault manager configuration.  Select up to 4 actions for each fault." VALUE 0x80002709 RecordLayout_4 0 CompuMethod_111 0 65535 /end CHARACTERISTIC
/begin CHARACTERISTIC FaultManager.ECTRangeHigh.Action_3 "Fault manager configuration.  Select up to 4 actions for each fault." VALUE 0x8000270B RecordLayout_4 0 CompuMethod_110 0 65535 /end CHARACTERISTIC
/begin CHARACTERISTIC FaultManager.ECTRangeHigh.Action_3_Condition "Fault manager configuration.  Select up to 4 actions for each fault." VALUE 0x8000270D RecordLayout_4 0 CompuMethod_111 0 65535 /end CHARACTERISTIC
/begin CHARACTERISTIC FaultManager.ECTRangeHigh.Action_4 "Fault manager configuration.  Select up to 4 actions for each fault." VALUE 0x8000270F RecordLayout_4 0 CompuMethod_110 0 65535 /end CHARACTERISTIC
/begin CHARACTERISTIC FaultManager.ECTRangeHigh.Action_4_Condition "Fault manager configuration.  Select up to 4 actions for each fault." VALUE 0x80002711 RecordLayout_4 0 CompuMethod_111 0 65535 /end CHARACTERISTIC
/begin CHARACTERISTIC FaultManager.ECTRangeLow.Mode "Fault manager configuration.  Select up to 4 actions for each fault." VALUE 0x80002713 RecordLayout_4 0 CompuMethod_108 0 65535 /end CHARACTERISTIC
/begin CHARACTERISTIC FaultManager.ECTRangeLow.ID "Fault manager configuration.  Select up to 4 actions for each fault." VALUE 0x80002715 RecordLayout_4 0 CompuMethod_1 0 65535 /end CHARACTERISTIC
/begin CHARACTERISTIC FaultManager.ECTRangeLow.Test "Fault manager configuration.  Select up to 4 actions for each fault." VALUE 0x80002717 RecordLayout_4 0 CompuMethod_109 0 65535 /end CHARACTERISTIC
/begin CHARACTERISTIC FaultManager.ECTRangeLow.Faulty_Samples__X_ "Fault manager configuration.  Select up to 4 actions for each fault." VALUE 0x80002719 RecordLayout_4 0 CompuMethod_1 0 65535 /end CHARACTERISTIC
/begin CHARACTERISTIC FaultManager.ECTRangeLow.Total_Samples__Y_ "Fault manager configuration.  Select up to 4 actions for each fault." VALUE 0x8000271B RecordLayout_4 0 CompuMethod_1 0 65535 /end CHARACTERISTIC
/begin CHARACTERISTIC FaultManager.ECTRangeLow.Action_1 "Fault manager configuration.  Select up to 4 actions for each fault." VALUE 0x8000271D RecordLayout_4 0 CompuMethod_110 0 65535 /end CHARACTERISTIC
/begin CHARACTERISTIC FaultManager.ECTRangeLow.Action_1_Condition "Fault manager configuration.  Select up to 4 actions for each fault." VALUE 0x8000271F RecordLayout_4 0 CompuMethod_111 0 65535 /end CHARACTERISTIC
/begin CHARACTERISTIC FaultManager.ECTRangeLow.Action_2 "Fault manager configuration.  Select up to 4 actions for each fault." VALUE 0x80002721 RecordLayout_4 0 CompuMethod_110 0 65535 /end CHARACTERISTIC
/begin CHARACTERISTIC FaultManager.ECTRangeLow.Action_2_Condition "Fault manager configuration.  Select up to 4 actions for each fault." VALUE 0x80002723 RecordLayout_4 0 CompuMethod_111 0 65535 /end CHARACTERISTIC
/begin CHARACTERISTIC FaultManager.ECTRangeLow.Action_3 "Fault manager configuration.  Select up to 4 actions for each fault." VALUE 0x80002725 RecordLayout_4 0 CompuMethod_110 0 65535 /end CHARACTERISTIC
/begin CHARACTERISTIC FaultManager.ECTRangeLow.Action_3_Condition "Fault manager configuration.  Select up to 4 actions for each fault." VALUE 0x80002727 RecordLayout_4 0 CompuMethod_111 0 65535 /end CHARACTERISTIC
/begin CHARACTERISTIC FaultManager.ECTRangeLow.Action_4 "Fault manager configuration.  Select up to 4 actions for each fault." VALUE 0x80002729 RecordLayout_4 0 CompuMethod_110 0 65535 /end CHARACTERISTIC
/begin CHARACTERISTIC FaultManager.ECTRangeLow.Action_4_Condition "Fault manager configuration.  Select up to 4 actions for each fault." VALUE 0x8000272B RecordLayout_4 0 CompuMethod_111 0 65535 /end CHARACTERISTIC
/begin CHARACTERISTIC FaultManager.ECTSevereOverTempFault.Mode "Fault manager configuration.  Select up to 4 actions for each fault." VALUE 0x8000272D RecordLayout_4 0 CompuMethod_108 0 65535 /end CHARACTERISTIC
/begin CHARACTERISTIC FaultManager.ECTSevereOverTempFault.ID "Fault manager configuration.  Select up to 4 actions for each fault." VALUE 0x8000272F RecordLayout_4 0 CompuMethod_1 0 65535 /end CHARACTERISTIC
/begin CHARACTERISTIC FaultManager.ECTSevereOverTempFault.Test "Fault manager configuration.  Select up to 4 actions for each fault." VALUE 0x80002731 RecordLayout_4 0 CompuMethod_109 0 65535 /end CHARACTERISTIC
/begin CHARACTERISTIC FaultManager.ECTSevereOverTempFault.Faulty_Samples__X_ "Fault manager configuration.  Select up to 4 actions for each fault." VALUE 0x80002733 RecordLayout_4 0 CompuMethod_1 0 65535 /end CHARACTERISTIC
/begin CHARACTERISTIC FaultManager.ECTSevereOverTempFault.Total_Samples__Y_ "Fault manager configuration.  Select up to 4 actions for each fault." VALUE 0x80002735 RecordLayout_4 0 CompuMethod_1 0 65535 /end CHARACTERISTIC
/begin CHARACTERISTIC FaultManager.ECTSevereOverTempFault.Action_1 "Fault manager configuration.  Select up to 4 actions for each fault." VALUE 0x80002737 RecordLayout_4 0 CompuMethod_110 0 65535 /end CHARACTERISTIC
/begin CHARACTERISTIC FaultManager.ECTSevereOverTempFault.Action_1_Condition "Fault manager configuration.  Select up to 4 actions for each fault." VALUE 0x80002739 RecordLayout_4 0 CompuMethod_111 0 65535 /end CHARACTERISTIC
/begin CHARACTERISTIC FaultManager.ECTSevereOverTempFault.Action_2 "Fault manager configuration.  Select up to 4 actions for each fault." VALUE 0x8000273B RecordLayout_4 0 CompuMethod_110 0 65535 /end CHARACTERISTIC
/begin CHARACTERISTIC FaultManager.ECTSevereOverTempFault.Action_2_Condition "Fault manager configuration.  Select up to 4 actions for each fault." VALUE 0x8000273D RecordLayout_4 0 CompuMethod_111 0 65535 /end CHARACTERISTIC
/begin CHARACTERISTIC FaultManager.ECTSevereOverTempFault.Action_3 "Fault manager configuration.  Select up to 4 actions for each fault." VALUE 0x8000273F RecordLayout_4 0 CompuMethod_110 0 65535 /end CHARACTERISTIC
/begin CHARACTERISTIC FaultManager.ECTSevereOverTempFault.Action_3_Condition "Fault manager configuration.  Select up to 4 actions for each fault." VALUE 0x80002741 RecordLayout_4 0 CompuMethod_111 0 65535 /end CHARACTERISTIC
/begin CHARACTERISTIC FaultManager.ECTSevereOverTempFault.Action_4 "Fault manager configuration.  Select up to 4 actions for each fault." VALUE 0x80002743 RecordLayout_4 0 CompuMethod_110 0 65535 /end CHARACTERISTIC
/begin CHARACTERISTIC FaultManager.ECTSevereOverTempFault.Action_4_Condition "Fault manager configuration.  Select up to 4 actions for each fault." VALUE 0x80002745 RecordLayout_4 0 CompuMethod_111 0 65535 /end CHARACTERISTIC
/begin CHARACTERISTIC FaultManager.EST1_Open.Mode "Fault manager configuration.  Select up to 4 actions for each fault." VALUE 0x80002747 RecordLayout_4 0 CompuMethod_108 0 65535 /end CHARACTERISTIC
/begin CHARACTERISTIC FaultManager.EST1_Open.ID "Fault manager configuration.  Select up to 4 actions for each fault." VALUE 0x80002749 RecordLayout_4 0 CompuMethod_1 0 65535 /end CHARACTERISTIC
/begin CHARACTERISTIC FaultManager.EST1_Open.Test "Fault manager configuration.  Select up to 4 actions for each fault." VALUE 0x8000274B RecordLayout_4 0 CompuMethod_109 0 65535 /end CHARACTERISTIC
/begin CHARACTERISTIC FaultManager.EST1_Open.Faulty_Samples__X_ "Fault manager configuration.  Select up to 4 actions for each fault." VALUE 0x8000274D RecordLayout_4 0 CompuMethod_1 0 65535 /end CHARACTERISTIC
/begin CHARACTERISTIC FaultManager.EST1_Open.Total_Samples__Y_ "Fault manager configuration.  Select up to 4 actions for each fault." VALUE 0x8000274F RecordLayout_4 0 CompuMethod_1 0 65535 /end CHARACTERISTIC
/begin CHARACTERISTIC FaultManager.EST1_Open.Action_1 "Fault manager configuration.  Select up to 4 actions for each fault." VALUE 0x80002751 RecordLayout_4 0 CompuMethod_110 0 65535 /end CHARACTERISTIC
/begin CHARACTERISTIC FaultManager.EST1_Open.Action_1_Condition "Fault manager configuration.  Select up to 4 actions for each fault." VALUE 0x80002753 RecordLayout_4 0 CompuMethod_111 0 65535 /end CHARACTERISTIC
/begin CHARACTERISTIC FaultManager.EST1_Open.Action_2 "Fault manager configuration.  Select up to 4 actions for each fault." VALUE 0x80002755 RecordLayout_4 0 CompuMethod_110 0 65535 /end CHARACTERISTIC
/begin CHARACTERISTIC FaultManager.EST1_Open.Action_2_Condition "Fault manager configuration.  Select up to 4 actions for each fault." VALUE 0x80002757 RecordLayout_4 0 CompuMethod_111 0 65535 /end CHARACTERISTIC
/begin CHARACTERISTIC FaultManager.EST1_Open.Action_3 "Fault manager configuration.  Select up to 4 actions for each fault." VALUE 0x80002759 RecordLayout_4 0 CompuMethod_110 0 65535 /end CHARACTERISTIC
/begin CHARACTERISTIC FaultManager.EST1_Open.Action_3_Condition "Fault manager configuration.  Select up to 4 actions for each fault." VALUE 0x8000275B RecordLayout_4 0 CompuMethod_111 0 65535 /end CHARACTERISTIC
/begin CHARACTERISTIC FaultManager.EST1_Open.Action_4 "Fault manager configuration.  Select up to 4 actions for each fault." VALUE 0x8000275D RecordLayout_4 0 CompuMethod_110 0 65535 /end CHARACTERISTIC
/begin CHARACTERISTIC FaultManager.EST1_Open.Action_4_Condition "Fault manager configuration.  Select up to 4 actions for each fault." VALUE 0x8000275F RecordLayout_4 0 CompuMethod_111 0 65535 /end CHARACTERISTIC
/begin CHARACTERISTIC FaultManager.EST1_Short.Mode "Fault manager configuration.  Select up to 4 actions for each fault." VALUE 0x80002761 RecordLayout_4 0 CompuMethod_108 0 65535 /end CHARACTERISTIC
/begin CHARACTERISTIC FaultManager.EST1_Short.ID "Fault manager configuration.  Select up to 4 actions for each fault." VALUE 0x80002763 RecordLayout_4 0 CompuMethod_1 0 65535 /end CHARACTERISTIC
/begin CHARACTERISTIC FaultManager.EST1_Short.Test "Fault manager configuration.  Select up to 4 actions for each fault." VALUE 0x80002765 RecordLayout_4 0 CompuMethod_109 0 65535 /end CHARACTERISTIC
/begin CHARACTERISTIC FaultManager.EST1_Short.Faulty_Samples__X_ "Fault manager configuration.  Select up to 4 actions for each fault." VALUE 0x80002767 RecordLayout_4 0 CompuMethod_1 0 65535 /end CHARACTERISTIC
/begin CHARACTERISTIC FaultManager.EST1_Short.Total_Samples__Y_ "Fault manager configuration.  Select up to 4 actions for each fault." VALUE 0x80002769 RecordLayout_4 0 CompuMethod_1 0 65535 /end CHARACTERISTIC
/begin CHARACTERISTIC FaultManager.EST1_Short.Action_1 "Fault manager configuration.  Select up to 4 actions for each fault." VALUE 0x8000276B RecordLayout_4 0 CompuMethod_110 0 65535 /end CHARACTERISTIC
/begin CHARACTERISTIC FaultManager.EST1_Short.Action_1_Condition "Fault manager configuration.  Select up to 4 actions for each fault." VALUE 0x8000276D RecordLayout_4 0 CompuMethod_111 0 65535 /end CHARACTERISTIC
/begin CHARACTERISTIC FaultManager.EST1_Short.Action_2 "Fault manager configuration.  Select up to 4 actions for each fault." VALUE 0x8000276F RecordLayout_4 0 CompuMethod_110 0 65535 /end CHARACTERISTIC
/begin CHARACTERISTIC FaultManager.EST1_Short.Action_2_Condition "Fault manager configuration.  Select up to 4 actions for each fault." VALUE 0x80002771 RecordLayout_4 0 CompuMethod_111 0 65535 /end CHARACTERISTIC
/begin CHARACTERISTIC FaultManager.EST1_Short.Action_3 "Fault manager configuration.  Select up to 4 actions for each fault." VALUE 0x80002773 RecordLayout_4 0 CompuMethod_110 0 65535 /end CHARACTERISTIC
/begin CHARACTERISTIC FaultManager.EST1_Short.Action_3_Condition "Fault manager configuration.  Select up to 4 actions for each fault." VALUE 0x80002775 RecordLayout_4 0 CompuMethod_111 0 65535 /end CHARACTERISTIC
/begin CHARACTERISTIC FaultManager.EST1_Short.Action_4 "Fault manager configuration.  Select up to 4 actions for each fault." VALUE 0x80002777 RecordLayout_4 0 CompuMethod_110 0 65535 /end CHARACTERISTIC
/begin CHARACTERISTIC FaultManager.EST1_Short.Action_4_Condition "Fault manager configuration.  Select up to 4 actions for each fault." VALUE 0x80002779 RecordLayout_4 0 CompuMethod_111 0 65535 /end CHARACTERISTIC
/begin CHARACTERISTIC FaultManager.EST2_Open.Mode "Fault manager configuration.  Select up to 4 actions for each fault." VALUE 0x8000277B RecordLayout_4 0 CompuMethod_108 0 65535 /end CHARACTERISTIC
/begin CHARACTERISTIC FaultManager.EST2_Open.ID "Fault manager configuration.  Select up to 4 actions for each fault." VALUE 0x8000277D RecordLayout_4 0 CompuMethod_1 0 65535 /end CHARACTERISTIC
/begin CHARACTERISTIC FaultManager.EST2_Open.Test "Fault manager configuration.  Select up to 4 actions for each fault." VALUE 0x8000277F RecordLayout_4 0 CompuMethod_109 0 65535 /end CHARACTERISTIC
/begin CHARACTERISTIC FaultManager.EST2_Open.Faulty_Samples__X_ "Fault manager configuration.  Select up to 4 actions for each fault." VALUE 0x80002781 RecordLayout_4 0 CompuMethod_1 0 65535 /end CHARACTERISTIC
/begin CHARACTERISTIC FaultManager.EST2_Open.Total_Samples__Y_ "Fault manager configuration.  Select up to 4 actions for each fault." VALUE 0x80002783 RecordLayout_4 0 CompuMethod_1 0 65535 /end CHARACTERISTIC
/begin CHARACTERISTIC FaultManager.EST2_Open.Action_1 "Fault manager configuration.  Select up to 4 actions for each fault." VALUE 0x80002785 RecordLayout_4 0 CompuMethod_110 0 65535 /end CHARACTERISTIC
/begin CHARACTERISTIC FaultManager.EST2_Open.Action_1_Condition "Fault manager configuration.  Select up to 4 actions for each fault." VALUE 0x80002787 RecordLayout_4 0 CompuMethod_111 0 65535 /end CHARACTERISTIC
/begin CHARACTERISTIC FaultManager.EST2_Open.Action_2 "Fault manager configuration.  Select up to 4 actions for each fault." VALUE 0x80002789 RecordLayout_4 0 CompuMethod_110 0 65535 /end CHARACTERISTIC
/begin CHARACTERISTIC FaultManager.EST2_Open.Action_2_Condition "Fault manager configuration.  Select up to 4 actions for each fault." VALUE 0x8000278B RecordLayout_4 0 CompuMethod_111 0 65535 /end CHARACTERISTIC
/begin CHARACTERISTIC FaultManager.EST2_Open.Action_3 "Fault manager configuration.  Select up to 4 actions for each fault." VALUE 0x8000278D RecordLayout_4 0 CompuMethod_110 0 65535 /end CHARACTERISTIC
/begin CHARACTERISTIC FaultManager.EST2_Open.Action_3_Condition "Fault manager configuration.  Select up to 4 actions for each fault." VALUE 0x8000278F RecordLayout_4 0 CompuMethod_111 0 65535 /end CHARACTERISTIC
/begin CHARACTERISTIC FaultManager.EST2_Open.Action_4 "Fault manager configuration.  Select up to 4 actions for each fault." VALUE 0x80002791 RecordLayout_4 0 CompuMethod_110 0 65535 /end CHARACTERISTIC
/begin CHARACTERISTIC FaultManager.EST2_Open.Action_4_Condition "Fault manager configuration.  Select up to 4 actions for each fault." VALUE 0x80002793 RecordLayout_4 0 CompuMethod_111 0 65535 /end CHARACTERISTIC
/begin CHARACTERISTIC FaultManager.EST2_Short.Mode "Fault manager configuration.  Select up to 4 actions for each fault." VALUE 0x80002795 RecordLayout_4 0 CompuMethod_108 0 65535 /end CHARACTERISTIC
/begin CHARACTERISTIC FaultManager.EST2_Short.ID "Fault manager configuration.  Select up to 4 actions for each fault." VALUE 0x80002797 RecordLayout_4 0 CompuMethod_1 0 65535 /end CHARACTERISTIC
/begin CHARACTERISTIC FaultManager.EST2_Short.Test "Fault manager configuration.  Select up to 4 actions for each fault." VALUE 0x80002799 RecordLayout_4 0 CompuMethod_109 0 65535 /end CHARACTERISTIC
/begin CHARACTERISTIC FaultManager.EST2_Short.Faulty_Samples__X_ "Fault manager configuration.  Select up to 4 actions for each fault." VALUE 0x8000279B RecordLayout_4 0 CompuMethod_1 0 65535 /end CHARACTERISTIC
/begin CHARACTERISTIC FaultManager.EST2_Short.Total_Samples__Y_ "Fault manager configuration.  Select up to 4 actions for each fault." VALUE 0x8000279D RecordLayout_4 0 CompuMethod_1 0 65535 /end CHARACTERISTIC
/begin CHARACTERISTIC FaultManager.EST2_Short.Action_1 "Fault manager configuration.  Select up to 4 actions for each fault." VALUE 0x8000279F RecordLayout_4 0 CompuMethod_110 0 65535 /end CHARACTERISTIC
/begin CHARACTERISTIC FaultManager.EST2_Short.Action_1_Condition "Fault manager configuration.  Select up to 4 actions for each fault." VALUE 0x800027A1 RecordLayout_4 0 CompuMethod_111 0 65535 /end CHARACTERISTIC
/begin CHARACTERISTIC FaultManager.EST2_Short.Action_2 "Fault manager configuration.  Select up to 4 actions for each fault." VALUE 0x800027A3 RecordLayout_4 0 CompuMethod_110 0 65535 /end CHARACTERISTIC
/begin CHARACTERISTIC FaultManager.EST2_Short.Action_2_Condition "Fault manager configuration.  Select up to 4 actions for each fault." VALUE 0x800027A5 RecordLayout_4 0 CompuMethod_111 0 65535 /end CHARACTERISTIC
/begin CHARACTERISTIC FaultManager.EST2_Short.Action_3 "Fault manager configuration.  Select up to 4 actions for each fault." VALUE 0x800027A7 RecordLayout_4 0 CompuMethod_110 0 65535 /end CHARACTERISTIC
/begin CHARACTERISTIC FaultManager.EST2_Short.Action_3_Condition "Fault manager configuration.  Select up to 4 actions for each fault." VALUE 0x800027A9 RecordLayout_4 0 CompuMethod_111 0 65535 /end CHARACTERISTIC
/begin CHARACTERISTIC FaultManager.EST2_Short.Action_4 "Fault manager configuration.  Select up to 4 actions for each fault." VALUE 0x800027AB RecordLayout_4 0 CompuMethod_110 0 65535 /end CHARACTERISTIC
/begin CHARACTERISTIC FaultManager.EST2_Short.Action_4_Condition "Fault manager configuration.  Select up to 4 actions for each fault." VALUE 0x800027AD RecordLayout_4 0 CompuMethod_111 0 65535 /end CHARACTERISTIC
/begin CHARACTERISTIC FaultManager.EST3_Open.Mode "Fault manager configuration.  Select up to 4 actions for each fault." VALUE 0x800027AF RecordLayout_4 0 CompuMethod_108 0 65535 /end CHARACTERISTIC
/begin CHARACTERISTIC FaultManager.EST3_Open.ID "Fault manager configuration.  Select up to 4 actions for each fault." VALUE 0x800027B1 RecordLayout_4 0 CompuMethod_1 0 65535 /end CHARACTERISTIC
/begin CHARACTERISTIC FaultManager.EST3_Open.Test "Fault manager configuration.  Select up to 4 actions for each fault." VALUE 0x800027B3 RecordLayout_4 0 CompuMethod_109 0 65535 /end CHARACTERISTIC
/begin CHARACTERISTIC FaultManager.EST3_Open.Faulty_Samples__X_ "Fault manager configuration.  Select up to 4 actions for each fault." VALUE 0x800027B5 RecordLayout_4 0 CompuMethod_1 0 65535 /end CHARACTERISTIC
/begin CHARACTERISTIC FaultManager.EST3_Open.Total_Samples__Y_ "Fault manager configuration.  Select up to 4 actions for each fault." VALUE 0x800027B7 RecordLayout_4 0 CompuMethod_1 0 65535 /end CHARACTERISTIC
/begin CHARACTERISTIC FaultManager.EST3_Open.Action_1 "Fault manager configuration.  Select up to 4 actions for each fault." VALUE 0x800027B9 RecordLayout_4 0 CompuMethod_110 0 65535 /end CHARACTERISTIC
/begin CHARACTERISTIC FaultManager.EST3_Open.Action_1_Condition "Fault manager configuration.  Select up to 4 actions for each fault." VALUE 0x800027BB RecordLayout_4 0 CompuMethod_111 0 65535 /end CHARACTERISTIC
/begin CHARACTERISTIC FaultManager.EST3_Open.Action_2 "Fault manager configuration.  Select up to 4 actions for each fault." VALUE 0x800027BD RecordLayout_4 0 CompuMethod_110 0 65535 /end CHARACTERISTIC
/begin CHARACTERISTIC FaultManager.EST3_Open.Action_2_Condition "Fault manager configuration.  Select up to 4 actions for each fault." VALUE 0x800027BF RecordLayout_4 0 CompuMethod_111 0 65535 /end CHARACTERISTIC
/begin CHARACTERISTIC FaultManager.EST3_Open.Action_3 "Fault manager configuration.  Select up to 4 actions for each fault." VALUE 0x800027C1 RecordLayout_4 0 CompuMethod_110 0 65535 /end CHARACTERISTIC
/begin CHARACTERISTIC FaultManager.EST3_Open.Action_3_Condition "Fault manager configuration.  Select up to 4 actions for each fault." VALUE 0x800027C3 RecordLayout_4 0 CompuMethod_111 0 65535 /end CHARACTERISTIC
/begin CHARACTERISTIC FaultManager.EST3_Open.Action_4 "Fault manager configuration.  Select up to 4 actions for each fault." VALUE 0x800027C5 RecordLayout_4 0 CompuMethod_110 0 65535 /end CHARACTERISTIC
/begin CHARACTERISTIC FaultManager.EST3_Open.Action_4_Condition "Fault manager configuration.  Select up to 4 actions for each fault." VALUE 0x800027C7 RecordLayout_4 0 CompuMethod_111 0 65535 /end CHARACTERISTIC
/begin CHARACTERISTIC FaultManager.EST3_Short.Mode "Fault manager configuration.  Select up to 4 actions for each fault." VALUE 0x800027C9 RecordLayout_4 0 CompuMethod_108 0 65535 /end CHARACTERISTIC
/begin CHARACTERISTIC FaultManager.EST3_Short.ID "Fault manager configuration.  Select up to 4 actions for each fault." VALUE 0x800027CB RecordLayout_4 0 CompuMethod_1 0 65535 /end CHARACTERISTIC
/begin CHARACTERISTIC FaultManager.EST3_Short.Test "Fault manager configuration.  Select up to 4 actions for each fault." VALUE 0x800027CD RecordLayout_4 0 CompuMethod_109 0 65535 /end CHARACTERISTIC
/begin CHARACTERISTIC FaultManager.EST3_Short.Faulty_Samples__X_ "Fault manager configuration.  Select up to 4 actions for each fault." VALUE 0x800027CF RecordLayout_4 0 CompuMethod_1 0 65535 /end CHARACTERISTIC
/begin CHARACTERISTIC FaultManager.EST3_Short.Total_Samples__Y_ "Fault manager configuration.  Select up to 4 actions for each fault." VALUE 0x800027D1 RecordLayout_4 0 CompuMethod_1 0 65535 /end CHARACTERISTIC
/begin CHARACTERISTIC FaultManager.EST3_Short.Action_1 "Fault manager configuration.  Select up to 4 actions for each fault." VALUE 0x800027D3 RecordLayout_4 0 CompuMethod_110 0 65535 /end CHARACTERISTIC
/begin CHARACTERISTIC FaultManager.EST3_Short.Action_1_Condition "Fault manager configuration.  Select up to 4 actions for each fault." VALUE 0x800027D5 RecordLayout_4 0 CompuMethod_111 0 65535 /end CHARACTERISTIC
/begin CHARACTERISTIC FaultManager.EST3_Short.Action_2 "Fault manager configuration.  Select up to 4 actions for each fault." VALUE 0x800027D7 RecordLayout_4 0 CompuMethod_110 0 65535 /end CHARACTERISTIC
/begin CHARACTERISTIC FaultManager.EST3_Short.Action_2_Condition "Fault manager configuration.  Select up to 4 actions for each fault." VALUE 0x800027D9 RecordLayout_4 0 CompuMethod_111 0 65535 /end CHARACTERISTIC
/begin CHARACTERISTIC FaultManager.EST3_Short.Action_3 "Fault manager configuration.  Select up to 4 actions for each fault." VALUE 0x800027DB RecordLayout_4 0 CompuMethod_110 0 65535 /end CHARACTERISTIC
/begin CHARACTERISTIC FaultManager.EST3_Short.Action_3_Condition "Fault manager configuration.  Select up to 4 actions for each fault." VALUE 0x800027DD RecordLayout_4 0 CompuMethod_111 0 65535 /end CHARACTERISTIC
/begin CHARACTERISTIC FaultManager.EST3_Short.Action_4 "Fault manager configuration.  Select up to 4 actions for each fault." VALUE 0x800027DF RecordLayout_4 0 CompuMethod_110 0 65535 /end CHARACTERISTIC
/begin CHARACTERISTIC FaultManager.EST3_Short.Action_4_Condition "Fault manager configuration.  Select up to 4 actions for each fault." VALUE 0x800027E1 RecordLayout_4 0 CompuMethod_111 0 65535 /end CHARACTERISTIC
/begin CHARACTERISTIC FaultManager.EST4_Open.Mode "Fault manager configuration.  Select up to 4 actions for each fault." VALUE 0x800027E3 RecordLayout_4 0 CompuMethod_108 0 65535 /end CHARACTERISTIC
/begin CHARACTERISTIC FaultManager.EST4_Open.ID "Fault manager configuration.  Select up to 4 actions for each fault." VALUE 0x800027E5 RecordLayout_4 0 CompuMethod_1 0 65535 /end CHARACTERISTIC
/begin CHARACTERISTIC FaultManager.EST4_Open.Test "Fault manager configuration.  Select up to 4 actions for each fault." VALUE 0x800027E7 RecordLayout_4 0 CompuMethod_109 0 65535 /end CHARACTERISTIC
/begin CHARACTERISTIC FaultManager.EST4_Open.Faulty_Samples__X_ "Fault manager configuration.  Select up to 4 actions for each fault." VALUE 0x800027E9 RecordLayout_4 0 CompuMethod_1 0 65535 /end CHARACTERISTIC
/begin CHARACTERISTIC FaultManager.EST4_Open.Total_Samples__Y_ "Fault manager configuration.  Select up to 4 actions for each fault." VALUE 0x800027EB RecordLayout_4 0 CompuMethod_1 0 65535 /end CHARACTERISTIC
/begin CHARACTERISTIC FaultManager.EST4_Open.Action_1 "Fault manager configuration.  Select up to 4 actions for each fault." VALUE 0x800027ED RecordLayout_4 0 CompuMethod_110 0 65535 /end CHARACTERISTIC
/begin CHARACTERISTIC FaultManager.EST4_Open.Action_1_Condition "Fault manager configuration.  Select up to 4 actions for each fault." VALUE 0x800027EF RecordLayout_4 0 CompuMethod_111 0 65535 /end CHARACTERISTIC
/begin CHARACTERISTIC FaultManager.EST4_Open.Action_2 "Fault manager configuration.  Select up to 4 actions for each fault." VALUE 0x800027F1 RecordLayout_4 0 CompuMethod_110 0 65535 /end CHARACTERISTIC
/begin CHARACTERISTIC FaultManager.EST4_Open.Action_2_Condition "Fault manager configuration.  Select up to 4 actions for each fault." VALUE 0x800027F3 RecordLayout_4 0 CompuMethod_111 0 65535 /end CHARACTERISTIC
/begin CHARACTERISTIC FaultManager.EST4_Open.Action_3 "Fault manager configuration.  Select up to 4 actions for each fault." VALUE 0x800027F5 RecordLayout_4 0 CompuMethod_110 0 65535 /end CHARACTERISTIC
/begin CHARACTERISTIC FaultManager.EST4_Open.Action_3_Condition "Fault manager configuration.  Select up to 4 actions for each fault." VALUE 0x800027F7 RecordLayout_4 0 CompuMethod_111 0 65535 /end CHARACTERISTIC
/begin CHARACTERISTIC FaultManager.EST4_Open.Action_4 "Fault manager configuration.  Select up to 4 actions for each fault." VALUE 0x800027F9 RecordLayout_4 0 CompuMethod_110 0 65535 /end CHARACTERISTIC
/begin CHARACTERISTIC FaultManager.EST4_Open.Action_4_Condition "Fault manager configuration.  Select up to 4 actions for each fault." VALUE 0x800027FB RecordLayout_4 0 CompuMethod_111 0 65535 /end CHARACTERISTIC
/begin CHARACTERISTIC FaultManager.EST4_Short.Mode "Fault manager configuration.  Select up to 4 actions for each fault." VALUE 0x800027FD RecordLayout_4 0 CompuMethod_108 0 65535 /end CHARACTERISTIC
/begin CHARACTERISTIC FaultManager.EST4_Short.ID "Fault manager configuration.  Select up to 4 actions for each fault." VALUE 0x800027FF RecordLayout_4 0 CompuMethod_1 0 65535 /end CHARACTERISTIC
/begin CHARACTERISTIC FaultManager.EST4_Short.Test "Fault manager configuration.  Select up to 4 actions for each fault." VALUE 0x80002801 RecordLayout_4 0 CompuMethod_109 0 65535 /end CHARACTERISTIC
/begin CHARACTERISTIC FaultManager.EST4_Short.Faulty_Samples__X_ "Fault manager configuration.  Select up to 4 actions for each fault." VALUE 0x80002803 RecordLayout_4 0 CompuMethod_1 0 65535 /end CHARACTERISTIC
/begin CHARACTERISTIC FaultManager.EST4_Short.Total_Samples__Y_ "Fault manager configuration.  Select up to 4 actions for each fault." VALUE 0x80002805 RecordLayout_4 0 CompuMethod_1 0 65535 /end CHARACTERISTIC
/begin CHARACTERISTIC FaultManager.EST4_Short.Action_1 "Fault manager configuration.  Select up to 4 actions for each fault." VALUE 0x80002807 RecordLayout_4 0 CompuMethod_110 0 65535 /end CHARACTERISTIC
/begin CHARACTERISTIC FaultManager.EST4_Short.Action_1_Condition "Fault manager configuration.  Select up to 4 actions for each fault." VALUE 0x80002809 RecordLayout_4 0 CompuMethod_111 0 65535 /end CHARACTERISTIC
/begin CHARACTERISTIC FaultManager.EST4_Short.Action_2 "Fault manager configuration.  Select up to 4 actions for each fault." VALUE 0x8000280B RecordLayout_4 0 CompuMethod_110 0 65535 /end CHARACTERISTIC
/begin CHARACTERISTIC FaultManager.EST4_Short.Action_2_Condition "Fault manager configuration.  Select up to 4 actions for each fault." VALUE 0x8000280D RecordLayout_4 0 CompuMethod_111 0 65535 /end CHARACTERISTIC
/begin CHARACTERISTIC FaultManager.EST4_Short.Action_3 "Fault manager configuration.  Select up to 4 actions for each fault." VALUE 0x8000280F RecordLayout_4 0 CompuMethod_110 0 65535 /end CHARACTERISTIC
/begin CHARACTERISTIC FaultManager.EST4_Short.Action_3_Condition "Fault manager configuration.  Select up to 4 actions for each fault." VALUE 0x80002811 RecordLayout_4 0 CompuMethod_111 0 65535 /end CHARACTERISTIC
/begin CHARACTERISTIC FaultManager.EST4_Short.Action_4 "Fault manager configuration.  Select up to 4 actions for each fault." VALUE 0x80002813 RecordLayout_4 0 CompuMethod_110 0 65535 /end CHARACTERISTIC
/begin CHARACTERISTIC FaultManager.EST4_Short.Action_4_Condition "Fault manager configuration.  Select up to 4 actions for each fault." VALUE 0x80002815 RecordLayout_4 0 CompuMethod_111 0 65535 /end CHARACTERISTIC
/begin CHARACTERISTIC FaultManager.EST5_Open.Mode "Fault manager configuration.  Select up to 4 actions for each fault." VALUE 0x80002817 RecordLayout_4 0 CompuMethod_108 0 65535 /end CHARACTERISTIC
/begin CHARACTERISTIC FaultManager.EST5_Open.ID "Fault manager configuration.  Select up to 4 actions for each fault." VALUE 0x80002819 RecordLayout_4 0 CompuMethod_1 0 65535 /end CHARACTERISTIC
/begin CHARACTERISTIC FaultManager.EST5_Open.Test "Fault manager configuration.  Select up to 4 actions for each fault." VALUE 0x8000281B RecordLayout_4 0 CompuMethod_109 0 65535 /end CHARACTERISTIC
/begin CHARACTERISTIC MatlabVersionTxt "MATLAB version used to build the application." ASCII 0x400006C7 RecordLayout_2 0 CompuMethod_2 0 255 NUMBER 80 MATRIX_DIM 80 1 1 READ_ONLY /end CHARACTERISTIC
/begin CHARACTERISTIC MotoHawkBuildGUID "GUID identifying the MotoHawk build session" ASCII 0x40000775 RecordLayout_2 0 CompuMethod_2 0 255 NUMBER 80 MATRIX_DIM 80 1 1 READ_ONLY /end CHARACTERISTIC
/begin CHARACTERISTIC MotoHawkModelGUID "GUID identifying the MotoHawk model" ASCII 0x400007C5 RecordLayout_2 0 CompuMethod_2 0 255 NUMBER 80 MATRIX_DIM 80 1 1 READ_ONLY /end CHARACTERISTIC
/begin CHARACTERISTIC MotoHawkModelName "Simulink model name used for the MotoHawk build" ASCII 0x40000815 RecordLayout_2 0 CompuMethod_2 0 255 NUMBER 80 MATRIX_DIM 80 1 1 READ_ONLY /end CHARACTERISTIC
/begin CHARACTERISTIC MotoHawkTokenGUID "GUID identifying the token inserted during the build.  May be empty if no token was available" ASCII 0x40000869 RecordLayout_2 0 CompuMethod_2 0 255 NUMBER 80 MATRIX_DIM 80 1 1 READ_ONLY /end CHARACTERISTIC
/begin CHARACTERISTIC MotoHawkVersionTxt "MotoHawk version used to build the application." ASCII 0x400008B9 RecordLayout_2 0 CompuMethod_2 0 255 NUMBER 50 MATRIX_DIM 50 1 1 READ_ONLY /end CHARACTERISTIC
/begin CHARACTERISTIC PartNumber "" ASCII 0x40000986 RecordLayout_2 0 CompuMethod_2 0 255 NUMBER 40 MATRIX_DIM 40 1 1 READ_ONLY /end CHARACTERISTIC
/begin CHARACTERISTIC PasswordTxt "Password protection for this calibration" ASCII 0x8000480D RecordLayout_2 0 CompuMethod_2 0 255 NUMBER 33 MATRIX_DIM 33 1 1 /end CHARACTERISTIC
/*~~~~~~~~~ 6.3.106 RECORD_LAYOUTs ~~~~~~~~~*/
/begin RECORD_LAYOUT RecordLayout_1 FNC_VALUES 1 UBYTE ROW_DIR DIRECT /end RECORD_LAYOUT
/begin RECORD_LAYOUT RecordLayout_2 FNC_VALUES 1 UBYTE ROW_DIR DIRECT /end RECORD_LAYOUT
/begin RECORD_LAYOUT RecordLayout_3 FNC_VALUES 1 ULONG ROW_DIR DIRECT /end RECORD_LAYOUT
/begin RECORD_LAYOUT RecordLayout_4 FNC_VALUES 1 UWORD ROW_DIR DIRECT /end RECORD_LAYOUT
/*~~~~~~~~~ 6.3.31 COMPU_METHODs ~~~~~~~~~*/
/begin COMPU_METHOD CompuMethod_1 "" RAT_FUNC "%3.0" "" COEFFS 0 1 0 0 0 1 /end COMPU_METHOD
/begin COMPU_METHOD CompuMethod_2 "" RAT_FUNC "%6.2" "" COEFFS 0 1 0 0 0 1 /end COMPU_METHOD
/begin COMPU_METHOD CompuMethod_3 "" RAT_FUNC "%6.2" "ID" COEFFS 0 1 0 0 0 1 /end COMPU_METHOD
/begin COMPU_METHOD CompuMethod_4 "" RAT_FUNC "%1.0" "bool" COEFFS 0 1 0 0 0 1 /end COMPU_METHOD
/begin COMPU_METHOD CompuMethod_11 "" RAT_FUNC "%1.0" "" COEFFS 0 1 0 0 0 1 /end COMPU_METHOD
/begin COMPU_METHOD CompuMethod_106 "" TAB_VERB "%3.0" "" COMPU_TAB_REF CompuVtab_31 /end COMPU_METHOD
/begin COMPU_METHOD CompuMethod_107 "" TAB_VERB "%3.0" "" COMPU_TAB_REF CompuVtab_32 /end COMPU_METHOD
/begin COMPU_METHOD CompuMethod_108 "" TAB_VERB "%3.0" "" COMPU_TAB_REF CompuVtab_33 /end COMPU_METHOD
/begin COMPU_METHOD CompuMethod_109 "" TAB_VERB "%3.0" "" COMPU_TAB_REF CompuVtab_34 /end COMPU_METHOD
/begin COMPU_METHOD CompuMethod_110 "" TAB_VERB "%3.0" "" COMPU_TAB_REF CompuVtab_35 /end COMPU_METHOD
/begin COMPU_METHOD CompuMethod_111 "" TAB_VERB "%3.0" "" COMPU_TAB_REF CompuVtab_36 /end COMPU_METHOD
/begin COMPU_METHOD CompuMethod_144 "" TAB_VERB "%3.0" "" COMPU_TAB_REF CompuVtab_54 /end COMPU_METHOD
/begin COMPU_METHOD CompuMethod_145 "" RAT_FUNC "%8.0" "seconds" COEFFS 0 1 0 0 0 1 /end COMPU_METHOD
/begin COMPU_METHOD CompuMethod_172 "" RAT_FUNC "%5.0" "MHz" COEFFS 0 1 0 0 0 1E-06 /end COMPU_METHOD
/begin COMPU_METHOD CompuMethod_175 "" TAB_VERB "%1.0" "" COMPU_TAB_REF CompuVtab_69 /end COMPU_METHOD
/begin COMPU_VTAB CompuVtab_31 "" TAB_VERB 154 0 "ACChargeHigh_Fault" 1 "ACChargeLow_Fault" 2 "ACPresRangeHigh" 3 "ACPresRangeLow" 4 "APP1_AdaptAdaptHiMax" 5 "APP1_AdaptAdaptHiMin" 6 "APP1_AdaptAdaptLoMax" 7 "APP1_AdaptAdaptLoMin" 8 "APP1_AdaptRangeHigh" 9 "APP1_AdaptRangeLow" 10 "APP2_AdaptAdaptHiMax" 11 "APP2_AdaptAdaptHiMin" 12 "APP2_AdaptAdaptLoMax" 13 "APP2_AdaptAdaptLoMin" 14 "APP2_AdaptRangeHigh" 15 "APP2_AdaptRangeLow" 16 "APP_Sensors_Conflict" 17 "AirflowMismatch_Fault" 18 "AltInop_Fault" 19 "Bank1_EquivRatioRangeHigh" 20 "Bank1_EquivRatioRangeLow" 21 "Bank2_EquivRatioRangeHigh" 22 "Bank2_EquivRatioRangeLow" 23 "CamEdgesFault" 24 "CamSyncFault" 25 "ClutchStuckHigh_Fault" 26 "CrankEdgesFault" 27 "CrankSyncFault" 28 "Cylinder1_HardMisfire" 29 "Cylinder2_HardMisfire" 30 "Cylinder3_HardMisfire" 31 "Cylinder4_HardMisfire" 32 "Cylinder5_HardMisfire" 33 "Cylinder6_HardMisfire" 34 "Cylinder7_HardMisfire" 35 "Cylinder8_HardMisfire" 36 "ECTOverTempFault" 37 "ECTRangeHigh" 38 "ECTRangeLow" 39 "ECTSevereOverTempFault" 40 "EST1_Open" 41 "EST1_Short" 42 "EST2_Open" 43 "EST2_Short" 44 "EST3_Open" 45 "EST3_Short" 46 "EST4_Open" 47 "EST4_Short" 48 "EST5_Open" 49 "EST5_Short" 50 "EST6_Open" 51 "EST6_Short" 52 "EST7_Open" 53 "EST7_Short" 54 "EST8_Open" 55 "EST8_Short" 56 "ETCSpringTest" 57 "ETC_Open_Fault" 58 "ETC_Sticking" 59 "EVAPRangeHigh" 60 "EVAPRangeLow" 61 "FuelAdaptRangeHi_BankA" 62 "FuelAdaptRangeHi_BankB" 63 "FuelAdaptRangeLow_BankA" 64 "FuelAdaptRangeLow_BankB" 65 "FuelPresHigh_Fault" 66 "FuelPresLow_Fault" 67 "FuelPresRangeHigh" 68 "FuelPresRangeLow" 69 "FuelSensRangeHigh" 70 "FuelSensRangeLow" 71 "Fuel_LvlRangeHigh" 72 "Fuel_LvlRangeLow" 73 "GPS_DateTime_Timeout" 74 "GPS_LatLong_Timeout" 75 "GPS_SpeedDir_Timeout" 76 "HardOverspeed" 77 "IATRangeHigh" 78 "IATRangeLow" 79 "Inj1Open" 80 "Inj2Open" 81 "Inj3Open" 82 "Inj4Open" 83 "Inj5Open" 84 "Inj6Open" 85 "Inj7Open" 86 "Inj8Open" 87 "Lambda1Error_Fault" 88 "Lambda1Fault_Fault" 89 "Lambda1HtrOpen_Fault" 90 "Lambda1HtrShort_Fault" 91 "Lambda1Overcool_Fault" 92 "Lambda1Overheat_Fault" 93 "Lambda1StuckInReset_Fault" 94 "Lambda1StuckInWarmup_Fault" 95 "Lambda1VoltHigh_Fault" 96 "Lambda1VoltLow_Fault" 97 "Lambda2Error_Fault" 98 "Lambda2Fault_Fault" 99 "Lambda2HtrOpen_Fault" 100 "Lambda2HtrShort_Fault" 101 "Lambda2Overcool_Fault" 102 "Lambda2Overheat_Fault" 103 "Lambda2StuckInReset_Fault" 104 "Lambda2StuckInWarmup_Fault" 105 "Lambda2VoltHigh_Fault" 106 "Lambda2VoltLow_Fault" 107 "Lambda_1_Timeout" 108 "Lambda_2_Timeout" 109 "Lambda_Bank2Bank_Fault" 110 "LeanProtect_Fault" 111 "MAFRangeHigh" 112 "MAFRangeLow" 113 "MAPRangeHigh" 114 "MAPRangeLow" 115 "MAPTimeRangeHigh" 116 "MAPTimeRangeLow" 117 "MAP_IR_HI" 118 "MAP_IR_LO" 119 "MAP_STICKING" 120 "MediumOverspeed" 121 "NoOil_Fault" 122 "O2FailedLean_BankA" 123 "O2FailedLean_BankB" 124 "O2FailedRich_BankA" 125 "O2FailedRich_BankB" 126 "O2NotActive_BankA" 127 "O2NotActive_BankB" 128 "OilPresRangeHigh" 129 "OilPresRangeLow" 130 "ScrambleStuckHigh_Fault" 131 "SensVoltRangeHigh" 132 "SensVoltRangeLow" 133 "SoftOverspeed" 134 "SysVoltRangeHigh" 135 "SysVoltRangeLow" 136 "TPS1AdaptHiMax" 137 "TPS1AdaptHiMin" 138 "TPS1AdaptLoMax" 139 "TPS1AdaptLoMin" 140 "TPS1RangeHigh" 141 "TPS1RangeLow" 142 "TPS2AdaptHiMax" 143 "TPS2AdaptHiMin" 144 "TPS2AdaptLoMax" 145 "TPS2AdaptLoMin" 146 "TPS2RangeHigh" 147 "TPS2RangeLow" 148 "TPS_Sensors_Conflict" 149 "VSPDRangeHigh" 150 "VSPDRangeLow" 151 "VoltLow_Fault" 152 "VoltTooHigh_Fault" 153 "(None)" /end COMPU_VTAB
/begin COMPU_VTAB CompuVtab_32 "" TAB_VERB 2 0 "-" 1 "Clear All Faults" /end COMPU_VTAB
/begin COMPU_VTAB CompuVtab_33 "" TAB_VERB 6 0 "Disabled" 1 "Enabled" 2 "Sticky" 3 "Enabled - Persistent" 4 "Sticky - Persistent" 5 "Save Occurred" /end COMPU_VTAB
/begin COMPU_VTAB CompuVtab_34 "" TAB_VERB 2 0 "-" 1 "Test" /end COMPU_VTAB
/begin COMPU_VTAB CompuVtab_35 "" TAB_VERB 15 0 "CutThrottle" 1 "DFCODisable" 2 "DelayedEngineShutdown" 3 "DisableAC" 4 "DisableFanRun" 5 "DisableFanStall" 6 "DisableO2Ctrl" 7 "DisableVEAdapt" 8 "EngineProtectLED" 9 "EngineShutdown" 10 "HardRevLimit" 11 "MIL_LED" 12 "MediumRevLimit" 13 "SoftRevLimit" 14 "(None)" /end COMPU_VTAB
/begin COMPU_VTAB CompuVtab_36 "" TAB_VERB 8 0 "(None)" 1 "Suspected" 2 "Active" 3 "Suspected or Active" 4 "Occurred" 5 "Suspected or Occurred" 6 "Active or Occurred" 7 "Suspected or Active or Occurred" /end COMPU_VTAB
/begin COMPU_VTAB CompuVtab_54 "" TAB_VERB 6 0 "Calibratable Development Module" 1 "Non-Calibratable Production Module" 2 "Software Dev Module (with RAM overlay only)" 3 "Software Dev Module (with Trace Pod & RAM)" 4 "Calibratable Development Module with Censorship disabled" 5 "Non-Calibratable Production Module with Censorship disabled" /end COMPU_VTAB
/begin COMPU_VTAB CompuVtab_69 "" TAB_VERB 40 0 "TPU Mask Undefined" 1 "60-6" 2 "GM24Xe" 3 "GM24Xe on Cam" 4 "N-1/N-2 [Half Moon Cam]" 5 "NX Encoder" 6 "NX Encoder on Cam" 7 "30-5 on Cnk" 8 "Hyundai 60" 9 "X Plus 1 on Cnk with ToothCam" 10 "X Shift 1 on Cnk" 11 "N Encoder" 12 "N-1/N-2 [Tooth Cam]" 13 "ISDL" 14 "X Pulse Width on Cam" 15 "X Pulse Width on Cnk" 16 "1 Pulse on Cnk" 17 "1 Pulse on Cam" 18 "N-1/N-2 Dual Redundancy" 19 "N-1/N-2 Variable Cam" 20 "N-1/N-2 [Duramax CAM] [Multiplexed EST (1,2, or 4,5,6,7,8) (9,10,11 or 13,14,15)]" 21 "X Plus 1 on Cnk + MuxPSP on EST > 9" 22 "NX Encoder with Hyundai 4 Tooth CAM with one wide" 23 "NX Encoder with 360Deg CAM Providing Crank Sync" 24 "NissanZ 36-6 Encoder, sync on custom CAM" 25 "36-1 Encoder, sync on custom Coyote CAM" 26 "N Groups of 4 teeth - 2, sync on CAM" 27 "NissanZ 36-6 Encoder, sync on 6Tooth 2Missing Plus2 Variable CAM" 28 "EVO9 2X Encoder with 1X_PLUS1 CAM on Exhaust and 4X Variable CAM on Intake" 29 "N-1/N-2 Variable Cam with Windowed Sync" 30 "36M4 (2x18 teeth sectors with 2 missing) and Kohki Cam" 31 "N-3/N-4 [ToothCam]" 32 "N-3/N-4 [Plus1Cam (X+1)]" 33 "Hyundai 60 with EncoderSynthesizer variant on TPUC" 34 "N-1/N-2 [Half Moon Cam]" 35 "X Plus 1 on Cnk with X Plus 1 Cam" 36 "X Plus 1 on Cnk with X Plus 1 Cam with Encoder Synthesizer" 37 "N-1/N-2 [XPlus1 Cam]" 38 "X Shift 1 Retarded [ToothCam]" 39 "N-1/N-2 [Tooth Cam] with MuxPSP" /end COMPU_VTAB
/*~~~~~~~~~ 6.3.65 FUNCTIONs ~~~~~~~~~*/
/begin FUNCTION Project_Config "" /begin DEF_CHARACTERISTIC project_id ProductID /end DEF_CHARACTERISTIC /end FUNCTION
/begin FUNCTION System_Config "" /begin DEF_CHARACTERISTIC FriendlyName PasswordTxt /end DEF_CHARACTERISTIC /begin SUB_FUNCTION Project_Config Trigger_Config Communication_Config /end SUB_FUNCTION /end FUNCTION
/begin FUNCTION System ""
 /begin SUB_FUNCTION System_Config Version Status I_O_Pins Debug CCP Performance Main_Power_Relay NonVolatile_Storage /end SUB_FUNCTION
/end FUNCTION
/begin FUNCTION Version ""
 /begin DEF_CHARACTERISTIC SwIdTxt CalIdTxt SwRevisionTxt CompilerVersion ControlCoreSDKRelease MatlabVersionTxt MotoHawkBuildGUID MotoHawkModelGUID MotoHawkModelName MotoHawkTokenGUID MotoHawkVersionTxt /end DEF_CHARACTERISTIC
 /begin OUT_MEASUREMENT table_0_rev table_1_rev table_2_rev KeyRev EriRev table_3_rev table_4_rev table_5_rev table_6_rev table_7_rev MotProgRev ApplicationCompatibilityArr LinkStatus MotoHawkModelSecondsInUse SystemFrequency TPUMaskType TPUMaskVers Unused /end OUT_MEASUREMENT
/end FUNCTION
/begin FUNCTION Module_Config "" /begin DEF_CHARACTERISTIC SerialNumber ModelNumber PartNumber /end DEF_CHARACTERISTIC
 /begin OUT_MEASUREMENT BootVerMaj BootVerMin EcuHwMaj EcuHwMin ConfigVerMaj ConfigVerMin ModuleCapability /end OUT_MEASUREMENT
/end FUNCTION
/begin FUNCTION Status "" /begin SUB_FUNCTION Module_Config OS Framework /end SUB_FUNCTION /end FUNCTION
/begin FUNCTION AC "" /begin OUT_MEASUREMENT AC /end OUT_MEASUREMENT /begin SUB_FUNCTION AC_Override AC_Config /end SUB_FUNCTION /end FUNCTION
/begin FUNCTION AC_Control "" /begin SUB_FUNCTION AC /end SUB_FUNCTION /end FUNCTION
/begin FUNCTION Outputs ""
 /begin SUB_FUNCTION AC_Control AEM_Infinity_Dash Coil_Control Injector_Control HBridge ETC_CutPower FAN_Control_2 FuelPump /end SUB_FUNCTION
/end FUNCTION
/begin FUNCTION Foreground "" /begin SUB_FUNCTION Outputs Control Inputs /end SUB_FUNCTION /end FUNCTION
/begin FUNCTION BaseEngineController_LS ""
 /begin DEF_CHARACTERISTIC FaultCommand FaultManager.ACChargeHigh_Fault.Mode FaultManager.ACChargeHigh_Fault.ID FaultManager.ACChargeHigh_Fault.Test FaultManager.ACChargeHigh_Fault.Faulty_Samples__X_ FaultManager.ACChargeHigh_Fault.Total_Samples__Y_ FaultManager.ACChargeHigh_Fault.Action_1 FaultManager.ACChargeHigh_Fault.Action_1_Condition FaultManager.ACChargeHigh_Fault.Action_2 FaultManager.ACChargeHigh_Fault.Action_2_Condition FaultManager.ACChargeHigh_Fault.Action_3 FaultManager.ACChargeHigh_Fault.Action_3_Condition FaultManager.ACChargeHigh_Fault.Action_4 FaultManager.ACChargeHigh_Fault.Action_4_Condition FaultManager.ACChargeLow_Fault.Mode FaultManager.ACChargeLow_Fault.ID FaultManager.ACChargeLow_Fault.Test FaultManager.ACChargeLow_Fault.Faulty_Samples__X_ FaultManager.ACChargeLow_Fault.Total_Samples__Y_ FaultManager.ACChargeLow_Fault.Action_1 FaultManager.ACChargeLow_Fault.Action_1_Condition FaultManager.ACChargeLow_Fault.Action_2 FaultManager.ACChargeLow_Fault.Action_2_Condition FaultManager.ACChargeLow_Fault.Action_3 FaultManager.ACChargeLow_Fault.Action_3_Condition FaultManager.ACChargeLow_Fault.Action_4 FaultManager.ACChargeLow_Fault.Action_4_Condition FaultManager.ACPresRangeHigh.Mode FaultManager.ACPresRangeHigh.ID FaultManager.ACPresRangeHigh.Test FaultManager.ACPresRangeHigh.Faulty_Samples__X_ FaultManager.ACPresRangeHigh.Total_Samples__Y_ FaultManager.ACPresRangeHigh.Action_1 FaultManager.ACPresRangeHigh.Action_1_Condition FaultManager.ACPresRangeHigh.Action_2 FaultManager.ACPresRangeHigh.Action_2_Condition FaultManager.ACPresRangeHigh.Action_3 FaultManager.ACPresRangeHigh.Action_3_Condition FaultManager.ACPresRangeHigh.Action_4 FaultManager.ACPresRangeHigh.Action_4_Condition FaultManager.ACPresRangeLow.Mode FaultManager.ACPresRangeLow.ID FaultManager.ACPresRangeLow.Test FaultManager.ACPresRangeLow.Faulty_Samples__X_ FaultManager.ACPresRangeLow.Total_Samples__Y_ FaultManager.ACPresRangeLow.Action_1 FaultManager.ACPresRangeLow.Action_1_Condition FaultManager.ACPresRangeLow.Action_2 FaultManager.ACPresRangeLow.Action_2_Condition FaultManager.ACPresRangeLow.Action_3 FaultManager.ACPresRangeLow.Action_3_Condition FaultManager.ACPresRangeLow.Action_4 FaultManager.ACPresRangeLow.Action_4_Condition FaultManager.APP1_AdaptAdaptHiMax.Mode FaultManager.APP1_AdaptAdaptHiMax.ID FaultManager.APP1_AdaptAdaptHiMax.Test FaultManager.APP1_AdaptAdaptHiMax.Faulty_Samples__X_ FaultManager.APP1_AdaptAdaptHiMax.Total_Samples__Y_ FaultManager.APP1_AdaptAdaptHiMax.Action_1 FaultManager.APP1_AdaptAdaptHiMax.Action_1_Condition FaultManager.APP1_AdaptAdaptHiMax.Action_2 FaultManager.APP1_AdaptAdaptHiMax.Action_2_Condition FaultManager.APP1_AdaptAdaptHiMax.Action_3 FaultManager.APP1_AdaptAdaptHiMax.Action_3_Condition FaultManager.APP1_AdaptAdaptHiMax.Action_4 FaultManager.APP1_AdaptAdaptHiMax.Action_4_Condition FaultManager.APP1_AdaptAdaptHiMin.Mode FaultManager.APP1_AdaptAdaptHiMin.ID FaultManager.APP1_AdaptAdaptHiMin.Test FaultManager.APP1_AdaptAdaptHiMin.Faulty_Samples__X_ FaultManager.APP1_AdaptAdaptHiMin.Total_Samples__Y_ FaultManager.APP1_AdaptAdaptHiMin.Action_1 FaultManager.APP1_AdaptAdaptHiMin.Action_1_Condition FaultManager.APP1_AdaptAdaptHiMin.Action_2 FaultManager.APP1_AdaptAdaptHiMin.Action_2_Condition FaultManager.APP1_AdaptAdaptHiMin.Action_3 FaultManager.APP1_AdaptAdaptHiMin.Action_3_Condition FaultManager.APP1_AdaptAdaptHiMin.Action_4 FaultManager.APP1_AdaptAdaptHiMin.Action_4_Condition FaultManager.APP1_AdaptAdaptLoMax.Mode FaultManager.APP1_AdaptAdaptLoMax.ID FaultManager.APP1_AdaptAdaptLoMax.Test FaultManager.APP1_AdaptAdaptLoMax.Faulty_Samples__X_ FaultManager.APP1_AdaptAdaptLoMax.Total_Samples__Y_ FaultManager.APP1_AdaptAdaptLoMax.Action_1 FaultManager.APP1_AdaptAdaptLoMax.Action_1_Condition FaultManager.APP1_AdaptAdaptLoMax.Action_2 FaultManager.APP1_AdaptAdaptLoMax.Action_2_Condition FaultManager.APP1_AdaptAdaptLoMax.Action_3 FaultManager.APP1_AdaptAdaptLoMax.Action_3_Condition FaultManager.APP1_AdaptAdaptLoMax.Action_4 FaultManager.APP1_AdaptAdaptLoMax.Action_4_Condition FaultManager.APP1_AdaptAdaptLoMin.Mode FaultManager.APP1_AdaptAdaptLoMin.ID FaultManager.APP1_AdaptAdaptLoMin.Test FaultManager.APP1_AdaptAdaptLoMin.Faulty_Samples__X_ FaultManager.APP1_AdaptAdaptLoMin.Total_Samples__Y_ FaultManager.APP1_AdaptAdaptLoMin.Action_1 FaultManager.APP1_AdaptAdaptLoMin.Action_1_Condition FaultManager.APP1_AdaptAdaptLoMin.Action_2 FaultManager.APP1_AdaptAdaptLoMin.Action_2_Condition FaultManager.APP1_AdaptAdaptLoMin.Action_3 FaultManager.APP1_AdaptAdaptLoMin.Action_3_Condition FaultManager.APP1_AdaptAdaptLoMin.Action_4 FaultManager.APP1_AdaptAdaptLoMin.Action_4_Condition FaultManager.APP1_AdaptRangeHigh.Mode FaultManager.APP1_AdaptRangeHigh.ID FaultManager.APP1_AdaptRangeHigh.Test FaultManager.APP1_AdaptRangeHigh.Faulty_Samples__X_ FaultManager.APP1_AdaptRangeHigh.Total_Samples__Y_ FaultManager.APP1_AdaptRangeHigh.Action_1 FaultManager.APP1_AdaptRangeHigh.Action_1_Condition FaultManager.APP1_AdaptRangeHigh.Action_2 FaultManager.APP1_AdaptRangeHigh.Action_2_Condition FaultManager.APP1_AdaptRangeHigh.Action_3 FaultManager.APP1_AdaptRangeHigh.Action_3_Condition FaultManager.APP1_AdaptRangeHigh.Action_4 FaultManager.APP1_AdaptRangeHigh.Action_4_Condition FaultManager.APP1_AdaptRangeLow.Mode FaultManager.APP1_AdaptRangeLow.ID FaultManager.APP1_AdaptRangeLow.Test FaultManager.APP1_AdaptRangeLow.Faulty_Samples__X_ FaultManager.APP1_AdaptRangeLow.Total_Samples__Y_ FaultManager.APP1_AdaptRangeLow.Action_1 FaultManager.APP1_AdaptRangeLow.Action_1_Condition FaultManager.APP1_AdaptRangeLow.Action_2 FaultManager.APP1_AdaptRangeLow.Action_2_Condition FaultManager.APP1_AdaptRangeLow.Action_3 FaultManager.APP1_AdaptRangeLow.Action_3_Condition FaultManager.APP1_AdaptRangeLow.Action_4 FaultManager.APP1_AdaptRangeLow.Action_4_Condition FaultManager.APP2_AdaptAdaptHiMax.Mode FaultManager.APP2_AdaptAdaptHiMax.ID FaultManager.APP2_AdaptAdaptHiMax.Test FaultManager.APP2_AdaptAdaptHiMax.Faulty_Samples__X_ FaultManager.APP2_AdaptAdaptHiMax.Total_Samples__Y_ FaultManager.APP2_AdaptAdaptHiMax.Action_1 FaultManager.APP2_AdaptAdaptHiMax.Action_1_Condition FaultManager.APP2_AdaptAdaptHiMax.Action_2 FaultManager.APP2_AdaptAdaptHiMax.Action_2_Condition FaultManager.APP2_AdaptAdaptHiMax.Action_3 FaultManager.APP2_AdaptAdaptHiMax.Action_3_Condition FaultManager.APP2_AdaptAdaptHiMax.Action_4 FaultManager.APP2_AdaptAdaptHiMax.Action_4_Condition FaultManager.APP2_AdaptAdaptHiMin.Mode FaultManager.APP2_AdaptAdaptHiMin.ID FaultManager.APP2_AdaptAdaptHiMin.Test FaultManager.APP2_AdaptAdaptHiMin.Faulty_Samples__X_ FaultManager.APP2_AdaptAdaptHiMin.Total_Samples__Y_ FaultManager.APP2_AdaptAdaptHiMin.Action_1 FaultManager.APP2_AdaptAdaptHiMin.Action_1_Condition FaultManager.APP2_AdaptAdaptHiMin.Action_2 FaultManager.APP2_AdaptAdaptHiMin.Action_2_Condition FaultManager.APP2_AdaptAdaptHiMin.Action_3 FaultManager.APP2_AdaptAdaptHiMin.Action_3_Condition FaultManager.APP2_AdaptAdaptHiMin.Action_4 FaultManager.APP2_AdaptAdaptHiMin.Action_4_Condition FaultManager.APP2_AdaptAdaptLoMax.Mode FaultManager.APP2_AdaptAdaptLoMax.ID FaultManager.APP2_AdaptAdaptLoMax.Test FaultManager.APP2_AdaptAdaptLoMax.Faulty_Samples__X_ FaultManager.APP2_AdaptAdaptLoMax.Total_Samples__Y_ FaultManager.APP2_AdaptAdaptLoMax.Action_1 FaultManager.APP2_AdaptAdaptLoMax.Action_1_Condition FaultManager.APP2_AdaptAdaptLoMax.Action_2 FaultManager.APP2_AdaptAdaptLoMax.Action_2_Condition FaultManager.APP2_AdaptAdaptLoMax.Action_3 FaultManager.APP2_AdaptAdaptLoMax.Action_3_Condition FaultManager.APP2_AdaptAdaptLoMax.Action_4 FaultManager.APP2_AdaptAdaptLoMax.Action_4_Condition FaultManager.APP2_AdaptAdaptLoMin.Mode FaultManager.APP2_AdaptAdaptLoMin.ID FaultManager.APP2_AdaptAdaptLoMin.Test FaultManager.APP2_AdaptAdaptLoMin.Faulty_Samples__X_ FaultManager.APP2_AdaptAdaptLoMin.Total_Samples__Y_ FaultManager.APP2_AdaptAdaptLoMin.Action_1 FaultManager.APP2_AdaptAdaptLoMin.Action_1_Condition FaultManager.APP2_AdaptAdaptLoMin.Action_2 FaultManager.APP2_AdaptAdaptLoMin.Action_2_Condition FaultManager.APP2_AdaptAdaptLoMin.Action_3 FaultManager.APP2_AdaptAdaptLoMin.Action_3_Condition FaultManager.APP2_AdaptAdaptLoMin.Action_4 FaultManager.APP2_AdaptAdaptLoMin.Action_4_Condition FaultManager.APP2_AdaptRangeHigh.Mode FaultManager.APP2_AdaptRangeHigh.ID FaultManager.APP2_AdaptRangeHigh.Test FaultManager.APP2_AdaptRangeHigh.Faulty_Samples__X_ FaultManager.APP2_AdaptRangeHigh.Total_Samples__Y_ FaultManager.APP2_AdaptRangeHigh.Action_1 FaultManager.APP2_AdaptRangeHigh.Action_1_Condition FaultManager.APP2_AdaptRangeHigh.Action_2 FaultManager.APP2_AdaptRangeHigh.Action_2_Condition FaultManager.APP2_AdaptRangeHigh.Action_3 FaultManager.APP2_AdaptRangeHigh.Action_3_Condition FaultManager.APP2_AdaptRangeHigh.Action_4 FaultManager.APP2_AdaptRangeHigh.Action_4_Condition FaultManager.APP2_AdaptRangeLow.Mode FaultManager.APP2_AdaptRangeLow.ID FaultManager.APP2_AdaptRangeLow.Test FaultManager.APP2_AdaptRangeLow.Faulty_Samples__X_ FaultManager.APP2_AdaptRangeLow.Total_Samples__Y_ FaultManager.APP2_AdaptRangeLow.Action_1 FaultManager.APP2_AdaptRangeLow.Action_1_Condition FaultManager.APP2_AdaptRangeLow.Action_2 FaultManager.APP2_AdaptRangeLow.Action_2_Condition FaultManager.APP2_AdaptRangeLow.Action_3 FaultManager.APP2_AdaptRangeLow.Action_3_Condition FaultManager.APP2_AdaptRangeLow.Action_4 FaultManager.APP2_AdaptRangeLow.Action_4_Condition FaultManager.APP_Sensors_Conflict.Mode FaultManager.APP_Sensors_Conflict.ID FaultManager.APP_Sensors_Conflict.Test FaultManager.APP_Sensors_Conflict.Faulty_Samples__X_ FaultManager.APP_Sensors_Conflict.Total_Samples__Y_ FaultManager.APP_Sensors_Conflict.Action_1 FaultManager.APP_Sensors_Conflict.Action_1_Condition FaultManager.APP_Sensors_Conflict.Action_2 FaultManager.APP_Sensors_Conflict.Action_2_Condition FaultManager.APP_Sensors_Conflict.Action_3 FaultManager.APP_Sensors_Conflict.Action_3_Condition FaultManager.APP_Sensors_Conflict.Action_4 FaultManager.APP_Sensors_Conflict.Action_4_Condition FaultManager.AirflowMismatch_Fault.Mode FaultManager.AirflowMismatch_Fault.ID FaultManager.AirflowMismatch_Fault.Test FaultManager.AirflowMismatch_Fault.Faulty_Samples__X_ FaultManager.AirflowMismatch_Fault.Total_Samples__Y_ FaultManager.AirflowMismatch_Fault.Action_1 FaultManager.AirflowMismatch_Fault.Action_1_Condition FaultManager.AirflowMismatch_Fault.Action_2 FaultManager.AirflowMismatch_Fault.Action_2_Condition FaultManager.AirflowMismatch_Fault.Action_3 FaultManager.AirflowMismatch_Fault.Action_3_Condition FaultManager.AirflowMismatch_Fault.Action_4 FaultManager.AirflowMismatch_Fault.Action_4_Condition FaultManager.AltInop_Fault.Mode FaultManager.AltInop_Fault.ID FaultManager.AltInop_Fault.Test FaultManager.AltInop_Fault.Faulty_Samples__X_ FaultManager.AltInop_Fault.Total_Samples__Y_ FaultManager.AltInop_Fault.Action_1 FaultManager.AltInop_Fault.Action_1_Condition FaultManager.AltInop_Fault.Action_2 FaultManager.AltInop_Fault.Action_2_Condition FaultManager.AltInop_Fault.Action_3 FaultManager.AltInop_Fault.Action_3_Condition FaultManager.AltInop_Fault.Action_4 FaultManager.AltInop_Fault.Action_4_Condition FaultManager.Bank1_EquivRatioRangeHigh.Mode FaultManager.Bank1_EquivRatioRangeHigh.ID FaultManager.Bank1_EquivRatioRangeHigh.Test FaultManager.Bank1_EquivRatioRangeHigh.Faulty_Samples__X_ FaultManager.Bank1_EquivRatioRangeHigh.Total_Samples__Y_ FaultManager.Bank1_EquivRatioRangeHigh.Action_1 FaultManager.Bank1_EquivRatioRangeHigh.Action_1_Condition FaultManager.Bank1_EquivRatioRangeHigh.Action_2 FaultManager.Bank1_EquivRatioRangeHigh.Action_2_Condition FaultManager.Bank1_EquivRatioRangeHigh.Action_3 FaultManager.Bank1_EquivRatioRangeHigh.Action_3_Condition FaultManager.Bank1_EquivRatioRangeHigh.Action_4 FaultManager.Bank1_EquivRatioRangeHigh.Action_4_Condition FaultManager.Bank1_EquivRatioRangeLow.Mode FaultManager.Bank1_EquivRatioRangeLow.ID FaultManager.Bank1_EquivRatioRangeLow.Test FaultManager.Bank1_EquivRatioRangeLow.Faulty_Samples__X_ FaultManager.Bank1_EquivRatioRangeLow.Total_Samples__Y_ FaultManager.Bank1_EquivRatioRangeLow.Action_1 FaultManager.Bank1_EquivRatioRangeLow.Action_1_Condition FaultManager.Bank1_EquivRatioRangeLow.Action_2 FaultManager.Bank1_EquivRatioRangeLow.Action_2_Condition FaultManager.Bank1_EquivRatioRangeLow.Action_3 FaultManager.Bank1_EquivRatioRangeLow.Action_3_Condition FaultManager.Bank1_EquivRatioRangeLow.Action_4 FaultManager.Bank1_EquivRatioRangeLow.Action_4_Condition FaultManager.Bank2_EquivRatioRangeHigh.Mode FaultManager.Bank2_EquivRatioRangeHigh.ID FaultManager.Bank2_EquivRatioRangeHigh.Test FaultManager.Bank2_EquivRatioRangeHigh.Faulty_Samples__X_ FaultManager.Bank2_EquivRatioRangeHigh.Total_Samples__Y_ FaultManager.Bank2_EquivRatioRangeHigh.Action_1 FaultManager.Bank2_EquivRatioRangeHigh.Action_1_Condition FaultManager.Bank2_EquivRatioRangeHigh.Action_2 FaultManager.Bank2_EquivRatioRangeHigh.Action_2_Condition FaultManager.Bank2_EquivRatioRangeHigh.Action_3 FaultManager.Bank2_EquivRatioRangeHigh.Action_3_Condition FaultManager.Bank2_EquivRatioRangeHigh.Action_4 FaultManager.Bank2_EquivRatioRangeHigh.Action_4_Condition FaultManager.Bank2_EquivRatioRangeLow.Mode FaultManager.Bank2_EquivRatioRangeLow.ID FaultManager.Bank2_EquivRatioRangeLow.Test FaultManager.Bank2_EquivRatioRangeLow.Faulty_Samples__X_ FaultManager.Bank2_EquivRatioRangeLow.Total_Samples__Y_ FaultManager.Bank2_EquivRatioRangeLow.Action_1 FaultManager.Bank2_EquivRatioRangeLow.Action_1_Condition FaultManager.Bank2_EquivRatioRangeLow.Action_2 FaultManager.Bank2_EquivRatioRangeLow.Action_2_Condition FaultManager.Bank2_EquivRatioRangeLow.Action_3 FaultManager.Bank2_EquivRatioRangeLow.Action_3_Condition FaultManager.Bank2_EquivRatioRangeLow.Action_4 FaultManager.Bank2_EquivRatioRangeLow.Action_4_Condition FaultManager.CamEdgesFault.Mode FaultManager.CamEdgesFault.ID FaultManager.CamEdgesFault.Test FaultManager.CamEdgesFault.Faulty_Samples__X_ FaultManager.CamEdgesFault.Total_Samples__Y_ FaultManager.CamEdgesFault.Action_1 FaultManager.CamEdgesFault.Action_1_Condition FaultManager.CamEdgesFault.Action_2 FaultManager.CamEdgesFault.Action_2_Condition FaultManager.CamEdgesFault.Action_3 FaultManager.CamEdgesFault.Action_3_Condition FaultManager.CamEdgesFault.Action_4 FaultManager.CamEdgesFault.Action_4_Condition FaultManager.CamSyncFault.Mode FaultManager.CamSyncFault.ID FaultManager.CamSyncFault.Test FaultManager.CamSyncFault.Faulty_Samples__X_ FaultManager.CamSyncFault.Total_Samples__Y_ FaultManager.CamSyncFault.Action_1 FaultManager.CamSyncFault.Action_1_Condition FaultManager.CamSyncFault.Action_2 FaultManager.CamSyncFault.Action_2_Condition FaultManager.CamSyncFault.Action_3 FaultManager.CamSyncFault.Action_3_Condition FaultManager.CamSyncFault.Action_4 FaultManager.CamSyncFault.Action_4_Condition FaultManager.ClutchStuckHigh_Fault.Mode FaultManager.ClutchStuckHigh_Fault.ID FaultManager.ClutchStuckHigh_Fault.Test FaultManager.ClutchStuckHigh_Fault.Faulty_Samples__X_ FaultManager.ClutchStuckHigh_Fault.Total_Samples__Y_ FaultManager.ClutchStuckHigh_Fault.Action_1 FaultManager.ClutchStuckHigh_Fault.Action_1_Condition FaultManager.ClutchStuckHigh_Fault.Action_2 FaultManager.ClutchStuckHigh_Fault.Action_2_Condition FaultManager.ClutchStuckHigh_Fault.Action_3 FaultManager.ClutchStuckHigh_Fault.Action_3_Condition FaultManager.ClutchStuckHigh_Fault.Action_4 FaultManager.ClutchStuckHigh_Fault.Action_4_Condition FaultManager.CrankEdgesFault.Mode FaultManager.CrankEdgesFault.ID FaultManager.CrankEdgesFault.Test FaultManager.CrankEdgesFault.Faulty_Samples__X_ FaultManager.CrankEdgesFault.Total_Samples__Y_ FaultManager.CrankEdgesFault.Action_1 FaultManager.CrankEdgesFault.Action_1_Condition FaultManager.CrankEdgesFault.Action_2 FaultManager.CrankEdgesFault.Action_2_Condition FaultManager.CrankEdgesFault.Action_3 FaultManager.CrankEdgesFault.Action_3_Condition FaultManager.CrankEdgesFault.Action_4 FaultManager.CrankEdgesFault.Action_4_Condition FaultManager.CrankSyncFault.Mode FaultManager.CrankSyncFault.ID FaultManager.CrankSyncFault.Test FaultManager.CrankSyncFault.Faulty_Samples__X_ FaultManager.CrankSyncFault.Total_Samples__Y_ FaultManager.CrankSyncFault.Action_1 FaultManager.CrankSyncFault.Action_1_Condition FaultManager.CrankSyncFault.Action_2 FaultManager.CrankSyncFault.Action_2_Condition FaultManager.CrankSyncFault.Action_3 FaultManager.CrankSyncFault.Action_3_Condition FaultManager.CrankSyncFault.Action_4 FaultManager.CrankSyncFault.Action_4_Condition FaultManager.Cylinder1_HardMisfire.Mode FaultManager.Cylinder1_HardMisfire.ID FaultManager.Cylinder1_HardMisfire.Test FaultManager.Cylinder1_HardMisfire.Faulty_Samples__X_ FaultManager.Cylinder1_HardMisfire.Total_Samples__Y_ FaultManager.Cylinder1_HardMisfire.Action_1 FaultManager.Cylinder1_HardMisfire.Action_1_Condition FaultManager.Cylinder1_HardMisfire.Action_2 FaultManager.Cylinder1_HardMisfire.Action_2_Condition FaultManager.Cylinder1_HardMisfire.Action_3 FaultManager.Cylinder1_HardMisfire.Action_3_Condition FaultManager.Cylinder1_HardMisfire.Action_4 FaultManager.Cylinder1_HardMisfire.Action_4_Condition FaultManager.Cylinder2_HardMisfire.Mode FaultManager.Cylinder2_HardMisfire.ID FaultManager.Cylinder2_HardMisfire.Test FaultManager.Cylinder2_HardMisfire.Faulty_Samples__X_ FaultManager.Cylinder2_HardMisfire.Total_Samples__Y_ FaultManager.Cylinder2_HardMisfire.Action_1 FaultManager.Cylinder2_HardMisfire.Action_1_Condition FaultManager.Cylinder2_HardMisfire.Action_2 FaultManager.Cylinder2_HardMisfire.Action_2_Condition FaultManager.Cylinder2_HardMisfire.Action_3 FaultManager.Cylinder2_HardMisfire.Action_3_Condition FaultManager.Cylinder2_HardMisfire.Action_4 FaultManager.Cylinder2_HardMisfire.Action_4_Condition FaultManager.Cylinder3_HardMisfire.Mode FaultManager.Cylinder3_HardMisfire.ID FaultManager.Cylinder3_HardMisfire.Test FaultManager.Cylinder3_HardMisfire.Faulty_Samples__X_ FaultManager.Cylinder3_HardMisfire.Total_Samples__Y_ FaultManager.Cylinder3_HardMisfire.Action_1 FaultManager.Cylinder3_HardMisfire.Action_1_Condition FaultManager.Cylinder3_HardMisfire.Action_2 FaultManager.Cylinder3_HardMisfire.Action_2_Condition FaultManager.Cylinder3_HardMisfire.Action_3 FaultManager.Cylinder3_HardMisfire.Action_3_Condition FaultManager.Cylinder3_HardMisfire.Action_4 FaultManager.Cylinder3_HardMisfire.Action_4_Condition FaultManager.Cylinder4_HardMisfire.Mode FaultManager.Cylinder4_HardMisfire.ID FaultManager.Cylinder4_HardMisfire.Test FaultManager.Cylinder4_HardMisfire.Faulty_Samples__X_ FaultManager.Cylinder4_HardMisfire.Total_Samples__Y_ FaultManager.Cylinder4_HardMisfire.Action_1 FaultManager.Cylinder4_HardMisfire.Action_1_Condition FaultManager.Cylinder4_HardMisfire.Action_2 FaultManager.Cylinder4_HardMisfire.Action_2_Condition FaultManager.Cylinder4_HardMisfire.Action_3 FaultManager.Cylinder4_HardMisfire.Action_3_Condition FaultManager.Cylinder4_HardMisfire.Action_4 FaultManager.Cylinder4_HardMisfire.Action_4_Condition FaultManager.Cylinder5_HardMisfire.Mode FaultManager.Cylinder5_HardMisfire.ID FaultManager.Cylinder5_HardMisfire.Test FaultManager.Cylinder5_HardMisfire.Faulty_Samples__X_ FaultManager.Cylinder5_HardMisfire.Total_Samples__Y_ FaultManager.Cylinder5_HardMisfire.Action_1 FaultManager.Cylinder5_HardMisfire.Action_1_Condition FaultManager.Cylinder5_HardMisfire.Action_2 FaultManager.Cylinder5_HardMisfire.Action_2_Condition FaultManager.Cylinder5_HardMisfire.Action_3 FaultManager.Cylinder5_HardMisfire.Action_3_Condition FaultManager.Cylinder5_HardMisfire.Action_4 FaultManager.Cylinder5_HardMisfire.Action_4_Condition FaultManager.Cylinder6_HardMisfire.Mode FaultManager.Cylinder6_HardMisfire.ID FaultManager.Cylinder6_HardMisfire.Test FaultManager.Cylinder6_HardMisfire.Faulty_Samples__X_ FaultManager.Cylinder6_HardMisfire.Total_Samples__Y_ FaultManager.Cylinder6_HardMisfire.Action_1 FaultManager.Cylinder6_HardMisfire.Action_1_Condition FaultManager.Cylinder6_HardMisfire.Action_2 FaultManager.Cylinder6_HardMisfire.Action_2_Condition FaultManager.Cylinder6_HardMisfire.Action_3 FaultManager.Cylinder6_HardMisfire.Action_3_Condition FaultManager.Cylinder6_HardMisfire.Action_4 FaultManager.Cylinder6_HardMisfire.Action_4_Condition FaultManager.Cylinder7_HardMisfire.Mode FaultManager.Cylinder7_HardMisfire.ID FaultManager.Cylinder7_HardMisfire.Test FaultManager.Cylinder7_HardMisfire.Faulty_Samples__X_ FaultManager.Cylinder7_HardMisfire.Total_Samples__Y_ FaultManager.Cylinder7_HardMisfire.Action_1 FaultManager.Cylinder7_HardMisfire.Action_1_Condition FaultManager.Cylinder7_HardMisfire.Action_2 FaultManager.Cylinder7_HardMisfire.Action_2_Condition FaultManager.Cylinder7_HardMisfire.Action_3 FaultManager.Cylinder7_HardMisfire.Action_3_Condition FaultManager.Cylinder7_HardMisfire.Action_4 FaultManager.Cylinder7_HardMisfire.Action_4_Condition FaultManager.Cylinder8_HardMisfire.Mode FaultManager.Cylinder8_HardMisfire.ID FaultManager.Cylinder8_HardMisfire.Test FaultManager.Cylinder8_HardMisfire.Faulty_Samples__X_ FaultManager.Cylinder8_HardMisfire.Total_Samples__Y_ FaultManager.Cylinder8_HardMisfire.Action_1 FaultManager.Cylinder8_HardMisfire.Action_1_Condition FaultManager.Cylinder8_HardMisfire.Action_2 FaultManager.Cylinder8_HardMisfire.Action_2_Condition FaultManager.Cylinder8_HardMisfire.Action_3 FaultManager.Cylinder8_HardMisfire.Action_3_Condition FaultManager.Cylinder8_HardMisfire.Action_4 FaultManager.Cylinder8_HardMisfire.Action_4_Condition FaultManager.ECTOverTempFault.Mode FaultManager.ECTOverTempFault.ID FaultManager.ECTOverTempFault.Test FaultManager.ECTOverTempFault.Faulty_Samples__X_ FaultManager.ECTOverTempFault.Total_Samples__Y_ FaultManager.ECTOverTempFault.Action_1 FaultManager.ECTOverTempFault.Action_1_Condition FaultManager.ECTOverTempFault.Action_2 FaultManager.ECTOverTempFault.Action_2_Condition FaultManager.ECTOverTempFault.Action_3 FaultManager.ECTOverTempFault.Action_3_Condition FaultManager.ECTOverTempFault.Action_4 FaultManager.ECTOverTempFault.Action_4_Condition FaultManager.ECTRangeHigh.Mode FaultManager.ECTRangeHigh.ID FaultManager.ECTRangeHigh.Test FaultManager.ECTRangeHigh.Faulty_Samples__X_ FaultManager.ECTRangeHigh.Total_Samples__Y_ FaultManager.ECTRangeHigh.Action_1 FaultManager.ECTRangeHigh.Action_1_Condition FaultManager.ECTRangeHigh.Action_2 FaultManager.ECTRangeHigh.Action_2_Condition FaultManager.ECTRangeHigh.Action_3 FaultManager.ECTRangeHigh.Action_3_Condition FaultManager.ECTRangeHigh.Action_4 FaultManager.ECTRangeHigh.Action_4_Condition FaultManager.ECTRangeLow.Mode FaultManager.ECTRangeLow.ID FaultManager.ECTRangeLow.Test FaultManager.ECTRangeLow.Faulty_Samples__X_ FaultManager.ECTRangeLow.Total_Samples__Y_ FaultManager.ECTRangeLow.Action_1 FaultManager.ECTRangeLow.Action_1_Condition FaultManager.ECTRangeLow.Action_2 FaultManager.ECTRangeLow.Action_2_Condition FaultManager.ECTRangeLow.Action_3 FaultManager.ECTRangeLow.Action_3_Condition FaultManager.ECTRangeLow.Action_4 FaultManager.ECTRangeLow.Action_4_Condition FaultManager.ECTSevereOverTempFault.Mode FaultManager.ECTSevereOverTempFault.ID FaultManager.ECTSevereOverTempFault.Test FaultManager.ECTSevereOverTempFault.Faulty_Samples__X_ FaultManager.ECTSevereOverTempFault.Total_Samples__Y_ FaultManager.ECTSevereOverTempFault.Action_1 FaultManager.ECTSevereOverTempFault.Action_1_Condition FaultManager.ECTSevereOverTempFault.Action_2 FaultManager.ECTSevereOverTempFault.Action_2_Condition FaultManager.ECTSevereOverTempFault.Action_3 FaultManager.ECTSevereOverTempFault.Action_3_Condition FaultManager.ECTSevereOverTempFault.Action_4 FaultManager.ECTSevereOverTempFault.Action_4_Condition FaultManager.EST1_Open.Mode FaultManager.EST1_Open.ID FaultManager.EST1_Open.Test FaultManager.EST1_Open.Faulty_Samples__X_ FaultManager.EST1_Open.Total_Samples__Y_ FaultManager.EST1_Open.Action_1 FaultManager.EST1_Open.Action_1_Condition FaultManager.EST1_Open.Action_2 FaultManager.EST1_Open.Action_2_Condition FaultManager.EST1_Open.Action_3 FaultManager.EST1_Open.Action_3_Condition FaultManager.EST1_Open.Action_4 FaultManager.EST1_Open.Action_4_Condition FaultManager.EST1_Short.Mode FaultManager.EST1_Short.ID FaultManager.EST1_Short.Test FaultManager.EST1_Short.Faulty_Samples__X_ FaultManager.EST1_Short.Total_Samples__Y_ FaultManager.EST1_Short.Action_1 FaultManager.EST1_Short.Action_1_Condition FaultManager.EST1_Short.Action_2 FaultManager.EST1_Short.Action_2_Condition FaultManager.EST1_Short.Action_3 FaultManager.EST1_Short.Action_3_Condition FaultManager.EST1_Short.Action_4 FaultManager.EST1_Short.Action_4_Condition FaultManager.EST2_Open.Mode FaultManager.EST2_Open.ID FaultManager.EST2_Open.Test FaultManager.EST2_Open.Faulty_Samples__X_ FaultManager.EST2_Open.Total_Samples__Y_ FaultManager.EST2_Open.Action_1 FaultManager.EST2_Open.Action_1_Condition FaultManager.EST2_Open.Action_2 FaultManager.EST2_Open.Action_2_Condition FaultManager.EST2_Open.Action_3 FaultManager.EST2_Open.Action_3_Condition FaultManager.EST2_Open.Action_4 FaultManager.EST2_Open.Action_4_Condition FaultManager.EST2_Short.Mode FaultManager.EST2_Short.ID FaultManager.EST2_Short.Test FaultManager.EST2_Short.Faulty_Samples__X_ FaultManager.EST2_Short.Total_Samples__Y_ FaultManager.EST2_Short.Action_1 FaultManager.EST2_Short.Action_1_Condition FaultManager.EST2_Short.Action_2 FaultManager.EST2_Short.Action_2_Condition FaultManager.EST2_Short.Action_3 FaultManager.EST2_Short.Action_3_Condition FaultManager.EST2_Short.Action_4 FaultManager.EST2_Short.Action_4_Condition FaultManager.EST3_Open.Mode FaultManager.EST3_Open.ID FaultManager.EST3_Open.Test FaultManager.EST3_Open.Faulty_Samples__X_ FaultManager.EST3_Open.Total_Samples__Y_ FaultManager.EST3_Open.Action_1 FaultManager.EST3_Open.Action_1_Condition FaultManager.EST3_Open.Action_2 FaultManager.EST3_Open.Action_2_Condition FaultManager.EST3_Open.Action_3 FaultManager.EST3_Open.Action_3_Condition FaultManager.EST3_Open.Action_4 FaultManager.EST3_Open.Action_4_Condition FaultManager.EST3_Short.Mode FaultManager.EST3_Short.ID FaultManager.EST3_Short.Test FaultManager.EST3_Short.Faulty_Samples__X_ FaultManager.EST3_Short.Total_Samples__Y_ FaultManager.EST3_Short.Action_1 FaultManager.EST3_Short.Action_1_Condition FaultManager.EST3_Short.Action_2 FaultManager.EST3_Short.Action_2_Condition FaultManager.EST3_Short.Action_3 FaultManager.EST3_Short.Action_3_Condition FaultManager.EST3_Short.Action_4 FaultManager.EST3_Short.Action_4_Condition FaultManager.EST4_Open.Mode FaultManager.EST4_Open.ID FaultManager.EST4_Open.Test FaultManager.EST4_Open.Faulty_Samples__X_ FaultManager.EST4_Open.Total_Samples__Y_ FaultManager.EST4_Open.Action_1 FaultManager.EST4_Open.Action_1_Condition FaultManager.EST4_Open.Action_2 FaultManager.EST4_Open.Action_2_Condition FaultManager.EST4_Open.Action_3 FaultManager.EST4_Open.Action_3_Condition FaultManager.EST4_Open.Action_4 FaultManager.EST4_Open.Action_4_Condition FaultManager.EST4_Short.Mode FaultManager.EST4_Short.ID FaultManager.EST4_Short.Test FaultManager.EST4_Short.Faulty_Samples__X_ FaultManager.EST4_Short.Total_Samples__Y_ FaultManager.EST4_Short.Action_1 FaultManager.EST4_Short.Action_1_Condition FaultManager.EST4_Short.Action_2 FaultManager.EST4_Short.Action_2_Condition FaultManager.EST4_Short.Action_3 FaultManager.EST4_Short.Action_3_Condition FaultManager.EST4_Short.Action_4 FaultManager.EST4_Short.Action_4_Condition FaultManager.EST5_Open.Mode FaultManager.EST5_Open.ID FaultManager.EST5_Open.Test /end DEF_CHARACTERISTIC
 /begin OUT_MEASUREMENT FaultMarquees.FaultMarquees.Current_Suspected FaultMarquees.FaultMarquees.Current_Active FaultMarquees.FaultMarquees.Current_Occurred /end OUT_MEASUREMENT
 /begin SUB_FUNCTION Foreground Action_Reasons /end SUB_FUNCTION
/end FUNCTION
/end MODULE
/end PROJECT
