ASAP2_VERSION 1 51
/begin PROJECT Project ""
/begin MODULE BaseEngin_023 ""
/begin MOD_COMMON /* MOD_COMMON Comment */ "" BYTE_ORDER MSB_FIRST ALIGNMENT_BYTE 1 ALIGNMENT_FLOAT32_IEEE 1 ALIGNMENT_FLOAT64_IEEE 1 ALIGNMENT_LONG 1 ALIGNMENT_WORD 1 /end MOD_COMMON
/begin MEASUREMENT Fuel_Economy_Filtered "" FLOAT32_IEEE CompuMethod_2 1 0 -1E+17 1E+17 ECU_ADDRESS 0x400005FA MATRIX_DIM 8 1 1 /end MEASUREMENT
/begin MEASUREMENT Fuel_Economy_Inst "" FLOAT32_IEEE CompuMethod_2 1 0 -1E+17 1E+17 ECU_ADDRESS 0x4000061A MATRIX_DIM 8 1 1 /end MEASUREMENT
/begin MEASUREMENT Fuel_Lvl "Final value after Linear Sensor Characterization" FLOAT32_IEEE CompuMethod_6 1 0 -1E+17 1E+17 ECU_ADDRESS 0x4000063A /end MEASUREMENT
/begin MEASUREMENT Fuel_LvlADC "Signal measured directly from sensor" UWORD CompuMethod_16 1 0 0 65535 ECU_ADDRESS 0x4000063E /end MEASUREMENT
/begin MEASUREMENT Fuel_LvlIdx "Look up table to allownon-linear characterization of sensors" UWORD CompuMethod_15 1 0 0 127.998 ECU_ADDRESS 0x40000640 /end MEASUREMENT
/begin MEASUREMENT Fuel_LvlRaw "After conversion to engineering units, before range checking" FLOAT32_IEEE CompuMethod_6 1 0 -1E+17 1E+17 ECU_ADDRESS 0x40000642 /end MEASUREMENT
/begin MEASUREMENT FuelDeltaPress "Fuel Delta Pressure - across the fuel injector" FLOAT32_IEEE CompuMethod_8 1 0 -1E+17 1E+17 ECU_ADDRESS 0x4000064F /end MEASUREMENT
/begin MEASUREMENT FuelDeltaPressure "Fuel pressure across injector (rail - manifold)" FLOAT32_IEEE CompuMethod_8 1 0 -1E+17 1E+17 ECU_ADDRESS 0x40000653 /end MEASUREMENT
/begin MEASUREMENT FuelLevel_FiltConst "FuelLevel_FiltConst" FLOAT32_IEEE CompuMethod_20 1 0 -1E+17 1E+17 ECU_ADDRESS 0x4000065F /end MEASUREMENT
/begin MEASUREMENT FuelLevel_FiltConstColIdx "FuelLevel_FiltConst" UWORD CompuMethod_15 1 0 0 127.998 ECU_ADDRESS 0x40000663 /end MEASUREMENT
/begin MEASUREMENT FuelLevel_FiltConstColIn "FuelLevel_FiltConst" FLOAT32_IEEE CompuMethod_117 1 0 -1E+17 1E+17 ECU_ADDRESS 0x40000665 /end MEASUREMENT
/begin MEASUREMENT FuelLevel_FiltConstRowIdx "FuelLevel_FiltConst" UWORD CompuMethod_15 1 0 0 127.998 ECU_ADDRESS 0x40000669 /end MEASUREMENT
/begin MEASUREMENT FuelLevel_FiltConstRowIn "FuelLevel_FiltConst" FLOAT32_IEEE CompuMethod_20 1 0 -1E+17 1E+17 ECU_ADDRESS 0x4000066B /end MEASUREMENT
/begin MEASUREMENT FuelLvl_Fin "" FLOAT32_IEEE CompuMethod_2 1 0 -1E+17 1E+17 ECU_ADDRESS 0x4000066F /end MEASUREMENT
/begin MEASUREMENT FuelLvl_NVM_Prb "" FLOAT32_IEEE CompuMethod_2 1 0 -1E+17 1E+17 ECU_ADDRESS 0x40000673 /end MEASUREMENT
/begin MEASUREMENT FUELP "Display output in engineering units" UBYTE CompuMethod_4 1 0 0 1 ECU_ADDRESS 0x40000677 /end MEASUREMENT
/begin MEASUREMENT FuelPres "Final value after Linear Sensor Characterization" FLOAT32_IEEE CompuMethod_13 1 0 -1E+17 1E+17 ECU_ADDRESS 0x40000678 /end MEASUREMENT
/begin MEASUREMENT FuelPres_FiltDirection "" UBYTE CompuMethod_34 1 0 0 1 ECU_ADDRESS 0x4000067C /end MEASUREMENT
/begin MEASUREMENT FuelPres_FiltFilterConst "" FLOAT32_IEEE CompuMethod_2 1 0 -1E+17 1E+17 ECU_ADDRESS 0x4000067D /end MEASUREMENT
/begin MEASUREMENT FuelPres_FiltFiltered "" FLOAT32_IEEE CompuMethod_2 1 0 -1E+17 1E+17 ECU_ADDRESS 0x40000681 /end MEASUREMENT
/begin MEASUREMENT FuelPresADC "Singal measured directly from sensor" UWORD CompuMethod_16 1 0 0 65535 ECU_ADDRESS 0x40000685 /end MEASUREMENT
/begin MEASUREMENT FuelPresRaw "After conversion to engineering units, before range checking" FLOAT32_IEEE CompuMethod_13 1 0 -1E+17 1E+17 ECU_ADDRESS 0x40000687 /end MEASUREMENT
/begin MEASUREMENT FuelSens "Final value after Linear Sensor Characterization" FLOAT32_IEEE CompuMethod_6 1 0 -1E+17 1E+17 ECU_ADDRESS 0x4000068F /end MEASUREMENT
/begin MEASUREMENT FuelSensADC "Singal measured directly from sensor" ULONG CompuMethod_119 1 0 0 4294970000 ECU_ADDRESS 0x40000693 /end MEASUREMENT
/begin MEASUREMENT FuelSensRaw "After conversion to engineering units, before range checking" FLOAT32_IEEE CompuMethod_6 1 0 -1E+17 1E+17 ECU_ADDRESS 0x40000697 /end MEASUREMENT
/begin MEASUREMENT GPS_Altitude_Prb "" FLOAT32_IEEE CompuMethod_2 1 0 -1E+17 1E+17 ECU_ADDRESS 0x400006A3 /end MEASUREMENT
/begin MEASUREMENT GPS_Course_Prb "" FLOAT32_IEEE CompuMethod_2 1 0 -1E+17 1E+17 ECU_ADDRESS 0x400006A7 /end MEASUREMENT
/begin MEASUREMENT GPS_DayUTC_Prb "" FLOAT32_IEEE CompuMethod_2 1 0 -1E+17 1E+17 ECU_ADDRESS 0x400006AB /end MEASUREMENT
/begin MEASUREMENT GPS_HoursUTC_Prb "" FLOAT32_IEEE CompuMethod_2 1 0 -1E+17 1E+17 ECU_ADDRESS 0x400006AF /end MEASUREMENT
/begin MEASUREMENT GPS_Latitude_Prb "" FLOAT32_IEEE CompuMethod_2 1 0 -1E+17 1E+17 ECU_ADDRESS 0x400006B3 /end MEASUREMENT
/begin MEASUREMENT GPS_Longitude_Prb "" FLOAT32_IEEE CompuMethod_2 1 0 -1E+17 1E+17 ECU_ADDRESS 0x400006B7 /end MEASUREMENT
/begin MEASUREMENT GPS_MinutesUTC_Prb "" FLOAT32_IEEE CompuMethod_2 1 0 -1E+17 1E+17 ECU_ADDRESS 0x400006BB /end MEASUREMENT
/begin MEASUREMENT GPS_MonthUTC_Prb "" FLOAT32_IEEE CompuMethod_2 1 0 -1E+17 1E+17 ECU_ADDRESS 0x400006BF /end MEASUREMENT
/begin MEASUREMENT GPS_SatelliteCount_Prb "" FLOAT32_IEEE CompuMethod_2 1 0 -1E+17 1E+17 ECU_ADDRESS 0x400006C3 /end MEASUREMENT
/begin MEASUREMENT GPS_SecondsUTC_Prb "" FLOAT32_IEEE CompuMethod_2 1 0 -1E+17 1E+17 ECU_ADDRESS 0x400006C7 /end MEASUREMENT
/begin MEASUREMENT GPS_Speed_Prb "" FLOAT32_IEEE CompuMethod_2 1 0 -1E+17 1E+17 ECU_ADDRESS 0x400006CB /end MEASUREMENT
/begin MEASUREMENT GPS_Valid_Prb "" UBYTE CompuMethod_11 1 0 0 1 ECU_ADDRESS 0x400006CF /end MEASUREMENT
/begin MEASUREMENT GPS_YearUTC_Prb "" FLOAT32_IEEE CompuMethod_2 1 0 -1E+17 1E+17 ECU_ADDRESS 0x400006D0 /end MEASUREMENT
/begin MEASUREMENT IAC_PDutyCycle "Actual duty cycle of actuator" FLOAT32_IEEE CompuMethod_6 1 0 -1E+17 1E+17 ECU_ADDRESS 0x400006D4 /end MEASUREMENT
/begin MEASUREMENT IAC_SDutyCycle "Actual duty cycle of actuator" FLOAT32_IEEE CompuMethod_6 1 0 -1E+17 1E+17 ECU_ADDRESS 0x400006D8 /end MEASUREMENT
/begin MEASUREMENT IAT "Final value after Linear Sensor Characterization" FLOAT32_IEEE CompuMethod_61 1 0 -1E+17 1E+17 ECU_ADDRESS 0x400006DC /end MEASUREMENT
/begin MEASUREMENT IAT_KeyUp "" FLOAT32_IEEE CompuMethod_61 1 0 -1E+17 1E+17 ECU_ADDRESS 0x400006E9 /end MEASUREMENT
/begin MEASUREMENT IAT_KeyUp09Idx "Index of IAT captured at key-up." UWORD CompuMethod_15 1 0 0 127.998 ECU_ADDRESS 0x400006ED /end MEASUREMENT
/begin MEASUREMENT IAT_KeyUp09In "Index of IAT captured at key-up." FLOAT32_IEEE CompuMethod_27 1 0 -1E+17 1E+17 ECU_ADDRESS 0x400006EF /end MEASUREMENT
/begin MEASUREMENT IAT05Idx "Index of IAT" UWORD CompuMethod_15 1 0 0 127.998 ECU_ADDRESS 0x400006FB /end MEASUREMENT
/begin MEASUREMENT IAT05In "Index of IAT" FLOAT32_IEEE CompuMethod_27 1 0 -1E+17 1E+17 ECU_ADDRESS 0x400006FD /end MEASUREMENT
/begin MEASUREMENT IAT17Idx "Index of IAT" UWORD CompuMethod_15 1 0 0 127.998 ECU_ADDRESS 0x40000701 /end MEASUREMENT
/begin MEASUREMENT IAT17In "Index of IAT" FLOAT32_IEEE CompuMethod_27 1 0 -1E+17 1E+17 ECU_ADDRESS 0x40000703 /end MEASUREMENT
/begin MEASUREMENT IATADC "Signal measured directly from sensor" UWORD CompuMethod_16 1 0 0 65535 ECU_ADDRESS 0x40000707 /end MEASUREMENT
/begin MEASUREMENT IATIdx "Look up table to allownon-linear characterization of sensors" UWORD CompuMethod_15 1 0 0 127.998 ECU_ADDRESS 0x40000729 /end MEASUREMENT
/begin MEASUREMENT IATRaw "After conversion to engineering units, before range checking" FLOAT32_IEEE CompuMethod_61 1 0 -1E+17 1E+17 ECU_ADDRESS 0x4000072B /end MEASUREMENT
/begin MEASUREMENT InjDeltaPress09Idx "" UWORD CompuMethod_15 1 0 0 127.998 ECU_ADDRESS 0x40000759 /end MEASUREMENT
/begin MEASUREMENT InjDeltaPress09In "" FLOAT32_IEEE CompuMethod_2 1 0 -1E+17 1E+17 ECU_ADDRESS 0x4000075B /end MEASUREMENT
/begin MEASUREMENT LeanSwPtDelta "If actual O2 reaches this point, switch the target to the RichTargetDelta" FLOAT32_IEEE CompuMethod_44 1 0 -1E+17 1E+17 ECU_ADDRESS 0x400007A6 /end MEASUREMENT
/begin MEASUREMENT LeanTargetDelta "Target on the lean side for perturbation." FLOAT32_IEEE CompuMethod_44 1 0 -1E+17 1E+17 ECU_ADDRESS 0x400007AA /end MEASUREMENT
/begin MEASUREMENT LiquidO2Control_DTerm "Closed-loop O2 control D-Term, for bank" FLOAT32_IEEE CompuMethod_33 1 0 -1E+17 1E+17 ECU_ADDRESS 0x400007AF /end MEASUREMENT
/begin MEASUREMENT LiquidO2Control_ErrorTerm "Closed-loop O2 control error-term, for bank" FLOAT32_IEEE CompuMethod_33 1 0 -1E+17 1E+17 ECU_ADDRESS 0x400007B3 /end MEASUREMENT
/begin MEASUREMENT LiquidO2Control_ITerm "Closed-loop O2 control I-Term" FLOAT32_IEEE CompuMethod_33 1 0 -1E+17 1E+17 ECU_ADDRESS 0x400007B7 /end MEASUREMENT
/begin MEASUREMENT LiquidO2Control_PTerm "Closed-loop O2 control P-Term" FLOAT32_IEEE CompuMethod_33 1 0 -1E+17 1E+17 ECU_ADDRESS 0x400007BB /end MEASUREMENT
/begin MEASUREMENT MAF "Final value after Linear Sensor Characterization" FLOAT32_IEEE CompuMethod_30 1 0 -1E+17 1E+17 ECU_ADDRESS 0x400007BF /end MEASUREMENT
/begin MEASUREMENT MAFADC "Signal measured directly from sensor" FLOAT32_IEEE CompuMethod_99 1 0 -1E+17 1E+17 ECU_ADDRESS 0x400007C9 /end MEASUREMENT
/begin MEASUREMENT MAFIdx "Look up table to allownon-linear characterization of sensors" UWORD CompuMethod_15 1 0 0 127.998 ECU_ADDRESS 0x400007D1 /end MEASUREMENT
/begin MEASUREMENT MAFPort05Idx "Index of MAF" UWORD CompuMethod_15 1 0 0 127.998 ECU_ADDRESS 0x400007D3 /end MEASUREMENT
/begin MEASUREMENT MAFPort05In "Index of MAF" FLOAT32_IEEE CompuMethod_30 1 0 -1E+17 1E+17 ECU_ADDRESS 0x400007D5 /end MEASUREMENT
/begin MEASUREMENT MAFRaw "After conversion to engineering units, before range checking" FLOAT32_IEEE CompuMethod_30 1 0 -1E+17 1E+17 ECU_ADDRESS 0x400007D9 /end MEASUREMENT
/begin MEASUREMENT MAP "Final value after Linear Sensor Characterization" FLOAT32_IEEE CompuMethod_8 1 0 -1E+17 1E+17 ECU_ADDRESS 0x400007E1 /end MEASUREMENT
/begin MEASUREMENT MAP_filtDirection "" UBYTE CompuMethod_34 1 0 0 1 ECU_ADDRESS 0x400007E5 /end MEASUREMENT
/begin MEASUREMENT MAP_filtFilterConst "" FLOAT32_IEEE CompuMethod_2 1 0 -1E+17 1E+17 ECU_ADDRESS 0x400007E6 /end MEASUREMENT
/begin MEASUREMENT MAP_filtFiltered "" FLOAT32_IEEE CompuMethod_2 1 0 -1E+17 1E+17 ECU_ADDRESS 0x400007EA /end MEASUREMENT
/begin MEASUREMENT MAP05Idx "Index of MAP" UWORD CompuMethod_15 1 0 0 127.998 ECU_ADDRESS 0x400007EE /end MEASUREMENT
/begin MEASUREMENT MAP05In "Index of MAP" FLOAT32_IEEE CompuMethod_8 1 0 -1E+17 1E+17 ECU_ADDRESS 0x400007F0 /end MEASUREMENT
/begin MEASUREMENT MAP09Idx "Index of MAP" UWORD CompuMethod_15 1 0 0 127.998 ECU_ADDRESS 0x400007F4 /end MEASUREMENT
/begin MEASUREMENT MAP09In "Index of MAP" FLOAT32_IEEE CompuMethod_8 1 0 -1E+17 1E+17 ECU_ADDRESS 0x400007F6 /end MEASUREMENT
/begin MEASUREMENT MAP17Idx "Index of MAP" UWORD CompuMethod_15 1 0 0 127.998 ECU_ADDRESS 0x400007FA /end MEASUREMENT
/begin MEASUREMENT MAP17In "Index of MAP" FLOAT32_IEEE CompuMethod_8 1 0 -1E+17 1E+17 ECU_ADDRESS 0x400007FC /end MEASUREMENT
/begin MEASUREMENT MAPADC "Singal measured directly from sensor" FLOAT32_IEEE CompuMethod_22 1 0 -1E+17 1E+17 ECU_ADDRESS 0x40000800 /end MEASUREMENT
/begin MEASUREMENT MAPRaw "After conversion to engineering units, before range checking" FLOAT32_IEEE CompuMethod_8 1 0 -1E+17 1E+17 ECU_ADDRESS 0x40000804 /end MEASUREMENT
/begin MEASUREMENT MAPTime "Final value after Linear Sensor Characterization" FLOAT32_IEEE CompuMethod_8 1 0 -1E+17 1E+17 ECU_ADDRESS 0x40000808 /end MEASUREMENT
/begin MEASUREMENT MAPTimeADC "Singal measured directly from sensor" UWORD CompuMethod_16 1 0 0 65535 ECU_ADDRESS 0x4000080C /end MEASUREMENT
/begin MEASUREMENT MAPTimeRaw "After conversion to engineering units, before range checking" FLOAT32_IEEE CompuMethod_8 1 0 -1E+17 1E+17 ECU_ADDRESS 0x4000080E /end MEASUREMENT
/begin MEASUREMENT MaxGovDGainErrorMult "" FLOAT32_IEEE CompuMethod_33 1 0 -1E+17 1E+17 ECU_ADDRESS 0x4000086A /end MEASUREMENT
/begin MEASUREMENT MaxGovDTerm "" FLOAT32_IEEE CompuMethod_2 1 0 -1E+17 1E+17 ECU_ADDRESS 0x4000086E /end MEASUREMENT
/begin MEASUREMENT MaxGovError "" FLOAT32_IEEE CompuMethod_2 1 0 -1E+17 1E+17 ECU_ADDRESS 0x40000872 /end MEASUREMENT
/begin MEASUREMENT MaxGovETCMode "" UBYTE CompuMethod_141 1 0 0 1 ECU_ADDRESS 0x40000876 /end MEASUREMENT
/begin MEASUREMENT MaxGovHold "" SBYTE CompuMethod_142 1 0 -128 127 ECU_ADDRESS 0x40000877 /end MEASUREMENT
/begin MEASUREMENT MaxGovIC "" FLOAT32_IEEE CompuMethod_2 1 0 -1E+17 1E+17 ECU_ADDRESS 0x40000878 /end MEASUREMENT
/begin MEASUREMENT MaxGovIGainErrorMult "" FLOAT32_IEEE CompuMethod_33 1 0 -1E+17 1E+17 ECU_ADDRESS 0x4000087C /end MEASUREMENT
/begin MEASUREMENT MaxGovITerm "" FLOAT32_IEEE CompuMethod_2 1 0 -1E+17 1E+17 ECU_ADDRESS 0x40000880 /end MEASUREMENT
/begin MEASUREMENT MaxGovOutput "" FLOAT32_IEEE CompuMethod_2 1 0 -1E+17 1E+17 ECU_ADDRESS 0x40000884 /end MEASUREMENT
/begin MEASUREMENT MaxGovPGainErrorMult "" FLOAT32_IEEE CompuMethod_33 1 0 -1E+17 1E+17 ECU_ADDRESS 0x40000888 /end MEASUREMENT
/begin MEASUREMENT MaxGovPreloadITerm "Preload for Max Gov PID ITerm based on engine acceleration rate upon entry into max gov." FLOAT32_IEEE CompuMethod_6 1 0 -1E+17 1E+17 ECU_ADDRESS 0x4000088C /end MEASUREMENT
/begin MEASUREMENT MaxGovPTerm "" FLOAT32_IEEE CompuMethod_2 1 0 -1E+17 1E+17 ECU_ADDRESS 0x40000890 /end MEASUREMENT
/begin MEASUREMENT MaxGovReset "" SBYTE CompuMethod_143 1 0 -128 127 ECU_ADDRESS 0x40000894 /end MEASUREMENT
/begin MEASUREMENT MaxGovRPMSetpoint "RPMSetpoint of Max Gov controller." FLOAT32_IEEE CompuMethod_25 1 0 -1E+17 1E+17 ECU_ADDRESS 0x40000895 /end MEASUREMENT
/begin MEASUREMENT MaxGovSpeedErrorIdx "" UWORD CompuMethod_15 1 0 0 127.998 ECU_ADDRESS 0x40000899 /end MEASUREMENT
/begin MEASUREMENT MaxGovSpeedErrorIn "" FLOAT32_IEEE CompuMethod_25 1 0 -1E+17 1E+17 ECU_ADDRESS 0x4000089B /end MEASUREMENT
/begin MEASUREMENT MaxGovState "" UBYTE CompuMethod_36 1 0 0 1 ECU_ADDRESS 0x4000089F /end MEASUREMENT
/begin MEASUREMENT MaxSparkLimit "Maximum allowable spark advance." FLOAT32_IEEE CompuMethod_70 1 0 -1E+17 1E+17 ECU_ADDRESS 0x400008A0 /end MEASUREMENT
/begin MEASUREMENT MinGovClntRPMSetPt "RPM setpoint based on ECT." FLOAT32_IEEE CompuMethod_25 1 0 -1E+17 1E+17 ECU_ADDRESS 0x400008A4 /end MEASUREMENT
/begin MEASUREMENT MinGovRPMSetPt "" FLOAT32_IEEE CompuMethod_2 1 0 -1E+17 1E+17 ECU_ADDRESS 0x400008A9 /end MEASUREMENT
/begin MEASUREMENT MinOilPressure_Fault "Minimum oil pressure based on RPM - engine faults and shuts down below this" FLOAT32_IEEE CompuMethod_144 1 0 -1E+17 1E+17 ECU_ADDRESS 0x400008AD /end MEASUREMENT
/begin MEASUREMENT MinOilPressure_Warn "Minimum oil pressure based on RPM - indicator light comes on below this" FLOAT32_IEEE CompuMethod_144 1 0 -1E+17 1E+17 ECU_ADDRESS 0x400008B1 /end MEASUREMENT
/begin MEASUREMENT MotoringDetectionFlag "" UBYTE CompuMethod_11 1 0 0 1 ECU_ADDRESS 0x40000A2C /end MEASUREMENT
/begin MEASUREMENT MotoringDetectionTime "" FLOAT32_IEEE CompuMethod_2 1 0 -1E+17 1E+17 ECU_ADDRESS 0x40000A2D /end MEASUREMENT
/begin MEASUREMENT NextCylinderToInject "Debug Variable" UBYTE CompuMethod_1 1 0 0 0 ECU_ADDRESS 0x40000A31 /end MEASUREMENT
/begin MEASUREMENT NextCylinderToSpark "Debug Variable" UBYTE CompuMethod_1 1 0 0 0 ECU_ADDRESS 0x40000A32 /end MEASUREMENT
/begin MEASUREMENT NextInjectorAngle "Debug Variable" FLOAT32_IEEE CompuMethod_2 1 0 0 0 ECU_ADDRESS 0x40000A33 /end MEASUREMENT
/begin MEASUREMENT NextSparkAngle "Debug Variable" FLOAT32_IEEE CompuMethod_2 1 0 0 0 ECU_ADDRESS 0x40000A37 /end MEASUREMENT
/begin MEASUREMENT NonVolatileCRC "Calculated NonVolatile CRC" ULONG CompuMethod_11 1 0 0 65535 ECU_ADDRESS 0x40000A3B /end MEASUREMENT
/begin MEASUREMENT NonVolatileFormatID "Unique identifier of the NonVolatile memory format.  Used to validate whether stored variables are in the correct form for the program" ULONG CompuMethod_60 1 0 0 4294970000 ECU_ADDRESS 0x40000A3F /end MEASUREMENT
/begin MEASUREMENT NonVolatileStatus "Indicates how NonVolatile memory was loaded" UBYTE CompuMethod_149 1 0 0 6 ECU_ADDRESS 0x40000A43 /end MEASUREMENT
/begin MEASUREMENT O2LeanTime "" FLOAT32_IEEE CompuMethod_2 1 0 -1E+17 1E+17 ECU_ADDRESS 0x40000A54 /end MEASUREMENT
/begin MEASUREMENT O2MAFErrGainMult "O2 PID controller system gain based on MAF port." FLOAT32_IEEE CompuMethod_49 1 0 -1E+17 1E+17 ECU_ADDRESS 0x40000A58 /end MEASUREMENT
/begin MEASUREMENT O2NECCTErrGainMult "O2 PID controller system gain based on NECCT." FLOAT32_IEEE CompuMethod_49 1 0 -1E+17 1E+17 ECU_ADDRESS 0x40000A5C /end MEASUREMENT
/begin MEASUREMENT O2NotActiveTime "" FLOAT32_IEEE CompuMethod_2 1 0 -1E+17 1E+17 ECU_ADDRESS 0x40000A60 /end MEASUREMENT
/begin MEASUREMENT O2RichTime "" FLOAT32_IEEE CompuMethod_2 1 0 -1E+17 1E+17 ECU_ADDRESS 0x40000A64 /end MEASUREMENT
/begin MEASUREMENT O2TargetEquivRatio "Current target equivalence ratio for closed-loop O2 control." FLOAT32_IEEE CompuMethod_153 1 0 -1E+17 1E+17 ECU_ADDRESS 0x40000A6D /end MEASUREMENT
/begin MEASUREMENT OilPres "Final value after Linear Sensor Characterization" FLOAT32_IEEE CompuMethod_144 1 0 -1E+17 1E+17 ECU_ADDRESS 0x40000A72 /end MEASUREMENT
/begin MEASUREMENT OilPres_FiltDirection "" UBYTE CompuMethod_34 1 0 0 1 ECU_ADDRESS 0x40000A76 /end MEASUREMENT
/begin MEASUREMENT OilPres_FiltFilterConst "" FLOAT32_IEEE CompuMethod_2 1 0 -1E+17 1E+17 ECU_ADDRESS 0x40000A77 /end MEASUREMENT
/begin MEASUREMENT OilPres_FiltFiltered "" FLOAT32_IEEE CompuMethod_2 1 0 -1E+17 1E+17 ECU_ADDRESS 0x40000A7B /end MEASUREMENT
/begin MEASUREMENT OilPresADC "Singal measured directly from sensor" UWORD CompuMethod_16 1 0 0 65535 ECU_ADDRESS 0x40000A7F /end MEASUREMENT
/begin MEASUREMENT OilPresRaw "After conversion to engineering units, before range checking" FLOAT32_IEEE CompuMethod_144 1 0 -1E+17 1E+17 ECU_ADDRESS 0x40000A81 /end MEASUREMENT
/begin MEASUREMENT OXY05Idx "Index of fuel oxygenation content" UWORD CompuMethod_15 1 0 0 127.998 ECU_ADDRESS 0x40000A87 /end MEASUREMENT
/begin MEASUREMENT OXY05In "Index of fuel oxygenation content" FLOAT32_IEEE CompuMethod_6 1 0 -1E+17 1E+17 ECU_ADDRESS 0x40000A89 /end MEASUREMENT
/begin MEASUREMENT OXYTransFuelMult "Transient fuel multiplier based on OXY.  Only engaged during transient fueling" FLOAT32_IEEE CompuMethod_2 1 0 -1E+17 1E+17 ECU_ADDRESS 0x40000A8D /end MEASUREMENT
/begin MEASUREMENT PHI1_FiltFin "" FLOAT32_IEEE CompuMethod_2 1 0 -1E+17 1E+17 ECU_ADDRESS 0x40000AC1 /end MEASUREMENT
/begin MEASUREMENT PHI2_FiltFin "" FLOAT32_IEEE CompuMethod_2 1 0 -1E+17 1E+17 ECU_ADDRESS 0x40000AC5 /end MEASUREMENT
/begin MEASUREMENT PostO2Delag "" FLOAT32_IEEE CompuMethod_2 1 0 -1E+17 1E+17 ECU_ADDRESS 0x40000AC9 /end MEASUREMENT
/begin MEASUREMENT PreO2Delag "" FLOAT32_IEEE CompuMethod_2 1 0 -1E+17 1E+17 ECU_ADDRESS 0x40000ACD /end MEASUREMENT
/begin MEASUREMENT pwm_create_ETCPin_PWMOutput "Debug Variable" UBYTE CompuMethod_31 1 0 0 0 ECU_ADDRESS 0x40000AD7 /end MEASUREMENT
/begin MEASUREMENT pwm_create_FAN1Pin_PWM_PWMOutput "Debug Variable" UBYTE CompuMethod_31 1 0 0 0 ECU_ADDRESS 0x40000AD8 /end MEASUREMENT
/begin MEASUREMENT pwm_create_FAN2Pin_PWM_PWMOutput "Debug Variable" UBYTE CompuMethod_31 1 0 0 0 ECU_ADDRESS 0x40000AD9 /end MEASUREMENT
/begin MEASUREMENT pwm_create_IAC_PPin_PWMOutput "Debug Variable" UBYTE CompuMethod_31 1 0 0 0 ECU_ADDRESS 0x40000ADA /end MEASUREMENT
/begin MEASUREMENT pwm_create_IAC_SPin_PWMOutput "Debug Variable" UBYTE CompuMethod_31 1 0 0 0 ECU_ADDRESS 0x40000ADB /end MEASUREMENT
/begin MEASUREMENT pwm_create_WASTEGATE_PWMOutput "Debug Variable" UBYTE CompuMethod_31 1 0 0 0 ECU_ADDRESS 0x40000ADC /end MEASUREMENT
/begin MEASUREMENT pwm_set_ETCPin_PWMOutput "Debug Variable" UBYTE CompuMethod_31 1 0 0 0 ECU_ADDRESS 0x40000ADD /end MEASUREMENT
/begin MEASUREMENT pwm_set_FAN1Pin_PWM_PWMOutput "Debug Variable" UBYTE CompuMethod_31 1 0 0 0 ECU_ADDRESS 0x40000ADE /end MEASUREMENT
/begin MEASUREMENT pwm_set_FAN2Pin_PWM_PWMOutput "Debug Variable" UBYTE CompuMethod_31 1 0 0 0 ECU_ADDRESS 0x40000ADF /end MEASUREMENT
/begin MEASUREMENT pwm_set_IAC_PPin_PWMOutput "Debug Variable" UBYTE CompuMethod_31 1 0 0 0 ECU_ADDRESS 0x40000AE0 /end MEASUREMENT
/begin MEASUREMENT pwm_set_IAC_SPin_PWMOutput "Debug Variable" UBYTE CompuMethod_31 1 0 0 0 ECU_ADDRESS 0x40000AE1 /end MEASUREMENT
/begin MEASUREMENT pwm_set_WASTEGATE_PWMOutput "Debug Variable" UBYTE CompuMethod_31 1 0 0 0 ECU_ADDRESS 0x40000AE2 /end MEASUREMENT
/begin MEASUREMENT resource_allocation "Debug Variable" UBYTE CompuMethod_31 1 0 0 0 ECU_ADDRESS 0x40000AE3 /end MEASUREMENT
/begin MEASUREMENT RevLimiterState "" UBYTE CompuMethod_159 1 0 0 255 ECU_ADDRESS 0x40000AE4 /end MEASUREMENT
/begin MEASUREMENT RichSwPtDelta "If actual O2 reaches this point, switch the target to the LeanTargetDelta" FLOAT32_IEEE CompuMethod_44 1 0 -1E+17 1E+17 ECU_ADDRESS 0x40000AE5 /end MEASUREMENT
/begin MEASUREMENT RichTargetDelta "Target on the rich side for perturbation." FLOAT32_IEEE CompuMethod_44 1 0 -1E+17 1E+17 ECU_ADDRESS 0x40000AE9 /end MEASUREMENT
/begin MEASUREMENT RPM05Idx "Index of RPM" UWORD CompuMethod_15 1 0 0 127.998 ECU_ADDRESS 0x40000AF1 /end MEASUREMENT
/begin MEASUREMENT RPM05In "Index of RPM" FLOAT32_IEEE CompuMethod_25 1 0 -1E+17 1E+17 ECU_ADDRESS 0x40000AF3 /end MEASUREMENT
/begin MEASUREMENT RPM09Idx "Index of RPM" UWORD CompuMethod_15 1 0 0 127.998 ECU_ADDRESS 0x40000AF7 /end MEASUREMENT
/begin MEASUREMENT RPM09In "Index of RPM" FLOAT32_IEEE CompuMethod_25 1 0 -1E+17 1E+17 ECU_ADDRESS 0x40000AF9 /end MEASUREMENT
/begin MEASUREMENT RPM17Idx "Index of RPM" UWORD CompuMethod_15 1 0 0 127.998 ECU_ADDRESS 0x40000AFD /end MEASUREMENT
/begin MEASUREMENT RPM17In "Index of RPM" FLOAT32_IEEE CompuMethod_25 1 0 -1E+17 1E+17 ECU_ADDRESS 0x40000AFF /end MEASUREMENT
/begin MEASUREMENT RPMFalling "Indicates whether the RPM is falling" UBYTE CompuMethod_161 1 0 0 1 ECU_ADDRESS 0x40000B0A /end MEASUREMENT
/begin MEASUREMENT RPMFilt_Final "" FLOAT32_IEEE CompuMethod_2 1 0 -1E+17 1E+17 ECU_ADDRESS 0x40000B0B /end MEASUREMENT
/begin MEASUREMENT RPMFilt_PostLowPass "" FLOAT32_IEEE CompuMethod_2 1 0 -1E+17 1E+17 ECU_ADDRESS 0x40000B0F /end MEASUREMENT
/begin MEASUREMENT Scramble "Display output in engineering units" UBYTE CompuMethod_26 1 0 0 1 ECU_ADDRESS 0x40000B17 /end MEASUREMENT
/begin MEASUREMENT Scramble_Raw "Display output in engineering units" FLOAT32_IEEE CompuMethod_22 1 0 -1E+17 1E+17 ECU_ADDRESS 0x40000B18 /end MEASUREMENT
/begin MEASUREMENT SensVolt "Final value after Linear Sensor Characterization" FLOAT32_IEEE CompuMethod_165 1 0 -1E+17 1E+17 ECU_ADDRESS 0x40000B1C /end MEASUREMENT
/begin MEASUREMENT SensVoltADC "Singal measured directly from sensor" UWORD CompuMethod_16 1 0 0 65535 ECU_ADDRESS 0x40000B20 /end MEASUREMENT
/begin MEASUREMENT SensVoltRaw "After conversion to engineering units, before range checking" FLOAT32_IEEE CompuMethod_165 1 0 -1E+17 1E+17 ECU_ADDRESS 0x40000B22 /end MEASUREMENT
/begin MEASUREMENT SpkMinGovDGainErrorMult "" FLOAT32_IEEE CompuMethod_33 1 0 -1E+17 1E+17 ECU_ADDRESS 0x40000B46 /end MEASUREMENT
/begin MEASUREMENT SpkMinGovDTerm "PID Derivative Term" FLOAT32_IEEE CompuMethod_89 1 0 -1E+17 1E+17 ECU_ADDRESS 0x40000B4A /end MEASUREMENT
/begin MEASUREMENT SpkMinGovError "PID Error Term" FLOAT32_IEEE CompuMethod_89 1 0 -1E+17 1E+17 ECU_ADDRESS 0x40000B4E /end MEASUREMENT
/begin MEASUREMENT SpkMinGovPGainErrorMult "" FLOAT32_IEEE CompuMethod_33 1 0 -1E+17 1E+17 ECU_ADDRESS 0x40000B56 /end MEASUREMENT
/begin MEASUREMENT SpkMinGovPTerm "PID Proportional Term" FLOAT32_IEEE CompuMethod_89 1 0 -1E+17 1E+17 ECU_ADDRESS 0x40000B5A /end MEASUREMENT
/begin MEASUREMENT SpkMinGovSpeedErrorIdx "" UWORD CompuMethod_15 1 0 0 127.998 ECU_ADDRESS 0x40000B5E /end MEASUREMENT
/begin MEASUREMENT SpkMinGovSpeedErrorIn "" FLOAT32_IEEE CompuMethod_2 1 0 -1E+17 1E+17 ECU_ADDRESS 0x40000B60 /end MEASUREMENT
/begin MEASUREMENT SSEng "" UBYTE CompuMethod_11 1 0 0 1 ECU_ADDRESS 0x40000B68 /end MEASUREMENT
/begin MEASUREMENT SSEngOpr "Steady-State Engine Operation" UBYTE CompuMethod_170 1 0 0 1 ECU_ADDRESS 0x40000B69 /end MEASUREMENT
/begin MEASUREMENT SSLoadDirection "" UBYTE CompuMethod_34 1 0 0 1 ECU_ADDRESS 0x40000B6A /end MEASUREMENT
/begin MEASUREMENT SSLoadFilterConst "" FLOAT32_IEEE CompuMethod_2 1 0 -1E+17 1E+17 ECU_ADDRESS 0x40000B6B /end MEASUREMENT
/begin MEASUREMENT SSLoadFiltered "" FLOAT32_IEEE CompuMethod_2 1 0 -1E+17 1E+17 ECU_ADDRESS 0x40000B6F /end MEASUREMENT
/begin MEASUREMENT SSRPMDirection "" UBYTE CompuMethod_34 1 0 0 1 ECU_ADDRESS 0x40000B73 /end MEASUREMENT
/begin MEASUREMENT SSRPMFilterConst "" FLOAT32_IEEE CompuMethod_2 1 0 -1E+17 1E+17 ECU_ADDRESS 0x40000B74 /end MEASUREMENT
/begin MEASUREMENT SSRPMFiltered "" FLOAT32_IEEE CompuMethod_2 1 0 -1E+17 1E+17 ECU_ADDRESS 0x40000B78 /end MEASUREMENT
/begin MEASUREMENT SysVolt "Final value after Linear Sensor Characterization" FLOAT32_IEEE CompuMethod_165 1 0 -1E+17 1E+17 ECU_ADDRESS 0x40000B81 /end MEASUREMENT
/begin MEASUREMENT SysVolt09Idx "Index of system voltage" UWORD CompuMethod_15 1 0 0 127.998 ECU_ADDRESS 0x40000B85 /end MEASUREMENT
/begin MEASUREMENT SysVolt09In "Index of system voltage" FLOAT32_IEEE CompuMethod_165 1 0 -1E+17 1E+17 ECU_ADDRESS 0x40000B87 /end MEASUREMENT
/begin MEASUREMENT SysVoltADC "Singal measured directly from sensor" UWORD CompuMethod_16 1 0 0 65535 ECU_ADDRESS 0x40000B8B /end MEASUREMENT
/begin MEASUREMENT SysVoltRaw "After conversion to engineering units, before range checking" FLOAT32_IEEE CompuMethod_165 1 0 -1E+17 1E+17 ECU_ADDRESS 0x40000B8D /end MEASUREMENT
/begin MEASUREMENT TimeSinceKeyOn "" FLOAT32_IEEE CompuMethod_2 1 0 -1E+17 1E+17 ECU_ADDRESS 0x40000B93 /end MEASUREMENT
/begin MEASUREMENT TimeSinceRun "" FLOAT32_IEEE CompuMethod_2 1 0 -1E+17 1E+17 ECU_ADDRESS 0x40000B97 /end MEASUREMENT
/begin MEASUREMENT TimeSinceStall "Indicates time since entering Stall State - saturates and disables at 2000 seconds" FLOAT32_IEEE CompuMethod_10 1 0 -1E+17 1E+17 ECU_ADDRESS 0x40000BA1 /end MEASUREMENT
/begin MEASUREMENT TotalSparkAdv "" FLOAT32_IEEE CompuMethod_2 1 0 -1E+17 1E+17 ECU_ADDRESS 0x40000BC9 /end MEASUREMENT
/begin MEASUREMENT TPS09Idx "Index of TPS" UWORD CompuMethod_15 1 0 0 127.998 ECU_ADDRESS 0x40000BD6 /end MEASUREMENT
/begin MEASUREMENT TPS09In "Index of TPS" FLOAT32_IEEE CompuMethod_6 1 0 -1E+17 1E+17 ECU_ADDRESS 0x40000BD8 /end MEASUREMENT
/begin MEASUREMENT TPS1Adapt_Hi "" FLOAT32_IEEE CompuMethod_2 1 0 -1E+17 1E+17 ECU_ADDRESS 0x40000BDC /end MEASUREMENT
/begin MEASUREMENT TPS1Adapt_Low "" FLOAT32_IEEE CompuMethod_2 1 0 -1E+17 1E+17 ECU_ADDRESS 0x40000BE0 /end MEASUREMENT
/begin MEASUREMENT TPS1ADC "" FLOAT32_IEEE CompuMethod_2 1 0 -1E+17 1E+17 ECU_ADDRESS 0x40000BE4 /end MEASUREMENT
/begin MEASUREMENT TPS1Percent "" FLOAT32_IEEE CompuMethod_2 1 0 -1E+17 1E+17 ECU_ADDRESS 0x40000BE8 /end MEASUREMENT
/begin MEASUREMENT TPS1PercentRaw "" FLOAT32_IEEE CompuMethod_2 1 0 -1E+17 1E+17 ECU_ADDRESS 0x40000BEC /end MEASUREMENT
/begin MEASUREMENT TPS2Adapt_Hi "" FLOAT32_IEEE CompuMethod_2 1 0 -1E+17 1E+17 ECU_ADDRESS 0x40000BF0 /end MEASUREMENT
/begin MEASUREMENT TPS2Adapt_Low "" FLOAT32_IEEE CompuMethod_2 1 0 -1E+17 1E+17 ECU_ADDRESS 0x40000BF4 /end MEASUREMENT
/begin MEASUREMENT TPS2ADC "" FLOAT32_IEEE CompuMethod_2 1 0 -1E+17 1E+17 ECU_ADDRESS 0x40000BF8 /end MEASUREMENT
/begin MEASUREMENT TPS2Percent "" FLOAT32_IEEE CompuMethod_2 1 0 -1E+17 1E+17 ECU_ADDRESS 0x40000BFC /end MEASUREMENT
/begin MEASUREMENT TPS2PercentRaw "" FLOAT32_IEEE CompuMethod_2 1 0 -1E+17 1E+17 ECU_ADDRESS 0x40000C00 /end MEASUREMENT
/begin MEASUREMENT TPSFinal "" FLOAT32_IEEE CompuMethod_6 1 0 -1E+17 1E+17 ECU_ADDRESS 0x40000C04 /end MEASUREMENT
/begin MEASUREMENT TPSRequestLookupAirOfst "" FLOAT32_IEEE CompuMethod_2 1 0 -1E+17 1E+17 ECU_ADDRESS 0x40000C08 /end MEASUREMENT
/begin MEASUREMENT TwoStep "Display output in engineering units" UBYTE CompuMethod_26 1 0 0 1 ECU_ADDRESS 0x40000C16 /end MEASUREMENT
/begin MEASUREMENT TwoStep_Raw "Display output in engineering units" UBYTE CompuMethod_26 1 0 0 1 ECU_ADDRESS 0x40000C17 /end MEASUREMENT
/begin MEASUREMENT VE_AdaptErrorIdxArrIdx "Multiplier on error for adaptation, should always be positive" UWORD CompuMethod_15 1 0 0 127.998 ECU_ADDRESS 0x40000C19 /end MEASUREMENT
/begin MEASUREMENT VE_AdaptErrorIdxArrIn "Multiplier on error for adaptation, should always be positive" FLOAT32_IEEE CompuMethod_2 1 0 -1E+17 1E+17 ECU_ADDRESS 0x40000C1B /end MEASUREMENT
/begin MEASUREMENT VEAdaptGainTbl "Multiplier on error for adaptation, should always be positive" FLOAT32_IEEE CompuMethod_2 1 0 -1E+17 1E+17 ECU_ADDRESS 0x40000C23 /end MEASUREMENT
/begin MEASUREMENT VSPD "Final value after Linear Sensor Characterization" FLOAT32_IEEE CompuMethod_180 1 0 -1E+17 1E+17 ECU_ADDRESS 0x40000C4A /end MEASUREMENT
/begin MEASUREMENT VSPD_ChangeReject_Enabled "" UBYTE CompuMethod_11 1 0 0 1 ECU_ADDRESS 0x40000C4E /end MEASUREMENT
/begin MEASUREMENT VSPD_DigFinal "" FLOAT32_IEEE CompuMethod_2 1 0 -1E+17 1E+17 ECU_ADDRESS 0x40000C4F /end MEASUREMENT
/begin MEASUREMENT VSPD_FinalFinal "" FLOAT32_IEEE CompuMethod_2 1 0 -1E+17 1E+17 ECU_ADDRESS 0x40000C5C /end MEASUREMENT
/begin MEASUREMENT VSPD_RateReject_Enabled "" UBYTE CompuMethod_11 1 0 0 1 ECU_ADDRESS 0x40000C60 /end MEASUREMENT
/begin MEASUREMENT VSPD09Idx "Index of VSPD" UWORD CompuMethod_15 1 0 0 127.998 ECU_ADDRESS 0x40000C61 /end MEASUREMENT
/begin MEASUREMENT VSPD09In "Index of VSPD" FLOAT32_IEEE CompuMethod_180 1 0 -1E+17 1E+17 ECU_ADDRESS 0x40000C63 /end MEASUREMENT
/begin MEASUREMENT VSPD17Idx "Index of VSPD" UWORD CompuMethod_15 1 0 0 127.998 ECU_ADDRESS 0x40000C67 /end MEASUREMENT
/begin MEASUREMENT VSPD17In "Index of VSPD" FLOAT32_IEEE CompuMethod_180 1 0 -1E+17 1E+17 ECU_ADDRESS 0x40000C69 /end MEASUREMENT
/begin MEASUREMENT VSPDADC "Signal measured directly from sensor" FLOAT32_IEEE CompuMethod_99 1 0 -1E+17 1E+17 ECU_ADDRESS 0x40000C6D /end MEASUREMENT
/begin MEASUREMENT VSPDIdx "Look up table to allownon-linear characterization of sensors" UWORD CompuMethod_15 1 0 0 127.998 ECU_ADDRESS 0x40000C71 /end MEASUREMENT
/begin MEASUREMENT VSPDRaw "After conversion to engineering units, before range checking" FLOAT32_IEEE CompuMethod_180 1 0 -1E+17 1E+17 ECU_ADDRESS 0x40000C73 /end MEASUREMENT
/begin MEASUREMENT Warmup_Time_Holdoff "Time before warmup fuel multiplier active" FLOAT32_IEEE CompuMethod_182 1 0 -1E+17 1E+17 ECU_ADDRESS 0x40000C77 /end MEASUREMENT
/begin MEASUREMENT WarmUpO2AdaptEnabled "Indicates whether FuelFlowComp map adapting is enabled due to WarmUp" UBYTE CompuMethod_47 1 0 0 1 ECU_ADDRESS 0x40000C7F /end MEASUREMENT
/begin MEASUREMENT WASTEGATEDutyCycle "Actual duty cycle of actuator" FLOAT32_IEEE CompuMethod_6 1 0 -1E+17 1E+17 ECU_ADDRESS 0x40000C84 /end MEASUREMENT
/begin CHARACTERISTIC Fuel_Cyl8_offset "Provide lock and relative offset to input signal." VALUE 0x80003B3A RecordLayout_4 0 CompuMethod_114 -1E+17 1E+17 /end CHARACTERISTIC
/begin CHARACTERISTIC Fuel_Cyl8_ovr "Provide lock and relative offset to input signal." VALUE 0x80003B3E RecordLayout_1 0 CompuMethod_115 0 1 /end CHARACTERISTIC
/begin CHARACTERISTIC Fuel_Global_offset "Provide lock and relative offset to input signal." VALUE 0x80003B3F RecordLayout_4 0 CompuMethod_114 -1E+17 1E+17 /end CHARACTERISTIC
/begin CHARACTERISTIC Fuel_Global_ovr "Provide lock and relative offset to input signal." VALUE 0x80003B43 RecordLayout_1 0 CompuMethod_115 0 1 /end CHARACTERISTIC
/begin CHARACTERISTIC Fuel_Lvl_new "Override result of linear sensor characterization, in engineering units" VALUE 0x80003B44 RecordLayout_4 0 CompuMethod_6 -1E+17 1E+17 /end CHARACTERISTIC
/begin CHARACTERISTIC Fuel_Lvl_ovr "" VALUE 0x80003B48 RecordLayout_1 0 CompuMethod_5 0 1 /end CHARACTERISTIC
/begin CHARACTERISTIC Fuel_LvlDefault "This is the initial default value should the sensor be in fault on key-up.  Otherwise the sensors outputs the last value prior to faulting" VALUE 0x80003B49 RecordLayout_4 0 CompuMethod_6 -1E+17 1E+17 /end CHARACTERISTIC
/begin CHARACTERISTIC Fuel_LvlFiltConst "Filter time constant" VALUE 0x80003B4D RecordLayout_4 0 CompuMethod_20 -1E+17 1E+17 /end CHARACTERISTIC
/begin CHARACTERISTIC Fuel_LvlMax "Maximum allowable input, indicating short or open circuit" VALUE 0x80003B85 RecordLayout_4 0 CompuMethod_22 -1E+17 1E+17 /end CHARACTERISTIC
/begin CHARACTERISTIC Fuel_LvlMin "Minimum allowable input, indicating short or open circuit" VALUE 0x80003B89 RecordLayout_4 0 CompuMethod_22 -1E+17 1E+17 /end CHARACTERISTIC
/begin CHARACTERISTIC Fuel_LvlTbl "Look up table to allownon-linear characterization of sensors" CURVE 0x80003B8D RecordLayout_4 0 CompuMethod_6 -1E+17 1E+17
 /begin AXIS_DESCR COM_AXIS Fuel_LvlADC CompuMethod_22 13 -1E+17 1E+17 AXIS_PTS_REF Fuel_LvlIdxArr /end AXIS_DESCR
/end CHARACTERISTIC
/begin CHARACTERISTIC FuelAdaptErrorLwrLim "Lower Limit Value" VALUE 0x80003BC6 RecordLayout_4 0 CompuMethod_48 -1E+17 1E+17 /end CHARACTERISTIC
/begin CHARACTERISTIC FuelAdaptErrorUprLim "Upper Limit Value" VALUE 0x80003BCA RecordLayout_4 0 CompuMethod_48 -1E+17 1E+17 /end CHARACTERISTIC
/begin CHARACTERISTIC FuelEconomy_FilterC "Time constant for fuel economy filter" VALUE 0x80003BF2 RecordLayout_4 0 CompuMethod_116 0.001 100 /end CHARACTERISTIC
/begin CHARACTERISTIC FuelFlowCompMaxValue "Maximum value that can be adapted into the FuelFlowCompMap" VALUE 0x80003E7E RecordLayout_4 0 CompuMethod_33 0 2 /end CHARACTERISTIC
/begin CHARACTERISTIC FuelFlowCompMinValue "Minimum value that can be adapted into the FuelFlowCompMap" VALUE 0x80003E82 RecordLayout_4 0 CompuMethod_33 0 2 /end CHARACTERISTIC
/begin CHARACTERISTIC FuelLevel_FiltConstMap "FuelLevel_FiltConst" MAP 0x80003EA2 RecordLayout_4 0 CompuMethod_20 0 1E+17
 /begin AXIS_DESCR COM_AXIS FuelLevel_FiltConstColIn CompuMethod_117 7 0 1E+17 AXIS_PTS_REF FuelLevel_FiltConstColIdxArr /end AXIS_DESCR
 /begin AXIS_DESCR COM_AXIS FuelLevel_FiltConstRowIn CompuMethod_20 7 0 1E+17 AXIS_PTS_REF FuelLevel_FiltConstRowIdxArr /end AXIS_DESCR
/end CHARACTERISTIC
/begin CHARACTERISTIC FuelLevel_FuelEevntAlpha "Fuel event alpha" VALUE 0x80003F82 RecordLayout_4 0 CompuMethod_118 0 1E+17 /end CHARACTERISTIC
/begin CHARACTERISTIC FuelLevel_KeyUpDelay "Fuel level time from key on delay" VALUE 0x80003F86 RecordLayout_4 0 CompuMethod_20 0 1E+17 /end CHARACTERISTIC
/begin CHARACTERISTIC FuelLevl_KeyUpDiff "Fuel level key up different for refuel event" VALUE 0x80003F8A RecordLayout_4 0 CompuMethod_6 0 1E+17 /end CHARACTERISTIC
/begin CHARACTERISTIC FUELP_new "Override actuator, in engineering units" VALUE 0x80003F91 RecordLayout_1 0 CompuMethod_4 0 1 /end CHARACTERISTIC
/begin CHARACTERISTIC FUELP_ovr "" VALUE 0x80003F92 RecordLayout_1 0 CompuMethod_5 0 1 /end CHARACTERISTIC
/begin CHARACTERISTIC FUELP_Polarity "Inverts the output of the actuator relative to the desired command - 0 = High True    1 = Low True" VALUE 0x80003F93 RecordLayout_1 0 CompuMethod_4 0 1 /end CHARACTERISTIC
/begin CHARACTERISTIC FuelPres_DeltaTarget "Target fuel pressure delta across injector (rail - manifold)" VALUE 0x80003F94 RecordLayout_4 0 CompuMethod_8 -1E+17 1E+17 /end CHARACTERISTIC
/begin CHARACTERISTIC FuelPres_DeltaTolerance "Target fuel pressure delta across injector (rail - manifold)" VALUE 0x80003F98 RecordLayout_4 0 CompuMethod_8 -1E+17 1E+17 /end CHARACTERISTIC
/begin CHARACTERISTIC FuelPres_FaultTimer "Number of seconds that fuel pressure must be out of spec for fault" VALUE 0x80003F9C RecordLayout_4 0 CompuMethod_10 0 1E+17 /end CHARACTERISTIC
/begin CHARACTERISTIC FuelPres_FiltDecFiltC "Filter time constant for a decreasing signal." VALUE 0x80003FA0 RecordLayout_4 0 CompuMethod_20 -1E+17 1E+17 /end CHARACTERISTIC
/begin CHARACTERISTIC FuelPres_FiltIncFiltC "Filter time constant for a increasing signal." VALUE 0x80003FA4 RecordLayout_4 0 CompuMethod_20 -1E+17 1E+17 /end CHARACTERISTIC
/begin CHARACTERISTIC FuelPres_new "Override result of linear sensor characterization, in engineering units" VALUE 0x80003FA8 RecordLayout_4 0 CompuMethod_14 -1E+17 1E+17 /end CHARACTERISTIC
/begin CHARACTERISTIC FuelPres_ovr "" VALUE 0x80003FAC RecordLayout_1 0 CompuMethod_5 0 1 /end CHARACTERISTIC
/begin CHARACTERISTIC FuelPresDfltValue "This is the initial default value should the sensor be in fault on key-up.  Otherwise the sensors outputs the last value prior to faulting" VALUE 0x80003FAD RecordLayout_4 0 CompuMethod_14 -1E+17 1E+17 /end CHARACTERISTIC
/begin CHARACTERISTIC FuelPresFilterConst "Filter time constant" VALUE 0x80003FB1 RecordLayout_4 0 CompuMethod_20 -1E+17 1E+17 /end CHARACTERISTIC
/begin CHARACTERISTIC FuelPresGain "Scaling from A/D counts to engineering units" VALUE 0x80003FB5 RecordLayout_4 0 CompuMethod_21 -1E+17 1E+17 /end CHARACTERISTIC
/begin CHARACTERISTIC FuelPresInputHiFltPos "Maximum allowable input, indicating short or open circuit" VALUE 0x80003FB9 RecordLayout_4 0 CompuMethod_22 -1E+17 1E+17 /end CHARACTERISTIC
/begin CHARACTERISTIC FuelPresInputLoFltPos "Minimum allowable input, indicating short or open circuit" VALUE 0x80003FBD RecordLayout_4 0 CompuMethod_22 -1E+17 1E+17 /end CHARACTERISTIC
/begin CHARACTERISTIC FuelPresOfst "Offset after gain in engineering units" VALUE 0x80003FC1 RecordLayout_4 0 CompuMethod_14 -1E+17 1E+17 /end CHARACTERISTIC
/begin CHARACTERISTIC FuelSens_new "Override result of linear sensor characterization, in engineering units" VALUE 0x80003FCE RecordLayout_4 0 CompuMethod_6 -1E+17 1E+17 /end CHARACTERISTIC
/begin CHARACTERISTIC FuelSens_ovr "" VALUE 0x80003FD2 RecordLayout_1 0 CompuMethod_5 0 1 /end CHARACTERISTIC
/begin CHARACTERISTIC FuelSensDfltValue "This is the initial default value should the sensor be in fault on key-up.  Otherwise the sensors outputs the last value prior to faulting" VALUE 0x80003FD3 RecordLayout_4 0 CompuMethod_6 -1E+17 1E+17 /end CHARACTERISTIC
/begin CHARACTERISTIC FuelSensFilterConst "Filter time constant" VALUE 0x80003FD7 RecordLayout_4 0 CompuMethod_20 -1E+17 1E+17 /end CHARACTERISTIC
/begin CHARACTERISTIC FuelSensGain "Scaling from A/D counts to engineering units" VALUE 0x80003FDB RecordLayout_4 0 CompuMethod_120 -1E+17 1E+17 /end CHARACTERISTIC
/begin CHARACTERISTIC FuelSensInputHiFltPos "Maximum allowable input, indicating short or open circuit" VALUE 0x80003FDF RecordLayout_4 0 CompuMethod_99 -1E+17 1E+17 /end CHARACTERISTIC
/begin CHARACTERISTIC FuelSensInputLoFltPos "Minimum allowable input, indicating short or open circuit" VALUE 0x80003FE3 RecordLayout_4 0 CompuMethod_99 -1E+17 1E+17 /end CHARACTERISTIC
/begin CHARACTERISTIC FuelSensOfst "Offset after gain in engineering units" VALUE 0x80003FE7 RecordLayout_4 0 CompuMethod_6 -1E+17 1E+17 /end CHARACTERISTIC
/begin CHARACTERISTIC FuelSensorPin_AliasProtect "Frequency input alias detection for FuelSensorPin" VALUE 0x80003FED RecordLayout_1 0 CompuMethod_122 0 1 /end CHARACTERISTIC
/begin CHARACTERISTIC FuelSensorPin_EdgeDetect "Frequency input edge trigger for FuelSensorPin" VALUE 0x80003FEE RecordLayout_1 0 CompuMethod_84 0 1 /end CHARACTERISTIC
/begin CHARACTERISTIC FuelSensorPin_Interface "Frequency input signal interface for FuelSensorPin" VALUE 0x80003FEF RecordLayout_1 0 CompuMethod_123 0 1 /end CHARACTERISTIC
/begin CHARACTERISTIC FuelSensorPin_MinFrequency "Minimum expected input frequency for FuelSensorPin" VALUE 0x80003FF0 RecordLayout_3 0 CompuMethod_124 0.01 10000 /end CHARACTERISTIC
/begin CHARACTERISTIC GPS_Altitude_Ovr_new "" VALUE 0x8000401C RecordLayout_4 0 CompuMethod_2 -1E+17 1E+17 /end CHARACTERISTIC
/begin CHARACTERISTIC GPS_Altitude_Ovr_ovr "" VALUE 0x80004020 RecordLayout_1 0 CompuMethod_5 0 1 /end CHARACTERISTIC
/begin CHARACTERISTIC GPS_Course_Ovr_new "" VALUE 0x80004021 RecordLayout_4 0 CompuMethod_2 -1E+17 1E+17 /end CHARACTERISTIC
/begin CHARACTERISTIC GPS_Course_Ovr_ovr "" VALUE 0x80004025 RecordLayout_1 0 CompuMethod_5 0 1 /end CHARACTERISTIC
/begin CHARACTERISTIC GPS_DateTime_Timeout "" VALUE 0x80004026 RecordLayout_4 0 CompuMethod_69 -1E+17 1E+17 /end CHARACTERISTIC
/begin CHARACTERISTIC GPS_DayUTC_Ovr_new "" VALUE 0x8000402A RecordLayout_4 0 CompuMethod_2 -1E+17 1E+17 /end CHARACTERISTIC
/begin CHARACTERISTIC GPS_DayUTC_Ovr_ovr "" VALUE 0x8000402E RecordLayout_1 0 CompuMethod_5 0 1 /end CHARACTERISTIC
/begin CHARACTERISTIC GPS_HoursUTC_Ovr_new "" VALUE 0x8000402F RecordLayout_4 0 CompuMethod_2 -1E+17 1E+17 /end CHARACTERISTIC
/begin CHARACTERISTIC GPS_HoursUTC_Ovr_ovr "" VALUE 0x80004033 RecordLayout_1 0 CompuMethod_5 0 1 /end CHARACTERISTIC
/begin CHARACTERISTIC GPS_Latitude_Ovr_new "" VALUE 0x80004034 RecordLayout_4 0 CompuMethod_2 -1E+17 1E+17 /end CHARACTERISTIC
/begin CHARACTERISTIC GPS_Latitude_Ovr_ovr "" VALUE 0x80004038 RecordLayout_1 0 CompuMethod_5 0 1 /end CHARACTERISTIC
/begin CHARACTERISTIC GPS_LatLong_Timeout "" VALUE 0x80004039 RecordLayout_4 0 CompuMethod_69 -1E+17 1E+17 /end CHARACTERISTIC
/begin CHARACTERISTIC GPS_Longitude_Ovr_new "" VALUE 0x8000403D RecordLayout_4 0 CompuMethod_2 -1E+17 1E+17 /end CHARACTERISTIC
/begin CHARACTERISTIC GPS_Longitude_Ovr_ovr "" VALUE 0x80004041 RecordLayout_1 0 CompuMethod_5 0 1 /end CHARACTERISTIC
/begin CHARACTERISTIC GPS_MinutesUTC_Ovr_new "" VALUE 0x80004042 RecordLayout_4 0 CompuMethod_2 -1E+17 1E+17 /end CHARACTERISTIC
/begin CHARACTERISTIC GPS_MinutesUTC_Ovr_ovr "" VALUE 0x80004046 RecordLayout_1 0 CompuMethod_5 0 1 /end CHARACTERISTIC
/begin CHARACTERISTIC GPS_MonthUTC_Ovr_new "" VALUE 0x80004047 RecordLayout_4 0 CompuMethod_2 -1E+17 1E+17 /end CHARACTERISTIC
/begin CHARACTERISTIC GPS_MonthUTC_Ovr_ovr "" VALUE 0x8000404B RecordLayout_1 0 CompuMethod_5 0 1 /end CHARACTERISTIC
/begin CHARACTERISTIC GPS_SatelliteCount_Ovr_new "" VALUE 0x8000404C RecordLayout_4 0 CompuMethod_2 -1E+17 1E+17 /end CHARACTERISTIC
/begin CHARACTERISTIC GPS_SatelliteCount_Ovr_ovr "" VALUE 0x80004050 RecordLayout_1 0 CompuMethod_5 0 1 /end CHARACTERISTIC
/begin CHARACTERISTIC GPS_SecondsUTC_Ovr_new "" VALUE 0x80004051 RecordLayout_4 0 CompuMethod_2 -1E+17 1E+17 /end CHARACTERISTIC
/begin CHARACTERISTIC GPS_SecondsUTC_Ovr_ovr "" VALUE 0x80004055 RecordLayout_1 0 CompuMethod_5 0 1 /end CHARACTERISTIC
/begin CHARACTERISTIC GPS_Speed_Ovr_new "" VALUE 0x80004056 RecordLayout_4 0 CompuMethod_2 -1E+17 1E+17 /end CHARACTERISTIC
/begin CHARACTERISTIC GPS_Speed_Ovr_ovr "" VALUE 0x8000405A RecordLayout_1 0 CompuMethod_5 0 1 /end CHARACTERISTIC
/begin CHARACTERISTIC GPS_SpeedDir_Timeout "" VALUE 0x8000405B RecordLayout_4 0 CompuMethod_69 -1E+17 1E+17 /end CHARACTERISTIC
/begin CHARACTERISTIC GPS_Valid_Ovr_new "" VALUE 0x8000405F RecordLayout_1 0 CompuMethod_11 0 1 /end CHARACTERISTIC
/begin CHARACTERISTIC GPS_Valid_Ovr_ovr "" VALUE 0x80004060 RecordLayout_1 0 CompuMethod_5 0 1 /end CHARACTERISTIC
/begin CHARACTERISTIC GPS_YearUTC_Ovr_new "" VALUE 0x80004061 RecordLayout_4 0 CompuMethod_2 -1E+17 1E+17 /end CHARACTERISTIC
/begin CHARACTERISTIC GPS_YearUTC_Ovr_ovr "" VALUE 0x80004065 RecordLayout_1 0 CompuMethod_5 0 1 /end CHARACTERISTIC
/begin CHARACTERISTIC HardCycle1Cyl1 "" VALUE 0x80004066 RecordLayout_7 0 CompuMethod_125 -128 127 /end CHARACTERISTIC
/begin CHARACTERISTIC HardCycle1Cyl1_TwoStep "" VALUE 0x80004067 RecordLayout_7 0 CompuMethod_125 -128 127 /end CHARACTERISTIC
/begin CHARACTERISTIC HardCycle1Cyl2 "" VALUE 0x80004068 RecordLayout_7 0 CompuMethod_125 -128 127 /end CHARACTERISTIC
/begin CHARACTERISTIC HardCycle1Cyl2_TwoStep "" VALUE 0x80004069 RecordLayout_7 0 CompuMethod_125 -128 127 /end CHARACTERISTIC
/begin CHARACTERISTIC HardCycle1Cyl3 "" VALUE 0x8000406A RecordLayout_7 0 CompuMethod_125 -128 127 /end CHARACTERISTIC
/begin CHARACTERISTIC HardCycle1Cyl3_TwoStep "" VALUE 0x8000406B RecordLayout_7 0 CompuMethod_125 -128 127 /end CHARACTERISTIC
/begin CHARACTERISTIC HardCycle1Cyl4 "" VALUE 0x8000406C RecordLayout_7 0 CompuMethod_125 -128 127 /end CHARACTERISTIC
/begin CHARACTERISTIC HardCycle1Cyl4_TwoStep "" VALUE 0x8000406D RecordLayout_7 0 CompuMethod_125 -128 127 /end CHARACTERISTIC
/begin CHARACTERISTIC HardCycle1Cyl5 "" VALUE 0x8000406E RecordLayout_7 0 CompuMethod_125 -128 127 /end CHARACTERISTIC
/begin CHARACTERISTIC HardCycle1Cyl5_TwoStep "" VALUE 0x8000406F RecordLayout_7 0 CompuMethod_125 -128 127 /end CHARACTERISTIC
/begin CHARACTERISTIC HardCycle1Cyl6 "" VALUE 0x80004070 RecordLayout_7 0 CompuMethod_125 -128 127 /end CHARACTERISTIC
/begin CHARACTERISTIC HardCycle1Cyl6_TwoStep "" VALUE 0x80004071 RecordLayout_7 0 CompuMethod_125 -128 127 /end CHARACTERISTIC
/begin CHARACTERISTIC HardCycle1Cyl7 "" VALUE 0x80004072 RecordLayout_7 0 CompuMethod_125 -128 127 /end CHARACTERISTIC
/begin CHARACTERISTIC HardCycle1Cyl7_TwoStep "" VALUE 0x80004073 RecordLayout_7 0 CompuMethod_125 -128 127 /end CHARACTERISTIC
/begin CHARACTERISTIC HardCycle1Cyl8 "" VALUE 0x80004074 RecordLayout_7 0 CompuMethod_125 -128 127 /end CHARACTERISTIC
/begin CHARACTERISTIC HardCycle1Cyl8_TwoStep "" VALUE 0x80004075 RecordLayout_7 0 CompuMethod_125 -128 127 /end CHARACTERISTIC
/begin CHARACTERISTIC HardCycle2Cyl1 "" VALUE 0x80004076 RecordLayout_7 0 CompuMethod_125 -128 127 /end CHARACTERISTIC
/begin CHARACTERISTIC HardCycle2Cyl1_TwoStep "" VALUE 0x80004077 RecordLayout_7 0 CompuMethod_125 -128 127 /end CHARACTERISTIC
/begin CHARACTERISTIC HardCycle2Cyl2 "" VALUE 0x80004078 RecordLayout_7 0 CompuMethod_125 -128 127 /end CHARACTERISTIC
/begin CHARACTERISTIC HardCycle2Cyl2_TwoStep "" VALUE 0x80004079 RecordLayout_7 0 CompuMethod_125 -128 127 /end CHARACTERISTIC
/begin CHARACTERISTIC HardCycle2Cyl3 "" VALUE 0x8000407A RecordLayout_7 0 CompuMethod_125 -128 127 /end CHARACTERISTIC
/begin CHARACTERISTIC HardCycle2Cyl3_TwoStep "" VALUE 0x8000407B RecordLayout_7 0 CompuMethod_125 -128 127 /end CHARACTERISTIC
/begin CHARACTERISTIC HardCycle2Cyl4 "" VALUE 0x8000407C RecordLayout_7 0 CompuMethod_125 -128 127 /end CHARACTERISTIC
/begin CHARACTERISTIC HardCycle2Cyl4_TwoStep "" VALUE 0x8000407D RecordLayout_7 0 CompuMethod_125 -128 127 /end CHARACTERISTIC
/begin CHARACTERISTIC HardCycle2Cyl5 "" VALUE 0x8000407E RecordLayout_7 0 CompuMethod_125 -128 127 /end CHARACTERISTIC
/begin CHARACTERISTIC HardCycle2Cyl5_TwoStep "" VALUE 0x8000407F RecordLayout_7 0 CompuMethod_125 -128 127 /end CHARACTERISTIC
/begin CHARACTERISTIC HardCycle2Cyl6 "" VALUE 0x80004080 RecordLayout_7 0 CompuMethod_125 -128 127 /end CHARACTERISTIC
/begin CHARACTERISTIC HardCycle2Cyl6_TwoStep "" VALUE 0x80004081 RecordLayout_7 0 CompuMethod_125 -128 127 /end CHARACTERISTIC
/begin CHARACTERISTIC HardCycle2Cyl7 "" VALUE 0x80004082 RecordLayout_7 0 CompuMethod_125 -128 127 /end CHARACTERISTIC
/begin CHARACTERISTIC HardCycle2Cyl7_TwoStep "" VALUE 0x80004083 RecordLayout_7 0 CompuMethod_125 -128 127 /end CHARACTERISTIC
/begin CHARACTERISTIC HardCycle2Cyl8 "" VALUE 0x80004084 RecordLayout_7 0 CompuMethod_125 -128 127 /end CHARACTERISTIC
/begin CHARACTERISTIC HardCycle2Cyl8_TwoStep "" VALUE 0x80004085 RecordLayout_7 0 CompuMethod_125 -128 127 /end CHARACTERISTIC
/begin CHARACTERISTIC HardCycle3Cyl1 "" VALUE 0x80004086 RecordLayout_7 0 CompuMethod_125 -128 127 /end CHARACTERISTIC
/begin CHARACTERISTIC HardCycle3Cyl1_TwoStep "" VALUE 0x80004087 RecordLayout_7 0 CompuMethod_125 -128 127 /end CHARACTERISTIC
/begin CHARACTERISTIC HardCycle3Cyl2 "" VALUE 0x80004088 RecordLayout_7 0 CompuMethod_125 -128 127 /end CHARACTERISTIC
/begin CHARACTERISTIC HardCycle3Cyl2_TwoStep "" VALUE 0x80004089 RecordLayout_7 0 CompuMethod_125 -128 127 /end CHARACTERISTIC
/begin CHARACTERISTIC HardCycle3Cyl3 "" VALUE 0x8000408A RecordLayout_7 0 CompuMethod_125 -128 127 /end CHARACTERISTIC
/begin CHARACTERISTIC HardCycle3Cyl3_TwoStep "" VALUE 0x8000408B RecordLayout_7 0 CompuMethod_125 -128 127 /end CHARACTERISTIC
/begin CHARACTERISTIC HardCycle3Cyl4 "" VALUE 0x8000408C RecordLayout_7 0 CompuMethod_125 -128 127 /end CHARACTERISTIC
/begin CHARACTERISTIC HardCycle3Cyl4_TwoStep "" VALUE 0x8000408D RecordLayout_7 0 CompuMethod_125 -128 127 /end CHARACTERISTIC
/begin CHARACTERISTIC HardCycle3Cyl5 "" VALUE 0x8000408E RecordLayout_7 0 CompuMethod_125 -128 127 /end CHARACTERISTIC
/begin CHARACTERISTIC HardCycle3Cyl5_TwoStep "" VALUE 0x8000408F RecordLayout_7 0 CompuMethod_125 -128 127 /end CHARACTERISTIC
/begin CHARACTERISTIC HardCycle3Cyl6 "" VALUE 0x80004090 RecordLayout_7 0 CompuMethod_125 -128 127 /end CHARACTERISTIC
/begin CHARACTERISTIC HardCycle3Cyl6_TwoStep "" VALUE 0x80004091 RecordLayout_7 0 CompuMethod_125 -128 127 /end CHARACTERISTIC
/begin CHARACTERISTIC HardCycle3Cyl7 "" VALUE 0x80004092 RecordLayout_7 0 CompuMethod_125 -128 127 /end CHARACTERISTIC
/begin CHARACTERISTIC HardCycle3Cyl7_TwoStep "" VALUE 0x80004093 RecordLayout_7 0 CompuMethod_125 -128 127 /end CHARACTERISTIC
/begin CHARACTERISTIC HardCycle3Cyl8 "" VALUE 0x80004094 RecordLayout_7 0 CompuMethod_125 -128 127 /end CHARACTERISTIC
/begin CHARACTERISTIC HardCycle3Cyl8_TwoStep "" VALUE 0x80004095 RecordLayout_7 0 CompuMethod_125 -128 127 /end CHARACTERISTIC
/begin CHARACTERISTIC HardCycle4Cyl1 "" VALUE 0x80004096 RecordLayout_7 0 CompuMethod_125 -128 127 /end CHARACTERISTIC
/begin CHARACTERISTIC HardCycle4Cyl1_TwoStep "" VALUE 0x80004097 RecordLayout_7 0 CompuMethod_125 -128 127 /end CHARACTERISTIC
/begin CHARACTERISTIC HardCycle4Cyl2 "" VALUE 0x80004098 RecordLayout_7 0 CompuMethod_125 -128 127 /end CHARACTERISTIC
/begin CHARACTERISTIC HardCycle4Cyl2_TwoStep "" VALUE 0x80004099 RecordLayout_7 0 CompuMethod_125 -128 127 /end CHARACTERISTIC
/begin CHARACTERISTIC HardCycle4Cyl3 "" VALUE 0x8000409A RecordLayout_7 0 CompuMethod_125 -128 127 /end CHARACTERISTIC
/begin CHARACTERISTIC HardCycle4Cyl3_TwoStep "" VALUE 0x8000409B RecordLayout_7 0 CompuMethod_125 -128 127 /end CHARACTERISTIC
/begin CHARACTERISTIC HardCycle4Cyl4 "" VALUE 0x8000409C RecordLayout_7 0 CompuMethod_125 -128 127 /end CHARACTERISTIC
/begin CHARACTERISTIC HardCycle4Cyl4_TwoStep "" VALUE 0x8000409D RecordLayout_7 0 CompuMethod_125 -128 127 /end CHARACTERISTIC
/begin CHARACTERISTIC HardCycle4Cyl5 "" VALUE 0x8000409E RecordLayout_7 0 CompuMethod_125 -128 127 /end CHARACTERISTIC
/begin CHARACTERISTIC HardCycle4Cyl5_TwoStep "" VALUE 0x8000409F RecordLayout_7 0 CompuMethod_125 -128 127 /end CHARACTERISTIC
/begin CHARACTERISTIC HardCycle4Cyl6 "" VALUE 0x800040A0 RecordLayout_7 0 CompuMethod_125 -128 127 /end CHARACTERISTIC
/begin CHARACTERISTIC HardCycle4Cyl6_TwoStep "" VALUE 0x800040A1 RecordLayout_7 0 CompuMethod_125 -128 127 /end CHARACTERISTIC
/begin CHARACTERISTIC HardCycle4Cyl7 "" VALUE 0x800040A2 RecordLayout_7 0 CompuMethod_125 -128 127 /end CHARACTERISTIC
/begin CHARACTERISTIC HardCycle4Cyl7_TwoStep "" VALUE 0x800040A3 RecordLayout_7 0 CompuMethod_125 -128 127 /end CHARACTERISTIC
/begin CHARACTERISTIC HardCycle4Cyl8 "" VALUE 0x800040A4 RecordLayout_7 0 CompuMethod_125 -128 127 /end CHARACTERISTIC
/begin CHARACTERISTIC HardCycle4Cyl8_TwoStep "" VALUE 0x800040A5 RecordLayout_7 0 CompuMethod_125 -128 127 /end CHARACTERISTIC
/begin CHARACTERISTIC HardOverBoostLimit "Hard overboost limit" VALUE 0x800040A6 RecordLayout_4 0 CompuMethod_56 -1E+17 1E+17 /end CHARACTERISTIC
/begin CHARACTERISTIC HardOverBoostTime "After hard overboost level reached for this time HardOverBoost_Fault becomes active" VALUE 0x800040AA RecordLayout_4 0 CompuMethod_10 0 1E+17 /end CHARACTERISTIC
/begin CHARACTERISTIC IAC_P_new "Override result of linear sensor characterization, in engineering units" VALUE 0x800040B4 RecordLayout_4 0 CompuMethod_6 -1E+17 1E+17 /end CHARACTERISTIC
/begin CHARACTERISTIC IAC_P_ovr "" VALUE 0x800040B8 RecordLayout_1 0 CompuMethod_5 0 1 /end CHARACTERISTIC
/begin CHARACTERISTIC IAC_PFrequency "Frequency of PWM output" VALUE 0x800040B9 RecordLayout_4 0 CompuMethod_99 -1E+17 1E+17 /end CHARACTERISTIC
/begin CHARACTERISTIC IAC_PGain "Scaling from engineering units to PWM duty cycle" VALUE 0x800040BD RecordLayout_4 0 CompuMethod_105 -1E+17 1E+17 /end CHARACTERISTIC
/begin CHARACTERISTIC IAC_PMaxLimit "Maximum limit of PWM signal." VALUE 0x800040C1 RecordLayout_4 0 CompuMethod_6 -1E+17 1E+17 /end CHARACTERISTIC
/begin CHARACTERISTIC IAC_PMinLimit "Minimum limit of PWM signal." VALUE 0x800040C5 RecordLayout_4 0 CompuMethod_6 -1E+17 1E+17 /end CHARACTERISTIC
/begin CHARACTERISTIC IAC_POffset "Offset from engineering units to PWM duty cycle" VALUE 0x800040C9 RecordLayout_4 0 CompuMethod_6 -1E+17 1E+17 /end CHARACTERISTIC
/begin CHARACTERISTIC IAC_S_new "Override result of linear sensor characterization, in engineering units" VALUE 0x800040CF RecordLayout_4 0 CompuMethod_6 -1E+17 1E+17 /end CHARACTERISTIC
/begin CHARACTERISTIC IAC_S_ovr "" VALUE 0x800040D3 RecordLayout_1 0 CompuMethod_5 0 1 /end CHARACTERISTIC
/begin CHARACTERISTIC IAC_SFrequency "Frequency of PWM output" VALUE 0x800040D4 RecordLayout_4 0 CompuMethod_99 -1E+17 1E+17 /end CHARACTERISTIC
/begin CHARACTERISTIC IAC_SGain "Scaling from engineering units to PWM duty cycle" VALUE 0x800040D8 RecordLayout_4 0 CompuMethod_105 -1E+17 1E+17 /end CHARACTERISTIC
/begin CHARACTERISTIC IAC_SMaxLimit "Maximum limit of PWM signal." VALUE 0x800040DC RecordLayout_4 0 CompuMethod_6 -1E+17 1E+17 /end CHARACTERISTIC
/begin CHARACTERISTIC IAC_SMinLimit "Minimum limit of PWM signal." VALUE 0x800040E0 RecordLayout_4 0 CompuMethod_6 -1E+17 1E+17 /end CHARACTERISTIC
/begin CHARACTERISTIC IAC_SOffset "Offset from engineering units to PWM duty cycle" VALUE 0x800040E4 RecordLayout_4 0 CompuMethod_6 -1E+17 1E+17 /end CHARACTERISTIC
/begin CHARACTERISTIC IAT_KeyUp_Count "Number of samples to average at key-up to produce signal value" VALUE 0x800040F3 RecordLayout_7 0 CompuMethod_1 -128 127 /end CHARACTERISTIC
/begin CHARACTERISTIC IAT_new "Override result of linear sensor characterization, in engineering units" VALUE 0x80004118 RecordLayout_4 0 CompuMethod_61 -1E+17 1E+17 /end CHARACTERISTIC
/begin CHARACTERISTIC IAT_ovr "" VALUE 0x8000411C RecordLayout_1 0 CompuMethod_5 0 1 /end CHARACTERISTIC
/begin CHARACTERISTIC IATDefault "This is the initial default value should the sensor be in fault on key-up.  Otherwise the sensors outputs the last value prior to faulting" VALUE 0x800042CD RecordLayout_4 0 CompuMethod_61 -1E+17 1E+17 /end CHARACTERISTIC
/begin CHARACTERISTIC IATFiltConst "Filter time constant" VALUE 0x800044D1 RecordLayout_4 0 CompuMethod_20 -1E+17 1E+17 /end CHARACTERISTIC
/begin CHARACTERISTIC IATMax "Maximum allowable input, indicating short or open circuit" VALUE 0x80004509 RecordLayout_4 0 CompuMethod_22 -1E+17 1E+17 /end CHARACTERISTIC
/begin CHARACTERISTIC IATMin "Minimum allowable input, indicating short or open circuit" VALUE 0x8000450D RecordLayout_4 0 CompuMethod_22 -1E+17 1E+17 /end CHARACTERISTIC
/begin CHARACTERISTIC IATTbl "Look up table to allownon-linear characterization of sensors" CURVE 0x80004514 RecordLayout_4 0 CompuMethod_61 -1E+17 1E+17
 /begin AXIS_DESCR COM_AXIS IATADC CompuMethod_22 13 -1E+17 1E+17 AXIS_PTS_REF IATIdxArr /end AXIS_DESCR
/end CHARACTERISTIC
/begin CHARACTERISTIC IdleEntryAirRampInFiltC "Decays TPS Setpoint from Crank TPS to Run State base value at this rate." VALUE 0x8000454C RecordLayout_4 0 CompuMethod_20 0.005 1E+17 /end CHARACTERISTIC
/begin CHARACTERISTIC InGearRPMCtrlEntryFiltC "Sets decay rate of RPM setpoint from entry RPM." VALUE 0x8000455A RecordLayout_4 0 CompuMethod_20 0.005 1E+17 /end CHARACTERISTIC
/begin CHARACTERISTIC InjEnable_new "" VAL_BLK 0x800045BA RecordLayout_1 0 CompuMethod_11 0 1 MATRIX_DIM 8 1 1 /end CHARACTERISTIC
/begin CHARACTERISTIC InjEnable_ovr "" VALUE 0x800045C2 RecordLayout_1 0 CompuMethod_5 0 1 /end CHARACTERISTIC
/begin CHARACTERISTIC LeanProtec_TmrThresh "Number of seconds that fuel pressure must be out of spec for fault" VALUE 0x800046D1 RecordLayout_4 0 CompuMethod_10 0 1E+17 /end CHARACTERISTIC
/begin CHARACTERISTIC LeanProtect_Threshold "Target fuel pressure delta across injector (rail - manifold)" VALUE 0x800046D5 RecordLayout_4 0 CompuMethod_8 -1E+17 1E+17 /end CHARACTERISTIC
/begin CHARACTERISTIC LeanSwPtDeltaMap "If actual O2 reaches this point, switch the target to the RichTargetDelta" MAP 0x800046D9 RecordLayout_4 0 CompuMethod_44 -1E+17 1E+17
 /begin AXIS_DESCR COM_AXIS RPM09In CompuMethod_25 9 0 14000 AXIS_PTS_REF RPM09IdxArr /end AXIS_DESCR
 /begin AXIS_DESCR COM_AXIS MAP09In CompuMethod_8 9 0 1000 AXIS_PTS_REF MAP09IdxArr /end AXIS_DESCR
/end CHARACTERISTIC
/begin CHARACTERISTIC LeanTargetDeltaMap "Target on the lean side for perturbation." MAP 0x8000481D RecordLayout_4 0 CompuMethod_44 -1E+17 1E+17
 /begin AXIS_DESCR COM_AXIS RPM09In CompuMethod_25 9 0 14000 AXIS_PTS_REF RPM09IdxArr /end AXIS_DESCR
 /begin AXIS_DESCR COM_AXIS MAP09In CompuMethod_8 9 0 1000 AXIS_PTS_REF MAP09IdxArr /end AXIS_DESCR
/end CHARACTERISTIC
/begin CHARACTERISTIC MAF_new "Override result of linear sensor characterization, in engineering units" VALUE 0x80004961 RecordLayout_4 0 CompuMethod_30 -1E+17 1E+17 /end CHARACTERISTIC
/begin CHARACTERISTIC MAF_ovr "" VALUE 0x80004965 RecordLayout_1 0 CompuMethod_5 0 1 /end CHARACTERISTIC
/begin CHARACTERISTIC MAF_Pin_AliasProtect "Frequency input alias detection for MAF_Pin" VALUE 0x80004968 RecordLayout_1 0 CompuMethod_122 0 1 /end CHARACTERISTIC
/begin CHARACTERISTIC MAF_Pin_EdgeDetect "Frequency input edge trigger for MAF_Pin" VALUE 0x80004969 RecordLayout_1 0 CompuMethod_84 0 1 /end CHARACTERISTIC
/begin CHARACTERISTIC MAF_Pin_Interface "Frequency input signal interface for MAF_Pin" VALUE 0x8000496A RecordLayout_1 0 CompuMethod_123 0 1 /end CHARACTERISTIC
/begin CHARACTERISTIC MAF_Pin_MinFrequency "Minimum expected input frequency for MAF_Pin" VALUE 0x8000496B RecordLayout_3 0 CompuMethod_124 0.01 10000 /end CHARACTERISTIC
/begin CHARACTERISTIC MAFDefault "This is the initial default value should the sensor be in fault on key-up.  Otherwise the sensors outputs the last value prior to faulting" VALUE 0x80004994 RecordLayout_4 0 CompuMethod_30 -1E+17 1E+17 /end CHARACTERISTIC
/begin CHARACTERISTIC MAFFiltConst "Filter time constant" VALUE 0x80004998 RecordLayout_4 0 CompuMethod_20 -1E+17 1E+17 /end CHARACTERISTIC
/begin CHARACTERISTIC MAFMax "Maximum allowable input, indicating short or open circuit" VALUE 0x800049D0 RecordLayout_4 0 CompuMethod_99 -1E+17 1E+17 /end CHARACTERISTIC
/begin CHARACTERISTIC MAFMin "Minimum allowable input, indicating short or open circuit" VALUE 0x800049D4 RecordLayout_4 0 CompuMethod_99 -1E+17 1E+17 /end CHARACTERISTIC
/begin CHARACTERISTIC MAFTbl "Look up table to allownon-linear characterization of sensors" CURVE 0x800049EC RecordLayout_4 0 CompuMethod_30 -1E+17 1E+17
 /begin AXIS_DESCR COM_AXIS MAFADC CompuMethod_99 13 -1E+17 1E+17 AXIS_PTS_REF MAFIdxArr /end AXIS_DESCR
/end CHARACTERISTIC
/begin CHARACTERISTIC MakeUp_EOI_new "" VALUE 0x80004A20 RecordLayout_4 0 CompuMethod_2 -1E+17 1E+17 /end CHARACTERISTIC
/begin CHARACTERISTIC MakeUp_EOI_ovr "" VALUE 0x80004A24 RecordLayout_1 0 CompuMethod_5 0 1 /end CHARACTERISTIC
/begin CHARACTERISTIC MAP_filtDecFiltC "Filter time constant for a decreasing signal." VALUE 0x80004B69 RecordLayout_4 0 CompuMethod_20 -1E+17 1E+17 /end CHARACTERISTIC
/begin CHARACTERISTIC MAP_filtIncFiltC "Filter time constant for a increasing signal." VALUE 0x80004B6D RecordLayout_4 0 CompuMethod_20 -1E+17 1E+17 /end CHARACTERISTIC
/begin CHARACTERISTIC MAP_IR_HI "In-range MAP fault logic. Maximum value that MAP should not exceed with closed throttle and engine running" VALUE 0x80004B71 RecordLayout_4 0 CompuMethod_8 0 1E+17 /end CHARACTERISTIC
/begin CHARACTERISTIC MAP_IR_LO "In-range MAP fault logic. Minimum value that MAP should not be less than with open throttle and engine running" VALUE 0x80004B75 RecordLayout_4 0 CompuMethod_8 0 1E+17 /end CHARACTERISTIC
/begin CHARACTERISTIC MAP_IR_TPS_CL "In-range MAP fault logic.  Maximum throttle position, below which MAP should be less than MAP_IR_HI" VALUE 0x80004B79 RecordLayout_4 0 CompuMethod_6 0 1E+17 /end CHARACTERISTIC
/begin CHARACTERISTIC MAP_IR_TPS_OP "In-range MAP fault logic.  Minimum throttle position, above which MAP should be greater than MAP_IR_LO" VALUE 0x80004B7D RecordLayout_4 0 CompuMethod_6 0 1E+17 /end CHARACTERISTIC
/begin CHARACTERISTIC MAP_new "Override result of linear sensor characterization, in engineering units" VALUE 0x80004B81 RecordLayout_4 0 CompuMethod_8 -1E+17 1E+17 /end CHARACTERISTIC
/begin CHARACTERISTIC MAP_ovr "" VALUE 0x80004B85 RecordLayout_1 0 CompuMethod_5 0 1 /end CHARACTERISTIC
/begin CHARACTERISTIC MAP_STUCK "In-range MAP fault logic.  Minimum difference between MAP and BARO with throttle closed. If less than this, a fault exists" VALUE 0x80004B86 RecordLayout_4 0 CompuMethod_8 0 1E+17 /end CHARACTERISTIC
/begin CHARACTERISTIC MAP_TPS_STUCK "In-range MAP fault logic.  Maximum throttle position, below_which MAP should be less than BARO" VALUE 0x80004B8A RecordLayout_4 0 CompuMethod_6 0 1E+17 /end CHARACTERISTIC
/begin CHARACTERISTIC MAPDfltValue "This is the initial default value should the sensor be in fault on key-up.  Otherwise the sensors outputs the last value prior to faulting" VALUE 0x80004C0A RecordLayout_4 0 CompuMethod_8 -1E+17 1E+17 /end CHARACTERISTIC
/begin CHARACTERISTIC MAPFilterConst "Filter time constant" VALUE 0x80004C0E RecordLayout_4 0 CompuMethod_20 -1E+17 1E+17 /end CHARACTERISTIC
/begin CHARACTERISTIC MAPGain "Scaling from A/D counts to engineering units" VALUE 0x80004C12 RecordLayout_4 0 CompuMethod_139 -1E+17 1E+17 /end CHARACTERISTIC
/begin CHARACTERISTIC MAPInputHiFltPos "Maximum allowable input, indicating short or open circuit" VALUE 0x80004C16 RecordLayout_4 0 CompuMethod_22 -1E+17 1E+17 /end CHARACTERISTIC
/begin CHARACTERISTIC MAPInputLoFltPos "Minimum allowable input, indicating short or open circuit" VALUE 0x80004C1A RecordLayout_4 0 CompuMethod_22 -1E+17 1E+17 /end CHARACTERISTIC
/begin CHARACTERISTIC MAPOfst "Offset after gain in engineering units" VALUE 0x80004C1E RecordLayout_4 0 CompuMethod_8 -1E+17 1E+17 /end CHARACTERISTIC
/begin CHARACTERISTIC MAPTime_new "Override result of linear sensor characterization, in engineering units" VALUE 0x80004C25 RecordLayout_4 0 CompuMethod_8 -1E+17 1E+17 /end CHARACTERISTIC
/begin CHARACTERISTIC MAPTime_ovr "" VALUE 0x80004C29 RecordLayout_1 0 CompuMethod_5 0 1 /end CHARACTERISTIC
/begin CHARACTERISTIC MAPTimeDfltValue "This is the initial default value should the sensor be in fault on key-up.  Otherwise the sensors outputs the last value prior to faulting" VALUE 0x80004C2A RecordLayout_4 0 CompuMethod_8 -1E+17 1E+17 /end CHARACTERISTIC
/begin CHARACTERISTIC MAPTimeFilterConst "Filter time constant" VALUE 0x80004C2E RecordLayout_4 0 CompuMethod_20 -1E+17 1E+17 /end CHARACTERISTIC
/begin CHARACTERISTIC MAPTimeGain "Scaling from A/D counts to engineering units" VALUE 0x80004C32 RecordLayout_4 0 CompuMethod_139 -1E+17 1E+17 /end CHARACTERISTIC
/begin CHARACTERISTIC MAPTimeInputHiFltPos "Maximum allowable input, indicating short or open circuit" VALUE 0x80004C36 RecordLayout_4 0 CompuMethod_22 -1E+17 1E+17 /end CHARACTERISTIC
/begin CHARACTERISTIC MAPTimeInputLoFltPos "Minimum allowable input, indicating short or open circuit" VALUE 0x80004C3A RecordLayout_4 0 CompuMethod_22 -1E+17 1E+17 /end CHARACTERISTIC
/begin CHARACTERISTIC MAPTimeOfst "Offset after gain in engineering units" VALUE 0x80004C3E RecordLayout_4 0 CompuMethod_8 -1E+17 1E+17 /end CHARACTERISTIC
/begin CHARACTERISTIC MaxGovDGain "Base D-gain for the max. governor controller." VALUE 0x80004C66 RecordLayout_4 0 CompuMethod_33 -1E+17 1E+17 /end CHARACTERISTIC
/begin CHARACTERISTIC MaxGovDGainErrorMultTbl "" CURVE 0x80004C6A RecordLayout_4 0 CompuMethod_33 -1E+17 1E+17
 /begin AXIS_DESCR COM_AXIS MaxGovSpeedErrorIn CompuMethod_25 9 -1E+17 1E+17 AXIS_PTS_REF MaxGovSpeedErrorIdxArr /end AXIS_DESCR
/end CHARACTERISTIC
/begin CHARACTERISTIC MaxGovDisable "Max governor manual disable" VALUE 0x80004C8E RecordLayout_1 0 CompuMethod_140 0 1 /end CHARACTERISTIC
/begin CHARACTERISTIC MaxGovErrorGain "Error gain for the max governor controller. This gain is applied to the RPM error term before it is used to calculate the P, I and D terms." VALUE 0x80004C8F RecordLayout_4 0 CompuMethod_33 -1E+17 1E+17 /end CHARACTERISTIC
/begin CHARACTERISTIC MaxGovIGain "Base I-gain for the max. governor controller." VALUE 0x80004C93 RecordLayout_4 0 CompuMethod_33 -1E+17 1E+17 /end CHARACTERISTIC
/begin CHARACTERISTIC MaxGovIGainErrorMultTbl "" CURVE 0x80004C97 RecordLayout_4 0 CompuMethod_33 -1E+17 1E+17
 /begin AXIS_DESCR COM_AXIS MaxGovSpeedErrorIn CompuMethod_25 9 -1E+17 1E+17 AXIS_PTS_REF MaxGovSpeedErrorIdxArr /end AXIS_DESCR
/end CHARACTERISTIC
/begin CHARACTERISTIC MaxGovInGearLowerLim "Max Gov RPM setpoint when in gear." VALUE 0x80004CBB RecordLayout_4 0 CompuMethod_25 0 1E+17 /end CHARACTERISTIC
/begin CHARACTERISTIC MaxGovInGearRPMSetPt "Max Gov RPM setpoint when in gear." VALUE 0x80004CBF RecordLayout_4 0 CompuMethod_25 0 1E+17 /end CHARACTERISTIC
/begin CHARACTERISTIC MaxGovInGearRPMThresh "When in-gear, RPM has to pass the base RPM setpoint minus this calibration. to start the I term preload and ramp-in." VALUE 0x80004CC3 RecordLayout_4 0 CompuMethod_25 0 1E+17 /end CHARACTERISTIC
/begin CHARACTERISTIC MaxGovInGearUpperLim "Max Gov RPM setpoint when in gear." VALUE 0x80004CC7 RecordLayout_4 0 CompuMethod_25 0 1E+17 /end CHARACTERISTIC
/begin CHARACTERISTIC MaxGovITermLowerLimit "Lower limit on max governor I-term value." VALUE 0x80004CCB RecordLayout_4 0 CompuMethod_6 -1E+17 1E+17 /end CHARACTERISTIC
/begin CHARACTERISTIC MaxGovITermUpperLimit "Upper limit on max governor I-term value." VALUE 0x80004CCF RecordLayout_4 0 CompuMethod_6 -1E+17 1E+17 /end CHARACTERISTIC
/begin CHARACTERISTIC MaxGovNtrlLowerLim "Max Gov RPM setpoint when in gear." VALUE 0x80004CD3 RecordLayout_4 0 CompuMethod_25 0 1E+17 /end CHARACTERISTIC
/begin CHARACTERISTIC MaxGovNtrlRPMSetPt "Max Gov RPM setpoint when in neutral." VALUE 0x80004CD7 RecordLayout_4 0 CompuMethod_25 0 1E+17 /end CHARACTERISTIC
/begin CHARACTERISTIC MaxGovNtrlRPMThresh "When in neutral, RPM has to pass the base RPM setpoint minus this calibration. to start the I term preload and ramp-in." VALUE 0x80004CDB RecordLayout_4 0 CompuMethod_25 0 1E+17 /end CHARACTERISTIC
/begin CHARACTERISTIC MaxGovNtrlUpperLim "Max Gov RPM setpoint when in gear." VALUE 0x80004CDF RecordLayout_4 0 CompuMethod_25 0 1E+17 /end CHARACTERISTIC
/begin CHARACTERISTIC MaxGovPGain "Base P-gain for the max. governor controller." VALUE 0x80004CE3 RecordLayout_4 0 CompuMethod_33 -1E+17 1E+17 /end CHARACTERISTIC
/begin CHARACTERISTIC MaxGovPGainErrorMultTbl "" CURVE 0x80004CE7 RecordLayout_4 0 CompuMethod_33 -1E+17 1E+17
 /begin AXIS_DESCR COM_AXIS MaxGovSpeedErrorIn CompuMethod_25 9 -1E+17 1E+17 AXIS_PTS_REF MaxGovSpeedErrorIdxArr /end AXIS_DESCR
/end CHARACTERISTIC
/begin CHARACTERISTIC MaxGovPIDOutLowerLimit "Lower limit on max governor PID Output." VALUE 0x80004D0B RecordLayout_4 0 CompuMethod_6 -1E+17 1E+17 /end CHARACTERISTIC
/begin CHARACTERISTIC MaxGovPIDOutUpperLimit "Upper limit on max governor PID Output." VALUE 0x80004D0F RecordLayout_4 0 CompuMethod_6 -1E+17 1E+17 /end CHARACTERISTIC
/begin CHARACTERISTIC MaxGovPreloadITermTbl "Preload for Max Gov PID ITerm based on engine acceleration rate upon entry into max gov." CURVE 0x80004D13 RecordLayout_4 0 CompuMethod_6 -1E+17 1E+17
 /begin AXIS_DESCR COM_AXIS RPMAccel17In CompuMethod_2 17 -1E+17 1E+17 AXIS_PTS_REF RPMAccel17IdxArr /end AXIS_DESCR
/end CHARACTERISTIC
/begin CHARACTERISTIC MaxGovRPMCtrlEntryFiltC "Filter rate at which Max Gov setup is increased to MaxGovBaseRPMSetpoint." VALUE 0x80004D57 RecordLayout_4 0 CompuMethod_20 0.005 1E+17 /end CHARACTERISTIC
/begin CHARACTERISTIC MaxGovTPSHyst "Hysterisis around max gov TPS entry criteria." VALUE 0x80004D7F RecordLayout_4 0 CompuMethod_6 0 1E+17 /end CHARACTERISTIC
/begin CHARACTERISTIC MaxSparkLimitOffIdle "Max. spark limit on the delivered spark advance, when not in idle control." VALUE 0x80004D83 RecordLayout_4 0 CompuMethod_70 -1E+17 1E+17 /end CHARACTERISTIC
/begin CHARACTERISTIC MaxSparkLimitTbl "Maximum allowable spark advance." CURVE 0x80004D87 RecordLayout_4 0 CompuMethod_70 -1E+17 1E+17
 /begin AXIS_DESCR COM_AXIS MAP09In CompuMethod_8 9 0 1000 AXIS_PTS_REF MAP09IdxArr /end AXIS_DESCR
/end CHARACTERISTIC
/begin CHARACTERISTIC Mech_PW_new "" VAL_BLK 0x80004DAB RecordLayout_4 0 CompuMethod_2 -1E+17 1E+17 MATRIX_DIM 8 1 1 /end CHARACTERISTIC
/begin CHARACTERISTIC Mech_PW_ovr "" VALUE 0x80004DCB RecordLayout_1 0 CompuMethod_5 0 1 /end CHARACTERISTIC
/begin CHARACTERISTIC MediumCycle1Cyl1 "" VALUE 0x80004DCC RecordLayout_7 0 CompuMethod_125 -128 127 /end CHARACTERISTIC
/begin CHARACTERISTIC MediumCycle1Cyl1_TwoStep "" VALUE 0x80004DCD RecordLayout_7 0 CompuMethod_125 -128 127 /end CHARACTERISTIC
/begin CHARACTERISTIC MediumCycle1Cyl2 "" VALUE 0x80004DCE RecordLayout_7 0 CompuMethod_125 -128 127 /end CHARACTERISTIC
/begin CHARACTERISTIC MediumCycle1Cyl2_TwoStep "" VALUE 0x80004DCF RecordLayout_7 0 CompuMethod_125 -128 127 /end CHARACTERISTIC
/begin CHARACTERISTIC MediumCycle1Cyl3 "" VALUE 0x80004DD0 RecordLayout_7 0 CompuMethod_125 -128 127 /end CHARACTERISTIC
/begin CHARACTERISTIC MediumCycle1Cyl3_TwoStep "" VALUE 0x80004DD1 RecordLayout_7 0 CompuMethod_125 -128 127 /end CHARACTERISTIC
/begin CHARACTERISTIC MediumCycle1Cyl4 "" VALUE 0x80004DD2 RecordLayout_7 0 CompuMethod_125 -128 127 /end CHARACTERISTIC
/begin CHARACTERISTIC MediumCycle1Cyl4_TwoStep "" VALUE 0x80004DD3 RecordLayout_7 0 CompuMethod_125 -128 127 /end CHARACTERISTIC
/begin CHARACTERISTIC MediumCycle1Cyl5 "" VALUE 0x80004DD4 RecordLayout_7 0 CompuMethod_125 -128 127 /end CHARACTERISTIC
/begin CHARACTERISTIC MediumCycle1Cyl5_TwoStep "" VALUE 0x80004DD5 RecordLayout_7 0 CompuMethod_125 -128 127 /end CHARACTERISTIC
/begin CHARACTERISTIC MediumCycle1Cyl6 "" VALUE 0x80004DD6 RecordLayout_7 0 CompuMethod_125 -128 127 /end CHARACTERISTIC
/begin CHARACTERISTIC MediumCycle1Cyl6_TwoStep "" VALUE 0x80004DD7 RecordLayout_7 0 CompuMethod_125 -128 127 /end CHARACTERISTIC
/begin CHARACTERISTIC MediumCycle1Cyl7 "" VALUE 0x80004DD8 RecordLayout_7 0 CompuMethod_125 -128 127 /end CHARACTERISTIC
/begin CHARACTERISTIC MediumCycle1Cyl7_TwoStep "" VALUE 0x80004DD9 RecordLayout_7 0 CompuMethod_125 -128 127 /end CHARACTERISTIC
/begin CHARACTERISTIC MediumCycle1Cyl8 "" VALUE 0x80004DDA RecordLayout_7 0 CompuMethod_125 -128 127 /end CHARACTERISTIC
/begin CHARACTERISTIC MediumCycle1Cyl8_TwoStep "" VALUE 0x80004DDB RecordLayout_7 0 CompuMethod_125 -128 127 /end CHARACTERISTIC
/begin CHARACTERISTIC MediumCycle2Cyl1 "" VALUE 0x80004DDC RecordLayout_7 0 CompuMethod_125 -128 127 /end CHARACTERISTIC
/begin CHARACTERISTIC MediumCycle2Cyl1_TwoStep "" VALUE 0x80004DDD RecordLayout_7 0 CompuMethod_125 -128 127 /end CHARACTERISTIC
/begin CHARACTERISTIC MediumCycle2Cyl2 "" VALUE 0x80004DDE RecordLayout_7 0 CompuMethod_125 -128 127 /end CHARACTERISTIC
/begin CHARACTERISTIC MediumCycle2Cyl2_TwoStep "" VALUE 0x80004DDF RecordLayout_7 0 CompuMethod_125 -128 127 /end CHARACTERISTIC
/begin CHARACTERISTIC MediumCycle2Cyl3 "" VALUE 0x80004DE0 RecordLayout_7 0 CompuMethod_125 -128 127 /end CHARACTERISTIC
/begin CHARACTERISTIC MediumCycle2Cyl3_TwoStep "" VALUE 0x80004DE1 RecordLayout_7 0 CompuMethod_125 -128 127 /end CHARACTERISTIC
/begin CHARACTERISTIC MediumCycle2Cyl4 "" VALUE 0x80004DE2 RecordLayout_7 0 CompuMethod_125 -128 127 /end CHARACTERISTIC
/begin CHARACTERISTIC MediumCycle2Cyl4_TwoStep "" VALUE 0x80004DE3 RecordLayout_7 0 CompuMethod_125 -128 127 /end CHARACTERISTIC
/begin CHARACTERISTIC MediumCycle2Cyl5 "" VALUE 0x80004DE4 RecordLayout_7 0 CompuMethod_125 -128 127 /end CHARACTERISTIC
/begin CHARACTERISTIC MediumCycle2Cyl5_TwoStep "" VALUE 0x80004DE5 RecordLayout_7 0 CompuMethod_125 -128 127 /end CHARACTERISTIC
/begin CHARACTERISTIC MediumCycle2Cyl6 "" VALUE 0x80004DE6 RecordLayout_7 0 CompuMethod_125 -128 127 /end CHARACTERISTIC
/begin CHARACTERISTIC MediumCycle2Cyl6_TwoStep "" VALUE 0x80004DE7 RecordLayout_7 0 CompuMethod_125 -128 127 /end CHARACTERISTIC
/begin CHARACTERISTIC MediumCycle2Cyl7 "" VALUE 0x80004DE8 RecordLayout_7 0 CompuMethod_125 -128 127 /end CHARACTERISTIC
/begin CHARACTERISTIC MediumCycle2Cyl7_TwoStep "" VALUE 0x80004DE9 RecordLayout_7 0 CompuMethod_125 -128 127 /end CHARACTERISTIC
/begin CHARACTERISTIC MediumCycle2Cyl8 "" VALUE 0x80004DEA RecordLayout_7 0 CompuMethod_125 -128 127 /end CHARACTERISTIC
/begin CHARACTERISTIC MediumCycle2Cyl8_TwoStep "" VALUE 0x80004DEB RecordLayout_7 0 CompuMethod_125 -128 127 /end CHARACTERISTIC
/begin CHARACTERISTIC MediumCycle3Cyl1 "" VALUE 0x80004DEC RecordLayout_7 0 CompuMethod_125 -128 127 /end CHARACTERISTIC
/begin CHARACTERISTIC MediumCycle3Cyl1_TwoStep "" VALUE 0x80004DED RecordLayout_7 0 CompuMethod_125 -128 127 /end CHARACTERISTIC
/begin CHARACTERISTIC MediumCycle3Cyl2 "" VALUE 0x80004DEE RecordLayout_7 0 CompuMethod_125 -128 127 /end CHARACTERISTIC
/begin CHARACTERISTIC MediumCycle3Cyl2_TwoStep "" VALUE 0x80004DEF RecordLayout_7 0 CompuMethod_125 -128 127 /end CHARACTERISTIC
/begin CHARACTERISTIC MediumCycle3Cyl3 "" VALUE 0x80004DF0 RecordLayout_7 0 CompuMethod_125 -128 127 /end CHARACTERISTIC
/begin CHARACTERISTIC MediumCycle3Cyl3_TwoStep "" VALUE 0x80004DF1 RecordLayout_7 0 CompuMethod_125 -128 127 /end CHARACTERISTIC
/begin CHARACTERISTIC MediumCycle3Cyl4 "" VALUE 0x80004DF2 RecordLayout_7 0 CompuMethod_125 -128 127 /end CHARACTERISTIC
/begin CHARACTERISTIC MediumCycle3Cyl4_TwoStep "" VALUE 0x80004DF3 RecordLayout_7 0 CompuMethod_125 -128 127 /end CHARACTERISTIC
/begin CHARACTERISTIC MediumCycle3Cyl5 "" VALUE 0x80004DF4 RecordLayout_7 0 CompuMethod_125 -128 127 /end CHARACTERISTIC
/begin CHARACTERISTIC MediumCycle3Cyl5_TwoStep "" VALUE 0x80004DF5 RecordLayout_7 0 CompuMethod_125 -128 127 /end CHARACTERISTIC
/begin CHARACTERISTIC MediumCycle3Cyl6 "" VALUE 0x80004DF6 RecordLayout_7 0 CompuMethod_125 -128 127 /end CHARACTERISTIC
/begin CHARACTERISTIC MediumCycle3Cyl6_TwoStep "" VALUE 0x80004DF7 RecordLayout_7 0 CompuMethod_125 -128 127 /end CHARACTERISTIC
/begin CHARACTERISTIC MediumCycle3Cyl7 "" VALUE 0x80004DF8 RecordLayout_7 0 CompuMethod_125 -128 127 /end CHARACTERISTIC
/begin CHARACTERISTIC MediumCycle3Cyl7_TwoStep "" VALUE 0x80004DF9 RecordLayout_7 0 CompuMethod_125 -128 127 /end CHARACTERISTIC
/begin CHARACTERISTIC MediumCycle3Cyl8 "" VALUE 0x80004DFA RecordLayout_7 0 CompuMethod_125 -128 127 /end CHARACTERISTIC
/begin CHARACTERISTIC MediumCycle3Cyl8_TwoStep "" VALUE 0x80004DFB RecordLayout_7 0 CompuMethod_125 -128 127 /end CHARACTERISTIC
/begin CHARACTERISTIC MediumCycle4Cyl1 "" VALUE 0x80004DFC RecordLayout_7 0 CompuMethod_125 -128 127 /end CHARACTERISTIC
/begin CHARACTERISTIC MediumCycle4Cyl1_TwoStep "" VALUE 0x80004DFD RecordLayout_7 0 CompuMethod_125 -128 127 /end CHARACTERISTIC
/begin CHARACTERISTIC MediumCycle4Cyl2 "" VALUE 0x80004DFE RecordLayout_7 0 CompuMethod_125 -128 127 /end CHARACTERISTIC
/begin CHARACTERISTIC MediumCycle4Cyl2_TwoStep "" VALUE 0x80004DFF RecordLayout_7 0 CompuMethod_125 -128 127 /end CHARACTERISTIC
/begin CHARACTERISTIC MediumCycle4Cyl3 "" VALUE 0x80004E00 RecordLayout_7 0 CompuMethod_125 -128 127 /end CHARACTERISTIC
/begin CHARACTERISTIC MediumCycle4Cyl3_TwoStep "" VALUE 0x80004E01 RecordLayout_7 0 CompuMethod_125 -128 127 /end CHARACTERISTIC
/begin CHARACTERISTIC MediumCycle4Cyl4 "" VALUE 0x80004E02 RecordLayout_7 0 CompuMethod_125 -128 127 /end CHARACTERISTIC
/begin CHARACTERISTIC MediumCycle4Cyl4_TwoStep "" VALUE 0x80004E03 RecordLayout_7 0 CompuMethod_125 -128 127 /end CHARACTERISTIC
/begin CHARACTERISTIC MediumCycle4Cyl5 "" VALUE 0x80004E04 RecordLayout_7 0 CompuMethod_125 -128 127 /end CHARACTERISTIC
/begin CHARACTERISTIC MediumCycle4Cyl5_TwoStep "" VALUE 0x80004E05 RecordLayout_7 0 CompuMethod_125 -128 127 /end CHARACTERISTIC
/begin CHARACTERISTIC MediumCycle4Cyl6 "" VALUE 0x80004E06 RecordLayout_7 0 CompuMethod_125 -128 127 /end CHARACTERISTIC
/begin CHARACTERISTIC MediumCycle4Cyl6_TwoStep "" VALUE 0x80004E07 RecordLayout_7 0 CompuMethod_125 -128 127 /end CHARACTERISTIC
/begin CHARACTERISTIC MediumCycle4Cyl7 "" VALUE 0x80004E08 RecordLayout_7 0 CompuMethod_125 -128 127 /end CHARACTERISTIC
/begin CHARACTERISTIC MediumCycle4Cyl7_TwoStep "" VALUE 0x80004E09 RecordLayout_7 0 CompuMethod_125 -128 127 /end CHARACTERISTIC
/begin CHARACTERISTIC MediumCycle4Cyl8 "" VALUE 0x80004E0A RecordLayout_7 0 CompuMethod_125 -128 127 /end CHARACTERISTIC
/begin CHARACTERISTIC MediumCycle4Cyl8_TwoStep "" VALUE 0x80004E0B RecordLayout_7 0 CompuMethod_125 -128 127 /end CHARACTERISTIC
/begin CHARACTERISTIC MinGovClntRPMSetPtTbl "RPM setpoint based on ECT." CURVE 0x80004E18 RecordLayout_4 0 CompuMethod_25 -1E+17 1E+17
 /begin AXIS_DESCR COM_AXIS ECT05In CompuMethod_27 5 -40 200 AXIS_PTS_REF ECT05IdxArr /end AXIS_DESCR
/end CHARACTERISTIC
/begin CHARACTERISTIC MinOilPressure_FaultTbl "Minimum oil pressure based on RPM - engine faults and shuts down below this" CURVE 0x80004E38 RecordLayout_4 0 CompuMethod_144 -1E+17 1E+17
 /begin AXIS_DESCR COM_AXIS RPM09In CompuMethod_25 9 0 14000 AXIS_PTS_REF RPM09IdxArr /end AXIS_DESCR
/end CHARACTERISTIC
/begin CHARACTERISTIC MinOilPressure_WarnTbl "Minimum oil pressure based on RPM - indicator light comes on below this" CURVE 0x80004E5C RecordLayout_4 0 CompuMethod_144 -1E+17 1E+17
 /begin AXIS_DESCR COM_AXIS RPM09In CompuMethod_25 9 0 14000 AXIS_PTS_REF RPM09IdxArr /end AXIS_DESCR
/end CHARACTERISTIC
/begin CHARACTERISTIC MinSparkLimit "Min. spark limit on the delivered spark advance." VALUE 0x80004E80 RecordLayout_4 0 CompuMethod_70 -1E+17 1E+17 /end CHARACTERISTIC
/begin CHARACTERISTIC MotoringDeltaRPMLimit "This is the amount RPM must be above the Setpoint RPM to set a Motorin Flag." VALUE 0x80004E84 RecordLayout_4 0 CompuMethod_25 -1E+17 1E+17 /end CHARACTERISTIC
/begin CHARACTERISTIC MotoringDtctTimerLimit "Amount of time engine speed has to be above the min gov. rpm set pt to set motoring flag." VALUE 0x80004E88 RecordLayout_4 0 CompuMethod_20 0 100 /end CHARACTERISTIC
/begin CHARACTERISTIC MPRD_new "Directly Override Main Power Relay" VALUE 0x80004E90 RecordLayout_1 0 CompuMethod_147 0 1 /end CHARACTERISTIC
/begin CHARACTERISTIC MPRD_ovr "" VALUE 0x80004E91 RecordLayout_1 0 CompuMethod_5 0 1 /end CHARACTERISTIC
/begin CHARACTERISTIC NonVolatileRestoreOnFirstStartup "Selects whether to restore from factory defaults the first time an application boots" VALUE 0x80004E92 RecordLayout_1 0 CompuMethod_148 0 1 /end CHARACTERISTIC
/begin CHARACTERISTIC NonVolatileRestoreOnStartup "Selects whether to restore from factory defaults on next startup" VALUE 0x80004E93 RecordLayout_1 0 CompuMethod_148 0 1 /end CHARACTERISTIC
/begin CHARACTERISTIC NoOilPres_FaultTime "After no oil pressure for this long the NoOilFault becomes active." VALUE 0x80004E94 RecordLayout_4 0 CompuMethod_10 0 1E+17 /end CHARACTERISTIC
/begin CHARACTERISTIC O2ActiveTimeThresh "Time limit O2 feedback can sit between rich and lean switch points before flagging O2NotActive fault" VALUE 0x80004E98 RecordLayout_4 0 CompuMethod_10 -1E+17 1E+17 /end CHARACTERISTIC
/begin CHARACTERISTIC O2CtrlAdaptDelayTime "O2 Control must be enabled for this amount of time before fuel adaption is enabled" VALUE 0x80004E9D RecordLayout_4 0 CompuMethod_10 0 1E+17 /end CHARACTERISTIC
/begin CHARACTERISTIC O2CtrlDGain "Base D-gain for the gaseous closed loop O2 controller." VALUE 0x80004EA1 RecordLayout_4 0 CompuMethod_151 -1E+17 1E+17 /end CHARACTERISTIC
/begin CHARACTERISTIC O2CtrlIGain "Base I-gain for the gaseous closed loop O2 controller." VALUE 0x80004EA5 RecordLayout_4 0 CompuMethod_151 -1E+17 1E+17 /end CHARACTERISTIC
/begin CHARACTERISTIC O2CtrlPGain "Base P-gain for the gaseous closed loop O2 controller." VALUE 0x80004EA9 RecordLayout_4 0 CompuMethod_151 -1E+17 1E+17 /end CHARACTERISTIC
/begin CHARACTERISTIC O2CtrlPIDOutLowerLimit "Lower limit on gaseous closed loop O2 PID Output." VALUE 0x80004EAD RecordLayout_4 0 CompuMethod_151 -1E+17 1E+17 /end CHARACTERISTIC
/begin CHARACTERISTIC O2CtrlPIDOutUpperLimit "Upper limit on gaseous closed loop O2 PID Output." VALUE 0x80004EB1 RecordLayout_4 0 CompuMethod_151 -1E+17 1E+17 /end CHARACTERISTIC
/begin CHARACTERISTIC O2DelagFilterConst "First-order filter time constant of the pre-catalyst O2 signal." VALUE 0x80004EB5 RecordLayout_4 0 CompuMethod_10 -1E+17 1E+17 /end CHARACTERISTIC
/begin CHARACTERISTIC O2ITermLowerLimit "Lower limit on gaseous closed loop O2 I Term." VALUE 0x80004EDE RecordLayout_4 0 CompuMethod_151 -1E+17 1E+17 /end CHARACTERISTIC
/begin CHARACTERISTIC O2ITermUpperLimit "Upper limit on gaseous closed loop O2 I Term." VALUE 0x80004EE2 RecordLayout_4 0 CompuMethod_151 -1E+17 1E+17 /end CHARACTERISTIC
/begin CHARACTERISTIC O2LeanTimeThresh "Time limit the O2 feedback can sit below the lean switch point before flagging O2FailedLean fault" VALUE 0x80004EE6 RecordLayout_4 0 CompuMethod_10 -1E+17 1E+17 /end CHARACTERISTIC
/begin CHARACTERISTIC O2MAFErrGainMultTbl "O2 PID controller system gain based on MAF port." CURVE 0x80004EEA RecordLayout_4 0 CompuMethod_49 -1E+17 1E+17
 /begin AXIS_DESCR COM_AXIS MAFPort05In CompuMethod_30 5 0 1000000 AXIS_PTS_REF MAFPort05IdxArr /end AXIS_DESCR
/end CHARACTERISTIC
/begin CHARACTERISTIC O2NECCTErrGainMultTbl "O2 PID controller system gain based on NECCT." CURVE 0x80004EFE RecordLayout_4 0 CompuMethod_49 -1E+17 1E+17
 /begin AXIS_DESCR COM_AXIS ECT09In CompuMethod_27 9 -40 200 AXIS_PTS_REF ECT09IdxArr /end AXIS_DESCR
/end CHARACTERISTIC
/begin CHARACTERISTIC O2RichTimeThresh "Time limit the O2 feedback can sit abovethe rich switch point before flagging O2FailedRich fault" VALUE 0x80004F22 RecordLayout_4 0 CompuMethod_10 -1E+17 1E+17 /end CHARACTERISTIC
/begin CHARACTERISTIC OilPres_FiltDecFiltC "Filter time constant for a decreasing signal." VALUE 0x80004F4A RecordLayout_4 0 CompuMethod_20 -1E+17 1E+17 /end CHARACTERISTIC
/begin CHARACTERISTIC OilPres_FiltIncFiltC "Filter time constant for a increasing signal." VALUE 0x80004F4E RecordLayout_4 0 CompuMethod_20 -1E+17 1E+17 /end CHARACTERISTIC
/begin CHARACTERISTIC OilPres_new "Override result of linear sensor characterization, in engineering units" VALUE 0x80004F52 RecordLayout_4 0 CompuMethod_144 -1E+17 1E+17 /end CHARACTERISTIC
/begin CHARACTERISTIC OilPres_ovr "" VALUE 0x80004F56 RecordLayout_1 0 CompuMethod_5 0 1 /end CHARACTERISTIC
/begin CHARACTERISTIC OilPresDfltValue "This is the initial default value should the sensor be in fault on key-up.  Otherwise the sensors outputs the last value prior to faulting" VALUE 0x80004F57 RecordLayout_4 0 CompuMethod_144 -1E+17 1E+17 /end CHARACTERISTIC
/begin CHARACTERISTIC OilPresFilterConst "Filter time constant" VALUE 0x80004F5B RecordLayout_4 0 CompuMethod_20 -1E+17 1E+17 /end CHARACTERISTIC
/begin CHARACTERISTIC OilPresGain "Scaling from A/D counts to engineering units" VALUE 0x80004F5F RecordLayout_4 0 CompuMethod_154 -1E+17 1E+17 /end CHARACTERISTIC
/begin CHARACTERISTIC OilPresInputHiFltPos "Maximum allowable input, indicating short or open circuit" VALUE 0x80004F63 RecordLayout_4 0 CompuMethod_22 -1E+17 1E+17 /end CHARACTERISTIC
/begin CHARACTERISTIC OilPresInputLoFltPos "Minimum allowable input, indicating short or open circuit" VALUE 0x80004F67 RecordLayout_4 0 CompuMethod_22 -1E+17 1E+17 /end CHARACTERISTIC
/begin CHARACTERISTIC OilPresOfst "Offset after gain in engineering units" VALUE 0x80004F6B RecordLayout_4 0 CompuMethod_144 -1E+17 1E+17 /end CHARACTERISTIC
/begin CHARACTERISTIC Overheat_MaxAPP "Max APP command to allow during overheat condition" VALUE 0x80004F7A RecordLayout_4 0 CompuMethod_6 -1E+17 1E+17 /end CHARACTERISTIC
/begin CHARACTERISTIC Overheat_ScaleAPP "Scale APP by this factor when overheating" VALUE 0x80004F7E RecordLayout_4 0 CompuMethod_156 -1E+17 1E+17 /end CHARACTERISTIC
/begin CHARACTERISTIC OXYTransFuelMultTbl "Transient fuel multiplier based on OXY.  Only engaged during transient fueling" CURVE 0x80004F96 RecordLayout_4 0 CompuMethod_2 -100 100
 /begin AXIS_DESCR COM_AXIS OXY05In CompuMethod_6 5 0 100 AXIS_PTS_REF OXY05IdxArr /end AXIS_DESCR
/end CHARACTERISTIC
/begin CHARACTERISTIC PH1_FiltDecConst "Filter time constant for a decreasing signal." VALUE 0x80004FCB RecordLayout_4 0 CompuMethod_20 -1E+17 1E+17 /end CHARACTERISTIC
/begin CHARACTERISTIC PH1_FiltIncConst "Filter time constant for a increasing signal." VALUE 0x80004FCF RecordLayout_4 0 CompuMethod_20 -1E+17 1E+17 /end CHARACTERISTIC
/begin CHARACTERISTIC PH2_FiltDecConst "Filter time constant for a decreasing signal." VALUE 0x80004FD3 RecordLayout_4 0 CompuMethod_20 -1E+17 1E+17 /end CHARACTERISTIC
/begin CHARACTERISTIC PH2_FiltIncConst "Filter time constant for a increasing signal." VALUE 0x80004FD7 RecordLayout_4 0 CompuMethod_20 -1E+17 1E+17 /end CHARACTERISTIC
/begin CHARACTERISTIC PHI1_DefaultVal "" VALUE 0x80004FDB RecordLayout_4 0 CompuMethod_2 -1E+17 1E+17 /end CHARACTERISTIC
/begin CHARACTERISTIC PHI2_DefaultVal "" VALUE 0x80004FDF RecordLayout_4 0 CompuMethod_2 -1E+17 1E+17 /end CHARACTERISTIC
/begin CHARACTERISTIC PostO2DelagFiltConst "First-order filter time constant of the post-catalyst O2 signal." VALUE 0x80004FE3 RecordLayout_4 0 CompuMethod_10 -1E+17 1E+17 /end CHARACTERISTIC
/begin CHARACTERISTIC RestoreNVFactoryDefaults "Restores NonVolatile Memory to Factory Defaults" VALUE 0x8000512E RecordLayout_1 0 CompuMethod_158 0 1 /end CHARACTERISTIC
/begin CHARACTERISTIC RevLimitType "Define the type of sequence to be disable when in Rev Limit" VALUE 0x80005133 RecordLayout_7 0 CompuMethod_160 -128 127 /end CHARACTERISTIC
/begin CHARACTERISTIC RichSwPtDeltaMap "If actual O2 reaches this point, switch the target to the LeanTargetDelta" MAP 0x80005134 RecordLayout_4 0 CompuMethod_44 -1E+17 1E+17
 /begin AXIS_DESCR COM_AXIS RPM09In CompuMethod_25 9 0 14000 AXIS_PTS_REF RPM09IdxArr /end AXIS_DESCR
 /begin AXIS_DESCR COM_AXIS MAP09In CompuMethod_8 9 0 1000 AXIS_PTS_REF MAP09IdxArr /end AXIS_DESCR
/end CHARACTERISTIC
/begin CHARACTERISTIC RichTargetDeltaMap "Target on the rich side for perturbation." MAP 0x80005278 RecordLayout_4 0 CompuMethod_44 -1E+17 1E+17
 /begin AXIS_DESCR COM_AXIS RPM09In CompuMethod_25 9 0 14000 AXIS_PTS_REF RPM09IdxArr /end AXIS_DESCR
 /begin AXIS_DESCR COM_AXIS MAP09In CompuMethod_8 9 0 1000 AXIS_PTS_REF MAP09IdxArr /end AXIS_DESCR
/end CHARACTERISTIC
/begin CHARACTERISTIC RPMFallingFiltConst "Filter time constant" VALUE 0x80005480 RecordLayout_4 0 CompuMethod_20 -1E+17 1E+17 /end CHARACTERISTIC
/begin CHARACTERISTIC RPMFallingRate "The minimum rate of change in RPM that triggers RPMFalling - This should be a positive value" VALUE 0x80005484 RecordLayout_4 0 CompuMethod_162 0 1000 /end CHARACTERISTIC
/begin CHARACTERISTIC RPMFilt_Enable "" VALUE 0x80005488 RecordLayout_1 0 CompuMethod_7 0 255 /end CHARACTERISTIC
/begin CHARACTERISTIC RPMFilt_LowPass "Filter time constant" VALUE 0x80005489 RecordLayout_4 0 CompuMethod_20 -1E+17 1E+17 /end CHARACTERISTIC
/begin CHARACTERISTIC RPMFilt_RoundValue "RPM round value" VALUE 0x8000548D RecordLayout_8 0 CompuMethod_75 0 1000 /end CHARACTERISTIC
/begin CHARACTERISTIC Scramble_new "Override actuator, in engineering units" VALUE 0x80005494 RecordLayout_1 0 CompuMethod_26 0 1 /end CHARACTERISTIC
/begin CHARACTERISTIC Scramble_ovr "" VALUE 0x80005495 RecordLayout_1 0 CompuMethod_5 0 1 /end CHARACTERISTIC
/begin CHARACTERISTIC ScrambleDebounceDelay "Cruise control debounce time" VALUE 0x80005496 RecordLayout_4 0 CompuMethod_164 -1E+17 1E+17 /end CHARACTERISTIC
/begin CHARACTERISTIC ScramblePolarity "0 = High True    1 = Low True" VALUE 0x8000549D RecordLayout_1 0 CompuMethod_4 0 1 /end CHARACTERISTIC
/begin CHARACTERISTIC ScrambleSwitchPt "Defines switch point in ADC units boolean conversion" VALUE 0x8000549E RecordLayout_4 0 CompuMethod_22 -1E+17 1E+17 /end CHARACTERISTIC
/begin CHARACTERISTIC SensVolt_new "Override result of linear sensor characterization, in engineering units" VALUE 0x800054A2 RecordLayout_4 0 CompuMethod_165 -1E+17 1E+17 /end CHARACTERISTIC
/begin CHARACTERISTIC SensVolt_ovr "" VALUE 0x800054A6 RecordLayout_1 0 CompuMethod_5 0 1 /end CHARACTERISTIC
/begin CHARACTERISTIC SensVoltDfltValue "This is the initial default value should the sensor be in fault on key-up.  Otherwise the sensors outputs the last value prior to faulting" VALUE 0x800054A7 RecordLayout_4 0 CompuMethod_165 -1E+17 1E+17 /end CHARACTERISTIC
/begin CHARACTERISTIC SensVoltFilterConst "Filter time constant" VALUE 0x800054AB RecordLayout_4 0 CompuMethod_20 -1E+17 1E+17 /end CHARACTERISTIC
/begin CHARACTERISTIC SensVoltGain "Scaling from A/D counts to engineering units" VALUE 0x800054AF RecordLayout_4 0 CompuMethod_166 -1E+17 1E+17 /end CHARACTERISTIC
/begin CHARACTERISTIC SensVoltInputHiFltPos "Maximum allowable input, indicating short or open circuit" VALUE 0x800054B3 RecordLayout_4 0 CompuMethod_22 -1E+17 1E+17 /end CHARACTERISTIC
/begin CHARACTERISTIC SensVoltInputLoFltPos "Minimum allowable input, indicating short or open circuit" VALUE 0x800054B7 RecordLayout_4 0 CompuMethod_22 -1E+17 1E+17 /end CHARACTERISTIC
/begin CHARACTERISTIC SensVoltOfst "Offset after gain in engineering units" VALUE 0x800054BB RecordLayout_4 0 CompuMethod_165 -1E+17 1E+17 /end CHARACTERISTIC
/begin CHARACTERISTIC SoftCycle1Cyl1 "" VALUE 0x800054C6 RecordLayout_7 0 CompuMethod_125 -128 127 /end CHARACTERISTIC
/begin CHARACTERISTIC SoftCycle1Cyl1_TwoStep "" VALUE 0x800054C7 RecordLayout_7 0 CompuMethod_125 -128 127 /end CHARACTERISTIC
/begin CHARACTERISTIC SoftCycle1Cyl2 "" VALUE 0x800054C8 RecordLayout_7 0 CompuMethod_125 -128 127 /end CHARACTERISTIC
/begin CHARACTERISTIC SoftCycle1Cyl2_TwoStep "" VALUE 0x800054C9 RecordLayout_7 0 CompuMethod_125 -128 127 /end CHARACTERISTIC
/begin CHARACTERISTIC SoftCycle1Cyl3 "" VALUE 0x800054CA RecordLayout_7 0 CompuMethod_125 -128 127 /end CHARACTERISTIC
/begin CHARACTERISTIC SoftCycle1Cyl3_TwoStep "" VALUE 0x800054CB RecordLayout_7 0 CompuMethod_125 -128 127 /end CHARACTERISTIC
/begin CHARACTERISTIC SoftCycle1Cyl4 "" VALUE 0x800054CC RecordLayout_7 0 CompuMethod_125 -128 127 /end CHARACTERISTIC
/begin CHARACTERISTIC SoftCycle1Cyl4_TwoStep "" VALUE 0x800054CD RecordLayout_7 0 CompuMethod_125 -128 127 /end CHARACTERISTIC
/begin CHARACTERISTIC SoftCycle1Cyl5 "" VALUE 0x800054CE RecordLayout_7 0 CompuMethod_125 -128 127 /end CHARACTERISTIC
/begin CHARACTERISTIC SoftCycle1Cyl5_TwoStep "" VALUE 0x800054CF RecordLayout_7 0 CompuMethod_125 -128 127 /end CHARACTERISTIC
/begin CHARACTERISTIC SoftCycle1Cyl6 "" VALUE 0x800054D0 RecordLayout_7 0 CompuMethod_125 -128 127 /end CHARACTERISTIC
/begin CHARACTERISTIC SoftCycle1Cyl6_TwoStep "" VALUE 0x800054D1 RecordLayout_7 0 CompuMethod_125 -128 127 /end CHARACTERISTIC
/begin CHARACTERISTIC SoftCycle1Cyl7 "" VALUE 0x800054D2 RecordLayout_7 0 CompuMethod_125 -128 127 /end CHARACTERISTIC
/begin CHARACTERISTIC SoftCycle1Cyl7_TwoStep "" VALUE 0x800054D3 RecordLayout_7 0 CompuMethod_125 -128 127 /end CHARACTERISTIC
/begin CHARACTERISTIC SoftCycle1Cyl8 "" VALUE 0x800054D4 RecordLayout_7 0 CompuMethod_125 -128 127 /end CHARACTERISTIC
/begin CHARACTERISTIC SoftCycle1Cyl8_TwoStep "" VALUE 0x800054D5 RecordLayout_7 0 CompuMethod_125 -128 127 /end CHARACTERISTIC
/begin CHARACTERISTIC SoftCycle2Cyl1 "" VALUE 0x800054D6 RecordLayout_7 0 CompuMethod_125 -128 127 /end CHARACTERISTIC
/begin CHARACTERISTIC SoftCycle2Cyl1_TwoStep "" VALUE 0x800054D7 RecordLayout_7 0 CompuMethod_125 -128 127 /end CHARACTERISTIC
/begin CHARACTERISTIC SoftCycle2Cyl2 "" VALUE 0x800054D8 RecordLayout_7 0 CompuMethod_125 -128 127 /end CHARACTERISTIC
/begin CHARACTERISTIC SoftCycle2Cyl2_TwoStep "" VALUE 0x800054D9 RecordLayout_7 0 CompuMethod_125 -128 127 /end CHARACTERISTIC
/begin CHARACTERISTIC SoftCycle2Cyl3 "" VALUE 0x800054DA RecordLayout_7 0 CompuMethod_125 -128 127 /end CHARACTERISTIC
/begin CHARACTERISTIC SoftCycle2Cyl3_TwoStep "" VALUE 0x800054DB RecordLayout_7 0 CompuMethod_125 -128 127 /end CHARACTERISTIC
/begin CHARACTERISTIC SoftCycle2Cyl4 "" VALUE 0x800054DC RecordLayout_7 0 CompuMethod_125 -128 127 /end CHARACTERISTIC
/begin CHARACTERISTIC SoftCycle2Cyl4_TwoStep "" VALUE 0x800054DD RecordLayout_7 0 CompuMethod_125 -128 127 /end CHARACTERISTIC
/begin CHARACTERISTIC SoftCycle2Cyl5 "" VALUE 0x800054DE RecordLayout_7 0 CompuMethod_125 -128 127 /end CHARACTERISTIC
/begin CHARACTERISTIC SoftCycle2Cyl5_TwoStep "" VALUE 0x800054DF RecordLayout_7 0 CompuMethod_125 -128 127 /end CHARACTERISTIC
/begin CHARACTERISTIC SoftCycle2Cyl6 "" VALUE 0x800054E0 RecordLayout_7 0 CompuMethod_125 -128 127 /end CHARACTERISTIC
/begin CHARACTERISTIC SoftCycle2Cyl6_TwoStep "" VALUE 0x800054E1 RecordLayout_7 0 CompuMethod_125 -128 127 /end CHARACTERISTIC
/begin CHARACTERISTIC SoftCycle2Cyl7 "" VALUE 0x800054E2 RecordLayout_7 0 CompuMethod_125 -128 127 /end CHARACTERISTIC
/begin CHARACTERISTIC SoftCycle2Cyl7_TwoStep "" VALUE 0x800054E3 RecordLayout_7 0 CompuMethod_125 -128 127 /end CHARACTERISTIC
/begin CHARACTERISTIC SoftCycle2Cyl8 "" VALUE 0x800054E4 RecordLayout_7 0 CompuMethod_125 -128 127 /end CHARACTERISTIC
/begin CHARACTERISTIC SoftCycle2Cyl8_TwoStep "" VALUE 0x800054E5 RecordLayout_7 0 CompuMethod_125 -128 127 /end CHARACTERISTIC
/begin CHARACTERISTIC SoftCycle3Cyl1 "" VALUE 0x800054E6 RecordLayout_7 0 CompuMethod_125 -128 127 /end CHARACTERISTIC
/begin CHARACTERISTIC SoftCycle3Cyl1_TwoStep "" VALUE 0x800054E7 RecordLayout_7 0 CompuMethod_125 -128 127 /end CHARACTERISTIC
/begin CHARACTERISTIC SoftCycle3Cyl2 "" VALUE 0x800054E8 RecordLayout_7 0 CompuMethod_125 -128 127 /end CHARACTERISTIC
/begin CHARACTERISTIC SoftCycle3Cyl2_TwoStep "" VALUE 0x800054E9 RecordLayout_7 0 CompuMethod_125 -128 127 /end CHARACTERISTIC
/begin CHARACTERISTIC SoftCycle3Cyl3 "" VALUE 0x800054EA RecordLayout_7 0 CompuMethod_125 -128 127 /end CHARACTERISTIC
/begin CHARACTERISTIC SoftCycle3Cyl3_TwoStep "" VALUE 0x800054EB RecordLayout_7 0 CompuMethod_125 -128 127 /end CHARACTERISTIC
/begin CHARACTERISTIC SoftCycle3Cyl4 "" VALUE 0x800054EC RecordLayout_7 0 CompuMethod_125 -128 127 /end CHARACTERISTIC
/begin CHARACTERISTIC SoftCycle3Cyl4_TwoStep "" VALUE 0x800054ED RecordLayout_7 0 CompuMethod_125 -128 127 /end CHARACTERISTIC
/begin CHARACTERISTIC SoftCycle3Cyl5 "" VALUE 0x800054EE RecordLayout_7 0 CompuMethod_125 -128 127 /end CHARACTERISTIC
/begin CHARACTERISTIC SoftCycle3Cyl5_TwoStep "" VALUE 0x800054EF RecordLayout_7 0 CompuMethod_125 -128 127 /end CHARACTERISTIC
/begin CHARACTERISTIC SoftCycle3Cyl6 "" VALUE 0x800054F0 RecordLayout_7 0 CompuMethod_125 -128 127 /end CHARACTERISTIC
/begin CHARACTERISTIC SoftCycle3Cyl6_TwoStep "" VALUE 0x800054F1 RecordLayout_7 0 CompuMethod_125 -128 127 /end CHARACTERISTIC
/begin CHARACTERISTIC SoftCycle3Cyl7 "" VALUE 0x800054F2 RecordLayout_7 0 CompuMethod_125 -128 127 /end CHARACTERISTIC
/begin CHARACTERISTIC SoftCycle3Cyl7_TwoStep "" VALUE 0x800054F3 RecordLayout_7 0 CompuMethod_125 -128 127 /end CHARACTERISTIC
/begin CHARACTERISTIC SoftCycle3Cyl8 "" VALUE 0x800054F4 RecordLayout_7 0 CompuMethod_125 -128 127 /end CHARACTERISTIC
/begin CHARACTERISTIC SoftCycle3Cyl8_TwoStep "" VALUE 0x800054F5 RecordLayout_7 0 CompuMethod_125 -128 127 /end CHARACTERISTIC
/begin CHARACTERISTIC SoftCycle4Cyl1 "" VALUE 0x800054F6 RecordLayout_7 0 CompuMethod_125 -128 127 /end CHARACTERISTIC
/begin CHARACTERISTIC SoftCycle4Cyl1_TwoStep "" VALUE 0x800054F7 RecordLayout_7 0 CompuMethod_125 -128 127 /end CHARACTERISTIC
/begin CHARACTERISTIC SoftCycle4Cyl2 "" VALUE 0x800054F8 RecordLayout_7 0 CompuMethod_125 -128 127 /end CHARACTERISTIC
/begin CHARACTERISTIC SoftCycle4Cyl2_TwoStep "" VALUE 0x800054F9 RecordLayout_7 0 CompuMethod_125 -128 127 /end CHARACTERISTIC
/begin CHARACTERISTIC SoftCycle4Cyl3 "" VALUE 0x800054FA RecordLayout_7 0 CompuMethod_125 -128 127 /end CHARACTERISTIC
/begin CHARACTERISTIC SoftCycle4Cyl3_TwoStep "" VALUE 0x800054FB RecordLayout_7 0 CompuMethod_125 -128 127 /end CHARACTERISTIC
/begin CHARACTERISTIC SoftCycle4Cyl4 "" VALUE 0x800054FC RecordLayout_7 0 CompuMethod_125 -128 127 /end CHARACTERISTIC
/begin CHARACTERISTIC SoftCycle4Cyl4_TwoStep "" VALUE 0x800054FD RecordLayout_7 0 CompuMethod_125 -128 127 /end CHARACTERISTIC
/begin CHARACTERISTIC SoftCycle4Cyl5 "" VALUE 0x800054FE RecordLayout_7 0 CompuMethod_125 -128 127 /end CHARACTERISTIC
/begin CHARACTERISTIC SoftCycle4Cyl5_TwoStep "" VALUE 0x800054FF RecordLayout_7 0 CompuMethod_125 -128 127 /end CHARACTERISTIC
/begin CHARACTERISTIC SoftCycle4Cyl6 "" VALUE 0x80005500 RecordLayout_7 0 CompuMethod_125 -128 127 /end CHARACTERISTIC
/begin CHARACTERISTIC SoftCycle4Cyl6_TwoStep "" VALUE 0x80005501 RecordLayout_7 0 CompuMethod_125 -128 127 /end CHARACTERISTIC
/begin CHARACTERISTIC SoftCycle4Cyl7 "" VALUE 0x80005502 RecordLayout_7 0 CompuMethod_125 -128 127 /end CHARACTERISTIC
/begin CHARACTERISTIC SoftCycle4Cyl7_TwoStep "" VALUE 0x80005503 RecordLayout_7 0 CompuMethod_125 -128 127 /end CHARACTERISTIC
/begin CHARACTERISTIC SoftCycle4Cyl8 "" VALUE 0x80005504 RecordLayout_7 0 CompuMethod_125 -128 127 /end CHARACTERISTIC
/begin CHARACTERISTIC SoftCycle4Cyl8_TwoStep "" VALUE 0x80005505 RecordLayout_7 0 CompuMethod_125 -128 127 /end CHARACTERISTIC
/begin CHARACTERISTIC SoftOverBoostLimit "Soft overboost limit" VALUE 0x80005506 RecordLayout_4 0 CompuMethod_56 -1E+17 1E+17 /end CHARACTERISTIC
/begin CHARACTERISTIC SoftOverBoostTime "After soft overboost level reached for this time SoftOverBoost_Fault becomes active" VALUE 0x8000550A RecordLayout_4 0 CompuMethod_10 0 1E+17 /end CHARACTERISTIC
/begin CHARACTERISTIC SOI_new "" VALUE 0x8000550E RecordLayout_4 0 CompuMethod_2 -1E+17 1E+17 /end CHARACTERISTIC
/begin CHARACTERISTIC SOI_ovr "" VALUE 0x80005512 RecordLayout_1 0 CompuMethod_5 0 1 /end CHARACTERISTIC
/begin CHARACTERISTIC SparkAdv_DeltaHi "Maximum increasing spark change per 5ms" VALUE 0x80005513 RecordLayout_4 0 CompuMethod_89 0 720 /end CHARACTERISTIC
/begin CHARACTERISTIC SparkAdv_DeltaLo "Maximum decreasing spark change per 5ms" VALUE 0x80005517 RecordLayout_4 0 CompuMethod_70 0 720 /end CHARACTERISTIC
/begin CHARACTERISTIC SparkDwell_offset "" VALUE 0x800059A7 RecordLayout_4 0 CompuMethod_2 -1E+17 1E+17 /end CHARACTERISTIC
/begin CHARACTERISTIC SparkDwell_ovr "" VALUE 0x800059AB RecordLayout_1 0 CompuMethod_167 0 1 /end CHARACTERISTIC
/begin CHARACTERISTIC SparkStartAngle_offset "Provides a relative offset to input signal" VALUE 0x800059B9 RecordLayout_4 0 CompuMethod_70 -1E+17 1E+17 /end CHARACTERISTIC
/begin CHARACTERISTIC SparkStartAngle_ovr "Provides a relative offset to input signal" VALUE 0x800059BD RecordLayout_1 0 CompuMethod_169 0 1 /end CHARACTERISTIC
/begin CHARACTERISTIC SparkStopAngle_offset "Provides a relative offset to input signal" VALUE 0x800059BE RecordLayout_4 0 CompuMethod_70 -1E+17 1E+17 /end CHARACTERISTIC
/begin CHARACTERISTIC SparkStopAngle_ovr "Provides a relative offset to input signal" VALUE 0x800059C2 RecordLayout_1 0 CompuMethod_169 0 1 /end CHARACTERISTIC
/begin CHARACTERISTIC SpkMinGovDGain "Base D-gain for the min. governor controller." VALUE 0x800059E7 RecordLayout_4 0 CompuMethod_33 -1E+17 1E+17 /end CHARACTERISTIC
/begin CHARACTERISTIC SpkMinGovDGainErrorMultTbl "" CURVE 0x800059EB RecordLayout_4 0 CompuMethod_33 -1E+17 1E+17
 /begin AXIS_DESCR COM_AXIS SpkMinGovSpeedErrorIn CompuMethod_2 9 -1E+17 1E+17 AXIS_PTS_REF SpkMinGovSpeedErrorIdxArr /end AXIS_DESCR
/end CHARACTERISTIC
/begin CHARACTERISTIC SpkMinGovErrorGain "Error gain for the min governor controller. This gain is applied to the RPM error term before it is used to calculate the P, I and D terms." VALUE 0x80005A0F RecordLayout_4 0 CompuMethod_33 -1E+17 1E+17 /end CHARACTERISTIC
/begin CHARACTERISTIC SpkMinGovPGain "Base P-gain for the min. governor controller." VALUE 0x80005A13 RecordLayout_4 0 CompuMethod_33 -1E+17 1E+17 /end CHARACTERISTIC
/begin CHARACTERISTIC SpkMinGovPGainErrorMultTbl "" CURVE 0x80005A17 RecordLayout_4 0 CompuMethod_33 -1E+17 1E+17
 /begin AXIS_DESCR COM_AXIS SpkMinGovSpeedErrorIn CompuMethod_2 9 -1E+17 1E+17 AXIS_PTS_REF SpkMinGovSpeedErrorIdxArr /end AXIS_DESCR
/end CHARACTERISTIC
/begin CHARACTERISTIC SpkMinGovPIDOutLowerLimit "Lower limit on spark min governor PID Output." VALUE 0x80005A3B RecordLayout_4 0 CompuMethod_89 -1E+17 1E+17 /end CHARACTERISTIC
/begin CHARACTERISTIC SpkMinGovPIDOutUpperLimit "Upper limit on spark min governor PID Output." VALUE 0x80005A3F RecordLayout_4 0 CompuMethod_89 -1E+17 1E+17 /end CHARACTERISTIC
/begin CHARACTERISTIC SSLoadDecFiltC "Filter time constant for a decreasing signal." VALUE 0x80005A67 RecordLayout_4 0 CompuMethod_20 -1E+17 1E+17 /end CHARACTERISTIC
/begin CHARACTERISTIC SSLoadIncFiltC "Filter time constant for a increasing signal." VALUE 0x80005A6B RecordLayout_4 0 CompuMethod_20 -1E+17 1E+17 /end CHARACTERISTIC
/begin CHARACTERISTIC SSLoadTol "Steady-State Load Tolerance" VALUE 0x80005A6F RecordLayout_4 0 CompuMethod_2 -1E+17 1E+17 /end CHARACTERISTIC
/begin CHARACTERISTIC SSRPMDecFiltC "Filter time constant for a decreasing signal." VALUE 0x80005A73 RecordLayout_4 0 CompuMethod_20 -1E+17 1E+17 /end CHARACTERISTIC
/begin CHARACTERISTIC SSRPMIncFiltC "Filter time constant for a increasing signal." VALUE 0x80005A77 RecordLayout_4 0 CompuMethod_20 -1E+17 1E+17 /end CHARACTERISTIC
/begin CHARACTERISTIC SSRPMTol "Steady-State RPM Tolerance" VALUE 0x80005A7B RecordLayout_4 0 CompuMethod_25 -1E+17 1E+17 /end CHARACTERISTIC
/begin CHARACTERISTIC StoreNV "Stores RAM-Shadowed memory to serial EEPROM" VALUE 0x80005A8B RecordLayout_1 0 CompuMethod_171 0 1 /end CHARACTERISTIC
/begin CHARACTERISTIC SysVolt_new "Override result of linear sensor characterization, in engineering units" VALUE 0x80005A8C RecordLayout_4 0 CompuMethod_165 -1E+17 1E+17 /end CHARACTERISTIC
/begin CHARACTERISTIC SysVolt_ovr "" VALUE 0x80005A90 RecordLayout_1 0 CompuMethod_5 0 1 /end CHARACTERISTIC
/begin CHARACTERISTIC SysVoltDfltValue "This is the initial default value should the sensor be in fault on key-up.  Otherwise the sensors outputs the last value prior to faulting" VALUE 0x80005AB8 RecordLayout_4 0 CompuMethod_165 -1E+17 1E+17 /end CHARACTERISTIC
/begin CHARACTERISTIC SysVoltFilterConst "Filter time constant" VALUE 0x80005ABC RecordLayout_4 0 CompuMethod_20 -1E+17 1E+17 /end CHARACTERISTIC
/begin CHARACTERISTIC SysVoltGain "Scaling from A/D counts to engineering units" VALUE 0x80005AC0 RecordLayout_4 0 CompuMethod_166 -1E+17 1E+17 /end CHARACTERISTIC
/begin CHARACTERISTIC SysVoltInputHiFltPos "Maximum allowable input, indicating short or open circuit" VALUE 0x80005AC4 RecordLayout_4 0 CompuMethod_22 -1E+17 1E+17 /end CHARACTERISTIC
/begin CHARACTERISTIC SysVoltInputLoFltPos "Minimum allowable input, indicating short or open circuit" VALUE 0x80005AC8 RecordLayout_4 0 CompuMethod_22 -1E+17 1E+17 /end CHARACTERISTIC
/begin CHARACTERISTIC SysVoltOfst "Offset after gain in engineering units" VALUE 0x80005ACC RecordLayout_4 0 CompuMethod_165 -1E+17 1E+17 /end CHARACTERISTIC
/begin CHARACTERISTIC TempOverheat_Fault "ECT limit above which fault is set." VALUE 0x80005AD1 RecordLayout_4 0 CompuMethod_27 -1E+17 1E+17 /end CHARACTERISTIC
/begin CHARACTERISTIC TempOverheat_Warn "ECT limit above which warning light comes on" VALUE 0x80005AD5 RecordLayout_4 0 CompuMethod_27 -1E+17 1E+17 /end CHARACTERISTIC
/begin CHARACTERISTIC TempOverheatSevere_Fault "ECT limit above which severe overheat fault is set." VALUE 0x80005AD9 RecordLayout_4 0 CompuMethod_27 -1E+17 1E+17 /end CHARACTERISTIC
/begin CHARACTERISTIC TPS1_new "Override result of linear sensor characterization, in engineering units" VALUE 0x80005B34 RecordLayout_4 0 CompuMethod_6 -1E+17 1E+17 /end CHARACTERISTIC
/begin CHARACTERISTIC TPS1_ovr "" VALUE 0x80005B38 RecordLayout_1 0 CompuMethod_5 0 1 /end CHARACTERISTIC
/begin CHARACTERISTIC TPS1_TPS2_Max_Deviation "Specifies the maximum allowable deviation between the two sensors" VALUE 0x80005B39 RecordLayout_4 0 CompuMethod_38 -1E+17 1E+17 /end CHARACTERISTIC
/begin CHARACTERISTIC TPS1Adapt_Delta "Specifies the minimum deviation amount to react to." VALUE 0x80005B3D RecordLayout_4 0 CompuMethod_22 -1E+17 1E+17 /end CHARACTERISTIC
/begin CHARACTERISTIC TPS1Adapt_Hi_Max "Specifies for the maximum value of the upper adapt range." VALUE 0x80005B41 RecordLayout_4 0 CompuMethod_35 -1E+17 1E+17 /end CHARACTERISTIC
/begin CHARACTERISTIC TPS1Adapt_Hi_Min "Specifies for the minimum value of the upper adapt range." VALUE 0x80005B45 RecordLayout_4 0 CompuMethod_35 -1E+17 1E+17 /end CHARACTERISTIC
/begin CHARACTERISTIC TPS1Adapt_Low_Max "Specifies for the maximum value of the lower adapt range." VALUE 0x80005B49 RecordLayout_4 0 CompuMethod_35 -1E+17 1E+17 /end CHARACTERISTIC
/begin CHARACTERISTIC TPS1Adapt_Low_Min "Specifies for the minimum value of the lower adapt range." VALUE 0x80005B4D RecordLayout_4 0 CompuMethod_35 -1E+17 1E+17 /end CHARACTERISTIC
/begin CHARACTERISTIC TPS1AdaptHiEnable "Enables or disables this adapt." VALUE 0x80005B51 RecordLayout_1 0 CompuMethod_36 0 1 /end CHARACTERISTIC
/begin CHARACTERISTIC TPS1AdaptLoEnable "Enables or disables this adapt." VALUE 0x80005B52 RecordLayout_1 0 CompuMethod_36 0 1 /end CHARACTERISTIC
/begin CHARACTERISTIC TPS1DfltValue "This is the initial default value should the sensor be in fault on key-up.  Otherwise the sensors outputs the last value prior to faulting" VALUE 0x80005B56 RecordLayout_4 0 CompuMethod_6 -1E+17 1E+17 /end CHARACTERISTIC
/begin CHARACTERISTIC TPS1FilterConst "Filter time constant" VALUE 0x80005B5A RecordLayout_4 0 CompuMethod_20 -1E+17 1E+17 /end CHARACTERISTIC
/begin CHARACTERISTIC TPS1InputHiFltPos "Hi limit of input signal which sets fault" VALUE 0x80005B5E RecordLayout_4 0 CompuMethod_22 -1E+17 1E+17 /end CHARACTERISTIC
/begin CHARACTERISTIC TPS1InputLoFltPos "Low limit of input signal which sets fault" VALUE 0x80005B62 RecordLayout_4 0 CompuMethod_22 -1E+17 1E+17 /end CHARACTERISTIC
/begin CHARACTERISTIC TPS1MaxLimit "Sets the upper limit on the potentiometer range." VALUE 0x80005B66 RecordLayout_4 0 CompuMethod_6 -1E+17 1E+17 /end CHARACTERISTIC
/begin CHARACTERISTIC TPS1Rev_Polarity "1 = Reverse Polarity (Smaller voltage values indicate larger % travel)" VALUE 0x80005B6A RecordLayout_1 0 CompuMethod_37 0 1 /end CHARACTERISTIC
/begin CHARACTERISTIC TPS2_new "Override result of linear sensor characterization, in engineering units" VALUE 0x80005B6B RecordLayout_4 0 CompuMethod_6 -1E+17 1E+17 /end CHARACTERISTIC
/begin CHARACTERISTIC TPS2_ovr "" VALUE 0x80005B6F RecordLayout_1 0 CompuMethod_5 0 1 /end CHARACTERISTIC
/begin CHARACTERISTIC TPS2Adapt_Delta "Specifies the minimum deviation amount to react to." VALUE 0x80005B70 RecordLayout_4 0 CompuMethod_22 -1E+17 1E+17 /end CHARACTERISTIC
/begin CHARACTERISTIC TPS2Adapt_Hi_Max "Specifies for the maximum value of the upper adapt range." VALUE 0x80005B74 RecordLayout_4 0 CompuMethod_35 -1E+17 1E+17 /end CHARACTERISTIC
/begin CHARACTERISTIC TPS2Adapt_Hi_Min "Specifies for the minimum value of the upper adapt range." VALUE 0x80005B78 RecordLayout_4 0 CompuMethod_35 -1E+17 1E+17 /end CHARACTERISTIC
/begin CHARACTERISTIC TPS2Adapt_Low_Max "Specifies for the maximum value of the lower adapt range." VALUE 0x80005B7C RecordLayout_4 0 CompuMethod_35 -1E+17 1E+17 /end CHARACTERISTIC
/begin CHARACTERISTIC TPS2Adapt_Low_Min "Specifies for the minimum value of the lower adapt range." VALUE 0x80005B80 RecordLayout_4 0 CompuMethod_35 -1E+17 1E+17 /end CHARACTERISTIC
/begin CHARACTERISTIC TPS2AdaptHiEnable "Enables or disables this adapt." VALUE 0x80005B84 RecordLayout_1 0 CompuMethod_36 0 1 /end CHARACTERISTIC
/begin CHARACTERISTIC TPS2AdaptLoEnable "Enables or disables this adapt." VALUE 0x80005B85 RecordLayout_1 0 CompuMethod_36 0 1 /end CHARACTERISTIC
/begin CHARACTERISTIC TPS2DfltValue "This is the initial default value should the sensor be in fault on key-up.  Otherwise the sensors outputs the last value prior to faulting" VALUE 0x80005B89 RecordLayout_4 0 CompuMethod_6 -1E+17 1E+17 /end CHARACTERISTIC
/begin CHARACTERISTIC TPS2FilterConst "Filter time constant" VALUE 0x80005B8D RecordLayout_4 0 CompuMethod_20 -1E+17 1E+17 /end CHARACTERISTIC
/begin CHARACTERISTIC TPS2InputHiFltPos "Hi limit of input signal which sets fault" VALUE 0x80005B91 RecordLayout_4 0 CompuMethod_22 -1E+17 1E+17 /end CHARACTERISTIC
/begin CHARACTERISTIC TPS2InputLoFltPos "Low limit of input signal which sets fault" VALUE 0x80005B95 RecordLayout_4 0 CompuMethod_22 -1E+17 1E+17 /end CHARACTERISTIC
/begin CHARACTERISTIC TPS2MaxLimit "Sets the upper limit on the potentiometer range." VALUE 0x80005B99 RecordLayout_4 0 CompuMethod_6 -1E+17 1E+17 /end CHARACTERISTIC
/begin CHARACTERISTIC TPS2Rev_Polarity "1 = Reverse Polarity (Smaller voltage values indicate larger % travel)" VALUE 0x80005B9D RecordLayout_1 0 CompuMethod_37 0 1 /end CHARACTERISTIC
/begin CHARACTERISTIC TwoStep_new "Override actuator, in engineering units" VALUE 0x80005B9E RecordLayout_1 0 CompuMethod_26 0 1 /end CHARACTERISTIC
/begin CHARACTERISTIC TwoStep_ovr "" VALUE 0x80005B9F RecordLayout_1 0 CompuMethod_5 0 1 /end CHARACTERISTIC
/begin CHARACTERISTIC TwoStepDebounceDelay "Two step debounce time" VALUE 0x80005BA0 RecordLayout_4 0 CompuMethod_164 -1E+17 1E+17 /end CHARACTERISTIC
/begin CHARACTERISTIC TwoStepHardRevOffset "RPM rev limit for hard action to be taken" VALUE 0x80005BA4 RecordLayout_4 0 CompuMethod_25 0 1E+17 /end CHARACTERISTIC
/begin CHARACTERISTIC TwoStepMediumRevOffset "RPM rev limit for medium action to be taken" VALUE 0x80005BA8 RecordLayout_4 0 CompuMethod_25 0 1E+17 /end CHARACTERISTIC
/begin CHARACTERISTIC TwoStepPolarity "0 = High True    1 = Low True" VALUE 0x80005BAE RecordLayout_1 0 CompuMethod_4 0 1 /end CHARACTERISTIC
/begin CHARACTERISTIC TwoStepRevLimit "Maximum RPM allowed, before any action is taken" VALUE 0x80005BAF RecordLayout_4 0 CompuMethod_25 0 1E+17 /end CHARACTERISTIC
/begin CHARACTERISTIC TwoStepRevLimitHyst "Hysteresis applied to MaxRPM once rev limit threshold is satisfied" VALUE 0x80005BB3 RecordLayout_4 0 CompuMethod_25 0 12000 /end CHARACTERISTIC
/begin CHARACTERISTIC VEAdaptGainTblTbl "Multiplier on error for adaptation, should always be positive" CURVE 0x80005BE0 RecordLayout_4 0 CompuMethod_2 -1E+17 1E+17
 /begin AXIS_DESCR COM_AXIS VE_AdaptErrorIdxArrIn CompuMethod_2 10 -1E+17 1E+17 AXIS_PTS_REF VE_AdaptErrorIdxArrIdxArr /end AXIS_DESCR
/end CHARACTERISTIC
/begin CHARACTERISTIC VEAdaptMax "Determines whether the Volumetric Efficiency map will be adapted using the MAF sensor" VALUE 0x80005C08 RecordLayout_4 0 CompuMethod_178 -1E+17 1E+17 /end CHARACTERISTIC
/begin CHARACTERISTIC VEAdaptMin "Determines whether the Volumetric Efficiency map will be adapted using the MAF sensor" VALUE 0x80005C0C RecordLayout_4 0 CompuMethod_178 -1E+17 1E+17 /end CHARACTERISTIC
/begin CHARACTERISTIC VPSD_ChangeReject "If VSPD changes by more than this per/second ignore it" VALUE 0x800067EC RecordLayout_4 0 CompuMethod_179 -1E+17 1E+17 /end CHARACTERISTIC
/begin CHARACTERISTIC VSPD_ChangeReject_Enable "Enable for if VSPD changes by more than this per/second ignore it" VALUE 0x800067F0 RecordLayout_1 0 CompuMethod_181 0 255 /end CHARACTERISTIC
/begin CHARACTERISTIC VSPD_DigitalPresent "" VALUE 0x800067F1 RecordLayout_1 0 CompuMethod_7 0 255 /end CHARACTERISTIC
/begin CHARACTERISTIC VSPD_GPSPreferred "" VALUE 0x800067FA RecordLayout_1 0 CompuMethod_7 0 255 /end CHARACTERISTIC
/begin CHARACTERISTIC VSPD_new "Override result of linear sensor characterization, in engineering units" VALUE 0x800067FB RecordLayout_4 0 CompuMethod_180 -1E+17 1E+17 /end CHARACTERISTIC
/begin CHARACTERISTIC VSPD_ovr "" VALUE 0x800067FF RecordLayout_1 0 CompuMethod_5 0 1 /end CHARACTERISTIC
/begin CHARACTERISTIC VSPD_Pin_AliasProtect "Frequency input alias detection for VSPD_Pin" VALUE 0x80006802 RecordLayout_1 0 CompuMethod_122 0 1 /end CHARACTERISTIC
/begin CHARACTERISTIC VSPD_Pin_EdgeDetect "Frequency input edge trigger for VSPD_Pin" VALUE 0x80006803 RecordLayout_1 0 CompuMethod_84 0 1 /end CHARACTERISTIC
/begin CHARACTERISTIC VSPD_Pin_Interface "Frequency input signal interface for VSPD_Pin" VALUE 0x80006804 RecordLayout_1 0 CompuMethod_123 0 1 /end CHARACTERISTIC
/begin CHARACTERISTIC VSPD_Pin_MinFrequency "Minimum expected input frequency for VSPD_Pin" VALUE 0x80006805 RecordLayout_3 0 CompuMethod_124 0.01 10000 /end CHARACTERISTIC
/begin CHARACTERISTIC VSPD_RateReject "If VSPD changes by more than this per/second ignore it" VALUE 0x80006809 RecordLayout_4 0 CompuMethod_179 -1E+17 1E+17 /end CHARACTERISTIC
/begin CHARACTERISTIC VSPD_RateReject_Enable "Enable for if VSPD changes by more than this per/second ignore it" VALUE 0x8000680D RecordLayout_1 0 CompuMethod_181 0 255 /end CHARACTERISTIC
/begin CHARACTERISTIC VSPD_RejectHoldTime "TimeToHoldLastValue" VALUE 0x8000680E RecordLayout_4 0 CompuMethod_20 -1E+17 1E+17 /end CHARACTERISTIC
/begin CHARACTERISTIC VSPD_ZeroSpeed "What VSPD filter considers zero speed" VALUE 0x80006812 RecordLayout_4 0 CompuMethod_117 -1E+17 1E+17 /end CHARACTERISTIC
/begin CHARACTERISTIC VSPDDefault "This is the initial default value should the sensor be in fault on key-up.  Otherwise the sensors outputs the last value prior to faulting" VALUE 0x8000687E RecordLayout_4 0 CompuMethod_180 -1E+17 1E+17 /end CHARACTERISTIC
/begin CHARACTERISTIC VSPDFiltConst "Filter time constant" VALUE 0x80006882 RecordLayout_4 0 CompuMethod_20 -1E+17 1E+17 /end CHARACTERISTIC
/begin CHARACTERISTIC VSPDMax "Maximum allowable input, indicating short or open circuit" VALUE 0x800068BA RecordLayout_4 0 CompuMethod_99 -1E+17 1E+17 /end CHARACTERISTIC
/begin CHARACTERISTIC VSPDMin "Minimum allowable input, indicating short or open circuit" VALUE 0x800068BE RecordLayout_4 0 CompuMethod_99 -1E+17 1E+17 /end CHARACTERISTIC
/begin CHARACTERISTIC VSPDTbl "Look up table to allownon-linear characterization of sensors" CURVE 0x800068C2 RecordLayout_4 0 CompuMethod_180 -1E+17 1E+17
 /begin AXIS_DESCR COM_AXIS VSPDADC CompuMethod_99 13 -1E+17 1E+17 AXIS_PTS_REF VSPDIdxArr /end AXIS_DESCR
/end CHARACTERISTIC
/begin CHARACTERISTIC Warmup_Time_HoldoffTbl "Time before warmup fuel multiplier active" CURVE 0x800068F6 RecordLayout_4 0 CompuMethod_182 0 3
 /begin AXIS_DESCR COM_AXIS ECT05In CompuMethod_27 5 -40 200 AXIS_PTS_REF ECT05IdxArr /end AXIS_DESCR
/end CHARACTERISTIC
/begin CHARACTERISTIC WASTEGATE_new "Override result of linear sensor characterization, in engineering units" VALUE 0x80006A74 RecordLayout_4 0 CompuMethod_6 -1E+17 1E+17 /end CHARACTERISTIC
/begin CHARACTERISTIC WASTEGATE_ovr "" VALUE 0x80006A78 RecordLayout_1 0 CompuMethod_5 0 1 /end CHARACTERISTIC
/begin CHARACTERISTIC WASTEGATEFrequency "Frequency of PWM output" VALUE 0x80006A79 RecordLayout_4 0 CompuMethod_99 -1E+17 1E+17 /end CHARACTERISTIC
/begin CHARACTERISTIC WASTEGATEGain "Scaling from engineering units to PWM duty cycle" VALUE 0x80006A7D RecordLayout_4 0 CompuMethod_105 -1E+17 1E+17 /end CHARACTERISTIC
/begin CHARACTERISTIC WastegateLossOfControl "Wastegate duty cycle having insufficient control of boost" VALUE 0x80006A81 RecordLayout_4 0 CompuMethod_6 -1E+17 1E+17 /end CHARACTERISTIC
/begin CHARACTERISTIC WASTEGATEMaxLimit "Maximum limit of PWM signal." VALUE 0x80006A85 RecordLayout_4 0 CompuMethod_6 -1E+17 1E+17 /end CHARACTERISTIC
/begin CHARACTERISTIC WASTEGATEMinLimit "Minimum limit of PWM signal." VALUE 0x80006A89 RecordLayout_4 0 CompuMethod_6 -1E+17 1E+17 /end CHARACTERISTIC
/begin CHARACTERISTIC WASTEGATEOffset "Offset from engineering units to PWM duty cycle" VALUE 0x80006A8D RecordLayout_4 0 CompuMethod_6 -1E+17 1E+17 /end CHARACTERISTIC
/begin CHARACTERISTIC WastegateTime "After wastegate loss of control level reached for this time Wastegate_Fault becomes active" VALUE 0x80006A91 RecordLayout_4 0 CompuMethod_10 0 1E+17 /end CHARACTERISTIC
/begin AXIS_PTS App05IdxArr "" 0x80000470 App05In RecordLayout_6 0 CompuMethod_2 5 -1E+17 1E+17 DEPOSIT ABSOLUTE /end AXIS_PTS
/begin AXIS_PTS ECT05IdxArr "Idex of ECT" 0x800020A5 ECT05In RecordLayout_6 0 CompuMethod_27 5 -40 200 DEPOSIT ABSOLUTE /end AXIS_PTS
/begin AXIS_PTS ECT09IdxArr "Index of ECT" 0x800020B9 ECT09In RecordLayout_6 0 CompuMethod_27 9 -40 200 DEPOSIT ABSOLUTE /end AXIS_PTS
/begin AXIS_PTS Fuel_LvlIdxArr "Look up table to allownon-linear characterization of sensors" 0x80003B51 Fuel_LvlADC RecordLayout_6 0 CompuMethod_22 13 -1E+17 1E+17 DEPOSIT ABSOLUTE /end AXIS_PTS
/begin AXIS_PTS FuelLevel_FiltConstColIdxArr "FuelLevel_FiltConst" 0x80003E86 FuelLevel_FiltConstColIn RecordLayout_6 0 CompuMethod_117 7 0 1E+17 DEPOSIT ABSOLUTE /end AXIS_PTS
/begin AXIS_PTS FuelLevel_FiltConstRowIdxArr "FuelLevel_FiltConst" 0x80003F66 FuelLevel_FiltConstRowIn RecordLayout_6 0 CompuMethod_20 7 0 1E+17 DEPOSIT ABSOLUTE /end AXIS_PTS
/begin AXIS_PTS IATIdxArr "Look up table to allownon-linear characterization of sensors" 0x800044D5 IATADC RecordLayout_6 0 CompuMethod_22 13 -1E+17 1E+17 DEPOSIT ABSOLUTE /end AXIS_PTS
/begin AXIS_PTS MAFIdxArr "Look up table to allownon-linear characterization of sensors" 0x8000499C MAFADC RecordLayout_6 0 CompuMethod_99 13 -1E+17 1E+17 DEPOSIT ABSOLUTE /end AXIS_PTS
/begin AXIS_PTS MAFPort05IdxArr "Index of MAF" 0x800049D8 MAFPort05In RecordLayout_6 0 CompuMethod_30 5 0 1000000 DEPOSIT ABSOLUTE /end AXIS_PTS
/begin AXIS_PTS MAP09IdxArr "Index of MAP" 0x80004BA2 MAP09In RecordLayout_6 0 CompuMethod_8 9 0 1000 DEPOSIT ABSOLUTE /end AXIS_PTS
/begin AXIS_PTS MaxGovSpeedErrorIdxArr "" 0x80004D5B MaxGovSpeedErrorIn RecordLayout_6 0 CompuMethod_25 9 -1E+17 1E+17 DEPOSIT ABSOLUTE /end AXIS_PTS
/begin AXIS_PTS OXY05IdxArr "Index of fuel oxygenation content" 0x80004F82 OXY05In RecordLayout_6 0 CompuMethod_6 5 0 100 DEPOSIT ABSOLUTE /end AXIS_PTS
/begin AXIS_PTS RPM05IdxArr "Index of RPM" 0x800053C0 RPM05In RecordLayout_6 0 CompuMethod_25 5 0 14000 DEPOSIT ABSOLUTE /end AXIS_PTS
/begin AXIS_PTS RPM09IdxArr "Index of RPM" 0x800053D4 RPM09In RecordLayout_6 0 CompuMethod_25 9 0 14000 DEPOSIT ABSOLUTE /end AXIS_PTS
/begin AXIS_PTS RPMAccel17IdxArr "" 0x8000543C RPMAccel17In RecordLayout_6 0 CompuMethod_2 17 -1E+17 1E+17 DEPOSIT ABSOLUTE /end AXIS_PTS
/begin AXIS_PTS SpkMinGovSpeedErrorIdxArr "" 0x80005A43 SpkMinGovSpeedErrorIn RecordLayout_6 0 CompuMethod_2 9 -1E+17 1E+17 DEPOSIT ABSOLUTE /end AXIS_PTS
/begin AXIS_PTS VE_AdaptErrorIdxArrIdxArr "Multiplier on error for adaptation, should always be positive" 0x80005BB7 VE_AdaptErrorIdxArrIn RecordLayout_6 0 CompuMethod_2 10 -1E+17 1E+17 DEPOSIT ABSOLUTE /end AXIS_PTS
/begin AXIS_PTS VSPDIdxArr "Look up table to allownon-linear characterization of sensors" 0x80006886 VSPDADC RecordLayout_6 0 CompuMethod_99 13 -1E+17 1E+17 DEPOSIT ABSOLUTE /end AXIS_PTS
/*~~~~~~~~~ 6.3.106 RECORD_LAYOUTs ~~~~~~~~~*/
/begin RECORD_LAYOUT RecordLayout_1 FNC_VALUES 1 UBYTE ROW_DIR DIRECT /end RECORD_LAYOUT
/begin RECORD_LAYOUT RecordLayout_3 FNC_VALUES 1 ULONG ROW_DIR DIRECT /end RECORD_LAYOUT
/begin RECORD_LAYOUT RecordLayout_4 FNC_VALUES 1 FLOAT32_IEEE ROW_DIR DIRECT /end RECORD_LAYOUT
/begin RECORD_LAYOUT RecordLayout_6 AXIS_PTS_X 1 FLOAT32_IEEE /* IndexIncr */ INDEX_INCR /* Addressing */ DIRECT /end RECORD_LAYOUT
/begin RECORD_LAYOUT RecordLayout_7 FNC_VALUES 1 SBYTE ROW_DIR DIRECT /end RECORD_LAYOUT
/begin RECORD_LAYOUT RecordLayout_8 FNC_VALUES 1 UWORD ROW_DIR DIRECT /end RECORD_LAYOUT
/*~~~~~~~~~ 6.3.31 COMPU_METHODs ~~~~~~~~~*/
/begin COMPU_METHOD CompuMethod_1 "" RAT_FUNC "%3.0" "" COEFFS 0 1 0 0 0 1 /end COMPU_METHOD
/begin COMPU_METHOD CompuMethod_2 "" RAT_FUNC "%6.2" "" COEFFS 0 1 0 0 0 1 /end COMPU_METHOD
/begin COMPU_METHOD CompuMethod_4 "" RAT_FUNC "%1.0" "bool" COEFFS 0 1 0 0 0 1 /end COMPU_METHOD
/begin COMPU_METHOD CompuMethod_5 "" TAB_VERB "%1.0" "" COMPU_TAB_REF CompuVtab_1 /end COMPU_METHOD
/begin COMPU_METHOD CompuMethod_6 "" RAT_FUNC "%6.2" "%" COEFFS 0 1 0 0 0 1 /end COMPU_METHOD
/begin COMPU_METHOD CompuMethod_7 "" TAB_VERB "%3.0" "" COMPU_TAB_REF CompuVtab_2 /end COMPU_METHOD
/begin COMPU_METHOD CompuMethod_8 "" RAT_FUNC "%6.2" "kPa" COEFFS 0 1 0 0 0 1 /end COMPU_METHOD
/begin COMPU_METHOD CompuMethod_10 "" RAT_FUNC "%6.2" "s" COEFFS 0 1 0 0 0 1 /end COMPU_METHOD
/begin COMPU_METHOD CompuMethod_11 "" RAT_FUNC "%1.0" "" COEFFS 0 1 0 0 0 1 /end COMPU_METHOD
/begin COMPU_METHOD CompuMethod_13 "" RAT_FUNC "%6.2" "kPaGauge" COEFFS 0 1 0 0 0 1 /end COMPU_METHOD
/begin COMPU_METHOD CompuMethod_14 "" RAT_FUNC "%6.2" "kPa Gauge" COEFFS 0 1 0 0 0 1 /end COMPU_METHOD
/begin COMPU_METHOD CompuMethod_15 "" RAT_FUNC "%6.2" "idx.frac" COEFFS 0 1 0 0 0 0.00195313 /end COMPU_METHOD
/begin COMPU_METHOD CompuMethod_16 "" RAT_FUNC "%5.0" "ADC" COEFFS 0 1 0 0 0 1 /end COMPU_METHOD
/begin COMPU_METHOD CompuMethod_20 "" RAT_FUNC "%6.2" "sec" COEFFS 0 1 0 0 0 1 /end COMPU_METHOD
/begin COMPU_METHOD CompuMethod_21 "" RAT_FUNC "%9.4" "kPa Gauge/ADC" COEFFS 0 1 0 0 0 1 /end COMPU_METHOD
/begin COMPU_METHOD CompuMethod_22 "" RAT_FUNC "%6.2" "ADC" COEFFS 0 1 0 0 0 1 /end COMPU_METHOD
/begin COMPU_METHOD CompuMethod_25 "" RAT_FUNC "%6.2" "RPM" COEFFS 0 1 0 0 0 1 /end COMPU_METHOD
/begin COMPU_METHOD CompuMethod_26 "" RAT_FUNC "%1.0" "Boolean" COEFFS 0 1 0 0 0 1 /end COMPU_METHOD
/begin COMPU_METHOD CompuMethod_27 "" RAT_FUNC "%6.2" "degC" COEFFS 0 1 0 0 0 1 /end COMPU_METHOD
/begin COMPU_METHOD CompuMethod_30 "" RAT_FUNC "%6.2" "g/s" COEFFS 0 1 0 0 0 1 /end COMPU_METHOD
/begin COMPU_METHOD CompuMethod_31 "" TAB_VERB "%6.2" "" COMPU_TAB_REF CompuVtab_6 /end COMPU_METHOD
/begin COMPU_METHOD CompuMethod_33 "" RAT_FUNC "%6.2" "mult" COEFFS 0 1 0 0 0 1 /end COMPU_METHOD
/begin COMPU_METHOD CompuMethod_34 "" TAB_VERB "%1.0" "" COMPU_TAB_REF CompuVtab_8 /end COMPU_METHOD
/begin COMPU_METHOD CompuMethod_35 "" RAT_FUNC "%6.2" "ADC Counts" COEFFS 0 1 0 0 0 1 /end COMPU_METHOD
/begin COMPU_METHOD CompuMethod_36 "" TAB_VERB "%1.0" "" COMPU_TAB_REF CompuVtab_2 /end COMPU_METHOD
/begin COMPU_METHOD CompuMethod_37 "" RAT_FUNC "%1.0" "boolean" COEFFS 0 1 0 0 0 1 /end COMPU_METHOD
/begin COMPU_METHOD CompuMethod_38 "" RAT_FUNC "%6.2" "Percent" COEFFS 0 1 0 0 0 1 /end COMPU_METHOD
/begin COMPU_METHOD CompuMethod_44 "" RAT_FUNC "%6.2" "EquivRatio" COEFFS 0 1 0 0 0 1 /end COMPU_METHOD
/begin COMPU_METHOD CompuMethod_47 "" TAB_VERB "%1.0" "" COMPU_TAB_REF CompuVtab_14 /end COMPU_METHOD
/begin COMPU_METHOD CompuMethod_48 "" RAT_FUNC "%5.4" "" COEFFS 0 1 0 0 0 1 /end COMPU_METHOD
/begin COMPU_METHOD CompuMethod_49 "" RAT_FUNC "%5.4" "mult" COEFFS 0 1 0 0 0 1 /end COMPU_METHOD
/begin COMPU_METHOD CompuMethod_56 "" RAT_FUNC "%6.2" "PSI" COEFFS 0 1 0 0 0 1 /end COMPU_METHOD
/begin COMPU_METHOD CompuMethod_60 "" RAT_FUNC "%8.0" "" COEFFS 0 1 0 0 0 1 /end COMPU_METHOD
/begin COMPU_METHOD CompuMethod_61 "" RAT_FUNC "%6.2" "C" COEFFS 0 1 0 0 0 1 /end COMPU_METHOD
/begin COMPU_METHOD CompuMethod_69 "" RAT_FUNC "%6.2" "ms" COEFFS 0 1 0 0 0 1 /end COMPU_METHOD
/begin COMPU_METHOD CompuMethod_70 "" RAT_FUNC "%6.2" "degBTDC" COEFFS 0 1 0 0 0 1 /end COMPU_METHOD
/begin COMPU_METHOD CompuMethod_75 "" RAT_FUNC "%5.0" "RPM" COEFFS 0 1 0 0 0 1 /end COMPU_METHOD
/begin COMPU_METHOD CompuMethod_84 "" TAB_VERB "%3.0" "" COMPU_TAB_REF CompuVtab_22 /end COMPU_METHOD
/begin COMPU_METHOD CompuMethod_89 "" RAT_FUNC "%6.2" "degCA" COEFFS 0 1 0 0 0 1 /end COMPU_METHOD
/begin COMPU_METHOD CompuMethod_99 "" RAT_FUNC "%6.2" "Hz" COEFFS 0 1 0 0 0 1 /end COMPU_METHOD
/begin COMPU_METHOD CompuMethod_105 "" RAT_FUNC "%6.2" "%/%" COEFFS 0 1 0 0 0 1 /end COMPU_METHOD
/begin COMPU_METHOD CompuMethod_114 "" RAT_FUNC "%6.2" "mg" COEFFS 0 1 0 0 0 1 /end COMPU_METHOD
/begin COMPU_METHOD CompuMethod_115 "" TAB_VERB "%1.0" "mg" COMPU_TAB_REF CompuVtab_13 /end COMPU_METHOD
/begin COMPU_METHOD CompuMethod_116 "" RAT_FUNC "%6.2" "Time const" COEFFS 0 1 0 0 0 1 /end COMPU_METHOD
/begin COMPU_METHOD CompuMethod_117 "" RAT_FUNC "%6.2" "mph" COEFFS 0 1 0 0 0 1 /end COMPU_METHOD
/begin COMPU_METHOD CompuMethod_118 "" RAT_FUNC "%6.2" "alpha" COEFFS 0 1 0 0 0 1 /end COMPU_METHOD
/begin COMPU_METHOD CompuMethod_119 "" RAT_FUNC "%8.0" "Hz" COEFFS 0 1 0 0 0 1 /end COMPU_METHOD
/begin COMPU_METHOD CompuMethod_120 "" RAT_FUNC "%9.4" "%/ADC" COEFFS 0 1 0 0 0 1 /end COMPU_METHOD
/begin COMPU_METHOD CompuMethod_122 "" TAB_VERB "%3.0" "" COMPU_TAB_REF CompuVtab_38 /end COMPU_METHOD
/begin COMPU_METHOD CompuMethod_123 "" TAB_VERB "%3.0" "" COMPU_TAB_REF CompuVtab_39 /end COMPU_METHOD
/begin COMPU_METHOD CompuMethod_124 "" RAT_FUNC "%7.2" "Hz" COEFFS 0 1 0 0 0 0.01 /end COMPU_METHOD
/begin COMPU_METHOD CompuMethod_125 "" TAB_VERB "%3.0" "" COMPU_TAB_REF CompuVtab_40 /end COMPU_METHOD
/begin COMPU_METHOD CompuMethod_139 "" RAT_FUNC "%9.4" "kPa/ADC" COEFFS 0 1 0 0 0 1 /end COMPU_METHOD
/begin COMPU_METHOD CompuMethod_140 "" TAB_VERB "%1.0" "" COMPU_TAB_REF CompuVtab_48 /end COMPU_METHOD
/begin COMPU_METHOD CompuMethod_141 "" TAB_VERB "%1.0" "" COMPU_TAB_REF CompuVtab_49 /end COMPU_METHOD
/begin COMPU_METHOD CompuMethod_142 "" TAB_VERB "%3.0" "" COMPU_TAB_REF CompuVtab_50 /end COMPU_METHOD
/begin COMPU_METHOD CompuMethod_143 "" TAB_VERB "%3.0" "" COMPU_TAB_REF CompuVtab_51 /end COMPU_METHOD
/begin COMPU_METHOD CompuMethod_144 "" RAT_FUNC "%6.2" "psi" COEFFS 0 1 0 0 0 1 /end COMPU_METHOD
/begin COMPU_METHOD CompuMethod_147 "" TAB_VERB "%1.0" "boolean" COMPU_TAB_REF CompuVtab_53 /end COMPU_METHOD
/begin COMPU_METHOD CompuMethod_148 "" TAB_VERB "%1.0" "" COMPU_TAB_REF CompuVtab_54 /end COMPU_METHOD
/begin COMPU_METHOD CompuMethod_149 "" TAB_VERB "%1.0" "" COMPU_TAB_REF CompuVtab_55 /end COMPU_METHOD
/begin COMPU_METHOD CompuMethod_151 "" RAT_FUNC "%8.3" "mult" COEFFS 0 1 0 0 0 1 /end COMPU_METHOD
/begin COMPU_METHOD CompuMethod_153 "" RAT_FUNC "%6.2" "ratio" COEFFS 0 1 0 0 0 1 /end COMPU_METHOD
/begin COMPU_METHOD CompuMethod_154 "" RAT_FUNC "%9.4" "psi/ADC" COEFFS 0 1 0 0 0 1 /end COMPU_METHOD
/begin COMPU_METHOD CompuMethod_156 "" RAT_FUNC "%6.2" "multiplier" COEFFS 0 1 0 0 0 1 /end COMPU_METHOD
/begin COMPU_METHOD CompuMethod_158 "" TAB_VERB "%1.0" "" COMPU_TAB_REF CompuVtab_59 /end COMPU_METHOD
/begin COMPU_METHOD CompuMethod_159 "" TAB_VERB "%3.0" "" COMPU_TAB_REF CompuVtab_60 /end COMPU_METHOD
/begin COMPU_METHOD CompuMethod_160 "" TAB_VERB "%3.0" "" COMPU_TAB_REF CompuVtab_61 /end COMPU_METHOD
/begin COMPU_METHOD CompuMethod_161 "" TAB_VERB "%1.0" "" COMPU_TAB_REF CompuVtab_62 /end COMPU_METHOD
/begin COMPU_METHOD CompuMethod_162 "" RAT_FUNC "%6.2" "RPM/sec" COEFFS 0 1 0 0 0 1 /end COMPU_METHOD
/begin COMPU_METHOD CompuMethod_164 "" RAT_FUNC "%6.2" "S" COEFFS 0 1 0 0 0 1 /end COMPU_METHOD
/begin COMPU_METHOD CompuMethod_165 "" RAT_FUNC "%6.2" "Volts" COEFFS 0 1 0 0 0 1 /end COMPU_METHOD
/begin COMPU_METHOD CompuMethod_166 "" RAT_FUNC "%9.4" "Volts/ADC" COEFFS 0 1 0 0 0 1 /end COMPU_METHOD
/begin COMPU_METHOD CompuMethod_167 "" TAB_VERB "%1.0" "" COMPU_TAB_REF CompuVtab_13 /end COMPU_METHOD
/begin COMPU_METHOD CompuMethod_169 "" TAB_VERB "%1.0" "degBTDC" COMPU_TAB_REF CompuVtab_13 /end COMPU_METHOD
/begin COMPU_METHOD CompuMethod_170 "" TAB_VERB "%1.0" "" COMPU_TAB_REF CompuVtab_63 /end COMPU_METHOD
/begin COMPU_METHOD CompuMethod_171 "" TAB_VERB "%1.0" "" COMPU_TAB_REF CompuVtab_64 /end COMPU_METHOD
/begin COMPU_METHOD CompuMethod_178 "" RAT_FUNC "%6.2" "bool" COEFFS 0 1 0 0 0 1 /end COMPU_METHOD
/begin COMPU_METHOD CompuMethod_179 "" RAT_FUNC "%6.2" "mph/s" COEFFS 0 1 0 0 0 1 /end COMPU_METHOD
/begin COMPU_METHOD CompuMethod_180 "" RAT_FUNC "%6.2" "MPH" COEFFS 0 1 0 0 0 1 /end COMPU_METHOD
/begin COMPU_METHOD CompuMethod_181 "" TAB_VERB "%3.0" "enum" COMPU_TAB_REF CompuVtab_2 /end COMPU_METHOD
/begin COMPU_METHOD CompuMethod_182 "" RAT_FUNC "%4.3" "sec" COEFFS 0 1 0 0 0 1 /end COMPU_METHOD
/*~~~~~~~~~ 6.3.34 COMPU_VTABs ~~~~~~~~~*/
/begin COMPU_VTAB CompuVtab_1 "" TAB_VERB 2 0 "Pass-Through" 1 "Override" /end COMPU_VTAB
/begin COMPU_VTAB CompuVtab_2 "" TAB_VERB 2 0 "Disabled" 1 "Enabled" /end COMPU_VTAB
/begin COMPU_VTAB CompuVtab_6 "" TAB_VERB 90 0 "Normal Operation" 1 "Bad Resource ID" 2 "Hardware Not Supported" 3 "Behaviour Not Supported" 4 "Bad Attribute Data" 5 "Fail On Create" 6 "Fail On Set Attributes" 7 "Resource Not Created" 8 "Missing Attribute" 9 "Behaviour Method Not Supported" 10 "A Service Failed" 11 "Failed to destroy a resource" 12 "Resource Was Created" 13 "Resource Conflict" 14 "Invalid Encoder Type" 15 "2-Strike Not Supported" 16 "720degCA Pattern Not Supported" 17 "CAM Pattern Not Supported" 18 "Unknown CAM Pattern Supplied" 19 "Engine Speed Present" 20 "Hardware Interface Not Supported" 21 "Service Already Started" 22 "Register Write Failed to verify" 23 "Register access was denied" 24 "Out of free store memory" 25 "Software Q Overrun" 26 "Hardware Q Overrun" 27 "Feature unsupported in archive" 28 "Insufficient FW resource" 29 "OS Resource conflict" 30 "Driver Mode conflict" 31 "RTC time is illegal" 32 "FFS unmounted" 33 "Access from an ISR" 34 "FFS internal" 35 "Operation timed out" 36 "Task Kernel API Usage" 37 "Operation aborted" 38 "File not Found" 39 "Invalid characters in filename" 40 "Duplicate filename" 41 "Filename is too long" 42 "Dir not empty on remove" 43 "Dir not found" 44 "Dir name invalid" 45 "Dir exists" 46 "Dir too deep" 47 "Illegal Handle" 48 "End of File" 49 "Media Full" 50 "Media Write" 51 "Media Read" 52 "Media Write Protected" 53 "File Read Only" 54 "FS Media Changed" 55 "Internal USB" 56 "Voltage too high for USB IC" 57 "Encoder not created" 64 "TPU Chan Conflict" 65 "TPU Func Unavailable" 66 "TPU Config" 67 "TPU Primative Usage" 68 "TPU Primitive Count" 69 "TPU Restricted TPU channel" 70 "TPU Not Created" 71 "TPU Self Modify constant write err" 72 "TPU Error 0x48" 73 "TPU Error 0x49" 74 "TPU Error 0x4A" 75 "TPU Error 0x4B" 76 "TPU Error 0x4C" 77 "TPU Error 0x4D" 78 "TPU Error 0x4E" 79 "TPU Error 0x4F" 80 "TPU Error 0x50" 81 "TPU Error 0x51" 82 "TPU Error 0x52" 83 "TPU Error 0x53" 84 "TPU Error 0x54" 85 "TPU Error 0x55" 86 "TPU Error 0x56" 87 "TPU Error 0x57" 88 "TPU Error 0x58" 89 "TPU Error 0x59" 90 "TPU Error 0x5A" 91 "TPU Error 0x5B" 92 "TPU Error 0x5C" 93 "TPU Error 0x5D" 94 "TPU Error 0x5E" 95 "TPU Error 0x5F" /end COMPU_VTAB
/begin COMPU_VTAB CompuVtab_8 "" TAB_VERB 2 0 "Decreasing" 1 "Increasing" /end COMPU_VTAB
/begin COMPU_VTAB CompuVtab_13 "" TAB_VERB 2 0 "Unlocked" 1 "Locked" /end COMPU_VTAB
/begin COMPU_VTAB CompuVtab_14 "" TAB_VERB 2 0 "Not Enabled" 1 "Enabled" /end COMPU_VTAB
/begin COMPU_VTAB CompuVtab_22 "" TAB_VERB 2 0 "Rising Edge" 1 "Falling Edge" /end COMPU_VTAB
/begin COMPU_VTAB CompuVtab_38 "" TAB_VERB 2 0 "No Alias Protect" 1 "Use Alias Protect" /end COMPU_VTAB
/begin COMPU_VTAB CompuVtab_39 "" TAB_VERB 2 0 "Digital Input" 1 "VR Input" /end COMPU_VTAB
/begin COMPU_VTAB CompuVtab_40 "" TAB_VERB 2 0 "Enable" 1 "Cut" /end COMPU_VTAB
/begin COMPU_VTAB CompuVtab_48 "" TAB_VERB 2 0 "Gov Enabled" 1 "Gov Disabled" /end COMPU_VTAB
/begin COMPU_VTAB CompuVtab_49 "" TAB_VERB 2 0 "ETC Req Mode" 1 "PID Mode" /end COMPU_VTAB
/begin COMPU_VTAB CompuVtab_50 "" TAB_VERB 2 0 "Hold Off" 1 "Hold On" /end COMPU_VTAB
/begin COMPU_VTAB CompuVtab_51 "" TAB_VERB 2 0 "Reset Off" 1 "Reset On" /end COMPU_VTAB
/begin COMPU_VTAB CompuVtab_53 "" TAB_VERB 2 0 "Off" 1 "On" /end COMPU_VTAB
/begin COMPU_VTAB CompuVtab_54 "" TAB_VERB 2 0 "Load saved application values on next startup" 1 "Load factory defaults on next startup" /end COMPU_VTAB
/begin COMPU_VTAB CompuVtab_55 "" TAB_VERB 7 0 "Currently loading NV from Factory FLASH to RAM" 1 "Currently loading NV from EEPROM to RAM" 2 "Currently storing NV from RAM to EEPROM" 3 "Detected new program.  Loaded Factory Defaults from FLASH" 4 "CRC failure.  Loaded Factory Defaults from FLASH" 5 "User requested refresh from Factory Defaults in FLASH." 6 "Successful refresh of EEPROM values from last shutdown" /end COMPU_VTAB
/begin COMPU_VTAB CompuVtab_59 "" TAB_VERB 2 0 "Run" 1 "Restore To Defaults" /end COMPU_VTAB
/begin COMPU_VTAB CompuVtab_60 "" TAB_VERB 4 0 "Disabled" 1 "Soft" 2 "Medium" 3 "Hard" /end COMPU_VTAB
/begin COMPU_VTAB CompuVtab_61 "" TAB_VERB 3 0 "Cut Spark" 1 "Cut Fuel" 2 "Cut Spark and Fuel" /end COMPU_VTAB
/begin COMPU_VTAB CompuVtab_62 "" TAB_VERB 2 0 "SteadyOrRising" 1 "Falling" /end COMPU_VTAB
/begin COMPU_VTAB CompuVtab_63 "" TAB_VERB 2 0 "Transient" 1 "Steady" /end COMPU_VTAB
/begin COMPU_VTAB CompuVtab_64 "" TAB_VERB 2 0 "Run" 1 "Store To EEPROM" /end COMPU_VTAB
/begin FUNCTION Fuel_Cyl8_Override "" /begin DEF_CHARACTERISTIC Fuel_Cyl8_offset Fuel_Cyl8_ovr /end DEF_CHARACTERISTIC /end FUNCTION
/begin FUNCTION Fuel_Economy "" /begin OUT_MEASUREMENT Fuel_Economy_Filtered Fuel_Economy_Inst /end OUT_MEASUREMENT /begin SUB_FUNCTION First_Order_Low_Pass__Tunable_ /end SUB_FUNCTION /end FUNCTION
/begin FUNCTION Fuel_Global_Override "" /begin DEF_CHARACTERISTIC Fuel_Global_offset Fuel_Global_ovr /end DEF_CHARACTERISTIC /end FUNCTION
/begin FUNCTION Fuel_Lvl "" /begin DEF_CHARACTERISTIC Fuel_LvlTbl /end DEF_CHARACTERISTIC /begin OUT_MEASUREMENT Fuel_Lvl Fuel_LvlADC Fuel_LvlIdx Fuel_LvlRaw /end OUT_MEASUREMENT /begin SUB_FUNCTION Fuel_Lvl_Override Fuel_Lvl_Config /end SUB_FUNCTION /end FUNCTION
/begin FUNCTION Fuel_Level "" /begin SUB_FUNCTION Fuel_Lvl /end SUB_FUNCTION /end FUNCTION
/begin FUNCTION Fuel_Lvl_Override "" /begin DEF_CHARACTERISTIC Fuel_Lvl_new Fuel_Lvl_ovr /end DEF_CHARACTERISTIC /end FUNCTION
/begin FUNCTION Fuel_Lvl_Config "" /begin DEF_CHARACTERISTIC Fuel_LvlDefault Fuel_LvlFiltConst Fuel_LvlMax Fuel_LvlMin /end DEF_CHARACTERISTIC /end FUNCTION
/begin FUNCTION Saturation__Tunable__2 "" /begin DEF_CHARACTERISTIC FuelAdaptErrorLwrLim FuelAdaptErrorUprLim /end DEF_CHARACTERISTIC /end FUNCTION
/begin FUNCTION DeltaPressureIndex "" /begin OUT_MEASUREMENT FuelDeltaPress InjDeltaPress09Idx InjDeltaPress09In /end OUT_MEASUREMENT /end FUNCTION
/begin FUNCTION Fuel_Delta_Pressure_Calculation "" /begin OUT_MEASUREMENT FuelDeltaPressure /end OUT_MEASUREMENT /end FUNCTION
/begin FUNCTION First_Order_Low_Pass__Tunable_ "" /begin DEF_CHARACTERISTIC FuelEconomy_FilterC /end DEF_CHARACTERISTIC /end FUNCTION
/begin FUNCTION Adapt_FuelFlowComp_Map "" /begin DEF_CHARACTERISTIC FuelFlowCompMaxValue FuelFlowCompMinValue /end DEF_CHARACTERISTIC /end FUNCTION
/begin FUNCTION FuelLevel ""
 /begin DEF_CHARACTERISTIC FuelLevel_FiltConstMap FuelLevel_FuelEevntAlpha FuelLevel_KeyUpDelay FuelLevl_KeyUpDiff /end DEF_CHARACTERISTIC
 /begin OUT_MEASUREMENT FuelLevel_FiltConst FuelLevel_FiltConstColIdx FuelLevel_FiltConstColIn FuelLevel_FiltConstRowIdx FuelLevel_FiltConstRowIn FuelLvl_Fin FuelLvl_NVM_Prb /end OUT_MEASUREMENT
/end FUNCTION
/begin FUNCTION FUELP "" /begin OUT_MEASUREMENT FUELP /end OUT_MEASUREMENT /begin SUB_FUNCTION FUELP_Override FUELP_Config /end SUB_FUNCTION /end FUNCTION
/begin FUNCTION FuelPump "" /begin SUB_FUNCTION FUELP /end SUB_FUNCTION /end FUNCTION
/begin FUNCTION FUELP_Override "" /begin DEF_CHARACTERISTIC FUELP_new FUELP_ovr /end DEF_CHARACTERISTIC /end FUNCTION
/begin FUNCTION FUELP_Config "" /begin DEF_CHARACTERISTIC FUELP_Polarity /end DEF_CHARACTERISTIC /end FUNCTION
/begin FUNCTION FuelPres "" /begin OUT_MEASUREMENT FuelPres FuelPresADC FuelPresRaw /end OUT_MEASUREMENT /begin SUB_FUNCTION FuelPres_Override FuelPres_Config /end SUB_FUNCTION /end FUNCTION
/begin FUNCTION Wrong_Fuel_Pressure_Fault_Logic ""
 /begin DEF_CHARACTERISTIC FuelPres_DeltaTarget FuelPres_DeltaTolerance FuelPres_FaultTimer /end DEF_CHARACTERISTIC
/end FUNCTION
/begin FUNCTION Dash_Message_3 ""
 /begin DEF_CHARACTERISTIC FuelPres_FiltDecFiltC FuelPres_FiltIncFiltC MAP_filtDecFiltC MAP_filtIncFiltC OilPres_FiltDecFiltC OilPres_FiltIncFiltC /end DEF_CHARACTERISTIC
 /begin OUT_MEASUREMENT FuelPres_FiltDirection FuelPres_FiltFilterConst FuelPres_FiltFiltered MAP_filtDirection MAP_filtFilterConst MAP_filtFiltered OilPres_FiltDirection OilPres_FiltFilterConst OilPres_FiltFiltered /end OUT_MEASUREMENT
/end FUNCTION
/begin FUNCTION FuelPres_Override "" /begin DEF_CHARACTERISTIC FuelPres_new FuelPres_ovr /end DEF_CHARACTERISTIC /end FUNCTION
/begin FUNCTION FuelPres_Config ""
 /begin DEF_CHARACTERISTIC FuelPresDfltValue FuelPresFilterConst FuelPresGain FuelPresInputHiFltPos FuelPresInputLoFltPos FuelPresOfst /end DEF_CHARACTERISTIC
/end FUNCTION
/begin FUNCTION FuelSens "" /begin OUT_MEASUREMENT FuelSens FuelSensADC FuelSensRaw /end OUT_MEASUREMENT /begin SUB_FUNCTION FuelSens_Override FuelSens_Config /end SUB_FUNCTION /end FUNCTION
/begin FUNCTION FuelSens_Override "" /begin DEF_CHARACTERISTIC FuelSens_new FuelSens_ovr /end DEF_CHARACTERISTIC /end FUNCTION
/begin FUNCTION FuelSens_Config ""
 /begin DEF_CHARACTERISTIC FuelSensDfltValue FuelSensFilterConst FuelSensGain FuelSensInputHiFltPos FuelSensInputLoFltPos FuelSensOfst /end DEF_CHARACTERISTIC
/end FUNCTION
/begin FUNCTION Frequency_In_Config ""
 /begin DEF_CHARACTERISTIC FuelSensorPin_AliasProtect FuelSensorPin_EdgeDetect FuelSensorPin_Interface FuelSensorPin_MinFrequency MAF_Pin_AliasProtect MAF_Pin_EdgeDetect MAF_Pin_Interface MAF_Pin_MinFrequency VSPD_Pin_AliasProtect VSPD_Pin_EdgeDetect VSPD_Pin_Interface VSPD_Pin_MinFrequency /end DEF_CHARACTERISTIC
/end FUNCTION
/begin FUNCTION GPS_Altitude_Ovr_Override "" /begin DEF_CHARACTERISTIC GPS_Altitude_Ovr_new GPS_Altitude_Ovr_ovr /end DEF_CHARACTERISTIC /end FUNCTION
/begin FUNCTION AEM_GPS ""
 /begin DEF_CHARACTERISTIC GPS_DateTime_Timeout GPS_LatLong_Timeout GPS_SpeedDir_Timeout /end DEF_CHARACTERISTIC
 /begin OUT_MEASUREMENT GPS_Altitude_Prb GPS_Course_Prb GPS_DayUTC_Prb GPS_HoursUTC_Prb GPS_Latitude_Prb GPS_Longitude_Prb GPS_MinutesUTC_Prb GPS_MonthUTC_Prb GPS_SatelliteCount_Prb GPS_SecondsUTC_Prb GPS_Speed_Prb GPS_Valid_Prb GPS_YearUTC_Prb /end OUT_MEASUREMENT
 /begin SUB_FUNCTION GPS_Altitude_Ovr_Override GPS_Course_Ovr_Override GPS_DayUTC_Ovr_Override GPS_HoursUTC_Ovr_Override GPS_Latitude_Ovr_Override GPS_Longitude_Ovr_Override GPS_MinutesUTC_Ovr_Override GPS_MonthUTC_Ovr_Override GPS_SatelliteCount_Ovr_Override GPS_SecondsUTC_Ovr_Override GPS_Speed_Ovr_Override GPS_Valid_Ovr_Override GPS_YearUTC_Ovr_Override /end SUB_FUNCTION
/end FUNCTION
/begin FUNCTION GPS_Course_Ovr_Override "" /begin DEF_CHARACTERISTIC GPS_Course_Ovr_new GPS_Course_Ovr_ovr /end DEF_CHARACTERISTIC /end FUNCTION
/begin FUNCTION GPS_DayUTC_Ovr_Override "" /begin DEF_CHARACTERISTIC GPS_DayUTC_Ovr_new GPS_DayUTC_Ovr_ovr /end DEF_CHARACTERISTIC /end FUNCTION
/begin FUNCTION GPS_HoursUTC_Ovr_Override "" /begin DEF_CHARACTERISTIC GPS_HoursUTC_Ovr_new GPS_HoursUTC_Ovr_ovr /end DEF_CHARACTERISTIC /end FUNCTION
/begin FUNCTION GPS_Latitude_Ovr_Override "" /begin DEF_CHARACTERISTIC GPS_Latitude_Ovr_new GPS_Latitude_Ovr_ovr /end DEF_CHARACTERISTIC /end FUNCTION
/begin FUNCTION GPS_Longitude_Ovr_Override "" /begin DEF_CHARACTERISTIC GPS_Longitude_Ovr_new GPS_Longitude_Ovr_ovr /end DEF_CHARACTERISTIC /end FUNCTION
/begin FUNCTION GPS_MinutesUTC_Ovr_Override "" /begin DEF_CHARACTERISTIC GPS_MinutesUTC_Ovr_new GPS_MinutesUTC_Ovr_ovr /end DEF_CHARACTERISTIC /end FUNCTION
/begin FUNCTION GPS_MonthUTC_Ovr_Override "" /begin DEF_CHARACTERISTIC GPS_MonthUTC_Ovr_new GPS_MonthUTC_Ovr_ovr /end DEF_CHARACTERISTIC /end FUNCTION
/begin FUNCTION GPS_SatelliteCount_Ovr_Override "" /begin DEF_CHARACTERISTIC GPS_SatelliteCount_Ovr_new GPS_SatelliteCount_Ovr_ovr /end DEF_CHARACTERISTIC /end FUNCTION
/begin FUNCTION GPS_SecondsUTC_Ovr_Override "" /begin DEF_CHARACTERISTIC GPS_SecondsUTC_Ovr_new GPS_SecondsUTC_Ovr_ovr /end DEF_CHARACTERISTIC /end FUNCTION
/begin FUNCTION GPS_Speed_Ovr_Override "" /begin DEF_CHARACTERISTIC GPS_Speed_Ovr_new GPS_Speed_Ovr_ovr /end DEF_CHARACTERISTIC /end FUNCTION
/begin FUNCTION GPS_Valid_Ovr_Override "" /begin DEF_CHARACTERISTIC GPS_Valid_Ovr_new GPS_Valid_Ovr_ovr /end DEF_CHARACTERISTIC /end FUNCTION
/begin FUNCTION GPS_YearUTC_Ovr_Override "" /begin DEF_CHARACTERISTIC GPS_YearUTC_Ovr_new GPS_YearUTC_Ovr_ovr /end DEF_CHARACTERISTIC /end FUNCTION
/begin FUNCTION Cycle1CutPatter ""
 /begin DEF_CHARACTERISTIC HardCycle1Cyl1 HardCycle1Cyl2 HardCycle1Cyl3 HardCycle1Cyl4 HardCycle1Cyl5 HardCycle1Cyl6 HardCycle1Cyl7 HardCycle1Cyl8 /end DEF_CHARACTERISTIC
/end FUNCTION
/begin FUNCTION Hard_Cycle_Cut_Pattern ""
 /begin SUB_FUNCTION Cycle1CutPatter Cycle2CutPatter Cycle3CutPatter Cycle4CutPatter /end SUB_FUNCTION
/end FUNCTION
/begin FUNCTION SequenceCutPattern "" /begin DEF_CHARACTERISTIC RevLimitType /end DEF_CHARACTERISTIC /begin OUT_MEASUREMENT RevLimiterState /end OUT_MEASUREMENT
 /begin SUB_FUNCTION Hard_Cycle_Cut_Pattern Hard_Cycle_Cut_Pattern_Two_Step Medium_Cycle_Cut_Pattern Medium_Cycle_Cut_Pattern_Two_Step Soft_Cycle_Cut_Pattern Soft_Cycle_Cut_Pattern_Two_Step /end SUB_FUNCTION
/end FUNCTION
/begin FUNCTION Cycle1CutPatter_1 ""
 /begin DEF_CHARACTERISTIC HardCycle1Cyl1_TwoStep HardCycle1Cyl2_TwoStep HardCycle1Cyl3_TwoStep HardCycle1Cyl4_TwoStep HardCycle1Cyl5_TwoStep HardCycle1Cyl6_TwoStep HardCycle1Cyl7_TwoStep HardCycle1Cyl8_TwoStep /end DEF_CHARACTERISTIC
/end FUNCTION
/begin FUNCTION Hard_Cycle_Cut_Pattern_Two_Step ""
 /begin SUB_FUNCTION Cycle1CutPatter_1 Cycle2CutPatter_1 Cycle3CutPatter_1 Cycle4CutPatter_1 /end SUB_FUNCTION
/end FUNCTION
/begin FUNCTION Cycle2CutPatter ""
 /begin DEF_CHARACTERISTIC HardCycle2Cyl1 HardCycle2Cyl2 HardCycle2Cyl3 HardCycle2Cyl4 HardCycle2Cyl5 HardCycle2Cyl6 HardCycle2Cyl7 HardCycle2Cyl8 /end DEF_CHARACTERISTIC
/end FUNCTION
/begin FUNCTION Cycle2CutPatter_1 ""
 /begin DEF_CHARACTERISTIC HardCycle2Cyl1_TwoStep HardCycle2Cyl2_TwoStep HardCycle2Cyl3_TwoStep HardCycle2Cyl4_TwoStep HardCycle2Cyl5_TwoStep HardCycle2Cyl6_TwoStep HardCycle2Cyl7_TwoStep HardCycle2Cyl8_TwoStep /end DEF_CHARACTERISTIC
/end FUNCTION
/begin FUNCTION Cycle3CutPatter ""
 /begin DEF_CHARACTERISTIC HardCycle3Cyl1 HardCycle3Cyl2 HardCycle3Cyl3 HardCycle3Cyl4 HardCycle3Cyl5 HardCycle3Cyl6 HardCycle3Cyl7 HardCycle3Cyl8 /end DEF_CHARACTERISTIC
/end FUNCTION
/begin FUNCTION Cycle3CutPatter_1 ""
 /begin DEF_CHARACTERISTIC HardCycle3Cyl1_TwoStep HardCycle3Cyl2_TwoStep HardCycle3Cyl3_TwoStep HardCycle3Cyl4_TwoStep HardCycle3Cyl5_TwoStep HardCycle3Cyl6_TwoStep HardCycle3Cyl7_TwoStep HardCycle3Cyl8_TwoStep /end DEF_CHARACTERISTIC
/end FUNCTION
/begin FUNCTION Cycle4CutPatter ""
 /begin DEF_CHARACTERISTIC HardCycle4Cyl1 HardCycle4Cyl2 HardCycle4Cyl3 HardCycle4Cyl4 HardCycle4Cyl5 HardCycle4Cyl6 HardCycle4Cyl7 HardCycle4Cyl8 /end DEF_CHARACTERISTIC
/end FUNCTION
/begin FUNCTION Cycle4CutPatter_1 ""
 /begin DEF_CHARACTERISTIC HardCycle4Cyl1_TwoStep HardCycle4Cyl2_TwoStep HardCycle4Cyl3_TwoStep HardCycle4Cyl4_TwoStep HardCycle4Cyl5_TwoStep HardCycle4Cyl6_TwoStep HardCycle4Cyl7_TwoStep HardCycle4Cyl8_TwoStep /end DEF_CHARACTERISTIC
/end FUNCTION
/begin FUNCTION Boost_Fault ""
 /begin DEF_CHARACTERISTIC HardOverBoostLimit HardOverBoostTime SoftOverBoostLimit SoftOverBoostTime WastegateLossOfControl WastegateTime /end DEF_CHARACTERISTIC
/end FUNCTION
/begin FUNCTION IAC_P_Override "" /begin DEF_CHARACTERISTIC IAC_P_new IAC_P_ovr /end DEF_CHARACTERISTIC /end FUNCTION
/begin FUNCTION IAC_P "" /begin OUT_MEASUREMENT IAC_PDutyCycle /end OUT_MEASUREMENT /begin SUB_FUNCTION IAC_P_Override IAC_P_Config /end SUB_FUNCTION /end FUNCTION
/begin FUNCTION IAC_Control "" /begin SUB_FUNCTION IAC_P IAC_S /end SUB_FUNCTION /end FUNCTION
/begin FUNCTION IAC_P_Config ""
 /begin DEF_CHARACTERISTIC IAC_PFrequency IAC_PGain IAC_PMaxLimit IAC_PMinLimit IAC_POffset /end DEF_CHARACTERISTIC
/end FUNCTION
/begin FUNCTION IAC_S_Override "" /begin DEF_CHARACTERISTIC IAC_S_new IAC_S_ovr /end DEF_CHARACTERISTIC /end FUNCTION
/begin FUNCTION IAC_S "" /begin OUT_MEASUREMENT IAC_SDutyCycle /end OUT_MEASUREMENT /begin SUB_FUNCTION IAC_S_Override IAC_S_Config /end SUB_FUNCTION /end FUNCTION
/begin FUNCTION IAC_S_Config ""
 /begin DEF_CHARACTERISTIC IAC_SFrequency IAC_SGain IAC_SMaxLimit IAC_SMinLimit IAC_SOffset /end DEF_CHARACTERISTIC
/end FUNCTION
/begin FUNCTION IAT "" /begin DEF_CHARACTERISTIC IATTbl /end DEF_CHARACTERISTIC /begin OUT_MEASUREMENT IAT IATADC IATIdx IATRaw /end OUT_MEASUREMENT /begin SUB_FUNCTION IAT_Override IAT_Config /end SUB_FUNCTION /end FUNCTION
/begin FUNCTION Capture_IAT_At_Startup "" /begin DEF_CHARACTERISTIC IAT_KeyUp_Count /end DEF_CHARACTERISTIC /begin OUT_MEASUREMENT IAT_KeyUp /end OUT_MEASUREMENT /end FUNCTION
/begin FUNCTION IAT_KeyUp "" /begin OUT_MEASUREMENT IAT_KeyUp09Idx IAT_KeyUp09In /end OUT_MEASUREMENT /end FUNCTION
/begin FUNCTION IAT_Override "" /begin DEF_CHARACTERISTIC IAT_new IAT_ovr /end DEF_CHARACTERISTIC /end FUNCTION
/begin FUNCTION IAT_Indexes "" /begin OUT_MEASUREMENT IAT05Idx IAT05In IAT17Idx IAT17In /end OUT_MEASUREMENT /end FUNCTION
/begin FUNCTION IAT_Config "" /begin DEF_CHARACTERISTIC IATDefault IATFiltConst IATMax IATMin /end DEF_CHARACTERISTIC /end FUNCTION
/begin FUNCTION Ramp_Air_Into_Idle_State "" /begin DEF_CHARACTERISTIC IdleEntryAirRampInFiltC /end DEF_CHARACTERISTIC /end FUNCTION
/begin FUNCTION Ramp_RPM "" /begin DEF_CHARACTERISTIC InGearRPMCtrlEntryFiltC /end DEF_CHARACTERISTIC /begin OUT_MEASUREMENT MinGovRPMSetPt /end OUT_MEASUREMENT /end FUNCTION
/begin FUNCTION InjEnable_Override "" /begin DEF_CHARACTERISTIC InjEnable_new InjEnable_ovr /end DEF_CHARACTERISTIC /end FUNCTION
/begin FUNCTION Lean_Protect "" /begin DEF_CHARACTERISTIC LeanProtec_TmrThresh LeanProtect_Threshold /end DEF_CHARACTERISTIC /end FUNCTION
/begin FUNCTION O2_Control_Switch_Point_Maps ""
 /begin DEF_CHARACTERISTIC LeanSwPtDeltaMap LeanTargetDeltaMap RichSwPtDeltaMap RichTargetDeltaMap /end DEF_CHARACTERISTIC
 /begin OUT_MEASUREMENT LeanSwPtDelta LeanTargetDelta RichSwPtDelta RichTargetDelta /end OUT_MEASUREMENT
/end FUNCTION
/begin FUNCTION O2_PID_Calibrations ""
 /begin DEF_CHARACTERISTIC O2CtrlDGain O2CtrlIGain O2CtrlPGain O2CtrlPIDOutLowerLimit O2CtrlPIDOutUpperLimit O2ITermLowerLimit O2ITermUpperLimit /end DEF_CHARACTERISTIC
 /begin SUB_FUNCTION O2_Control_Switch_Point_Maps Error_Gain_Scheduling /end SUB_FUNCTION
/end FUNCTION
/begin FUNCTION Closed_Loop_O2_PID_Controller ""
 /begin OUT_MEASUREMENT LiquidO2Control_DTerm LiquidO2Control_ErrorTerm LiquidO2Control_ITerm LiquidO2Control_PTerm /end OUT_MEASUREMENT
/end FUNCTION
/begin FUNCTION O2_PID_Controller "" /begin OUT_MEASUREMENT O2TargetEquivRatio /end OUT_MEASUREMENT
 /begin SUB_FUNCTION Closed_Loop_O2_PID_Controller Equivalence_Ratio_Perturbation /end SUB_FUNCTION
/end FUNCTION
/begin FUNCTION MAF "" /begin DEF_CHARACTERISTIC MAFTbl /end DEF_CHARACTERISTIC /begin OUT_MEASUREMENT MAF MAFADC MAFIdx MAFRaw /end OUT_MEASUREMENT /begin SUB_FUNCTION MAF_Override MAF_Config /end SUB_FUNCTION /end FUNCTION
/begin FUNCTION MAF_Override "" /begin DEF_CHARACTERISTIC MAF_new MAF_ovr /end DEF_CHARACTERISTIC /end FUNCTION
/begin FUNCTION MAF_Config "" /begin DEF_CHARACTERISTIC MAFDefault MAFFiltConst MAFMax MAFMin /end DEF_CHARACTERISTIC /end FUNCTION
/begin FUNCTION MAFPortIndex "" /begin OUT_MEASUREMENT MAFPort05Idx MAFPort05In /end OUT_MEASUREMENT /end FUNCTION
/begin FUNCTION MakeUp_EOI_Override "" /begin DEF_CHARACTERISTIC MakeUp_EOI_new MakeUp_EOI_ovr /end DEF_CHARACTERISTIC /end FUNCTION
/begin FUNCTION _MAP "" /begin OUT_MEASUREMENT MAP MAPADC MAPRaw /end OUT_MEASUREMENT /begin SUB_FUNCTION MAP_Override MAP_Config /end SUB_FUNCTION /end FUNCTION
/begin FUNCTION MAP_Fault_Logic ""
 /begin DEF_CHARACTERISTIC MAP_IR_HI MAP_IR_LO MAP_IR_TPS_CL MAP_IR_TPS_OP MAP_STUCK MAP_TPS_STUCK /end DEF_CHARACTERISTIC
/end FUNCTION
/begin FUNCTION MAP_Override "" /begin DEF_CHARACTERISTIC MAP_new MAP_ovr /end DEF_CHARACTERISTIC /end FUNCTION
/begin FUNCTION MAP_Indexes "" /begin OUT_MEASUREMENT MAP05Idx MAP05In MAP09Idx MAP09In MAP17Idx MAP17In /end OUT_MEASUREMENT /end FUNCTION
/begin FUNCTION MAP_Config ""
 /begin DEF_CHARACTERISTIC MAPDfltValue MAPFilterConst MAPGain MAPInputHiFltPos MAPInputLoFltPos MAPOfst /end DEF_CHARACTERISTIC
/end FUNCTION
/begin FUNCTION MAPTime "" /begin OUT_MEASUREMENT MAPTime MAPTimeADC MAPTimeRaw /end OUT_MEASUREMENT /begin SUB_FUNCTION MAPTime_Override MAPTime_Config /end SUB_FUNCTION /end FUNCTION
/begin FUNCTION MAPTime_Override "" /begin DEF_CHARACTERISTIC MAPTime_new MAPTime_ovr /end DEF_CHARACTERISTIC /end FUNCTION
/begin FUNCTION MAPTime_Config ""
 /begin DEF_CHARACTERISTIC MAPTimeDfltValue MAPTimeFilterConst MAPTimeGain MAPTimeInputHiFltPos MAPTimeInputLoFltPos MAPTimeOfst /end DEF_CHARACTERISTIC
/end FUNCTION
/begin FUNCTION Universal_PID__Tunable___Scheduled__2 ""
 /begin DEF_CHARACTERISTIC MaxGovDGain MaxGovDGainErrorMultTbl MaxGovErrorGain MaxGovIGain MaxGovIGainErrorMultTbl MaxGovITermLowerLimit MaxGovITermUpperLimit MaxGovPGain MaxGovPGainErrorMultTbl MaxGovPIDOutLowerLimit MaxGovPIDOutUpperLimit /end DEF_CHARACTERISTIC
 /begin OUT_MEASUREMENT MaxGovDGainErrorMult MaxGovDTerm MaxGovError MaxGovIGainErrorMult MaxGovITerm MaxGovPGainErrorMult MaxGovPTerm MaxGovSpeedErrorIdx MaxGovSpeedErrorIn /end OUT_MEASUREMENT
/end FUNCTION
/begin FUNCTION MaxGovernor "" /begin OUT_MEASUREMENT MaxGovOutput TPSRequestLookupAirOfst /end OUT_MEASUREMENT
 /begin SUB_FUNCTION Universal_PID__Tunable___Scheduled__2 MaxGovState I_Term_Preload Trigger_Pre_load Ramp_RPM_1 /end SUB_FUNCTION
/end FUNCTION
/begin FUNCTION MaxGovState "" /begin DEF_CHARACTERISTIC MaxGovDisable MaxGovTPSHyst /end DEF_CHARACTERISTIC /begin OUT_MEASUREMENT MaxGovETCMode MaxGovHold MaxGovReset MaxGovState /end OUT_MEASUREMENT /end FUNCTION
/begin FUNCTION I_Term_Preload "" /begin DEF_CHARACTERISTIC MaxGovPreloadITermTbl /end DEF_CHARACTERISTIC /begin OUT_MEASUREMENT MaxGovIC MaxGovPreloadITerm /end OUT_MEASUREMENT /end FUNCTION
/begin FUNCTION InGear ""
 /begin DEF_CHARACTERISTIC MaxGovInGearLowerLim MaxGovInGearRPMSetPt MaxGovInGearRPMThresh MaxGovInGearUpperLim /end DEF_CHARACTERISTIC
/end FUNCTION
/begin FUNCTION Trigger_Pre_load "" /begin SUB_FUNCTION InGear InNeutral /end SUB_FUNCTION /end FUNCTION
/begin FUNCTION InNeutral ""
 /begin DEF_CHARACTERISTIC MaxGovNtrlLowerLim MaxGovNtrlRPMSetPt MaxGovNtrlRPMThresh MaxGovNtrlUpperLim /end DEF_CHARACTERISTIC
/end FUNCTION
/begin FUNCTION Ramp_RPM_1 "" /begin DEF_CHARACTERISTIC MaxGovRPMCtrlEntryFiltC /end DEF_CHARACTERISTIC /begin OUT_MEASUREMENT MaxGovRPMSetpoint /end OUT_MEASUREMENT /end FUNCTION
/begin FUNCTION SparkAdvanceLimiter "" /begin DEF_CHARACTERISTIC MaxSparkLimitOffIdle MaxSparkLimitTbl MinSparkLimit /end DEF_CHARACTERISTIC /begin OUT_MEASUREMENT MaxSparkLimit TotalSparkAdv /end OUT_MEASUREMENT /end FUNCTION
/begin FUNCTION Mech_PW_Override "" /begin DEF_CHARACTERISTIC Mech_PW_new Mech_PW_ovr /end DEF_CHARACTERISTIC /end FUNCTION
/begin FUNCTION Cycle1CutPatter_2 ""
 /begin DEF_CHARACTERISTIC MediumCycle1Cyl1 MediumCycle1Cyl2 MediumCycle1Cyl3 MediumCycle1Cyl4 MediumCycle1Cyl5 MediumCycle1Cyl6 MediumCycle1Cyl7 MediumCycle1Cyl8 /end DEF_CHARACTERISTIC
/end FUNCTION
/begin FUNCTION Medium_Cycle_Cut_Pattern ""
 /begin SUB_FUNCTION Cycle1CutPatter_2 Cycle2CutPatter_2 Cycle3CutPatter_2 Cycle4CutPatter_2 /end SUB_FUNCTION
/end FUNCTION
/begin FUNCTION Cycle1CutPatter_3 ""
 /begin DEF_CHARACTERISTIC MediumCycle1Cyl1_TwoStep MediumCycle1Cyl2_TwoStep MediumCycle1Cyl3_TwoStep MediumCycle1Cyl4_TwoStep MediumCycle1Cyl5_TwoStep MediumCycle1Cyl6_TwoStep MediumCycle1Cyl7_TwoStep MediumCycle1Cyl8_TwoStep /end DEF_CHARACTERISTIC
/end FUNCTION
/begin FUNCTION Medium_Cycle_Cut_Pattern_Two_Step ""
 /begin SUB_FUNCTION Cycle1CutPatter_3 Cycle2CutPatter_3 Cycle3CutPatter_3 Cycle4CutPatter_3 /end SUB_FUNCTION
/end FUNCTION
/begin FUNCTION Cycle2CutPatter_2 ""
 /begin DEF_CHARACTERISTIC MediumCycle2Cyl1 MediumCycle2Cyl2 MediumCycle2Cyl3 MediumCycle2Cyl4 MediumCycle2Cyl5 MediumCycle2Cyl6 MediumCycle2Cyl7 MediumCycle2Cyl8 /end DEF_CHARACTERISTIC
/end FUNCTION
/begin FUNCTION Cycle2CutPatter_3 ""
 /begin DEF_CHARACTERISTIC MediumCycle2Cyl1_TwoStep MediumCycle2Cyl2_TwoStep MediumCycle2Cyl3_TwoStep MediumCycle2Cyl4_TwoStep MediumCycle2Cyl5_TwoStep MediumCycle2Cyl6_TwoStep MediumCycle2Cyl7_TwoStep MediumCycle2Cyl8_TwoStep /end DEF_CHARACTERISTIC
/end FUNCTION
/begin FUNCTION Cycle3CutPatter_2 ""
 /begin DEF_CHARACTERISTIC MediumCycle3Cyl1 MediumCycle3Cyl2 MediumCycle3Cyl3 MediumCycle3Cyl4 MediumCycle3Cyl5 MediumCycle3Cyl6 MediumCycle3Cyl7 MediumCycle3Cyl8 /end DEF_CHARACTERISTIC
/end FUNCTION
/begin FUNCTION Cycle3CutPatter_3 ""
 /begin DEF_CHARACTERISTIC MediumCycle3Cyl1_TwoStep MediumCycle3Cyl2_TwoStep MediumCycle3Cyl3_TwoStep MediumCycle3Cyl4_TwoStep MediumCycle3Cyl5_TwoStep MediumCycle3Cyl6_TwoStep MediumCycle3Cyl7_TwoStep MediumCycle3Cyl8_TwoStep /end DEF_CHARACTERISTIC
/end FUNCTION
/begin FUNCTION Cycle4CutPatter_2 ""
 /begin DEF_CHARACTERISTIC MediumCycle4Cyl1 MediumCycle4Cyl2 MediumCycle4Cyl3 MediumCycle4Cyl4 MediumCycle4Cyl5 MediumCycle4Cyl6 MediumCycle4Cyl7 MediumCycle4Cyl8 /end DEF_CHARACTERISTIC
/end FUNCTION
/begin FUNCTION Cycle4CutPatter_3 ""
 /begin DEF_CHARACTERISTIC MediumCycle4Cyl1_TwoStep MediumCycle4Cyl2_TwoStep MediumCycle4Cyl3_TwoStep MediumCycle4Cyl4_TwoStep MediumCycle4Cyl5_TwoStep MediumCycle4Cyl6_TwoStep MediumCycle4Cyl7_TwoStep MediumCycle4Cyl8_TwoStep /end DEF_CHARACTERISTIC
/end FUNCTION
/begin FUNCTION Base_RPM_Set_Pt "" /begin DEF_CHARACTERISTIC MinGovClntRPMSetPtTbl /end DEF_CHARACTERISTIC /begin OUT_MEASUREMENT MinGovClntRPMSetPt /end OUT_MEASUREMENT /end FUNCTION
/begin FUNCTION Low_Oil_Pressure_Fault_Logic ""
 /begin DEF_CHARACTERISTIC MinOilPressure_FaultTbl MinOilPressure_WarnTbl NoOilPres_FaultTime /end DEF_CHARACTERISTIC
 /begin OUT_MEASUREMENT MinOilPressure_Fault MinOilPressure_Warn /end OUT_MEASUREMENT
/end FUNCTION
/begin FUNCTION MotoringDetection "" /begin DEF_CHARACTERISTIC MotoringDeltaRPMLimit MotoringDtctTimerLimit /end DEF_CHARACTERISTIC /begin OUT_MEASUREMENT MotoringDetectionFlag MotoringDetectionTime /end OUT_MEASUREMENT /end FUNCTION
/begin FUNCTION MPRD_Override "" /begin DEF_CHARACTERISTIC MPRD_new MPRD_ovr /end DEF_CHARACTERISTIC /end FUNCTION
/begin FUNCTION Injector_Sequence "" /begin OUT_MEASUREMENT NextCylinderToInject NextInjectorAngle /end OUT_MEASUREMENT /end FUNCTION
/begin FUNCTION General "" /begin SUB_FUNCTION Injector_Sequence Spark_Sequence /end SUB_FUNCTION /end FUNCTION
/begin FUNCTION Spark_Sequence "" /begin OUT_MEASUREMENT NextCylinderToSpark NextSparkAngle /end OUT_MEASUREMENT /end FUNCTION
/begin FUNCTION NonVolatile_Storage "" /begin DEF_CHARACTERISTIC RestoreNVFactoryDefaults StoreNV /end DEF_CHARACTERISTIC /begin OUT_MEASUREMENT NonVolatileCRC NonVolatileFormatID NonVolatileStatus /end OUT_MEASUREMENT /begin SUB_FUNCTION NonVolatile_Storage_Config /end SUB_FUNCTION /end FUNCTION
/begin FUNCTION NonVolatile_Storage_Config ""
 /begin DEF_CHARACTERISTIC NonVolatileRestoreOnFirstStartup NonVolatileRestoreOnStartup /end DEF_CHARACTERISTIC
/end FUNCTION
/begin FUNCTION Equivalence_Ratio_Perturbation "" /begin DEF_CHARACTERISTIC O2ActiveTimeThresh O2LeanTimeThresh O2RichTimeThresh /end DEF_CHARACTERISTIC /begin OUT_MEASUREMENT O2LeanTime O2NotActiveTime O2RichTime /end OUT_MEASUREMENT /end FUNCTION
/begin FUNCTION O2_Control_Enable_Delay "" /begin DEF_CHARACTERISTIC O2CtrlAdaptDelayTime /end DEF_CHARACTERISTIC /end FUNCTION
/begin FUNCTION O2_De_lag "" /begin DEF_CHARACTERISTIC O2DelagFilterConst PostO2DelagFiltConst /end DEF_CHARACTERISTIC /begin OUT_MEASUREMENT PostO2Delag PreO2Delag /end OUT_MEASUREMENT /end FUNCTION
/begin FUNCTION Error_Gain_Scheduling "" /begin DEF_CHARACTERISTIC O2MAFErrGainMultTbl O2NECCTErrGainMultTbl /end DEF_CHARACTERISTIC /begin OUT_MEASUREMENT O2MAFErrGainMult O2NECCTErrGainMult /end OUT_MEASUREMENT /end FUNCTION
/begin FUNCTION OilPres "" /begin OUT_MEASUREMENT OilPres OilPresADC OilPresRaw /end OUT_MEASUREMENT /begin SUB_FUNCTION OilPres_Override OilPres_Config /end SUB_FUNCTION /end FUNCTION
/begin FUNCTION OilPres_Override "" /begin DEF_CHARACTERISTIC OilPres_new OilPres_ovr /end DEF_CHARACTERISTIC /end FUNCTION
/begin FUNCTION OilPres_Config ""
 /begin DEF_CHARACTERISTIC OilPresDfltValue OilPresFilterConst OilPresGain OilPresInputHiFltPos OilPresInputLoFltPos OilPresOfst /end DEF_CHARACTERISTIC
/end FUNCTION
/begin FUNCTION CutThrottle_APP_Limiting "" /begin DEF_CHARACTERISTIC Overheat_MaxAPP Overheat_ScaleAPP /end DEF_CHARACTERISTIC /end FUNCTION
/begin FUNCTION OXY_Index "" /begin OUT_MEASUREMENT OXY05Idx OXY05In /end OUT_MEASUREMENT /end FUNCTION
/begin FUNCTION OXY_Transient_Fueling "" /begin DEF_CHARACTERISTIC OXYTransFuelMultTbl /end DEF_CHARACTERISTIC /begin OUT_MEASUREMENT OXYTransFuelMult /end OUT_MEASUREMENT /end FUNCTION
/begin FUNCTION DecreasingFilter "" /begin DEF_CHARACTERISTIC PH1_FiltDecConst /end DEF_CHARACTERISTIC /end FUNCTION
/begin FUNCTION PHI_Filt "" /begin DEF_CHARACTERISTIC PHI1_DefaultVal /end DEF_CHARACTERISTIC /begin OUT_MEASUREMENT PHI1_FiltFin /end OUT_MEASUREMENT /begin SUB_FUNCTION DecreasingFilter IncreasingFilter /end SUB_FUNCTION /end FUNCTION
/begin FUNCTION IncreasingFilter "" /begin DEF_CHARACTERISTIC PH1_FiltIncConst /end DEF_CHARACTERISTIC /end FUNCTION
/begin FUNCTION DecreasingFilter_1 "" /begin DEF_CHARACTERISTIC PH2_FiltDecConst /end DEF_CHARACTERISTIC /end FUNCTION
/begin FUNCTION PHI_Filt1 "" /begin DEF_CHARACTERISTIC PHI2_DefaultVal /end DEF_CHARACTERISTIC /begin OUT_MEASUREMENT PHI2_FiltFin /end OUT_MEASUREMENT /begin SUB_FUNCTION DecreasingFilter_1 IncreasingFilter_1 /end SUB_FUNCTION /end FUNCTION
/begin FUNCTION IncreasingFilter_1 "" /begin DEF_CHARACTERISTIC PH2_FiltIncConst /end DEF_CHARACTERISTIC /end FUNCTION
/begin FUNCTION PWM ""
 /begin OUT_MEASUREMENT pwm_create_ETCPin_PWMOutput pwm_create_FAN1Pin_PWM_PWMOutput pwm_create_FAN2Pin_PWM_PWMOutput pwm_create_IAC_PPin_PWMOutput pwm_create_IAC_SPin_PWMOutput pwm_create_WASTEGATE_PWMOutput pwm_set_ETCPin_PWMOutput pwm_set_FAN1Pin_PWM_PWMOutput pwm_set_FAN2Pin_PWM_PWMOutput pwm_set_IAC_PPin_PWMOutput pwm_set_IAC_SPin_PWMOutput pwm_set_WASTEGATE_PWMOutput /end OUT_MEASUREMENT
/end FUNCTION
/begin FUNCTION Other "" /begin OUT_MEASUREMENT resource_allocation /end OUT_MEASUREMENT /end FUNCTION
/begin FUNCTION RPM_Indexes "" /begin OUT_MEASUREMENT RPM05Idx RPM05In RPM09Idx RPM09In RPM17Idx RPM17In /end OUT_MEASUREMENT /end FUNCTION
/begin FUNCTION Determine_if_RPM_is_Falling "" /begin DEF_CHARACTERISTIC RPMFallingFiltConst RPMFallingRate /end DEF_CHARACTERISTIC /begin OUT_MEASUREMENT RPMFalling /end OUT_MEASUREMENT /end FUNCTION
/begin FUNCTION RPM_Filt "" /begin DEF_CHARACTERISTIC RPMFilt_Enable RPMFilt_LowPass RPMFilt_RoundValue /end DEF_CHARACTERISTIC /begin OUT_MEASUREMENT RPMFilt_Final RPMFilt_PostLowPass /end OUT_MEASUREMENT /end FUNCTION
/begin FUNCTION Scramble "" /begin DEF_CHARACTERISTIC ScrambleDebounceDelay /end DEF_CHARACTERISTIC /begin OUT_MEASUREMENT Scramble Scramble_Raw /end OUT_MEASUREMENT /begin SUB_FUNCTION Scramble_Override Scramble_Config /end SUB_FUNCTION /end FUNCTION
/begin FUNCTION Scramble_Override "" /begin DEF_CHARACTERISTIC Scramble_new Scramble_ovr /end DEF_CHARACTERISTIC /end FUNCTION
/begin FUNCTION Scramble_Config "" /begin DEF_CHARACTERISTIC ScramblePolarity ScrambleSwitchPt /end DEF_CHARACTERISTIC /end FUNCTION
/begin FUNCTION SensVolt "" /begin OUT_MEASUREMENT SensVolt SensVoltADC SensVoltRaw /end OUT_MEASUREMENT /begin SUB_FUNCTION SensVolt_Override SensVolt_Config /end SUB_FUNCTION /end FUNCTION
/begin FUNCTION SensVolt_Override "" /begin DEF_CHARACTERISTIC SensVolt_new SensVolt_ovr /end DEF_CHARACTERISTIC /end FUNCTION
/begin FUNCTION SensVolt_Config ""
 /begin DEF_CHARACTERISTIC SensVoltDfltValue SensVoltFilterConst SensVoltGain SensVoltInputHiFltPos SensVoltInputLoFltPos SensVoltOfst /end DEF_CHARACTERISTIC
/end FUNCTION
/begin FUNCTION Cycle1CutPatter_4 ""
 /begin DEF_CHARACTERISTIC SoftCycle1Cyl1 SoftCycle1Cyl2 SoftCycle1Cyl3 SoftCycle1Cyl4 SoftCycle1Cyl5 SoftCycle1Cyl6 SoftCycle1Cyl7 SoftCycle1Cyl8 /end DEF_CHARACTERISTIC
/end FUNCTION
/begin FUNCTION Soft_Cycle_Cut_Pattern ""
 /begin SUB_FUNCTION Cycle1CutPatter_4 Cycle2CutPatter_4 Cycle3CutPatter_4 Cycle4CutPatter_4 /end SUB_FUNCTION
/end FUNCTION
/begin FUNCTION Cycle1CutPatter_5 ""
 /begin DEF_CHARACTERISTIC SoftCycle1Cyl1_TwoStep SoftCycle1Cyl2_TwoStep SoftCycle1Cyl3_TwoStep SoftCycle1Cyl4_TwoStep SoftCycle1Cyl5_TwoStep SoftCycle1Cyl6_TwoStep SoftCycle1Cyl7_TwoStep SoftCycle1Cyl8_TwoStep /end DEF_CHARACTERISTIC
/end FUNCTION
/begin FUNCTION Soft_Cycle_Cut_Pattern_Two_Step ""
 /begin SUB_FUNCTION Cycle1CutPatter_5 Cycle2CutPatter_5 Cycle3CutPatter_5 Cycle4CutPatter_5 /end SUB_FUNCTION
/end FUNCTION
/begin FUNCTION Cycle2CutPatter_4 ""
 /begin DEF_CHARACTERISTIC SoftCycle2Cyl1 SoftCycle2Cyl2 SoftCycle2Cyl3 SoftCycle2Cyl4 SoftCycle2Cyl5 SoftCycle2Cyl6 SoftCycle2Cyl7 SoftCycle2Cyl8 /end DEF_CHARACTERISTIC
/end FUNCTION
/begin FUNCTION Cycle2CutPatter_5 ""
 /begin DEF_CHARACTERISTIC SoftCycle2Cyl1_TwoStep SoftCycle2Cyl2_TwoStep SoftCycle2Cyl3_TwoStep SoftCycle2Cyl4_TwoStep SoftCycle2Cyl5_TwoStep SoftCycle2Cyl6_TwoStep SoftCycle2Cyl7_TwoStep SoftCycle2Cyl8_TwoStep /end DEF_CHARACTERISTIC
/end FUNCTION
/begin FUNCTION Cycle3CutPatter_4 ""
 /begin DEF_CHARACTERISTIC SoftCycle3Cyl1 SoftCycle3Cyl2 SoftCycle3Cyl3 SoftCycle3Cyl4 SoftCycle3Cyl5 SoftCycle3Cyl6 SoftCycle3Cyl7 SoftCycle3Cyl8 /end DEF_CHARACTERISTIC
/end FUNCTION
/begin FUNCTION Cycle3CutPatter_5 ""
 /begin DEF_CHARACTERISTIC SoftCycle3Cyl1_TwoStep SoftCycle3Cyl2_TwoStep SoftCycle3Cyl3_TwoStep SoftCycle3Cyl4_TwoStep SoftCycle3Cyl5_TwoStep SoftCycle3Cyl6_TwoStep SoftCycle3Cyl7_TwoStep SoftCycle3Cyl8_TwoStep /end DEF_CHARACTERISTIC
/end FUNCTION
/begin FUNCTION Cycle4CutPatter_4 ""
 /begin DEF_CHARACTERISTIC SoftCycle4Cyl1 SoftCycle4Cyl2 SoftCycle4Cyl3 SoftCycle4Cyl4 SoftCycle4Cyl5 SoftCycle4Cyl6 SoftCycle4Cyl7 SoftCycle4Cyl8 /end DEF_CHARACTERISTIC
/end FUNCTION
/begin FUNCTION Cycle4CutPatter_5 ""
 /begin DEF_CHARACTERISTIC SoftCycle4Cyl1_TwoStep SoftCycle4Cyl2_TwoStep SoftCycle4Cyl3_TwoStep SoftCycle4Cyl4_TwoStep SoftCycle4Cyl5_TwoStep SoftCycle4Cyl6_TwoStep SoftCycle4Cyl7_TwoStep SoftCycle4Cyl8_TwoStep /end DEF_CHARACTERISTIC
/end FUNCTION
/begin FUNCTION SOI_Override "" /begin DEF_CHARACTERISTIC SOI_new SOI_ovr /end DEF_CHARACTERISTIC /end FUNCTION
/begin FUNCTION Spark_Advance_Rate_Limiter "" /begin DEF_CHARACTERISTIC SparkAdv_DeltaHi SparkAdv_DeltaLo /end DEF_CHARACTERISTIC /end FUNCTION
/begin FUNCTION SparkDwell_Override "" /begin DEF_CHARACTERISTIC SparkDwell_offset SparkDwell_ovr /end DEF_CHARACTERISTIC /end FUNCTION
/begin FUNCTION SparkStartAngle_Override "" /begin DEF_CHARACTERISTIC SparkStartAngle_offset SparkStartAngle_ovr /end DEF_CHARACTERISTIC /end FUNCTION
/begin FUNCTION SparkStopAngle_Override "" /begin DEF_CHARACTERISTIC SparkStopAngle_offset SparkStopAngle_ovr /end DEF_CHARACTERISTIC /end FUNCTION
/begin FUNCTION PID_Gain_Select ""
 /begin DEF_CHARACTERISTIC SpkMinGovDGain SpkMinGovDGainErrorMultTbl SpkMinGovPGain SpkMinGovPGainErrorMultTbl /end DEF_CHARACTERISTIC
 /begin OUT_MEASUREMENT SpkMinGovDGainErrorMult SpkMinGovPGainErrorMult /end OUT_MEASUREMENT
/end FUNCTION
/begin FUNCTION Universal_PD__Tunable___Scheduled_ ""
 /begin DEF_CHARACTERISTIC SpkMinGovErrorGain SpkMinGovPIDOutLowerLimit SpkMinGovPIDOutUpperLimit /end DEF_CHARACTERISTIC
 /begin OUT_MEASUREMENT SpkMinGovDTerm SpkMinGovError SpkMinGovPTerm SpkMinGovSpeedErrorIdx SpkMinGovSpeedErrorIn /end OUT_MEASUREMENT
 /begin SUB_FUNCTION PID_Gain_Select /end SUB_FUNCTION
/end FUNCTION
/begin FUNCTION LoadBasedCalcs ""
 /begin OUT_MEASUREMENT SSEng SSLoadDirection SSLoadFilterConst SSLoadFiltered SSRPMDirection SSRPMFilterConst SSRPMFiltered /end OUT_MEASUREMENT
 /begin SUB_FUNCTION Engine_Steady_State_Flag LoadBasedCalcs_Config /end SUB_FUNCTION
/end FUNCTION
/begin FUNCTION Engine_Steady_State_Flag "" /begin DEF_CHARACTERISTIC SSLoadTol SSRPMTol /end DEF_CHARACTERISTIC /begin OUT_MEASUREMENT SSEngOpr /end OUT_MEASUREMENT /end FUNCTION
/begin FUNCTION LoadBasedCalcs_Config "" /begin DEF_CHARACTERISTIC SSLoadDecFiltC SSLoadIncFiltC SSRPMDecFiltC SSRPMIncFiltC /end DEF_CHARACTERISTIC /end FUNCTION
/begin FUNCTION SysVolt "" /begin OUT_MEASUREMENT SysVolt SysVoltADC SysVoltRaw /end OUT_MEASUREMENT /begin SUB_FUNCTION SysVolt_Override SysVolt_Config /end SUB_FUNCTION /end FUNCTION
/begin FUNCTION SysVolt_Override "" /begin DEF_CHARACTERISTIC SysVolt_new SysVolt_ovr /end DEF_CHARACTERISTIC /end FUNCTION
/begin FUNCTION SysVolt_Index "" /begin OUT_MEASUREMENT SysVolt09Idx SysVolt09In /end OUT_MEASUREMENT /end FUNCTION
/begin FUNCTION SysVolt_Config ""
 /begin DEF_CHARACTERISTIC SysVoltDfltValue SysVoltFilterConst SysVoltGain SysVoltInputHiFltPos SysVoltInputLoFltPos SysVoltOfst /end DEF_CHARACTERISTIC
/end FUNCTION
/begin FUNCTION Engine_Overheat_Fault_Logic ""
 /begin DEF_CHARACTERISTIC TempOverheat_Fault TempOverheat_Warn TempOverheatSevere_Fault /end DEF_CHARACTERISTIC
/end FUNCTION
/begin FUNCTION Time_Since_Key_On "" /begin OUT_MEASUREMENT TimeSinceKeyOn /end OUT_MEASUREMENT /end FUNCTION
/begin FUNCTION Time_Since_Run "" /begin OUT_MEASUREMENT TimeSinceRun /end OUT_MEASUREMENT /end FUNCTION
/begin FUNCTION Time_Since_Stall "" /begin OUT_MEASUREMENT TimeSinceStall /end OUT_MEASUREMENT /end FUNCTION
/begin FUNCTION TPS_Indexes "" /begin OUT_MEASUREMENT TPS09Idx TPS09In /end OUT_MEASUREMENT /end FUNCTION
/begin FUNCTION TPS1_Override "" /begin DEF_CHARACTERISTIC TPS1_new TPS1_ovr /end DEF_CHARACTERISTIC /end FUNCTION
/begin FUNCTION TPS1 ""
 /begin OUT_MEASUREMENT TPS1Adapt_Hi TPS1Adapt_Low TPS1ADC TPS1Percent TPS1PercentRaw /end OUT_MEASUREMENT
 /begin SUB_FUNCTION TPS1_Override TPS1_Config /end SUB_FUNCTION
/end FUNCTION
/begin FUNCTION TPS__Sensor_Arbitration "" /begin DEF_CHARACTERISTIC TPS1_TPS2_Max_Deviation /end DEF_CHARACTERISTIC /begin OUT_MEASUREMENT TPSFinal /end OUT_MEASUREMENT /end FUNCTION
/begin FUNCTION TPS1_Config ""
 /begin DEF_CHARACTERISTIC TPS1Adapt_Delta TPS1Adapt_Hi_Max TPS1Adapt_Hi_Min TPS1Adapt_Low_Max TPS1Adapt_Low_Min TPS1AdaptHiEnable TPS1AdaptLoEnable TPS1DfltValue TPS1FilterConst TPS1InputHiFltPos TPS1InputLoFltPos TPS1MaxLimit TPS1Rev_Polarity /end DEF_CHARACTERISTIC
/end FUNCTION
/begin FUNCTION TPS2_Override "" /begin DEF_CHARACTERISTIC TPS2_new TPS2_ovr /end DEF_CHARACTERISTIC /end FUNCTION
/begin FUNCTION TPS2 ""
 /begin OUT_MEASUREMENT TPS2Adapt_Hi TPS2Adapt_Low TPS2ADC TPS2Percent TPS2PercentRaw /end OUT_MEASUREMENT
 /begin SUB_FUNCTION TPS2_Override TPS2_Config /end SUB_FUNCTION
/end FUNCTION
/begin FUNCTION TPS2_Config ""
 /begin DEF_CHARACTERISTIC TPS2Adapt_Delta TPS2Adapt_Hi_Max TPS2Adapt_Hi_Min TPS2Adapt_Low_Max TPS2Adapt_Low_Min TPS2AdaptHiEnable TPS2AdaptLoEnable TPS2DfltValue TPS2FilterConst TPS2InputHiFltPos TPS2InputLoFltPos TPS2MaxLimit TPS2Rev_Polarity /end DEF_CHARACTERISTIC
/end FUNCTION
/begin FUNCTION TwoStep "" /begin OUT_MEASUREMENT TwoStep TwoStep_Raw /end OUT_MEASUREMENT /begin SUB_FUNCTION TwoStep_Override TwoStep_Config /end SUB_FUNCTION /end FUNCTION
/begin FUNCTION TwoStep_Override "" /begin DEF_CHARACTERISTIC TwoStep_new TwoStep_ovr /end DEF_CHARACTERISTIC /end FUNCTION
/begin FUNCTION Two_Step "" /begin DEF_CHARACTERISTIC TwoStepDebounceDelay /end DEF_CHARACTERISTIC /end FUNCTION
/begin FUNCTION TwoStepRevLimit ""
 /begin DEF_CHARACTERISTIC TwoStepHardRevOffset TwoStepMediumRevOffset TwoStepRevLimit TwoStepRevLimitHyst /end DEF_CHARACTERISTIC
/end FUNCTION
/begin FUNCTION TwoStep_Config "" /begin DEF_CHARACTERISTIC TwoStepPolarity /end DEF_CHARACTERISTIC /end FUNCTION
/begin FUNCTION Adapt_VolEff_Map "" /begin DEF_CHARACTERISTIC VEAdaptGainTblTbl VEAdaptMax VEAdaptMin /end DEF_CHARACTERISTIC
 /begin OUT_MEASUREMENT VE_AdaptErrorIdxArrIdx VE_AdaptErrorIdxArrIn VEAdaptGainTbl /end OUT_MEASUREMENT
/end FUNCTION
/begin FUNCTION VSPD_Filt ""
 /begin DEF_CHARACTERISTIC VPSD_ChangeReject VSPD_ChangeReject_Enable VSPD_RateReject VSPD_RateReject_Enable VSPD_RejectHoldTime VSPD_ZeroSpeed /end DEF_CHARACTERISTIC
 /begin OUT_MEASUREMENT VSPD_ChangeReject_Enabled VSPD_DigFinal VSPD_RateReject_Enabled /end OUT_MEASUREMENT
/end FUNCTION
/begin FUNCTION VSPD "" /begin DEF_CHARACTERISTIC VSPDTbl /end DEF_CHARACTERISTIC /begin OUT_MEASUREMENT VSPD VSPDADC VSPDIdx VSPDRaw /end OUT_MEASUREMENT /begin SUB_FUNCTION VSPD_Override VSPD_Config /end SUB_FUNCTION /end FUNCTION
/begin FUNCTION VSPD_Selector "" /begin DEF_CHARACTERISTIC VSPD_DigitalPresent VSPD_GPSPreferred /end DEF_CHARACTERISTIC /begin OUT_MEASUREMENT VSPD_FinalFinal /end OUT_MEASUREMENT /end FUNCTION
/begin FUNCTION VSPD_Override "" /begin DEF_CHARACTERISTIC VSPD_new VSPD_ovr /end DEF_CHARACTERISTIC /end FUNCTION
/begin FUNCTION VSPD_Index "" /begin OUT_MEASUREMENT VSPD09Idx VSPD09In VSPD17Idx VSPD17In /end OUT_MEASUREMENT /end FUNCTION
/begin FUNCTION VSPD_Config "" /begin DEF_CHARACTERISTIC VSPDDefault VSPDFiltConst VSPDMax VSPDMin /end DEF_CHARACTERISTIC /end FUNCTION
/begin FUNCTION Warm_Up_Fuel_Holdoff "" /begin DEF_CHARACTERISTIC Warmup_Time_HoldoffTbl /end DEF_CHARACTERISTIC /begin OUT_MEASUREMENT Warmup_Time_Holdoff /end OUT_MEASUREMENT /end FUNCTION
/begin FUNCTION WarmUp_Disable "" /begin OUT_MEASUREMENT WarmUpO2AdaptEnabled /end OUT_MEASUREMENT /end FUNCTION
/begin FUNCTION WASTEGATE_Override "" /begin DEF_CHARACTERISTIC WASTEGATE_new WASTEGATE_ovr /end DEF_CHARACTERISTIC /end FUNCTION
/begin FUNCTION WASTEGATE "" /begin OUT_MEASUREMENT WASTEGATEDutyCycle /end OUT_MEASUREMENT /begin SUB_FUNCTION WASTEGATE_Override WASTEGATE_Config /end SUB_FUNCTION /end FUNCTION
/begin FUNCTION WASTEGATE_Control "" /begin SUB_FUNCTION WASTEGATE /end SUB_FUNCTION /end FUNCTION
/begin FUNCTION WASTEGATE_Config ""
 /begin DEF_CHARACTERISTIC WASTEGATEFrequency WASTEGATEGain WASTEGATEMaxLimit WASTEGATEMinLimit WASTEGATEOffset /end DEF_CHARACTERISTIC
/end FUNCTION
/end MODULE
/end PROJECT
