ASAP2_VERSION 1 51
/begin PROJECT Project ""
/begin MODULE BaseEngin_042 ""
/begin MOD_COMMON /* MOD_COMMON Comment */ "" BYTE_ORDER MSB_FIRST ALIGNMENT_BYTE 1 ALIGNMENT_FLOAT32_IEEE 1 ALIGNMENT_FLOAT64_IEEE 1 ALIGNMENT_LONG 1 ALIGNMENT_WORD 1 /end MOD_COMMON
/begin MEASUREMENT ETC_IGainMult "Multiplier on the ETC I gain based on ETC error." FLOAT32_IEEE CompuMethod_2 1 0 -1E+17 1E+17 ECU_ADDRESS 0x40000431 /end MEASUREMENT
/begin MEASUREMENT ETC_PGainMult "Multiplier on the ETC P gain based on ETC error." FLOAT32_IEEE CompuMethod_2 1 0 -1E+17 1E+17 ECU_ADDRESS 0x40000435 /end MEASUREMENT
/begin MEASUREMENT ETC_ShutdownSetpointMode "Shutdown mode for ETC setpoint. 0=Passthrough, 1=LoAdapt, 2=SpringTest." SBYTE CompuMethod_1 1 0 -128 127 ECU_ADDRESS 0x40000443 /end MEASUREMENT
/begin MEASUREMENT ETCDamperSwtichState "" UBYTE CompuMethod_11 1 0 0 1 ECU_ADDRESS 0x4000044C /end MEASUREMENT
/begin MEASUREMENT ETCDamperTPS "" FLOAT32_IEEE CompuMethod_2 1 0 -1E+17 1E+17 ECU_ADDRESS 0x4000044D /end MEASUREMENT
/begin MEASUREMENT ETCDamperTPSThresh "" FLOAT32_IEEE CompuMethod_2 1 0 -1E+17 1E+17 ECU_ADDRESS 0x40000451 /end MEASUREMENT
/begin MEASUREMENT ETCStallStateShutdown "" UBYTE CompuMethod_8 1 0 0 1 ECU_ADDRESS 0x4000048A /end MEASUREMENT
/begin MEASUREMENT Ethanol_Spk_Ofst "Total Spark Offset based on ECT, IAT2, engine speed and load" FLOAT32_IEEE CompuMethod_88 1 0 -1E+17 1E+17 ECU_ADDRESS 0x4000048B /end MEASUREMENT
/begin MEASUREMENT Ethanol_SpkOfstMult "Multiplier on ECT spark offset table." FLOAT32_IEEE CompuMethod_32 1 0 -1E+17 1E+17 ECU_ADDRESS 0x4000048F /end MEASUREMENT
/begin MEASUREMENT EthSpkMod "Spark advance as a function of ethanol %" FLOAT32_IEEE CompuMethod_66 1 0 -1E+17 1E+17 ECU_ADDRESS 0x40000493 /end MEASUREMENT
/begin MEASUREMENT EVAP "Final value after Linear Sensor Characterization" FLOAT32_IEEE CompuMethod_80 1 0 -1E+17 1E+17 ECU_ADDRESS 0x40000497 /end MEASUREMENT
/begin MEASUREMENT EVAPADC "Signal measured directly from sensor" UWORD CompuMethod_17 1 0 0 65535 ECU_ADDRESS 0x4000049B /end MEASUREMENT
/begin MEASUREMENT EVAPIdx "Look up table to allownon-linear characterization of sensors" UWORD CompuMethod_15 1 0 0 127.998 ECU_ADDRESS 0x4000049D /end MEASUREMENT
/begin MEASUREMENT EVAPRaw "After conversion to engineering units, before range checking" FLOAT32_IEEE CompuMethod_80 1 0 -1E+17 1E+17 ECU_ADDRESS 0x4000049F /end MEASUREMENT
/begin MEASUREMENT FAN1_PWMDutyCycle "Actual duty cycle of actuator" FLOAT32_IEEE CompuMethod_7 1 0 -1E+17 1E+17 ECU_ADDRESS 0x400004A3 /end MEASUREMENT
/begin MEASUREMENT FAN2_PWMDutyCycle "Actual duty cycle of actuator" FLOAT32_IEEE CompuMethod_7 1 0 -1E+17 1E+17 ECU_ADDRESS 0x400004AB /end MEASUREMENT
/begin MEASUREMENT FaultActionReason._.CutThrottle "Displays a rolling marquee of the reasons for fault action: FaultActionReason." UBYTE CompuMethod_106 1 0 0 255 ECU_ADDRESS 0x400004B3 /end MEASUREMENT
/begin MEASUREMENT FaultActionReason._.DFCODisable "Displays a rolling marquee of the reasons for fault action: FaultActionReason." UBYTE CompuMethod_106 1 0 0 255 ECU_ADDRESS 0x400004B4 /end MEASUREMENT
/begin MEASUREMENT FaultActionReason._.DelayedEngineShutdown "Displays a rolling marquee of the reasons for fault action: FaultActionReason." UBYTE CompuMethod_106 1 0 0 255 ECU_ADDRESS 0x400004B5 /end MEASUREMENT
/begin MEASUREMENT FaultActionReason._.DisableAC "Displays a rolling marquee of the reasons for fault action: FaultActionReason." UBYTE CompuMethod_106 1 0 0 255 ECU_ADDRESS 0x400004B6 /end MEASUREMENT
/begin MEASUREMENT FaultActionReason._.DisableFanRun "Displays a rolling marquee of the reasons for fault action: FaultActionReason." UBYTE CompuMethod_106 1 0 0 255 ECU_ADDRESS 0x400004B7 /end MEASUREMENT
/begin MEASUREMENT FaultActionReason._.DisableFanStall "Displays a rolling marquee of the reasons for fault action: FaultActionReason." UBYTE CompuMethod_106 1 0 0 255 ECU_ADDRESS 0x400004B8 /end MEASUREMENT
/begin MEASUREMENT FaultActionReason._.DisableO2Ctrl "Displays a rolling marquee of the reasons for fault action: FaultActionReason." UBYTE CompuMethod_106 1 0 0 255 ECU_ADDRESS 0x400004B9 /end MEASUREMENT
/begin MEASUREMENT FaultActionReason._.DisableVEAdapt "Displays a rolling marquee of the reasons for fault action: FaultActionReason." UBYTE CompuMethod_106 1 0 0 255 ECU_ADDRESS 0x400004BA /end MEASUREMENT
/begin MEASUREMENT FaultActionReason._.EngineProtectLED "Displays a rolling marquee of the reasons for fault action: FaultActionReason." UBYTE CompuMethod_106 1 0 0 255 ECU_ADDRESS 0x400004BB /end MEASUREMENT
/begin MEASUREMENT FaultActionReason._.EngineShutdown "Displays a rolling marquee of the reasons for fault action: FaultActionReason." UBYTE CompuMethod_106 1 0 0 255 ECU_ADDRESS 0x400004BC /end MEASUREMENT
/begin MEASUREMENT FaultActionReason._.HardRevLimit "Displays a rolling marquee of the reasons for fault action: FaultActionReason." UBYTE CompuMethod_106 1 0 0 255 ECU_ADDRESS 0x400004BD /end MEASUREMENT
/begin MEASUREMENT FaultActionReason._.MIL_LED "Displays a rolling marquee of the reasons for fault action: FaultActionReason." UBYTE CompuMethod_106 1 0 0 255 ECU_ADDRESS 0x400004BE /end MEASUREMENT
/begin MEASUREMENT FaultActionReason._.MediumRevLimit "Displays a rolling marquee of the reasons for fault action: FaultActionReason." UBYTE CompuMethod_106 1 0 0 255 ECU_ADDRESS 0x400004BF /end MEASUREMENT
/begin MEASUREMENT FaultActionReason._.SoftRevLimit "Displays a rolling marquee of the reasons for fault action: FaultActionReason." UBYTE CompuMethod_106 1 0 0 255 ECU_ADDRESS 0x400004C0 /end MEASUREMENT
/begin MEASUREMENT FrameworkGlueErrors "This indicates the currently Active Errors within the Framework Glue module." UWORD CompuMethod_113 1 0 0 65535 ECU_ADDRESS 0x400004D5 /end MEASUREMENT
/begin MEASUREMENT freq_in_create_FuelSensorPin "Debug Variable" UBYTE CompuMethod_30 1 0 0 0 ECU_ADDRESS 0x400004D7 /end MEASUREMENT
/begin MEASUREMENT freq_in_create_MAF_Pin "Debug Variable" UBYTE CompuMethod_30 1 0 0 0 ECU_ADDRESS 0x400004D8 /end MEASUREMENT
/begin MEASUREMENT freq_in_create_VSPD_Pin "Debug Variable" UBYTE CompuMethod_30 1 0 0 0 ECU_ADDRESS 0x400004D9 /end MEASUREMENT
/begin MEASUREMENT freq_in_read_FuelSensorPin "Debug Variable" UBYTE CompuMethod_30 1 0 0 0 ECU_ADDRESS 0x400004DA /end MEASUREMENT
/begin MEASUREMENT freq_in_read_MAF_Pin "Debug Variable" UBYTE CompuMethod_30 1 0 0 0 ECU_ADDRESS 0x400004DB /end MEASUREMENT
/begin MEASUREMENT freq_in_read_VSPD_Pin "Debug Variable" UBYTE CompuMethod_30 1 0 0 0 ECU_ADDRESS 0x400004DC /end MEASUREMENT
/begin MEASUREMENT Fuel_Economy_Filtered "" FLOAT32_IEEE CompuMethod_2 1 0 -1E+17 1E+17 ECU_ADDRESS 0x400004DD MATRIX_DIM 8 1 1 /end MEASUREMENT
/begin MEASUREMENT Fuel_Economy_Inst "" FLOAT32_IEEE CompuMethod_2 1 0 -1E+17 1E+17 ECU_ADDRESS 0x400004FD MATRIX_DIM 8 1 1 /end MEASUREMENT
/begin MEASUREMENT Fuel_Lvl "Final value after Linear Sensor Characterization" FLOAT32_IEEE CompuMethod_7 1 0 -1E+17 1E+17 ECU_ADDRESS 0x4000051D /end MEASUREMENT
/begin MEASUREMENT Fuel_LvlADC "Signal measured directly from sensor" UWORD CompuMethod_17 1 0 0 65535 ECU_ADDRESS 0x40000521 /end MEASUREMENT
/begin MEASUREMENT Fuel_LvlIdx "Look up table to allownon-linear characterization of sensors" UWORD CompuMethod_15 1 0 0 127.998 ECU_ADDRESS 0x40000523 /end MEASUREMENT
/begin MEASUREMENT Fuel_LvlRaw "After conversion to engineering units, before range checking" FLOAT32_IEEE CompuMethod_7 1 0 -1E+17 1E+17 ECU_ADDRESS 0x40000525 /end MEASUREMENT
/begin MEASUREMENT FuelDeltaPress "Fuel Delta Pressure - across the fuel injector" FLOAT32_IEEE CompuMethod_16 1 0 -1E+17 1E+17 ECU_ADDRESS 0x4000053A /end MEASUREMENT
/begin MEASUREMENT FuelDeltaPressure "Fuel pressure across injector (rail - manifold)" FLOAT32_IEEE CompuMethod_16 1 0 -1E+17 1E+17 ECU_ADDRESS 0x4000053E /end MEASUREMENT
/begin MEASUREMENT FuelLevel_FiltConst "FuelLevel_FiltConst" FLOAT32_IEEE CompuMethod_19 1 0 -1E+17 1E+17 ECU_ADDRESS 0x4000054E /end MEASUREMENT
/begin MEASUREMENT FuelLevel_FiltConstColIdx "FuelLevel_FiltConst" UWORD CompuMethod_15 1 0 0 127.998 ECU_ADDRESS 0x40000552 /end MEASUREMENT
/begin MEASUREMENT FuelLevel_FiltConstColIn "FuelLevel_FiltConst" FLOAT32_IEEE CompuMethod_115 1 0 -1E+17 1E+17 ECU_ADDRESS 0x40000554 /end MEASUREMENT
/begin MEASUREMENT FuelLevel_FiltConstRowIdx "FuelLevel_FiltConst" UWORD CompuMethod_15 1 0 0 127.998 ECU_ADDRESS 0x40000558 /end MEASUREMENT
/begin MEASUREMENT FuelLevel_FiltConstRowIn "FuelLevel_FiltConst" FLOAT32_IEEE CompuMethod_19 1 0 -1E+17 1E+17 ECU_ADDRESS 0x4000055A /end MEASUREMENT
/begin MEASUREMENT FuelLevel_RefuelEvent "" UBYTE CompuMethod_11 1 0 0 1 ECU_ADDRESS 0x4000055E /end MEASUREMENT
/begin MEASUREMENT FuelLvl_Fin "" FLOAT32_IEEE CompuMethod_2 1 0 -1E+17 1E+17 ECU_ADDRESS 0x4000055F /end MEASUREMENT
/begin MEASUREMENT FuelLvl_NVM_Prb "" FLOAT32_IEEE CompuMethod_2 1 0 -1E+17 1E+17 ECU_ADDRESS 0x40000563 /end MEASUREMENT
/begin MEASUREMENT FUELP "Display output in engineering units" UBYTE CompuMethod_4 1 0 0 1 ECU_ADDRESS 0x40000567 /end MEASUREMENT
/begin MEASUREMENT FuelPres "Final value after Linear Sensor Characterization" FLOAT32_IEEE CompuMethod_13 1 0 -1E+17 1E+17 ECU_ADDRESS 0x40000568 /end MEASUREMENT
/begin MEASUREMENT FuelPresADC "Singal measured directly from sensor" UWORD CompuMethod_17 1 0 0 65535 ECU_ADDRESS 0x4000056C /end MEASUREMENT
/begin MEASUREMENT FuelPresRaw "After conversion to engineering units, before range checking" FLOAT32_IEEE CompuMethod_13 1 0 -1E+17 1E+17 ECU_ADDRESS 0x4000056E /end MEASUREMENT
/begin MEASUREMENT FuelSens "Final value after Linear Sensor Characterization" FLOAT32_IEEE CompuMethod_7 1 0 -1E+17 1E+17 ECU_ADDRESS 0x40000577 /end MEASUREMENT
/begin MEASUREMENT FuelSensADC "Singal measured directly from sensor" ULONG CompuMethod_118 1 0 0 4294970000 ECU_ADDRESS 0x4000057B /end MEASUREMENT
/begin MEASUREMENT FuelSensRaw "After conversion to engineering units, before range checking" FLOAT32_IEEE CompuMethod_7 1 0 -1E+17 1E+17 ECU_ADDRESS 0x4000057F /end MEASUREMENT
/begin MEASUREMENT GearEstimated "" UBYTE CompuMethod_1 1 0 0 255 ECU_ADDRESS 0x40000583 /end MEASUREMENT
/begin MEASUREMENT GPS_Altitude_Prb "" FLOAT32_IEEE CompuMethod_2 1 0 -1E+17 1E+17 ECU_ADDRESS 0x40000588 /end MEASUREMENT
/begin MEASUREMENT GPS_Course_Prb "" FLOAT32_IEEE CompuMethod_2 1 0 -1E+17 1E+17 ECU_ADDRESS 0x4000058C /end MEASUREMENT
/begin MEASUREMENT GPS_DayUTC_Prb "" UBYTE CompuMethod_1 1 0 0 255 ECU_ADDRESS 0x40000590 /end MEASUREMENT
/begin MEASUREMENT GPS_HoursUTC_Prb "" UBYTE CompuMethod_1 1 0 0 255 ECU_ADDRESS 0x40000591 /end MEASUREMENT
/begin MEASUREMENT GPS_Latitude_Prb "" FLOAT32_IEEE CompuMethod_2 1 0 -1E+17 1E+17 ECU_ADDRESS 0x40000592 /end MEASUREMENT
/begin MEASUREMENT GPS_Longitude_Prb "" FLOAT32_IEEE CompuMethod_2 1 0 -1E+17 1E+17 ECU_ADDRESS 0x40000596 /end MEASUREMENT
/begin MEASUREMENT GPS_MinutesUTC_Prb "" UBYTE CompuMethod_1 1 0 0 255 ECU_ADDRESS 0x4000059A /end MEASUREMENT
/begin MEASUREMENT GPS_MonthUTC_Prb "" UBYTE CompuMethod_1 1 0 0 255 ECU_ADDRESS 0x4000059B /end MEASUREMENT
/begin MEASUREMENT GPS_SatelliteCount_Prb "" UBYTE CompuMethod_1 1 0 0 255 ECU_ADDRESS 0x4000059C /end MEASUREMENT
/begin MEASUREMENT GPS_SecondsUTC_Prb "" UBYTE CompuMethod_1 1 0 0 255 ECU_ADDRESS 0x4000059D /end MEASUREMENT
/begin MEASUREMENT GPS_Speed_Prb "" FLOAT32_IEEE CompuMethod_2 1 0 -1E+17 1E+17 ECU_ADDRESS 0x4000059E /end MEASUREMENT
/begin MEASUREMENT GPS_Valid_Prb "" UBYTE CompuMethod_11 1 0 0 1 ECU_ADDRESS 0x400005A2 /end MEASUREMENT
/begin MEASUREMENT GPS_YearUTC_Prb "" UWORD CompuMethod_9 1 0 0 65535 ECU_ADDRESS 0x400005A3 /end MEASUREMENT
/begin MEASUREMENT IAT "Final value after Linear Sensor Characterization" FLOAT32_IEEE CompuMethod_80 1 0 -1E+17 1E+17 ECU_ADDRESS 0x400005A5 /end MEASUREMENT
/begin MEASUREMENT IAT_KeyUp "" FLOAT32_IEEE CompuMethod_80 1 0 -1E+17 1E+17 ECU_ADDRESS 0x400005A9 /end MEASUREMENT
/begin MEASUREMENT IAT_KeyUp09Idx "Index of IAT captured at key-up." UWORD CompuMethod_15 1 0 0 127.998 ECU_ADDRESS 0x400005AD /end MEASUREMENT
/begin MEASUREMENT IAT_KeyUp09In "Index of IAT captured at key-up." FLOAT32_IEEE CompuMethod_57 1 0 -1E+17 1E+17 ECU_ADDRESS 0x400005AF /end MEASUREMENT
/begin MEASUREMENT IAT05Idx "Index of IAT" UWORD CompuMethod_15 1 0 0 127.998 ECU_ADDRESS 0x400005BB /end MEASUREMENT
/begin MEASUREMENT IAT05In "Index of IAT" FLOAT32_IEEE CompuMethod_57 1 0 -1E+17 1E+17 ECU_ADDRESS 0x400005BD /end MEASUREMENT
/begin MEASUREMENT IAT07Idx "Index of IAT" UWORD CompuMethod_15 1 0 0 127.998 ECU_ADDRESS 0x400005C1 /end MEASUREMENT
/begin MEASUREMENT IAT07In "Index of IAT" FLOAT32_IEEE CompuMethod_57 1 0 -1E+17 1E+17 ECU_ADDRESS 0x400005C3 /end MEASUREMENT
/begin MEASUREMENT IAT17Idx "Index of IAT" UWORD CompuMethod_15 1 0 0 127.998 ECU_ADDRESS 0x400005C7 /end MEASUREMENT
/begin MEASUREMENT IAT17In "Index of IAT" FLOAT32_IEEE CompuMethod_57 1 0 -1E+17 1E+17 ECU_ADDRESS 0x400005C9 /end MEASUREMENT
/begin MEASUREMENT IATADC "Signal measured directly from sensor" UWORD CompuMethod_17 1 0 0 65535 ECU_ADDRESS 0x400005CD /end MEASUREMENT
/begin MEASUREMENT IATIdx "Look up table to allownon-linear characterization of sensors" UWORD CompuMethod_15 1 0 0 127.998 ECU_ADDRESS 0x400005D7 /end MEASUREMENT
/begin MEASUREMENT IATRaw "After conversion to engineering units, before range checking" FLOAT32_IEEE CompuMethod_80 1 0 -1E+17 1E+17 ECU_ADDRESS 0x400005D9 /end MEASUREMENT
/begin MEASUREMENT InjDC "" FLOAT32_IEEE CompuMethod_2 1 0 -1E+17 1E+17 ECU_ADDRESS 0x400005E7 MATRIX_DIM 8 1 1 /end MEASUREMENT
/begin MEASUREMENT InjDeltaPress09Idx "" UWORD CompuMethod_15 1 0 0 127.998 ECU_ADDRESS 0x40000607 /end MEASUREMENT
/begin MEASUREMENT InjDeltaPress09In "" FLOAT32_IEEE CompuMethod_2 1 0 -1E+17 1E+17 ECU_ADDRESS 0x40000609 /end MEASUREMENT
/begin MEASUREMENT InjdPComp "Injector characterization compenastion based on dP across injector." FLOAT32_IEEE CompuMethod_132 1 0 -1E+17 1E+17 ECU_ADDRESS 0x4000060D /end MEASUREMENT
/begin MEASUREMENT InjEPW "" FLOAT32_IEEE CompuMethod_2 1 0 -1E+17 1E+17 ECU_ADDRESS 0x40000619 /end MEASUREMENT
/begin MEASUREMENT InjMPW "" FLOAT32_IEEE CompuMethod_2 1 0 -1E+17 1E+17 ECU_ADDRESS 0x4000061D MATRIX_DIM 8 1 1 /end MEASUREMENT
/begin MEASUREMENT InjTurnOff "Injector turn off time" FLOAT32_IEEE CompuMethod_64 1 0 -1E+17 1E+17 ECU_ADDRESS 0x40000645 /end MEASUREMENT
/begin MEASUREMENT InjTurnOn "Injector turn on time." FLOAT32_IEEE CompuMethod_64 1 0 -1E+17 1E+17 ECU_ADDRESS 0x40000649 /end MEASUREMENT
/begin MEASUREMENT LeanSwPtDelta "If actual O2 reaches this point, switch the target to the RichTargetDelta" FLOAT32_IEEE CompuMethod_42 1 0 -1E+17 1E+17 ECU_ADDRESS 0x40000654 /end MEASUREMENT
/begin MEASUREMENT LeanTargetDelta "Target on the lean side for perturbation." FLOAT32_IEEE CompuMethod_42 1 0 -1E+17 1E+17 ECU_ADDRESS 0x40000658 /end MEASUREMENT
/begin MEASUREMENT LiquidO2Control_DTerm_BankA "Closed-loop O2 control D-Term, for bank" FLOAT32_IEEE CompuMethod_32 1 0 -1E+17 1E+17 ECU_ADDRESS 0x4000065D /end MEASUREMENT
/begin MEASUREMENT LiquidO2Control_DTerm_BankB "Closed-loop O2 control D-Term, for bank" FLOAT32_IEEE CompuMethod_32 1 0 -1E+17 1E+17 ECU_ADDRESS 0x40000661 /end MEASUREMENT
/begin MEASUREMENT LiquidO2Control_ErrorTerm_BankA "Closed-loop O2 control error-term, for bank" FLOAT32_IEEE CompuMethod_32 1 0 -1E+17 1E+17 ECU_ADDRESS 0x40000665 /end MEASUREMENT
/begin MEASUREMENT LiquidO2Control_ErrorTerm_BankB "Closed-loop O2 control error-term, for bank" FLOAT32_IEEE CompuMethod_32 1 0 -1E+17 1E+17 ECU_ADDRESS 0x40000669 /end MEASUREMENT
/begin MEASUREMENT LiquidO2Control_ITerm_BankA "Closed-loop O2 control I-Term" FLOAT32_IEEE CompuMethod_32 1 0 -1E+17 1E+17 ECU_ADDRESS 0x4000066D /end MEASUREMENT
/begin MEASUREMENT LiquidO2Control_ITerm_BankB "Closed-loop O2 control I-Term" FLOAT32_IEEE CompuMethod_32 1 0 -1E+17 1E+17 ECU_ADDRESS 0x40000671 /end MEASUREMENT
/begin MEASUREMENT LiquidO2Control_PTerm_BankA "Closed-loop O2 control P-Term" FLOAT32_IEEE CompuMethod_32 1 0 -1E+17 1E+17 ECU_ADDRESS 0x40000675 /end MEASUREMENT
/begin MEASUREMENT LiquidO2Control_PTerm_BankB "Closed-loop O2 control P-Term" FLOAT32_IEEE CompuMethod_32 1 0 -1E+17 1E+17 ECU_ADDRESS 0x40000679 /end MEASUREMENT
/begin MEASUREMENT MAF "Final value after Linear Sensor Characterization" FLOAT32_IEEE CompuMethod_29 1 0 -1E+17 1E+17 ECU_ADDRESS 0x4000067D /end MEASUREMENT
/begin MEASUREMENT MAFADC "Signal measured directly from sensor" FLOAT32_IEEE CompuMethod_98 1 0 -1E+17 1E+17 ECU_ADDRESS 0x40000687 /end MEASUREMENT
/begin MEASUREMENT MAFIdx "Look up table to allownon-linear characterization of sensors" UWORD CompuMethod_15 1 0 0 127.998 ECU_ADDRESS 0x4000068F /end MEASUREMENT
/begin MEASUREMENT MAFPort05Idx "Index of MAF" UWORD CompuMethod_15 1 0 0 127.998 ECU_ADDRESS 0x40000691 /end MEASUREMENT
/begin MEASUREMENT MAFPort05In "Index of MAF" FLOAT32_IEEE CompuMethod_29 1 0 -1E+17 1E+17 ECU_ADDRESS 0x40000693 /end MEASUREMENT
/begin MEASUREMENT MAFRaw "After conversion to engineering units, before range checking" FLOAT32_IEEE CompuMethod_29 1 0 -1E+17 1E+17 ECU_ADDRESS 0x40000697 /end MEASUREMENT
/begin MEASUREMENT MAP "Final value after Linear Sensor Characterization" FLOAT32_IEEE CompuMethod_16 1 0 -1E+17 1E+17 ECU_ADDRESS 0x4000069F /end MEASUREMENT
/begin MEASUREMENT MAP05Idx "Index of MAP" UWORD CompuMethod_15 1 0 0 127.998 ECU_ADDRESS 0x400006A3 /end MEASUREMENT
/begin MEASUREMENT MAP05In "Index of MAP" FLOAT32_IEEE CompuMethod_16 1 0 -1E+17 1E+17 ECU_ADDRESS 0x400006A5 /end MEASUREMENT
/begin MEASUREMENT MAP09Idx "Index of MAP" UWORD CompuMethod_15 1 0 0 127.998 ECU_ADDRESS 0x400006A9 /end MEASUREMENT
/begin MEASUREMENT MAP09In "Index of MAP" FLOAT32_IEEE CompuMethod_16 1 0 -1E+17 1E+17 ECU_ADDRESS 0x400006AB /end MEASUREMENT
/begin MEASUREMENT MAP17Idx "Index of MAP" UWORD CompuMethod_15 1 0 0 127.998 ECU_ADDRESS 0x400006AF /end MEASUREMENT
/begin MEASUREMENT MAP17In "Index of MAP" FLOAT32_IEEE CompuMethod_16 1 0 -1E+17 1E+17 ECU_ADDRESS 0x400006B1 /end MEASUREMENT
/begin MEASUREMENT MAPADC "Singal measured directly from sensor" FLOAT32_IEEE CompuMethod_21 1 0 -1E+17 1E+17 ECU_ADDRESS 0x400006B5 /end MEASUREMENT
/begin MEASUREMENT MAPRaw "After conversion to engineering units, before range checking" FLOAT32_IEEE CompuMethod_16 1 0 -1E+17 1E+17 ECU_ADDRESS 0x400006B9 /end MEASUREMENT
/begin MEASUREMENT MAPTime "Final value after Linear Sensor Characterization" FLOAT32_IEEE CompuMethod_16 1 0 -1E+17 1E+17 ECU_ADDRESS 0x400006BD /end MEASUREMENT
/begin MEASUREMENT MAPTimeADC "Singal measured directly from sensor" UWORD CompuMethod_17 1 0 0 65535 ECU_ADDRESS 0x400006C1 /end MEASUREMENT
/begin MEASUREMENT MAPTimeRaw "After conversion to engineering units, before range checking" FLOAT32_IEEE CompuMethod_16 1 0 -1E+17 1E+17 ECU_ADDRESS 0x400006C3 /end MEASUREMENT
/begin MEASUREMENT MaxAllowableMPW "" FLOAT32_IEEE CompuMethod_2 1 0 -1E+17 1E+17 ECU_ADDRESS 0x40000717 /end MEASUREMENT
/begin MEASUREMENT MaxGovDGainErrorMult "" FLOAT32_IEEE CompuMethod_32 1 0 -1E+17 1E+17 ECU_ADDRESS 0x4000071F /end MEASUREMENT
/begin MEASUREMENT MaxGovDTerm "" FLOAT32_IEEE CompuMethod_2 1 0 -1E+17 1E+17 ECU_ADDRESS 0x40000723 /end MEASUREMENT
/begin MEASUREMENT MaxGovError "" FLOAT32_IEEE CompuMethod_2 1 0 -1E+17 1E+17 ECU_ADDRESS 0x40000727 /end MEASUREMENT
/begin MEASUREMENT MaxGovETCMode "" UBYTE CompuMethod_140 1 0 0 1 ECU_ADDRESS 0x4000072B /end MEASUREMENT
/begin MEASUREMENT MaxGovHold "" SBYTE CompuMethod_141 1 0 -128 127 ECU_ADDRESS 0x4000072C /end MEASUREMENT
/begin MEASUREMENT MaxGovIC "" FLOAT32_IEEE CompuMethod_2 1 0 -1E+17 1E+17 ECU_ADDRESS 0x4000072D /end MEASUREMENT
/begin MEASUREMENT MaxGovIGainErrorMult "" FLOAT32_IEEE CompuMethod_32 1 0 -1E+17 1E+17 ECU_ADDRESS 0x40000731 /end MEASUREMENT
/begin MEASUREMENT MaxGovITerm "" FLOAT32_IEEE CompuMethod_2 1 0 -1E+17 1E+17 ECU_ADDRESS 0x40000735 /end MEASUREMENT
/begin MEASUREMENT MaxGovOutput "" FLOAT32_IEEE CompuMethod_2 1 0 -1E+17 1E+17 ECU_ADDRESS 0x40000739 /end MEASUREMENT
/begin MEASUREMENT MaxGovPGainErrorMult "" FLOAT32_IEEE CompuMethod_32 1 0 -1E+17 1E+17 ECU_ADDRESS 0x4000073D /end MEASUREMENT
/begin MEASUREMENT MaxGovPreloadITerm "Preload for Max Gov PID ITerm based on engine acceleration rate upon entry into max gov." FLOAT32_IEEE CompuMethod_7 1 0 -1E+17 1E+17 ECU_ADDRESS 0x40000741 /end MEASUREMENT
/begin MEASUREMENT MaxGovPTerm "" FLOAT32_IEEE CompuMethod_2 1 0 -1E+17 1E+17 ECU_ADDRESS 0x40000745 /end MEASUREMENT
/begin MEASUREMENT MaxGovReset "" SBYTE CompuMethod_142 1 0 -128 127 ECU_ADDRESS 0x40000749 /end MEASUREMENT
/begin MEASUREMENT MaxGovRPMSetpoint "RPMSetpoint of Max Gov controller." FLOAT32_IEEE CompuMethod_71 1 0 -1E+17 1E+17 ECU_ADDRESS 0x4000074A /end MEASUREMENT
/begin MEASUREMENT MaxGovSpeedErrorIdx "" UWORD CompuMethod_15 1 0 0 127.998 ECU_ADDRESS 0x4000074E /end MEASUREMENT
/begin MEASUREMENT MaxGovSpeedErrorIn "" FLOAT32_IEEE CompuMethod_71 1 0 -1E+17 1E+17 ECU_ADDRESS 0x40000750 /end MEASUREMENT
/begin MEASUREMENT MaxGovState "" UBYTE CompuMethod_8 1 0 0 1 ECU_ADDRESS 0x40000754 /end MEASUREMENT
/begin MEASUREMENT MaxSparkLimit "Maximum allowable spark advance." FLOAT32_IEEE CompuMethod_66 1 0 -1E+17 1E+17 ECU_ADDRESS 0x40000755 /end MEASUREMENT
/begin MEASUREMENT MinGovClntRPMSetPt "RPM setpoint based on ECT." SWORD CompuMethod_24 1 0 -32768 32767 ECU_ADDRESS 0x4000075D /end MEASUREMENT
/begin MEASUREMENT MinGovRPMSetPt "" FLOAT32_IEEE CompuMethod_2 1 0 -1E+17 1E+17 ECU_ADDRESS 0x40000760 /end MEASUREMENT
/begin MEASUREMENT MinOilPressure_Fault "Minimum oil pressure based on RPM - engine faults and shuts down below this" FLOAT32_IEEE CompuMethod_143 1 0 -1E+17 1E+17 ECU_ADDRESS 0x40000764 /end MEASUREMENT
/begin MEASUREMENT MinOilPressure_Warn "Minimum oil pressure based on RPM - indicator light comes on below this" FLOAT32_IEEE CompuMethod_143 1 0 -1E+17 1E+17 ECU_ADDRESS 0x40000768 /end MEASUREMENT
/begin MEASUREMENT MotoringDetectionFlag "" UBYTE CompuMethod_11 1 0 0 1 ECU_ADDRESS 0x400008EB /end MEASUREMENT
/begin MEASUREMENT MotoringDetectionTime "" FLOAT32_IEEE CompuMethod_2 1 0 -1E+17 1E+17 ECU_ADDRESS 0x400008EC /end MEASUREMENT
/begin MEASUREMENT NextCylinderToInject "Debug Variable" UBYTE CompuMethod_1 1 0 0 0 ECU_ADDRESS 0x400008F0 /end MEASUREMENT
/begin MEASUREMENT NextCylinderToSpark "Debug Variable" UBYTE CompuMethod_1 1 0 0 0 ECU_ADDRESS 0x400008F1 /end MEASUREMENT
/begin MEASUREMENT NextInjectorAngle "Debug Variable" FLOAT32_IEEE CompuMethod_2 1 0 0 0 ECU_ADDRESS 0x400008F2 /end MEASUREMENT
/begin MEASUREMENT NextSparkAngle "Debug Variable" FLOAT32_IEEE CompuMethod_2 1 0 0 0 ECU_ADDRESS 0x400008F6 /end MEASUREMENT
/begin MEASUREMENT NonVolatileCRC "Calculated NonVolatile CRC" ULONG CompuMethod_11 1 0 0 65535 ECU_ADDRESS 0x400008FA /end MEASUREMENT
/begin MEASUREMENT NonVolatileFormatID "Unique identifier of the NonVolatile memory format.  Used to validate whether stored variables are in the correct form for the program" ULONG CompuMethod_56 1 0 0 4294970000 ECU_ADDRESS 0x400008FE /end MEASUREMENT
/begin MEASUREMENT NonVolatileStatus "Indicates how NonVolatile memory was loaded" UBYTE CompuMethod_148 1 0 0 6 ECU_ADDRESS 0x40000902 /end MEASUREMENT
/begin MEASUREMENT O2BankA_O2Delag "" FLOAT32_IEEE CompuMethod_2 1 0 -1E+17 1E+17 ECU_ADDRESS 0x40000907 /end MEASUREMENT
/begin MEASUREMENT O2BankB_O2Delag "" FLOAT32_IEEE CompuMethod_2 1 0 -1E+17 1E+17 ECU_ADDRESS 0x4000090B /end MEASUREMENT
/begin MEASUREMENT O2Diag_Bank2Bank_DiffAlwd "" FLOAT32_IEEE CompuMethod_2 1 0 -1E+17 1E+17 ECU_ADDRESS 0x40000911 /end MEASUREMENT
/begin MEASUREMENT O2FuelMult "Closed-loop O2 control fuel multiplier." FLOAT32_IEEE CompuMethod_32 1 0 -1E+17 1E+17 ECU_ADDRESS 0x40000916 MATRIX_DIM 8 1 1 /end MEASUREMENT
/begin MEASUREMENT O2LeanTime_BankA "" FLOAT32_IEEE CompuMethod_2 1 0 -1E+17 1E+17 ECU_ADDRESS 0x40000942 /end MEASUREMENT
/begin MEASUREMENT O2LeanTime_BankB "" FLOAT32_IEEE CompuMethod_2 1 0 -1E+17 1E+17 ECU_ADDRESS 0x40000946 /end MEASUREMENT
/begin MEASUREMENT O2MAFErrGainMult "O2 PID controller system gain based on MAF port." FLOAT32_IEEE CompuMethod_49 1 0 -1E+17 1E+17 ECU_ADDRESS 0x4000094A /end MEASUREMENT
/begin MEASUREMENT O2NECCTErrGainMult "O2 PID controller system gain based on NECCT." FLOAT32_IEEE CompuMethod_49 1 0 -1E+17 1E+17 ECU_ADDRESS 0x4000094E /end MEASUREMENT
/begin MEASUREMENT O2NotActiveTime_BankA "" FLOAT32_IEEE CompuMethod_2 1 0 -1E+17 1E+17 ECU_ADDRESS 0x40000952 /end MEASUREMENT
/begin MEASUREMENT O2NotActiveTime_BankB "" FLOAT32_IEEE CompuMethod_2 1 0 -1E+17 1E+17 ECU_ADDRESS 0x40000956 /end MEASUREMENT
/begin MEASUREMENT O2RichTime_BankA "" FLOAT32_IEEE CompuMethod_2 1 0 -1E+17 1E+17 ECU_ADDRESS 0x4000095A /end MEASUREMENT
/begin MEASUREMENT O2RichTime_BankB "" FLOAT32_IEEE CompuMethod_2 1 0 -1E+17 1E+17 ECU_ADDRESS 0x4000095E /end MEASUREMENT
/begin MEASUREMENT O2TargetEquivRatio_BankA "Current target equivalence ratio for closed-loop O2 control." FLOAT32_IEEE CompuMethod_153 1 0 -1E+17 1E+17 ECU_ADDRESS 0x40000967 /end MEASUREMENT
/begin MEASUREMENT O2TargetEquivRatio_BankB "Current target equivalence ratio for closed-loop O2 control." FLOAT32_IEEE CompuMethod_153 1 0 -1E+17 1E+17 ECU_ADDRESS 0x4000096B /end MEASUREMENT
/begin MEASUREMENT OilPres "Final value after Linear Sensor Characterization" FLOAT32_IEEE CompuMethod_143 1 0 -1E+17 1E+17 ECU_ADDRESS 0x40000970 /end MEASUREMENT
/begin MEASUREMENT OilPresADC "Singal measured directly from sensor" UWORD CompuMethod_17 1 0 0 65535 ECU_ADDRESS 0x40000974 /end MEASUREMENT
/begin MEASUREMENT OilPresRaw "After conversion to engineering units, before range checking" FLOAT32_IEEE CompuMethod_143 1 0 -1E+17 1E+17 ECU_ADDRESS 0x40000976 /end MEASUREMENT
/begin MEASUREMENT OXY05Idx "Index of fuel oxygenation content" UWORD CompuMethod_15 1 0 0 127.998 ECU_ADDRESS 0x4000097C /end MEASUREMENT
/begin MEASUREMENT OXY05In "Index of fuel oxygenation content" FLOAT32_IEEE CompuMethod_7 1 0 -1E+17 1E+17 ECU_ADDRESS 0x4000097E /end MEASUREMENT
/begin MEASUREMENT OXYTransFuelMult "Transient fuel multiplier based on OXY.  Only engaged during transient fueling" FLOAT32_IEEE CompuMethod_2 1 0 -1E+17 1E+17 ECU_ADDRESS 0x40000982 /end MEASUREMENT
/begin MEASUREMENT PHI1_FiltFin "" FLOAT32_IEEE CompuMethod_2 1 0 -1E+17 1E+17 ECU_ADDRESS 0x400009B6 /end MEASUREMENT
/begin MEASUREMENT PHI2_FiltFin "" FLOAT32_IEEE CompuMethod_2 1 0 -1E+17 1E+17 ECU_ADDRESS 0x400009BA /end MEASUREMENT
/begin MEASUREMENT pwm_create_ETCPin_PWMOutput "Debug Variable" UBYTE CompuMethod_30 1 0 0 0 ECU_ADDRESS 0x400009C4 /end MEASUREMENT
/begin MEASUREMENT pwm_create_FAN1Pin_PWM_PWMOutput "Debug Variable" UBYTE CompuMethod_30 1 0 0 0 ECU_ADDRESS 0x400009C5 /end MEASUREMENT
/begin MEASUREMENT pwm_create_FAN2Pin_PWM_PWMOutput "Debug Variable" UBYTE CompuMethod_30 1 0 0 0 ECU_ADDRESS 0x400009C6 /end MEASUREMENT
/begin MEASUREMENT pwm_set_ETCPin_PWMOutput "Debug Variable" UBYTE CompuMethod_30 1 0 0 0 ECU_ADDRESS 0x400009C7 /end MEASUREMENT
/begin MEASUREMENT pwm_set_FAN1Pin_PWM_PWMOutput "Debug Variable" UBYTE CompuMethod_30 1 0 0 0 ECU_ADDRESS 0x400009C8 /end MEASUREMENT
/begin MEASUREMENT pwm_set_FAN2Pin_PWM_PWMOutput "Debug Variable" UBYTE CompuMethod_30 1 0 0 0 ECU_ADDRESS 0x400009C9 /end MEASUREMENT
/begin MEASUREMENT resource_allocation "Debug Variable" UBYTE CompuMethod_30 1 0 0 0 ECU_ADDRESS 0x400009CA /end MEASUREMENT
/begin MEASUREMENT RevLimiterState "" UBYTE CompuMethod_159 1 0 0 255 ECU_ADDRESS 0x400009CB /end MEASUREMENT
/begin MEASUREMENT RichSwPtDelta "If actual O2 reaches this point, switch the target to the LeanTargetDelta" FLOAT32_IEEE CompuMethod_42 1 0 -1E+17 1E+17 ECU_ADDRESS 0x400009CC /end MEASUREMENT
/begin MEASUREMENT RichTargetDelta "Target on the rich side for perturbation." FLOAT32_IEEE CompuMethod_42 1 0 -1E+17 1E+17 ECU_ADDRESS 0x400009D0 /end MEASUREMENT
/begin MEASUREMENT RPM05Idx "Index of RPM" UWORD CompuMethod_15 1 0 0 127.998 ECU_ADDRESS 0x400009D8 /end MEASUREMENT
/begin MEASUREMENT RPM05In "Index of RPM" FLOAT32_IEEE CompuMethod_71 1 0 -1E+17 1E+17 ECU_ADDRESS 0x400009DA /end MEASUREMENT
/begin MEASUREMENT RPM09Idx "Index of RPM" UWORD CompuMethod_15 1 0 0 127.998 ECU_ADDRESS 0x400009DE /end MEASUREMENT
/begin MEASUREMENT RPM09In "Index of RPM" FLOAT32_IEEE CompuMethod_71 1 0 -1E+17 1E+17 ECU_ADDRESS 0x400009E0 /end MEASUREMENT
/begin MEASUREMENT RPM17Idx "Index of RPM" UWORD CompuMethod_15 1 0 0 127.998 ECU_ADDRESS 0x400009E4 /end MEASUREMENT
/begin MEASUREMENT RPM17In "Index of RPM" FLOAT32_IEEE CompuMethod_71 1 0 -1E+17 1E+17 ECU_ADDRESS 0x400009E6 /end MEASUREMENT
/begin MEASUREMENT RPMFalling "Indicates whether the RPM is falling" UBYTE CompuMethod_161 1 0 0 1 ECU_ADDRESS 0x400009F1 /end MEASUREMENT
/begin MEASUREMENT SensVolt "Final value after Linear Sensor Characterization" FLOAT32_IEEE CompuMethod_164 1 0 -1E+17 1E+17 ECU_ADDRESS 0x400009F6 /end MEASUREMENT
/begin MEASUREMENT SensVoltADC "Singal measured directly from sensor" UWORD CompuMethod_17 1 0 0 65535 ECU_ADDRESS 0x400009FA /end MEASUREMENT
/begin MEASUREMENT SensVoltRaw "After conversion to engineering units, before range checking" FLOAT32_IEEE CompuMethod_164 1 0 -1E+17 1E+17 ECU_ADDRESS 0x400009FC /end MEASUREMENT
/begin MEASUREMENT SpkMinGovDGainErrorMult "" FLOAT32_IEEE CompuMethod_32 1 0 -1E+17 1E+17 ECU_ADDRESS 0x40000A17 /end MEASUREMENT
/begin MEASUREMENT SpkMinGovDTerm "PID Derivative Term" FLOAT32_IEEE CompuMethod_88 1 0 -1E+17 1E+17 ECU_ADDRESS 0x40000A1B /end MEASUREMENT
/begin MEASUREMENT SpkMinGovError "PID Error Term" FLOAT32_IEEE CompuMethod_88 1 0 -1E+17 1E+17 ECU_ADDRESS 0x40000A1F /end MEASUREMENT
/begin MEASUREMENT SpkMinGovPGainErrorMult "" FLOAT32_IEEE CompuMethod_32 1 0 -1E+17 1E+17 ECU_ADDRESS 0x40000A27 /end MEASUREMENT
/begin MEASUREMENT SpkMinGovPTerm "PID Proportional Term" FLOAT32_IEEE CompuMethod_88 1 0 -1E+17 1E+17 ECU_ADDRESS 0x40000A2B /end MEASUREMENT
/begin MEASUREMENT SpkMinGovSpeedErrorIdx "" UWORD CompuMethod_15 1 0 0 127.998 ECU_ADDRESS 0x40000A2F /end MEASUREMENT
/begin MEASUREMENT SpkMinGovSpeedErrorIn "" FLOAT32_IEEE CompuMethod_2 1 0 -1E+17 1E+17 ECU_ADDRESS 0x40000A31 /end MEASUREMENT
/begin MEASUREMENT SSEng "" UBYTE CompuMethod_11 1 0 0 1 ECU_ADDRESS 0x40000A39 /end MEASUREMENT
/begin MEASUREMENT SSEngOpr "Steady-State Engine Operation" UBYTE CompuMethod_169 1 0 0 1 ECU_ADDRESS 0x40000A3A /end MEASUREMENT
/begin MEASUREMENT SSLoadDirection "" UBYTE CompuMethod_103 1 0 0 1 ECU_ADDRESS 0x40000A3B /end MEASUREMENT
/begin MEASUREMENT SSLoadFilterConst "" FLOAT32_IEEE CompuMethod_2 1 0 -1E+17 1E+17 ECU_ADDRESS 0x40000A3C /end MEASUREMENT
/begin MEASUREMENT SSLoadFiltered "" FLOAT32_IEEE CompuMethod_2 1 0 -1E+17 1E+17 ECU_ADDRESS 0x40000A40 /end MEASUREMENT
/begin MEASUREMENT SSRPMDirection "" UBYTE CompuMethod_103 1 0 0 1 ECU_ADDRESS 0x40000A44 /end MEASUREMENT
/begin MEASUREMENT SSRPMFilterConst "" FLOAT32_IEEE CompuMethod_2 1 0 -1E+17 1E+17 ECU_ADDRESS 0x40000A45 /end MEASUREMENT
/begin MEASUREMENT SSRPMFiltered "" FLOAT32_IEEE CompuMethod_2 1 0 -1E+17 1E+17 ECU_ADDRESS 0x40000A49 /end MEASUREMENT
/begin MEASUREMENT SysVolt "Final value after Linear Sensor Characterization" FLOAT32_IEEE CompuMethod_164 1 0 -1E+17 1E+17 ECU_ADDRESS 0x40000A52 /end MEASUREMENT
/begin MEASUREMENT SysVolt09Idx "Index of system voltage" UWORD CompuMethod_15 1 0 0 127.998 ECU_ADDRESS 0x40000A56 /end MEASUREMENT
/begin MEASUREMENT SysVolt09In "Index of system voltage" FLOAT32_IEEE CompuMethod_164 1 0 -1E+17 1E+17 ECU_ADDRESS 0x40000A58 /end MEASUREMENT
/begin MEASUREMENT SysVoltADC "Singal measured directly from sensor" UWORD CompuMethod_17 1 0 0 65535 ECU_ADDRESS 0x40000A5C /end MEASUREMENT
/begin MEASUREMENT SysVoltRaw "After conversion to engineering units, before range checking" FLOAT32_IEEE CompuMethod_164 1 0 -1E+17 1E+17 ECU_ADDRESS 0x40000A5E /end MEASUREMENT
/begin MEASUREMENT TimeSinceKeyOn "" FLOAT32_IEEE CompuMethod_2 1 0 -1E+17 1E+17 ECU_ADDRESS 0x40000A64 /end MEASUREMENT
/begin MEASUREMENT TimeSinceRun "" FLOAT32_IEEE CompuMethod_2 1 0 -1E+17 1E+17 ECU_ADDRESS 0x40000A68 /end MEASUREMENT
/begin MEASUREMENT TimeSinceStall "Indicates time since entering Stall State - saturates and disables at 2000 seconds" FLOAT32_IEEE CompuMethod_46 1 0 -1E+17 1E+17 ECU_ADDRESS 0x40000A72 /end MEASUREMENT
/begin MEASUREMENT TotalFPC "Total fuel per cylinder after application of transient algorithm" FLOAT32_IEEE CompuMethod_174 1 0 -1E+17 1E+17 ECU_ADDRESS 0x40000A7A MATRIX_DIM 8 1 1 /end MEASUREMENT
/begin MEASUREMENT TotalSparkAdv "" FLOAT32_IEEE CompuMethod_2 1 0 -1E+17 1E+17 ECU_ADDRESS 0x40000A9A /end MEASUREMENT
/begin MEASUREMENT TPS09Idx "Index of TPS" UWORD CompuMethod_15 1 0 0 127.998 ECU_ADDRESS 0x40000A9E /end MEASUREMENT
/begin MEASUREMENT TPS09In "Index of TPS" FLOAT32_IEEE CompuMethod_7 1 0 -1E+17 1E+17 ECU_ADDRESS 0x40000AA0 /end MEASUREMENT
/begin MEASUREMENT TPS1Adapt_Hi "" FLOAT32_IEEE CompuMethod_2 1 0 -1E+17 1E+17 ECU_ADDRESS 0x40000AA4 /end MEASUREMENT
/begin MEASUREMENT TPS1Adapt_Low "" FLOAT32_IEEE CompuMethod_2 1 0 -1E+17 1E+17 ECU_ADDRESS 0x40000AA8 /end MEASUREMENT
/begin MEASUREMENT TPS1ADC "" FLOAT32_IEEE CompuMethod_2 1 0 -1E+17 1E+17 ECU_ADDRESS 0x40000AAC /end MEASUREMENT
/begin MEASUREMENT TPS1Percent "" FLOAT32_IEEE CompuMethod_2 1 0 -1E+17 1E+17 ECU_ADDRESS 0x40000AB0 /end MEASUREMENT
/begin MEASUREMENT TPS1PercentRaw "" FLOAT32_IEEE CompuMethod_2 1 0 -1E+17 1E+17 ECU_ADDRESS 0x40000AB4 /end MEASUREMENT
/begin MEASUREMENT TPS2Adapt_Hi "" FLOAT32_IEEE CompuMethod_2 1 0 -1E+17 1E+17 ECU_ADDRESS 0x40000AB8 /end MEASUREMENT
/begin MEASUREMENT TPS2Adapt_Low "" FLOAT32_IEEE CompuMethod_2 1 0 -1E+17 1E+17 ECU_ADDRESS 0x40000ABC /end MEASUREMENT
/begin MEASUREMENT TPS2ADC "" FLOAT32_IEEE CompuMethod_2 1 0 -1E+17 1E+17 ECU_ADDRESS 0x40000AC0 /end MEASUREMENT
/begin MEASUREMENT TPS2Percent "" FLOAT32_IEEE CompuMethod_2 1 0 -1E+17 1E+17 ECU_ADDRESS 0x40000AC4 /end MEASUREMENT
/begin MEASUREMENT TPS2PercentRaw "" FLOAT32_IEEE CompuMethod_2 1 0 -1E+17 1E+17 ECU_ADDRESS 0x40000AC8 /end MEASUREMENT
/begin MEASUREMENT TPSFinal "" FLOAT32_IEEE CompuMethod_7 1 0 -1E+17 1E+17 ECU_ADDRESS 0x40000ACC /end MEASUREMENT
/begin MEASUREMENT TPSRequestLookupAirOfst "" FLOAT32_IEEE CompuMethod_2 1 0 -1E+17 1E+17 ECU_ADDRESS 0x40000AD0 /end MEASUREMENT
/begin MEASUREMENT VE_AdaptErrorIdxArrIdx "Multiplier on error for adaptation, should always be positive" UWORD CompuMethod_15 1 0 0 127.998 ECU_ADDRESS 0x40000ADF /end MEASUREMENT
/begin MEASUREMENT VE_AdaptErrorIdxArrIn "Multiplier on error for adaptation, should always be positive" FLOAT32_IEEE CompuMethod_2 1 0 -1E+17 1E+17 ECU_ADDRESS 0x40000AE1 /end MEASUREMENT
/begin MEASUREMENT VEAdaptGainTbl "Multiplier on error for adaptation, should always be positive" FLOAT32_IEEE CompuMethod_2 1 0 -1E+17 1E+17 ECU_ADDRESS 0x40000AE9 /end MEASUREMENT
/begin MEASUREMENT VSPD "Final value after Linear Sensor Characterization" FLOAT32_IEEE CompuMethod_180 1 0 -1E+17 1E+17 ECU_ADDRESS 0x40000B10 /end MEASUREMENT
/begin MEASUREMENT VSPD_DigFinal "" FLOAT32_IEEE CompuMethod_2 1 0 -1E+17 1E+17 ECU_ADDRESS 0x40000B14 /end MEASUREMENT
/begin MEASUREMENT VSPD_FinalFinal "" FLOAT32_IEEE CompuMethod_2 1 0 -1E+17 1E+17 ECU_ADDRESS 0x40000B18 /end MEASUREMENT
/begin MEASUREMENT VSPD07Idx "Index of VSPD" UWORD CompuMethod_15 1 0 0 127.998 ECU_ADDRESS 0x40000B1C /end MEASUREMENT
/begin MEASUREMENT VSPD07In "Index of VSPD" FLOAT32_IEEE CompuMethod_180 1 0 -1E+17 1E+17 ECU_ADDRESS 0x40000B1E /end MEASUREMENT
/begin MEASUREMENT VSPD09Idx "Index of VSPD" UWORD CompuMethod_15 1 0 0 127.998 ECU_ADDRESS 0x40000B22 /end MEASUREMENT
/begin MEASUREMENT VSPD09In "Index of VSPD" FLOAT32_IEEE CompuMethod_180 1 0 -1E+17 1E+17 ECU_ADDRESS 0x40000B24 /end MEASUREMENT
/begin MEASUREMENT VSPD17Idx "Index of VSPD" UWORD CompuMethod_15 1 0 0 127.998 ECU_ADDRESS 0x40000B28 /end MEASUREMENT
/begin MEASUREMENT VSPD17In "Index of VSPD" FLOAT32_IEEE CompuMethod_180 1 0 -1E+17 1E+17 ECU_ADDRESS 0x40000B2A /end MEASUREMENT
/begin MEASUREMENT VSPDADC "Signal measured directly from sensor" FLOAT32_IEEE CompuMethod_98 1 0 -1E+17 1E+17 ECU_ADDRESS 0x40000B2E /end MEASUREMENT
/begin MEASUREMENT VSPDIdx "Look up table to allownon-linear characterization of sensors" UWORD CompuMethod_15 1 0 0 127.998 ECU_ADDRESS 0x40000B32 /end MEASUREMENT
/begin MEASUREMENT VSPDRaw "After conversion to engineering units, before range checking" FLOAT32_IEEE CompuMethod_180 1 0 -1E+17 1E+17 ECU_ADDRESS 0x40000B34 /end MEASUREMENT
/begin MEASUREMENT Warmup_Time_Holdoff "Time before warmup fuel multiplier active" FLOAT32_IEEE CompuMethod_183 1 0 -1E+17 1E+17 ECU_ADDRESS 0x40000B38 /end MEASUREMENT
/begin MEASUREMENT WarmUpO2AdaptEnabled "Indicates whether FuelFlowComp map adapting is enabled due to WarmUp" UBYTE CompuMethod_47 1 0 0 1 ECU_ADDRESS 0x40000B40 /end MEASUREMENT
/begin CHARACTERISTIC ETC_IGainMultTbl "Multiplier on the ETC I gain based on ETC error." CURVE 0x80001AB6 RecordLayout_5 0 CompuMethod_2 -1E+17 1E+17
 /begin AXIS_DESCR COM_AXIS ETC_ErrorIn CompuMethod_2 10 -1E+17 1E+17 AXIS_PTS_REF ETC_ErrorIdxArr /end AXIS_DESCR
/end CHARACTERISTIC
/begin CHARACTERISTIC ETC_LoAdaptRateLimit "Dictates the rate at which the ETC setpoint is decreased during shutdown to perform a low TPS adapt." VALUE 0x80001ADE RecordLayout_5 0 CompuMethod_100 -1E+17 1E+17 /end CHARACTERISTIC
/begin CHARACTERISTIC ETC_new "Override result of linear sensor characterization, in engineering units" VALUE 0x80001AE2 RecordLayout_5 0 CompuMethod_2 -1E+17 1E+17 /end CHARACTERISTIC
/begin CHARACTERISTIC ETC_ovr "" VALUE 0x80001AEE RecordLayout_1 0 CompuMethod_5 0 1 /end CHARACTERISTIC
/begin CHARACTERISTIC ETC_PGainMultTbl "Multiplier on the ETC P gain based on ETC error." CURVE 0x80001AEF RecordLayout_5 0 CompuMethod_2 -1E+17 1E+17
 /begin AXIS_DESCR COM_AXIS ETC_ErrorIn CompuMethod_2 10 -1E+17 1E+17 AXIS_PTS_REF ETC_ErrorIdxArr /end AXIS_DESCR
/end CHARACTERISTIC
/begin CHARACTERISTIC ETC_StickingThresh "Defines error limit between TPS_Request and TPS where ETC sticking fault will be set." VALUE 0x80001B7F RecordLayout_5 0 CompuMethod_7 -1E+17 1E+17 /end CHARACTERISTIC
/begin CHARACTERISTIC ETCDamperSwitchHyst "Hysterisis around the ThrPosDamperSwitchThresh." VALUE 0x80001BA7 RecordLayout_5 0 CompuMethod_100 -1E+17 1E+17 /end CHARACTERISTIC
/begin CHARACTERISTIC ETCDamperSwitchThresh "When filtered derivative of TPS is greater than this threshold, Damper_Up gain will be used." VALUE 0x80001BAB RecordLayout_5 0 CompuMethod_100 -1E+17 1E+17 /end CHARACTERISTIC
/begin CHARACTERISTIC ETCDamperTPSFilt "Filter time constant" VALUE 0x80001BAF RecordLayout_5 0 CompuMethod_19 -1E+17 1E+17 /end CHARACTERISTIC
/begin CHARACTERISTIC ETCIGain "PID Integral Gain" VALUE 0x80001C13 RecordLayout_5 0 CompuMethod_32 -1E+17 1E+17 /end CHARACTERISTIC
/begin CHARACTERISTIC ETCLwrLim "Lower Limit Value" VALUE 0x80001C1F RecordLayout_5 0 CompuMethod_7 -1E+17 1E+17 /end CHARACTERISTIC
/begin CHARACTERISTIC ETCPGain "PID Proportional Gain" VALUE 0x80001C23 RecordLayout_5 0 CompuMethod_32 -1E+17 1E+17 /end CHARACTERISTIC
/begin CHARACTERISTIC ETCReq_new "Override the electronic throttle position" VALUE 0x80001C2D RecordLayout_5 0 CompuMethod_7 0 100 /end CHARACTERISTIC
/begin CHARACTERISTIC ETCReq_ovr "" VALUE 0x80001C31 RecordLayout_1 0 CompuMethod_5 0 1 /end CHARACTERISTIC
/begin CHARACTERISTIC ETCShutdownTimerThresh "Time limit in Stall State after which ETC will shutdown." VALUE 0x80002106 RecordLayout_5 0 CompuMethod_46 -1E+17 1E+17 /end CHARACTERISTIC
/begin CHARACTERISTIC ETCTuneAmp "" VALUE 0x8000210A RecordLayout_5 0 CompuMethod_2 -1E+17 1E+17 /end CHARACTERISTIC
/begin CHARACTERISTIC ETCTuneEnable "" VALUE 0x8000210E RecordLayout_1 0 CompuMethod_8 0 1 /end CHARACTERISTIC
/begin CHARACTERISTIC ETCTuneFreq "" VALUE 0x8000210F RecordLayout_5 0 CompuMethod_98 0 100 /end CHARACTERISTIC
/begin CHARACTERISTIC ETCTuneOffset "" VALUE 0x80002113 RecordLayout_5 0 CompuMethod_2 -1E+17 1E+17 /end CHARACTERISTIC
/begin CHARACTERISTIC ETCUprLim "Upper Limit Value" VALUE 0x80002117 RecordLayout_5 0 CompuMethod_7 -1E+17 1E+17 /end CHARACTERISTIC
/begin CHARACTERISTIC Ethanol_SpkOfstMultMap "Multiplier on ECT spark offset table." MAP 0x8000211B RecordLayout_5 0 CompuMethod_32 -1E+17 1E+17
 /begin AXIS_DESCR COM_AXIS RPM09In CompuMethod_71 9 0 14000 AXIS_PTS_REF RPM09IdxArr /end AXIS_DESCR
 /begin AXIS_DESCR COM_AXIS MAP09In CompuMethod_16 9 0 1000 AXIS_PTS_REF MAP09IdxArr /end AXIS_DESCR
/end CHARACTERISTIC
/begin CHARACTERISTIC EthSpkModTbl "Spark advance as a function of ethanol %" CURVE 0x8000225F RecordLayout_5 0 CompuMethod_66 -1E+17 1E+17
 /begin AXIS_DESCR COM_AXIS OXY05In CompuMethod_7 5 0 100 AXIS_PTS_REF OXY05IdxArr /end AXIS_DESCR
/end CHARACTERISTIC
/begin CHARACTERISTIC EVAP_new "Override result of linear sensor characterization, in engineering units" VALUE 0x80002273 RecordLayout_5 0 CompuMethod_80 -1E+17 1E+17 /end CHARACTERISTIC
/begin CHARACTERISTIC EVAP_ovr "" VALUE 0x80002277 RecordLayout_1 0 CompuMethod_5 0 1 /end CHARACTERISTIC
/begin CHARACTERISTIC EVAPDefault "This is the initial default value should the sensor be in fault on key-up.  Otherwise the sensors outputs the last value prior to faulting" VALUE 0x80002278 RecordLayout_5 0 CompuMethod_80 -1E+17 1E+17 /end CHARACTERISTIC
/begin CHARACTERISTIC EVAPFiltConst "Filter time constant" VALUE 0x8000227C RecordLayout_5 0 CompuMethod_19 -1E+17 1E+17 /end CHARACTERISTIC
/begin CHARACTERISTIC EVAPMax "Maximum allowable input, indicating short or open circuit" VALUE 0x800022B4 RecordLayout_5 0 CompuMethod_21 -1E+17 1E+17 /end CHARACTERISTIC
/begin CHARACTERISTIC EVAPMin "Minimum allowable input, indicating short or open circuit" VALUE 0x800022B8 RecordLayout_5 0 CompuMethod_21 -1E+17 1E+17 /end CHARACTERISTIC
/begin CHARACTERISTIC EVAPTbl "Look up table to allownon-linear characterization of sensors" CURVE 0x800022BF RecordLayout_5 0 CompuMethod_80 -1E+17 1E+17
 /begin AXIS_DESCR COM_AXIS EVAPADC CompuMethod_21 13 -1E+17 1E+17 AXIS_PTS_REF EVAPIdxArr /end AXIS_DESCR
/end CHARACTERISTIC
/begin CHARACTERISTIC Fall_Rate "" VALUE 0x800022F3 RecordLayout_5 0 CompuMethod_2 -1E+17 1E+17 /end CHARACTERISTIC
/begin CHARACTERISTIC FAN1_PWM_new "Override result of linear sensor characterization, in engineering units" VALUE 0x800022F8 RecordLayout_5 0 CompuMethod_7 -1E+17 1E+17 /end CHARACTERISTIC
/begin CHARACTERISTIC FAN1_PWM_ovr "" VALUE 0x800022FC RecordLayout_1 0 CompuMethod_5 0 1 /end CHARACTERISTIC
/begin CHARACTERISTIC FAN1_PWMFrequency "Frequency of PWM output" VALUE 0x800022FD RecordLayout_5 0 CompuMethod_98 -1E+17 1E+17 /end CHARACTERISTIC
/begin CHARACTERISTIC FAN1_PWMGain "Scaling from engineering units to PWM duty cycle" VALUE 0x80002301 RecordLayout_5 0 CompuMethod_105 -1E+17 1E+17 /end CHARACTERISTIC
/begin CHARACTERISTIC FAN1_PWMMaxLimit "Maximum limit of PWM signal." VALUE 0x80002305 RecordLayout_5 0 CompuMethod_7 -1E+17 1E+17 /end CHARACTERISTIC
/begin CHARACTERISTIC FAN1_PWMMinLimit "Minimum limit of PWM signal." VALUE 0x80002309 RecordLayout_5 0 CompuMethod_7 -1E+17 1E+17 /end CHARACTERISTIC
/begin CHARACTERISTIC FAN1_PWMOffset "Offset from engineering units to PWM duty cycle" VALUE 0x8000230D RecordLayout_5 0 CompuMethod_7 -1E+17 1E+17 /end CHARACTERISTIC
/begin CHARACTERISTIC FAN2_PWM_new "Override result of linear sensor characterization, in engineering units" VALUE 0x80002317 RecordLayout_5 0 CompuMethod_7 -1E+17 1E+17 /end CHARACTERISTIC
/begin CHARACTERISTIC FAN2_PWM_ovr "" VALUE 0x8000231B RecordLayout_1 0 CompuMethod_5 0 1 /end CHARACTERISTIC
/begin CHARACTERISTIC FAN2_PWMFrequency "Frequency of PWM output" VALUE 0x8000231C RecordLayout_5 0 CompuMethod_98 -1E+17 1E+17 /end CHARACTERISTIC
/begin CHARACTERISTIC FAN2_PWMGain "Scaling from engineering units to PWM duty cycle" VALUE 0x80002320 RecordLayout_5 0 CompuMethod_105 -1E+17 1E+17 /end CHARACTERISTIC
/begin CHARACTERISTIC FAN2_PWMMaxLimit "Maximum limit of PWM signal." VALUE 0x80002324 RecordLayout_5 0 CompuMethod_7 -1E+17 1E+17 /end CHARACTERISTIC
/begin CHARACTERISTIC FAN2_PWMMinLimit "Minimum limit of PWM signal." VALUE 0x80002328 RecordLayout_5 0 CompuMethod_7 -1E+17 1E+17 /end CHARACTERISTIC
/begin CHARACTERISTIC FAN2_PWMOffset "Offset from engineering units to PWM duty cycle" VALUE 0x8000232C RecordLayout_5 0 CompuMethod_7 -1E+17 1E+17 /end CHARACTERISTIC
/begin CHARACTERISTIC FDR "" VALUE 0x800032C1 RecordLayout_5 0 CompuMethod_2 -1E+17 1E+17 /end CHARACTERISTIC
/begin CHARACTERISTIC Filter_Type_Selection "Filter Section For Fuel Oxygenation Sensor" VALUE 0x800032E7 RecordLayout_1 0 CompuMethod_112 0 255 /end CHARACTERISTIC
/begin CHARACTERISTIC FinalGain "Gain 4 For Moving Average Filter" VALUE 0x800032E8 RecordLayout_5 0 CompuMethod_2 -1E+17 1E+17 /end CHARACTERISTIC
/begin CHARACTERISTIC Flex_Filt "Filter time constant" VALUE 0x800032EC RecordLayout_5 0 CompuMethod_19 -1E+17 1E+17 /end CHARACTERISTIC
/begin CHARACTERISTIC Fuel_Lvl_new "Override result of linear sensor characterization, in engineering units" VALUE 0x800032F4 RecordLayout_5 0 CompuMethod_7 -1E+17 1E+17 /end CHARACTERISTIC
/begin CHARACTERISTIC Fuel_Lvl_ovr "" VALUE 0x800032F8 RecordLayout_1 0 CompuMethod_5 0 1 /end CHARACTERISTIC
/begin CHARACTERISTIC Fuel_LvlDefault "This is the initial default value should the sensor be in fault on key-up.  Otherwise the sensors outputs the last value prior to faulting" VALUE 0x800032F9 RecordLayout_5 0 CompuMethod_7 -1E+17 1E+17 /end CHARACTERISTIC
/begin CHARACTERISTIC Fuel_LvlFiltConst "Filter time constant" VALUE 0x800032FD RecordLayout_5 0 CompuMethod_19 -1E+17 1E+17 /end CHARACTERISTIC
/begin CHARACTERISTIC Fuel_LvlMax "Maximum allowable input, indicating short or open circuit" VALUE 0x80003315 RecordLayout_5 0 CompuMethod_21 -1E+17 1E+17 /end CHARACTERISTIC
/begin CHARACTERISTIC Fuel_LvlMin "Minimum allowable input, indicating short or open circuit" VALUE 0x80003319 RecordLayout_5 0 CompuMethod_21 -1E+17 1E+17 /end CHARACTERISTIC
/begin CHARACTERISTIC Fuel_LvlTbl "Look up table to allownon-linear characterization of sensors" CURVE 0x8000331D RecordLayout_5 0 CompuMethod_7 -1E+17 1E+17
 /begin AXIS_DESCR COM_AXIS Fuel_LvlADC CompuMethod_21 5 -1E+17 1E+17 AXIS_PTS_REF Fuel_LvlIdxArr /end AXIS_DESCR
/end CHARACTERISTIC
/begin CHARACTERISTIC FuelAdaptError_BankALwrLim "Lower Limit Value" VALUE 0x80003336 RecordLayout_5 0 CompuMethod_48 -1E+17 1E+17 /end CHARACTERISTIC
/begin CHARACTERISTIC FuelAdaptError_BankAUprLim "Upper Limit Value" VALUE 0x8000333A RecordLayout_5 0 CompuMethod_48 -1E+17 1E+17 /end CHARACTERISTIC
/begin CHARACTERISTIC FuelAdaptError_BankBLwrLim "Lower Limit Value" VALUE 0x8000333E RecordLayout_5 0 CompuMethod_48 -1E+17 1E+17 /end CHARACTERISTIC
/begin CHARACTERISTIC FuelAdaptError_BankBUprLim "Upper Limit Value" VALUE 0x80003342 RecordLayout_5 0 CompuMethod_48 -1E+17 1E+17 /end CHARACTERISTIC
/begin CHARACTERISTIC FuelEconomy_FilterC "Time constant for fuel economy filter" VALUE 0x8000336E RecordLayout_5 0 CompuMethod_114 0.001 100 /end CHARACTERISTIC
/begin CHARACTERISTIC FuelFlowCompMaxValue "Maximum value that can be adapted into the FuelFlowCompMap" VALUE 0x8000373E RecordLayout_5 0 CompuMethod_32 0 2 /end CHARACTERISTIC
/begin CHARACTERISTIC FuelFlowCompMaxValue_BankA "Maximum value that can be adapted into the FuelFlowCompMap" VALUE 0x80003742 RecordLayout_5 0 CompuMethod_32 0 2 /end CHARACTERISTIC
/begin CHARACTERISTIC FuelFlowCompMinValue "Minimum value that can be adapted into the FuelFlowCompMap" VALUE 0x80003746 RecordLayout_5 0 CompuMethod_32 0 2 /end CHARACTERISTIC
/begin CHARACTERISTIC FuelFlowCompMinValue_BankA "Minimum value that can be adapted into the FuelFlowCompMap" VALUE 0x8000374A RecordLayout_5 0 CompuMethod_32 0 2 /end CHARACTERISTIC
/begin CHARACTERISTIC FuelLevel_FiltConstMap "FuelLevel_FiltConst" MAP 0x8000376A RecordLayout_5 0 CompuMethod_19 0 1E+17
 /begin AXIS_DESCR COM_AXIS FuelLevel_FiltConstColIn CompuMethod_115 7 0 1E+17 AXIS_PTS_REF FuelLevel_FiltConstColIdxArr /end AXIS_DESCR
 /begin AXIS_DESCR COM_AXIS FuelLevel_FiltConstRowIn CompuMethod_19 7 0 1E+17 AXIS_PTS_REF FuelLevel_FiltConstRowIdxArr /end AXIS_DESCR
/end CHARACTERISTIC
/begin CHARACTERISTIC FuelLevel_FuelEevntAlpha "Fuel event alpha" VALUE 0x8000384A RecordLayout_5 0 CompuMethod_116 0 1E+17 /end CHARACTERISTIC
/begin CHARACTERISTIC FuelLevel_KeyUpDelay "Fuel level time from key on delay" VALUE 0x8000384E RecordLayout_5 0 CompuMethod_19 0 1E+17 /end CHARACTERISTIC
/begin CHARACTERISTIC FuelLevl_KeyUpDiff "Fuel level key up different for refuel event" VALUE 0x80003852 RecordLayout_5 0 CompuMethod_7 0 1E+17 /end CHARACTERISTIC
/begin CHARACTERISTIC FUELP_new "Override actuator, in engineering units" VALUE 0x80003859 RecordLayout_1 0 CompuMethod_4 0 1 /end CHARACTERISTIC
/begin CHARACTERISTIC FUELP_ovr "" VALUE 0x8000385A RecordLayout_1 0 CompuMethod_5 0 1 /end CHARACTERISTIC
/begin CHARACTERISTIC FUELP_Polarity "Inverts the output of the actuator relative to the desired command - 0 = High True    1 = Low True" VALUE 0x8000385B RecordLayout_1 0 CompuMethod_4 0 1 /end CHARACTERISTIC
/begin CHARACTERISTIC FuelPres_DeltaTarget "Target fuel pressure delta across injector (rail - manifold)" VALUE 0x8000385C RecordLayout_5 0 CompuMethod_16 -1E+17 1E+17 /end CHARACTERISTIC
/begin CHARACTERISTIC FuelPres_DeltaTolerance "Target fuel pressure delta across injector (rail - manifold)" VALUE 0x80003860 RecordLayout_5 0 CompuMethod_16 -1E+17 1E+17 /end CHARACTERISTIC
/begin CHARACTERISTIC FuelPres_Filt "Filter time constant" VALUE 0x80003864 RecordLayout_5 0 CompuMethod_19 -1E+17 1E+17 /end CHARACTERISTIC
/begin CHARACTERISTIC FuelPres_new "Override result of linear sensor characterization, in engineering units" VALUE 0x80003868 RecordLayout_5 0 CompuMethod_14 -1E+17 1E+17 /end CHARACTERISTIC
/begin CHARACTERISTIC FuelPres_ovr "" VALUE 0x8000386C RecordLayout_1 0 CompuMethod_5 0 1 /end CHARACTERISTIC
/begin CHARACTERISTIC FuelPresDfltValue "This is the initial default value should the sensor be in fault on key-up.  Otherwise the sensors outputs the last value prior to faulting" VALUE 0x8000386D RecordLayout_5 0 CompuMethod_14 -1E+17 1E+17 /end CHARACTERISTIC
/begin CHARACTERISTIC FuelPresFilterConst "Filter time constant" VALUE 0x80003871 RecordLayout_5 0 CompuMethod_19 -1E+17 1E+17 /end CHARACTERISTIC
/begin CHARACTERISTIC FuelPresGain "Scaling from A/D counts to engineering units" VALUE 0x80003875 RecordLayout_5 0 CompuMethod_20 -1E+17 1E+17 /end CHARACTERISTIC
/begin CHARACTERISTIC FuelPresInputHiFltPos "Maximum allowable input, indicating short or open circuit" VALUE 0x80003879 RecordLayout_5 0 CompuMethod_21 -1E+17 1E+17 /end CHARACTERISTIC
/begin CHARACTERISTIC FuelPresInputLoFltPos "Minimum allowable input, indicating short or open circuit" VALUE 0x8000387D RecordLayout_5 0 CompuMethod_21 -1E+17 1E+17 /end CHARACTERISTIC
/begin CHARACTERISTIC FuelPresOfst "Offset after gain in engineering units" VALUE 0x80003881 RecordLayout_5 0 CompuMethod_14 -1E+17 1E+17 /end CHARACTERISTIC
/begin CHARACTERISTIC FuelSens_new "Override result of linear sensor characterization, in engineering units" VALUE 0x80003892 RecordLayout_5 0 CompuMethod_7 -1E+17 1E+17 /end CHARACTERISTIC
/begin CHARACTERISTIC FuelSens_ovr "" VALUE 0x80003896 RecordLayout_1 0 CompuMethod_5 0 1 /end CHARACTERISTIC
/begin CHARACTERISTIC FuelSensDfltValue "This is the initial default value should the sensor be in fault on key-up.  Otherwise the sensors outputs the last value prior to faulting" VALUE 0x80003897 RecordLayout_5 0 CompuMethod_7 -1E+17 1E+17 /end CHARACTERISTIC
/begin CHARACTERISTIC FuelSensFilterConst "Filter time constant" VALUE 0x8000389B RecordLayout_5 0 CompuMethod_19 -1E+17 1E+17 /end CHARACTERISTIC
/begin CHARACTERISTIC FuelSensGain "Scaling from A/D counts to engineering units" VALUE 0x8000389F RecordLayout_5 0 CompuMethod_119 -1E+17 1E+17 /end CHARACTERISTIC
/begin CHARACTERISTIC FuelSensInputHiFltPos "Maximum allowable input, indicating short or open circuit" VALUE 0x800038A3 RecordLayout_5 0 CompuMethod_98 -1E+17 1E+17 /end CHARACTERISTIC
/begin CHARACTERISTIC FuelSensInputLoFltPos "Minimum allowable input, indicating short or open circuit" VALUE 0x800038A7 RecordLayout_5 0 CompuMethod_98 -1E+17 1E+17 /end CHARACTERISTIC
/begin CHARACTERISTIC FuelSensOfst "Offset after gain in engineering units" VALUE 0x800038AB RecordLayout_5 0 CompuMethod_7 -1E+17 1E+17 /end CHARACTERISTIC
/begin CHARACTERISTIC FuelSensorPin_AliasProtect "Frequency input alias detection for FuelSensorPin" VALUE 0x800038B1 RecordLayout_1 0 CompuMethod_121 0 1 /end CHARACTERISTIC
/begin CHARACTERISTIC FuelSensorPin_EdgeDetect "Frequency input edge trigger for FuelSensorPin" VALUE 0x800038B2 RecordLayout_1 0 CompuMethod_83 0 1 /end CHARACTERISTIC
/begin CHARACTERISTIC FuelSensorPin_Interface "Frequency input signal interface for FuelSensorPin" VALUE 0x800038B3 RecordLayout_1 0 CompuMethod_122 0 1 /end CHARACTERISTIC
/begin CHARACTERISTIC FuelSensorPin_MinFrequency "Minimum expected input frequency for FuelSensorPin" VALUE 0x800038B4 RecordLayout_3 0 CompuMethod_123 0.01 10000 /end CHARACTERISTIC
/begin CHARACTERISTIC Gain1 "Gain 1 For Moving Average Filter" VALUE 0x800038B8 RecordLayout_5 0 CompuMethod_2 -1E+17 1E+17 /end CHARACTERISTIC
/begin CHARACTERISTIC Gain2 "Gain 2 For Moving Average Filter" VALUE 0x800038BC RecordLayout_5 0 CompuMethod_2 -1E+17 1E+17 /end CHARACTERISTIC
/begin CHARACTERISTIC Gain3 "Gain 3 For Moving Average Filter" VALUE 0x800038C0 RecordLayout_5 0 CompuMethod_2 -1E+17 1E+17 /end CHARACTERISTIC
/begin CHARACTERISTIC Gear1Ratio "" VALUE 0x800038C4 RecordLayout_5 0 CompuMethod_2 -1E+17 1E+17 /end CHARACTERISTIC
/begin CHARACTERISTIC Gear2Ratio "" VALUE 0x800038C8 RecordLayout_5 0 CompuMethod_2 -1E+17 1E+17 /end CHARACTERISTIC
/begin CHARACTERISTIC Gear3Ratio "" VALUE 0x800038CC RecordLayout_5 0 CompuMethod_2 -1E+17 1E+17 /end CHARACTERISTIC
/begin CHARACTERISTIC Gear4Ratio "" VALUE 0x800038D0 RecordLayout_5 0 CompuMethod_2 -1E+17 1E+17 /end CHARACTERISTIC
/begin CHARACTERISTIC Gear5Ratio "" VALUE 0x800038D4 RecordLayout_5 0 CompuMethod_2 -1E+17 1E+17 /end CHARACTERISTIC
/begin CHARACTERISTIC Gear6Ratio "" VALUE 0x800038D8 RecordLayout_5 0 CompuMethod_2 -1E+17 1E+17 /end CHARACTERISTIC
/begin CHARACTERISTIC GearMatchHyst "" VALUE 0x800038DC RecordLayout_5 0 CompuMethod_2 -1E+17 1E+17 /end CHARACTERISTIC
/begin CHARACTERISTIC GPS_DateTime_Timeout "" VALUE 0x800038E0 RecordLayout_4 0 CompuMethod_124 0 65535 /end CHARACTERISTIC
/begin CHARACTERISTIC GPS_LatLong_Timeout "" VALUE 0x800038E2 RecordLayout_4 0 CompuMethod_124 0 65535 /end CHARACTERISTIC
/begin CHARACTERISTIC GPS_SpeedDir_Timeout "" VALUE 0x800038E4 RecordLayout_4 0 CompuMethod_124 0 65535 /end CHARACTERISTIC
/begin CHARACTERISTIC HardCycle1Cyl1 "" VALUE 0x800038E6 RecordLayout_8 0 CompuMethod_125 -128 127 /end CHARACTERISTIC
/begin CHARACTERISTIC HardCycle1Cyl2 "" VALUE 0x800038E7 RecordLayout_8 0 CompuMethod_125 -128 127 /end CHARACTERISTIC
/begin CHARACTERISTIC HardCycle1Cyl3 "" VALUE 0x800038E8 RecordLayout_8 0 CompuMethod_125 -128 127 /end CHARACTERISTIC
/begin CHARACTERISTIC HardCycle1Cyl4 "" VALUE 0x800038E9 RecordLayout_8 0 CompuMethod_125 -128 127 /end CHARACTERISTIC
/begin CHARACTERISTIC HardCycle1Cyl5 "" VALUE 0x800038EA RecordLayout_8 0 CompuMethod_125 -128 127 /end CHARACTERISTIC
/begin CHARACTERISTIC HardCycle1Cyl6 "" VALUE 0x800038EB RecordLayout_8 0 CompuMethod_125 -128 127 /end CHARACTERISTIC
/begin CHARACTERISTIC HardCycle1Cyl7 "" VALUE 0x800038EC RecordLayout_8 0 CompuMethod_125 -128 127 /end CHARACTERISTIC
/begin CHARACTERISTIC HardCycle1Cyl8 "" VALUE 0x800038ED RecordLayout_8 0 CompuMethod_125 -128 127 /end CHARACTERISTIC
/begin CHARACTERISTIC HardCycle2Cyl1 "" VALUE 0x800038EE RecordLayout_8 0 CompuMethod_125 -128 127 /end CHARACTERISTIC
/begin CHARACTERISTIC HardCycle2Cyl2 "" VALUE 0x800038EF RecordLayout_8 0 CompuMethod_125 -128 127 /end CHARACTERISTIC
/begin CHARACTERISTIC HardCycle2Cyl3 "" VALUE 0x800038F0 RecordLayout_8 0 CompuMethod_125 -128 127 /end CHARACTERISTIC
/begin CHARACTERISTIC HardCycle2Cyl4 "" VALUE 0x800038F1 RecordLayout_8 0 CompuMethod_125 -128 127 /end CHARACTERISTIC
/begin CHARACTERISTIC HardCycle2Cyl5 "" VALUE 0x800038F2 RecordLayout_8 0 CompuMethod_125 -128 127 /end CHARACTERISTIC
/begin CHARACTERISTIC HardCycle2Cyl6 "" VALUE 0x800038F3 RecordLayout_8 0 CompuMethod_125 -128 127 /end CHARACTERISTIC
/begin CHARACTERISTIC HardCycle2Cyl7 "" VALUE 0x800038F4 RecordLayout_8 0 CompuMethod_125 -128 127 /end CHARACTERISTIC
/begin CHARACTERISTIC HardCycle2Cyl8 "" VALUE 0x800038F5 RecordLayout_8 0 CompuMethod_125 -128 127 /end CHARACTERISTIC
/begin CHARACTERISTIC HardCycle3Cyl1 "" VALUE 0x800038F6 RecordLayout_8 0 CompuMethod_125 -128 127 /end CHARACTERISTIC
/begin CHARACTERISTIC HardCycle3Cyl2 "" VALUE 0x800038F7 RecordLayout_8 0 CompuMethod_125 -128 127 /end CHARACTERISTIC
/begin CHARACTERISTIC HardCycle3Cyl3 "" VALUE 0x800038F8 RecordLayout_8 0 CompuMethod_125 -128 127 /end CHARACTERISTIC
/begin CHARACTERISTIC HardCycle3Cyl4 "" VALUE 0x800038F9 RecordLayout_8 0 CompuMethod_125 -128 127 /end CHARACTERISTIC
/begin CHARACTERISTIC HardCycle3Cyl5 "" VALUE 0x800038FA RecordLayout_8 0 CompuMethod_125 -128 127 /end CHARACTERISTIC
/begin CHARACTERISTIC HardCycle3Cyl6 "" VALUE 0x800038FB RecordLayout_8 0 CompuMethod_125 -128 127 /end CHARACTERISTIC
/begin CHARACTERISTIC HardCycle3Cyl7 "" VALUE 0x800038FC RecordLayout_8 0 CompuMethod_125 -128 127 /end CHARACTERISTIC
/begin CHARACTERISTIC HardCycle3Cyl8 "" VALUE 0x800038FD RecordLayout_8 0 CompuMethod_125 -128 127 /end CHARACTERISTIC
/begin CHARACTERISTIC HardCycle4Cyl1 "" VALUE 0x800038FE RecordLayout_8 0 CompuMethod_125 -128 127 /end CHARACTERISTIC
/begin CHARACTERISTIC HardCycle4Cyl2 "" VALUE 0x800038FF RecordLayout_8 0 CompuMethod_125 -128 127 /end CHARACTERISTIC
/begin CHARACTERISTIC HardCycle4Cyl3 "" VALUE 0x80003900 RecordLayout_8 0 CompuMethod_125 -128 127 /end CHARACTERISTIC
/begin CHARACTERISTIC HardCycle4Cyl4 "" VALUE 0x80003901 RecordLayout_8 0 CompuMethod_125 -128 127 /end CHARACTERISTIC
/begin CHARACTERISTIC HardCycle4Cyl5 "" VALUE 0x80003902 RecordLayout_8 0 CompuMethod_125 -128 127 /end CHARACTERISTIC
/begin CHARACTERISTIC HardCycle4Cyl6 "" VALUE 0x80003903 RecordLayout_8 0 CompuMethod_125 -128 127 /end CHARACTERISTIC
/begin CHARACTERISTIC HardCycle4Cyl7 "" VALUE 0x80003904 RecordLayout_8 0 CompuMethod_125 -128 127 /end CHARACTERISTIC
/begin CHARACTERISTIC HardCycle4Cyl8 "" VALUE 0x80003905 RecordLayout_8 0 CompuMethod_125 -128 127 /end CHARACTERISTIC
/begin CHARACTERISTIC IAT_KeyUp_Count "Number of samples to average at key-up to produce signal value" VALUE 0x8000390B RecordLayout_8 0 CompuMethod_1 -128 127 /end CHARACTERISTIC
/begin CHARACTERISTIC IAT_new "Override result of linear sensor characterization, in engineering units" VALUE 0x80003930 RecordLayout_5 0 CompuMethod_80 -1E+17 1E+17 /end CHARACTERISTIC
/begin CHARACTERISTIC IAT_ovr "" VALUE 0x80003934 RecordLayout_1 0 CompuMethod_5 0 1 /end CHARACTERISTIC
/begin CHARACTERISTIC IATDefault "This is the initial default value should the sensor be in fault on key-up.  Otherwise the sensors outputs the last value prior to faulting" VALUE 0x80003B01 RecordLayout_5 0 CompuMethod_80 -1E+17 1E+17 /end CHARACTERISTIC
/begin CHARACTERISTIC IATFiltConst "Filter time constant" VALUE 0x80003BE5 RecordLayout_5 0 CompuMethod_19 -1E+17 1E+17 /end CHARACTERISTIC
/begin CHARACTERISTIC IATMax "Maximum allowable input, indicating short or open circuit" VALUE 0x80003C1D RecordLayout_5 0 CompuMethod_21 -1E+17 1E+17 /end CHARACTERISTIC
/begin CHARACTERISTIC IATMin "Minimum allowable input, indicating short or open circuit" VALUE 0x80003C21 RecordLayout_5 0 CompuMethod_21 -1E+17 1E+17 /end CHARACTERISTIC
/begin CHARACTERISTIC IATTbl "Look up table to allownon-linear characterization of sensors" CURVE 0x80003C28 RecordLayout_5 0 CompuMethod_80 -1E+17 1E+17
 /begin AXIS_DESCR COM_AXIS IATADC CompuMethod_21 13 -1E+17 1E+17 AXIS_PTS_REF IATIdxArr /end AXIS_DESCR
/end CHARACTERISTIC
/begin CHARACTERISTIC IdleEntryAirRampInFiltC "Decays TPS Setpoint from Crank TPS to Run State base value at this rate." VALUE 0x80003C60 RecordLayout_5 0 CompuMethod_19 0.005 1E+17 /end CHARACTERISTIC
/begin CHARACTERISTIC InGearRPMCtrlEntryFiltC "Sets decay rate of RPM setpoint from entry RPM." VALUE 0x80003C6C RecordLayout_5 0 CompuMethod_19 0.005 1E+17 /end CHARACTERISTIC
/begin CHARACTERISTIC InjdPCompTbl "Injector characterization compenastion based on dP across injector." CURVE 0x80003C98 RecordLayout_5 0 CompuMethod_132 -1E+17 1E+17
 /begin AXIS_DESCR COM_AXIS InjDeltaPress09In CompuMethod_2 9 -1E+17 1E+17 AXIS_PTS_REF InjDeltaPress09IdxArr /end AXIS_DESCR
/end CHARACTERISTIC
/begin CHARACTERISTIC InjEnable_new "" VAL_BLK 0x80003CCC RecordLayout_1 0 CompuMethod_11 0 1 MATRIX_DIM 8 1 1 /end CHARACTERISTIC
/begin CHARACTERISTIC InjEnable_ovr "" VALUE 0x80003CD4 RecordLayout_1 0 CompuMethod_5 0 1 /end CHARACTERISTIC
/begin CHARACTERISTIC InjGain "Gain value used in the linear transformation of FPC to mechanical pulsewidth." VALUE 0x80003CD5 RecordLayout_5 0 CompuMethod_133 0 1E+17 /end CHARACTERISTIC
/begin CHARACTERISTIC InjOffset "Offset value used in the linear transformation of FPC to mechanical pulsewidth." VALUE 0x80003CD9 RecordLayout_5 0 CompuMethod_134 -1E+17 1E+17 /end CHARACTERISTIC
/begin CHARACTERISTIC InjTurnOffTbl "Injector turn off time" CURVE 0x80003CDD RecordLayout_5 0 CompuMethod_64 -1E+17 1E+17
 /begin AXIS_DESCR COM_AXIS InjDeltaPress09In CompuMethod_2 9 -1E+17 1E+17 AXIS_PTS_REF InjDeltaPress09IdxArr /end AXIS_DESCR
/end CHARACTERISTIC
/begin CHARACTERISTIC InjTurnOnTbl "Injector turn on time." CURVE 0x80003D01 RecordLayout_5 0 CompuMethod_64 -1E+17 1E+17
 /begin AXIS_DESCR COM_AXIS SysVolt09In CompuMethod_164 9 0 32 AXIS_PTS_REF SysVolt09IdxArr /end AXIS_DESCR
/end CHARACTERISTIC
/begin CHARACTERISTIC Lambda1_VoltHighThresh "" VALUE 0x80003D8F RecordLayout_5 0 CompuMethod_2 -1E+17 1E+17 /end CHARACTERISTIC
/begin CHARACTERISTIC Lambda1_VoltLowThresh "" VALUE 0x80003D93 RecordLayout_5 0 CompuMethod_2 -1E+17 1E+17 /end CHARACTERISTIC
/begin CHARACTERISTIC Lambda2_VoltHighThresh "" VALUE 0x80003D97 RecordLayout_5 0 CompuMethod_2 -1E+17 1E+17 /end CHARACTERISTIC
/begin CHARACTERISTIC Lambda2_VoltLowThresh "" VALUE 0x80003D9B RecordLayout_5 0 CompuMethod_2 -1E+17 1E+17 /end CHARACTERISTIC
/begin CHARACTERISTIC LeanProtect_Threshold "Target fuel pressure delta across injector (rail - manifold)" VALUE 0x80003D9F RecordLayout_5 0 CompuMethod_16 -1E+17 1E+17 /end CHARACTERISTIC
/begin CHARACTERISTIC LeanSwPtDeltaMap "If actual O2 reaches this point, switch the target to the RichTargetDelta" MAP 0x80003DA3 RecordLayout_5 0 CompuMethod_42 -1E+17 1E+17
 /begin AXIS_DESCR COM_AXIS RPM09In CompuMethod_71 9 0 14000 AXIS_PTS_REF RPM09IdxArr /end AXIS_DESCR
 /begin AXIS_DESCR COM_AXIS MAP09In CompuMethod_16 9 0 1000 AXIS_PTS_REF MAP09IdxArr /end AXIS_DESCR
/end CHARACTERISTIC
/begin CHARACTERISTIC LeanTargetDeltaMap "Target on the lean side for perturbation." MAP 0x80003EE7 RecordLayout_5 0 CompuMethod_42 -1E+17 1E+17
 /begin AXIS_DESCR COM_AXIS RPM09In CompuMethod_71 9 0 14000 AXIS_PTS_REF RPM09IdxArr /end AXIS_DESCR
 /begin AXIS_DESCR COM_AXIS MAP09In CompuMethod_16 9 0 1000 AXIS_PTS_REF MAP09IdxArr /end AXIS_DESCR
/end CHARACTERISTIC
/begin CHARACTERISTIC LVDiag_AltInop "" VALUE 0x8000402B RecordLayout_5 0 CompuMethod_2 -1E+17 1E+17 /end CHARACTERISTIC
/begin CHARACTERISTIC LVDiag_VoltLow "" VALUE 0x8000402F RecordLayout_5 0 CompuMethod_2 -1E+17 1E+17 /end CHARACTERISTIC
/begin CHARACTERISTIC LVDiag_VoltTooHigh "" VALUE 0x80004033 RecordLayout_5 0 CompuMethod_2 -1E+17 1E+17 /end CHARACTERISTIC
/begin CHARACTERISTIC MAF_new "Override result of linear sensor characterization, in engineering units" VALUE 0x80004037 RecordLayout_5 0 CompuMethod_29 -1E+17 1E+17 /end CHARACTERISTIC
/begin CHARACTERISTIC MAF_ovr "" VALUE 0x8000403B RecordLayout_1 0 CompuMethod_5 0 1 /end CHARACTERISTIC
/begin CHARACTERISTIC MAF_Pin_AliasProtect "Frequency input alias detection for MAF_Pin" VALUE 0x8000403E RecordLayout_1 0 CompuMethod_121 0 1 /end CHARACTERISTIC
/begin CHARACTERISTIC MAF_Pin_EdgeDetect "Frequency input edge trigger for MAF_Pin" VALUE 0x8000403F RecordLayout_1 0 CompuMethod_83 0 1 /end CHARACTERISTIC
/begin CHARACTERISTIC MAF_Pin_Interface "Frequency input signal interface for MAF_Pin" VALUE 0x80004040 RecordLayout_1 0 CompuMethod_122 0 1 /end CHARACTERISTIC
/begin CHARACTERISTIC MAF_Pin_MinFrequency "Minimum expected input frequency for MAF_Pin" VALUE 0x80004041 RecordLayout_3 0 CompuMethod_123 0.01 10000 /end CHARACTERISTIC
/begin CHARACTERISTIC MAFDefault "This is the initial default value should the sensor be in fault on key-up.  Otherwise the sensors outputs the last value prior to faulting" VALUE 0x8000406A RecordLayout_5 0 CompuMethod_29 -1E+17 1E+17 /end CHARACTERISTIC
/begin CHARACTERISTIC MAFFiltConst "Filter time constant" VALUE 0x8000406E RecordLayout_5 0 CompuMethod_19 -1E+17 1E+17 /end CHARACTERISTIC
/begin CHARACTERISTIC MAFMax "Maximum allowable input, indicating short or open circuit" VALUE 0x800040A6 RecordLayout_5 0 CompuMethod_98 -1E+17 1E+17 /end CHARACTERISTIC
/begin CHARACTERISTIC MAFMin "Minimum allowable input, indicating short or open circuit" VALUE 0x800040AA RecordLayout_5 0 CompuMethod_98 -1E+17 1E+17 /end CHARACTERISTIC
/begin CHARACTERISTIC MAFTbl "Look up table to allownon-linear characterization of sensors" CURVE 0x800040C2 RecordLayout_5 0 CompuMethod_29 -1E+17 1E+17
 /begin AXIS_DESCR COM_AXIS MAFADC CompuMethod_98 13 -1E+17 1E+17 AXIS_PTS_REF MAFIdxArr /end AXIS_DESCR
/end CHARACTERISTIC
/begin CHARACTERISTIC MakeUp_EOI_new "" VALUE 0x800040F6 RecordLayout_5 0 CompuMethod_2 -1E+17 1E+17 /end CHARACTERISTIC
/begin CHARACTERISTIC MakeUp_EOI_ovr "" VALUE 0x800040FA RecordLayout_1 0 CompuMethod_5 0 1 /end CHARACTERISTIC
/begin CHARACTERISTIC MAP_filt "Filter time constant" VALUE 0x8000423F RecordLayout_5 0 CompuMethod_19 -1E+17 1E+17 /end CHARACTERISTIC
/begin CHARACTERISTIC MAP_IR_HI "In-range MAP fault logic. Maximum value that MAP should not exceed with closed throttle and engine running" VALUE 0x80004243 RecordLayout_5 0 CompuMethod_16 0 1E+17 /end CHARACTERISTIC
/begin CHARACTERISTIC MAP_IR_LO "In-range MAP fault logic. Minimum value that MAP should not be less than with open throttle and engine running" VALUE 0x80004247 RecordLayout_5 0 CompuMethod_16 0 1E+17 /end CHARACTERISTIC
/begin CHARACTERISTIC MAP_IR_TPS_CL "In-range MAP fault logic.  Maximum throttle position, below which MAP should be less than MAP_IR_HI" VALUE 0x8000424B RecordLayout_5 0 CompuMethod_7 0 1E+17 /end CHARACTERISTIC
/begin CHARACTERISTIC MAP_IR_TPS_OP "In-range MAP fault logic.  Minimum throttle position, above which MAP should be greater than MAP_IR_LO" VALUE 0x8000424F RecordLayout_5 0 CompuMethod_7 0 1E+17 /end CHARACTERISTIC
/begin CHARACTERISTIC MAP_new "Override result of linear sensor characterization, in engineering units" VALUE 0x80004253 RecordLayout_5 0 CompuMethod_16 -1E+17 1E+17 /end CHARACTERISTIC
/begin CHARACTERISTIC MAP_ovr "" VALUE 0x80004257 RecordLayout_1 0 CompuMethod_5 0 1 /end CHARACTERISTIC
/begin CHARACTERISTIC MAP_STUCK "In-range MAP fault logic.  Minimum difference between MAP and BARO with throttle closed. If less than this, a fault exists" VALUE 0x80004258 RecordLayout_5 0 CompuMethod_16 0 1E+17 /end CHARACTERISTIC
/begin CHARACTERISTIC MAP_TPS_STUCK "In-range MAP fault logic.  Maximum throttle position, below_which MAP should be less than BARO" VALUE 0x8000425C RecordLayout_5 0 CompuMethod_7 0 1E+17 /end CHARACTERISTIC
/begin CHARACTERISTIC MAPDfltValue "This is the initial default value should the sensor be in fault on key-up.  Otherwise the sensors outputs the last value prior to faulting" VALUE 0x800042DC RecordLayout_5 0 CompuMethod_16 -1E+17 1E+17 /end CHARACTERISTIC
/begin CHARACTERISTIC MAPFilterConst "Filter time constant" VALUE 0x800042E0 RecordLayout_5 0 CompuMethod_19 -1E+17 1E+17 /end CHARACTERISTIC
/begin CHARACTERISTIC MAPGain "Scaling from A/D counts to engineering units" VALUE 0x800042E4 RecordLayout_5 0 CompuMethod_138 -1E+17 1E+17 /end CHARACTERISTIC
/begin CHARACTERISTIC MAPInputHiFltPos "Maximum allowable input, indicating short or open circuit" VALUE 0x800042E8 RecordLayout_5 0 CompuMethod_21 -1E+17 1E+17 /end CHARACTERISTIC
/begin CHARACTERISTIC MAPInputLoFltPos "Minimum allowable input, indicating short or open circuit" VALUE 0x800042EC RecordLayout_5 0 CompuMethod_21 -1E+17 1E+17 /end CHARACTERISTIC
/begin CHARACTERISTIC MAPOfst "Offset after gain in engineering units" VALUE 0x800042F0 RecordLayout_5 0 CompuMethod_16 -1E+17 1E+17 /end CHARACTERISTIC
/begin CHARACTERISTIC MAPTime_new "Override result of linear sensor characterization, in engineering units" VALUE 0x800042F7 RecordLayout_5 0 CompuMethod_16 -1E+17 1E+17 /end CHARACTERISTIC
/begin CHARACTERISTIC MAPTime_ovr "" VALUE 0x800042FB RecordLayout_1 0 CompuMethod_5 0 1 /end CHARACTERISTIC
/begin CHARACTERISTIC MAPTimeDfltValue "This is the initial default value should the sensor be in fault on key-up.  Otherwise the sensors outputs the last value prior to faulting" VALUE 0x800042FC RecordLayout_5 0 CompuMethod_16 -1E+17 1E+17 /end CHARACTERISTIC
/begin CHARACTERISTIC MAPTimeFilterConst "Filter time constant" VALUE 0x80004300 RecordLayout_5 0 CompuMethod_19 -1E+17 1E+17 /end CHARACTERISTIC
/begin CHARACTERISTIC MAPTimeGain "Scaling from A/D counts to engineering units" VALUE 0x80004304 RecordLayout_5 0 CompuMethod_138 -1E+17 1E+17 /end CHARACTERISTIC
/begin CHARACTERISTIC MAPTimeInputHiFltPos "Maximum allowable input, indicating short or open circuit" VALUE 0x80004308 RecordLayout_5 0 CompuMethod_21 -1E+17 1E+17 /end CHARACTERISTIC
/begin CHARACTERISTIC MAPTimeInputLoFltPos "Minimum allowable input, indicating short or open circuit" VALUE 0x8000430C RecordLayout_5 0 CompuMethod_21 -1E+17 1E+17 /end CHARACTERISTIC
/begin CHARACTERISTIC MAPTimeOfst "Offset after gain in engineering units" VALUE 0x80004310 RecordLayout_5 0 CompuMethod_16 -1E+17 1E+17 /end CHARACTERISTIC
/begin CHARACTERISTIC MaxGovDGain "Base D-gain for the max. governor controller." VALUE 0x80004338 RecordLayout_5 0 CompuMethod_32 -1E+17 1E+17 /end CHARACTERISTIC
/begin CHARACTERISTIC MaxGovDGainErrorMultTbl "" CURVE 0x8000433C RecordLayout_5 0 CompuMethod_32 -1E+17 1E+17
 /begin AXIS_DESCR COM_AXIS MaxGovSpeedErrorIn CompuMethod_71 9 -1E+17 1E+17 AXIS_PTS_REF MaxGovSpeedErrorIdxArr /end AXIS_DESCR
/end CHARACTERISTIC
/begin CHARACTERISTIC MaxGovDisable "Max governor manual disable" VALUE 0x80004360 RecordLayout_1 0 CompuMethod_139 0 1 /end CHARACTERISTIC
/begin CHARACTERISTIC MaxGovErrorGain "Error gain for the max governor controller. This gain is applied to the RPM error term before it is used to calculate the P, I and D terms." VALUE 0x80004361 RecordLayout_5 0 CompuMethod_32 -1E+17 1E+17 /end CHARACTERISTIC
/begin CHARACTERISTIC MaxGovIGain "Base I-gain for the max. governor controller." VALUE 0x80004365 RecordLayout_5 0 CompuMethod_32 -1E+17 1E+17 /end CHARACTERISTIC
/begin CHARACTERISTIC MaxGovIGainErrorMultTbl "" CURVE 0x80004369 RecordLayout_5 0 CompuMethod_32 -1E+17 1E+17
 /begin AXIS_DESCR COM_AXIS MaxGovSpeedErrorIn CompuMethod_71 9 -1E+17 1E+17 AXIS_PTS_REF MaxGovSpeedErrorIdxArr /end AXIS_DESCR
/end CHARACTERISTIC
/begin CHARACTERISTIC MaxGovInGearLowerLim "Max Gov RPM setpoint when in gear." VALUE 0x8000438D RecordLayout_4 0 CompuMethod_24 0 65535 /end CHARACTERISTIC
/begin CHARACTERISTIC MaxGovInGearRPMSetPt "Max Gov RPM setpoint when in gear." VALUE 0x8000438F RecordLayout_4 0 CompuMethod_24 0 65535 /end CHARACTERISTIC
/begin CHARACTERISTIC MaxGovInGearRPMThresh "When in-gear, RPM has to pass the base RPM setpoint minus this calibration. to start the I term preload and ramp-in." VALUE 0x80004391 RecordLayout_4 0 CompuMethod_24 0 65535 /end CHARACTERISTIC
/begin CHARACTERISTIC MaxGovInGearUpperLim "Max Gov RPM setpoint when in gear." VALUE 0x80004393 RecordLayout_4 0 CompuMethod_24 0 65535 /end CHARACTERISTIC
/begin CHARACTERISTIC MaxGovITermLowerLimit "Lower limit on max governor I-term value." VALUE 0x80004395 RecordLayout_5 0 CompuMethod_7 -1E+17 1E+17 /end CHARACTERISTIC
/begin CHARACTERISTIC MaxGovITermUpperLimit "Upper limit on max governor I-term value." VALUE 0x80004399 RecordLayout_5 0 CompuMethod_7 -1E+17 1E+17 /end CHARACTERISTIC
/begin CHARACTERISTIC MaxGovNtrlLowerLim "Max Gov RPM setpoint when in gear." VALUE 0x8000439D RecordLayout_4 0 CompuMethod_24 0 65535 /end CHARACTERISTIC
/begin CHARACTERISTIC MaxGovNtrlRPMSetPt "Max Gov RPM setpoint when in neutral." VALUE 0x8000439F RecordLayout_4 0 CompuMethod_24 0 65535 /end CHARACTERISTIC
/begin CHARACTERISTIC MaxGovNtrlRPMThresh "When in neutral, RPM has to pass the base RPM setpoint minus this calibration. to start the I term preload and ramp-in." VALUE 0x800043A1 RecordLayout_4 0 CompuMethod_24 0 65535 /end CHARACTERISTIC
/begin CHARACTERISTIC MaxGovNtrlUpperLim "Max Gov RPM setpoint when in gear." VALUE 0x800043A3 RecordLayout_4 0 CompuMethod_24 0 65535 /end CHARACTERISTIC
/begin CHARACTERISTIC MaxGovPGain "Base P-gain for the max. governor controller." VALUE 0x800043A5 RecordLayout_5 0 CompuMethod_32 -1E+17 1E+17 /end CHARACTERISTIC
/begin CHARACTERISTIC MaxGovPGainErrorMultTbl "" CURVE 0x800043A9 RecordLayout_5 0 CompuMethod_32 -1E+17 1E+17
 /begin AXIS_DESCR COM_AXIS MaxGovSpeedErrorIn CompuMethod_71 9 -1E+17 1E+17 AXIS_PTS_REF MaxGovSpeedErrorIdxArr /end AXIS_DESCR
/end CHARACTERISTIC
/begin CHARACTERISTIC MaxGovPIDOutLowerLimit "Lower limit on max governor PID Output." VALUE 0x800043CD RecordLayout_5 0 CompuMethod_7 -1E+17 1E+17 /end CHARACTERISTIC
/begin CHARACTERISTIC MaxGovPIDOutUpperLimit "Upper limit on max governor PID Output." VALUE 0x800043D1 RecordLayout_5 0 CompuMethod_7 -1E+17 1E+17 /end CHARACTERISTIC
/begin CHARACTERISTIC MaxGovPreloadITermTbl "Preload for Max Gov PID ITerm based on engine acceleration rate upon entry into max gov." CURVE 0x800043D5 RecordLayout_5 0 CompuMethod_7 -1E+17 1E+17
 /begin AXIS_DESCR COM_AXIS RPMAccel17In CompuMethod_2 17 -1E+17 1E+17 AXIS_PTS_REF RPMAccel17IdxArr /end AXIS_DESCR
/end CHARACTERISTIC
/begin CHARACTERISTIC MaxGovRPMCtrlEntryFiltC "Filter rate at which Max Gov setup is increased to MaxGovBaseRPMSetpoint." VALUE 0x80004419 RecordLayout_5 0 CompuMethod_19 0.005 1E+17 /end CHARACTERISTIC
/begin CHARACTERISTIC MaxGovTPSHyst "Hysterisis around max gov TPS entry criteria." VALUE 0x80004441 RecordLayout_5 0 CompuMethod_7 0 1E+17 /end CHARACTERISTIC
/begin CHARACTERISTIC MaxSparkLimitOffIdle "Max. spark limit on the delivered spark advance, when not in idle control." VALUE 0x80004445 RecordLayout_5 0 CompuMethod_66 -1E+17 1E+17 /end CHARACTERISTIC
/begin CHARACTERISTIC MaxSparkLimitTbl "Maximum allowable spark advance." CURVE 0x80004449 RecordLayout_5 0 CompuMethod_66 -1E+17 1E+17
 /begin AXIS_DESCR COM_AXIS MAP09In CompuMethod_16 9 0 1000 AXIS_PTS_REF MAP09IdxArr /end AXIS_DESCR
/end CHARACTERISTIC
/begin CHARACTERISTIC Mech_PW_new "" VAL_BLK 0x8000446D RecordLayout_5 0 CompuMethod_2 -1E+17 1E+17 MATRIX_DIM 8 1 1 /end CHARACTERISTIC
/begin CHARACTERISTIC Mech_PW_ovr "" VALUE 0x8000448D RecordLayout_1 0 CompuMethod_5 0 1 /end CHARACTERISTIC
/begin CHARACTERISTIC MediumCycle1Cyl1 "" VALUE 0x8000448E RecordLayout_8 0 CompuMethod_125 -128 127 /end CHARACTERISTIC
/begin CHARACTERISTIC MediumCycle1Cyl2 "" VALUE 0x8000448F RecordLayout_8 0 CompuMethod_125 -128 127 /end CHARACTERISTIC
/begin CHARACTERISTIC MediumCycle1Cyl3 "" VALUE 0x80004490 RecordLayout_8 0 CompuMethod_125 -128 127 /end CHARACTERISTIC
/begin CHARACTERISTIC MediumCycle1Cyl4 "" VALUE 0x80004491 RecordLayout_8 0 CompuMethod_125 -128 127 /end CHARACTERISTIC
/begin CHARACTERISTIC MediumCycle1Cyl5 "" VALUE 0x80004492 RecordLayout_8 0 CompuMethod_125 -128 127 /end CHARACTERISTIC
/begin CHARACTERISTIC MediumCycle1Cyl6 "" VALUE 0x80004493 RecordLayout_8 0 CompuMethod_125 -128 127 /end CHARACTERISTIC
/begin CHARACTERISTIC MediumCycle1Cyl7 "" VALUE 0x80004494 RecordLayout_8 0 CompuMethod_125 -128 127 /end CHARACTERISTIC
/begin CHARACTERISTIC MediumCycle1Cyl8 "" VALUE 0x80004495 RecordLayout_8 0 CompuMethod_125 -128 127 /end CHARACTERISTIC
/begin CHARACTERISTIC MediumCycle2Cyl1 "" VALUE 0x80004496 RecordLayout_8 0 CompuMethod_125 -128 127 /end CHARACTERISTIC
/begin CHARACTERISTIC MediumCycle2Cyl2 "" VALUE 0x80004497 RecordLayout_8 0 CompuMethod_125 -128 127 /end CHARACTERISTIC
/begin CHARACTERISTIC MediumCycle2Cyl3 "" VALUE 0x80004498 RecordLayout_8 0 CompuMethod_125 -128 127 /end CHARACTERISTIC
/begin CHARACTERISTIC MediumCycle2Cyl4 "" VALUE 0x80004499 RecordLayout_8 0 CompuMethod_125 -128 127 /end CHARACTERISTIC
/begin CHARACTERISTIC MediumCycle2Cyl5 "" VALUE 0x8000449A RecordLayout_8 0 CompuMethod_125 -128 127 /end CHARACTERISTIC
/begin CHARACTERISTIC MediumCycle2Cyl6 "" VALUE 0x8000449B RecordLayout_8 0 CompuMethod_125 -128 127 /end CHARACTERISTIC
/begin CHARACTERISTIC MediumCycle2Cyl7 "" VALUE 0x8000449C RecordLayout_8 0 CompuMethod_125 -128 127 /end CHARACTERISTIC
/begin CHARACTERISTIC MediumCycle2Cyl8 "" VALUE 0x8000449D RecordLayout_8 0 CompuMethod_125 -128 127 /end CHARACTERISTIC
/begin CHARACTERISTIC MediumCycle3Cyl1 "" VALUE 0x8000449E RecordLayout_8 0 CompuMethod_125 -128 127 /end CHARACTERISTIC
/begin CHARACTERISTIC MediumCycle3Cyl2 "" VALUE 0x8000449F RecordLayout_8 0 CompuMethod_125 -128 127 /end CHARACTERISTIC
/begin CHARACTERISTIC MediumCycle3Cyl3 "" VALUE 0x800044A0 RecordLayout_8 0 CompuMethod_125 -128 127 /end CHARACTERISTIC
/begin CHARACTERISTIC MediumCycle3Cyl4 "" VALUE 0x800044A1 RecordLayout_8 0 CompuMethod_125 -128 127 /end CHARACTERISTIC
/begin CHARACTERISTIC MediumCycle3Cyl5 "" VALUE 0x800044A2 RecordLayout_8 0 CompuMethod_125 -128 127 /end CHARACTERISTIC
/begin CHARACTERISTIC MediumCycle3Cyl6 "" VALUE 0x800044A3 RecordLayout_8 0 CompuMethod_125 -128 127 /end CHARACTERISTIC
/begin CHARACTERISTIC MediumCycle3Cyl7 "" VALUE 0x800044A4 RecordLayout_8 0 CompuMethod_125 -128 127 /end CHARACTERISTIC
/begin CHARACTERISTIC MediumCycle3Cyl8 "" VALUE 0x800044A5 RecordLayout_8 0 CompuMethod_125 -128 127 /end CHARACTERISTIC
/begin CHARACTERISTIC MediumCycle4Cyl1 "" VALUE 0x800044A6 RecordLayout_8 0 CompuMethod_125 -128 127 /end CHARACTERISTIC
/begin CHARACTERISTIC MediumCycle4Cyl2 "" VALUE 0x800044A7 RecordLayout_8 0 CompuMethod_125 -128 127 /end CHARACTERISTIC
/begin CHARACTERISTIC MediumCycle4Cyl3 "" VALUE 0x800044A8 RecordLayout_8 0 CompuMethod_125 -128 127 /end CHARACTERISTIC
/begin CHARACTERISTIC MediumCycle4Cyl4 "" VALUE 0x800044A9 RecordLayout_8 0 CompuMethod_125 -128 127 /end CHARACTERISTIC
/begin CHARACTERISTIC MediumCycle4Cyl5 "" VALUE 0x800044AA RecordLayout_8 0 CompuMethod_125 -128 127 /end CHARACTERISTIC
/begin CHARACTERISTIC MediumCycle4Cyl6 "" VALUE 0x800044AB RecordLayout_8 0 CompuMethod_125 -128 127 /end CHARACTERISTIC
/begin CHARACTERISTIC MediumCycle4Cyl7 "" VALUE 0x800044AC RecordLayout_8 0 CompuMethod_125 -128 127 /end CHARACTERISTIC
/begin CHARACTERISTIC MediumCycle4Cyl8 "" VALUE 0x800044AD RecordLayout_8 0 CompuMethod_125 -128 127 /end CHARACTERISTIC
/begin CHARACTERISTIC MinGovClntRPMSetPtTbl "RPM setpoint based on ECT." CURVE 0x800044D8 RecordLayout_6 0 CompuMethod_24 -32768 32767
 /begin AXIS_DESCR COM_AXIS ECT05In CompuMethod_57 5 -40 200 AXIS_PTS_REF ECT05IdxArr /end AXIS_DESCR
/end CHARACTERISTIC
/begin CHARACTERISTIC MinOilPressure_FaultTbl "Minimum oil pressure based on RPM - engine faults and shuts down below this" CURVE 0x800044EE RecordLayout_5 0 CompuMethod_143 -1E+17 1E+17
 /begin AXIS_DESCR COM_AXIS RPM09In CompuMethod_71 9 0 14000 AXIS_PTS_REF RPM09IdxArr /end AXIS_DESCR
/end CHARACTERISTIC
/begin CHARACTERISTIC MinOilPressure_WarnTbl "Minimum oil pressure based on RPM - indicator light comes on below this" CURVE 0x80004512 RecordLayout_5 0 CompuMethod_143 -1E+17 1E+17
 /begin AXIS_DESCR COM_AXIS RPM09In CompuMethod_71 9 0 14000 AXIS_PTS_REF RPM09IdxArr /end AXIS_DESCR
/end CHARACTERISTIC
/begin CHARACTERISTIC MinSparkLimit "Min. spark limit on the delivered spark advance." VALUE 0x80004536 RecordLayout_5 0 CompuMethod_66 -1E+17 1E+17 /end CHARACTERISTIC
/begin CHARACTERISTIC MisfireDiag_HardMisfireThreshold "" VALUE 0x80004542 RecordLayout_5 0 CompuMethod_2 -1E+17 1E+17 /end CHARACTERISTIC
/begin CHARACTERISTIC MisfireDiag_StartRPMAvgCnt "" VALUE 0x8000455F RecordLayout_1 0 CompuMethod_1 0 255 /end CHARACTERISTIC
/begin CHARACTERISTIC MisfireDiag_StopRPMAvgCnt "" VALUE 0x80004570 RecordLayout_1 0 CompuMethod_1 0 255 /end CHARACTERISTIC
/begin CHARACTERISTIC MotoringDeltaRPMLimit "This is the amount RPM must be above the Setpoint RPM to set a Motorin Flag." VALUE 0x80004573 RecordLayout_6 0 CompuMethod_24 -32768 32767 /end CHARACTERISTIC
/begin CHARACTERISTIC MotoringDtctTimerLimit "Amount of time engine speed has to be above the min gov. rpm set pt to set motoring flag." VALUE 0x80004575 RecordLayout_5 0 CompuMethod_19 0 100 /end CHARACTERISTIC
/begin CHARACTERISTIC MPRD_new "Directly Override Main Power Relay" VALUE 0x8000457D RecordLayout_1 0 CompuMethod_146 0 1 /end CHARACTERISTIC
/begin CHARACTERISTIC MPRD_ovr "" VALUE 0x8000457E RecordLayout_1 0 CompuMethod_5 0 1 /end CHARACTERISTIC
/begin CHARACTERISTIC NonVolatileRestoreOnFirstStartup "Selects whether to restore from factory defaults the first time an application boots" VALUE 0x8000457F RecordLayout_1 0 CompuMethod_147 0 1 /end CHARACTERISTIC
/begin CHARACTERISTIC NonVolatileRestoreOnStartup "Selects whether to restore from factory defaults on next startup" VALUE 0x80004580 RecordLayout_1 0 CompuMethod_147 0 1 /end CHARACTERISTIC
/begin CHARACTERISTIC O2ActiveTimeThresh_BankA "Time limit O2 feedback can sit between rich and lean switch points before flagging O2NotActive fault" VALUE 0x80004581 RecordLayout_5 0 CompuMethod_46 -1E+17 1E+17 /end CHARACTERISTIC
/begin CHARACTERISTIC O2ActiveTimeThresh_BankB "Time limit O2 feedback can sit between rich and lean switch points before flagging O2NotActive fault" VALUE 0x80004585 RecordLayout_5 0 CompuMethod_46 -1E+17 1E+17 /end CHARACTERISTIC
/begin CHARACTERISTIC O2BankA_DelagFilterConst "First-order filter time constant of the pre-catalyst O2 signal." VALUE 0x80004589 RecordLayout_5 0 CompuMethod_46 -1E+17 1E+17 /end CHARACTERISTIC
/begin CHARACTERISTIC O2BankB_DelagFiltConst "First-order filter time constant of the post-catalyst O2 signal." VALUE 0x8000458D RecordLayout_5 0 CompuMethod_46 -1E+17 1E+17 /end CHARACTERISTIC
/begin CHARACTERISTIC O2CtrlAdaptDelayTime "O2 Control must be enabled for this amount of time before fuel adaption is enabled" VALUE 0x80004592 RecordLayout_5 0 CompuMethod_46 0 1E+17 /end CHARACTERISTIC
/begin CHARACTERISTIC O2CtrlDGain "Base D-gain for the gaseous closed loop O2 controller." VALUE 0x80004596 RecordLayout_5 0 CompuMethod_150 -1E+17 1E+17 /end CHARACTERISTIC
/begin CHARACTERISTIC O2CtrlIGain "Base I-gain for the gaseous closed loop O2 controller." VALUE 0x8000459A RecordLayout_5 0 CompuMethod_150 -1E+17 1E+17 /end CHARACTERISTIC
/begin CHARACTERISTIC O2CtrlPGain "Base P-gain for the gaseous closed loop O2 controller." VALUE 0x8000459E RecordLayout_5 0 CompuMethod_150 -1E+17 1E+17 /end CHARACTERISTIC
/begin CHARACTERISTIC O2CtrlPIDOutLowerLimit "Lower limit on gaseous closed loop O2 PID Output." VALUE 0x800045A2 RecordLayout_5 0 CompuMethod_150 -1E+17 1E+17 /end CHARACTERISTIC
/begin CHARACTERISTIC O2CtrlPIDOutUpperLimit "Upper limit on gaseous closed loop O2 PID Output." VALUE 0x800045A6 RecordLayout_5 0 CompuMethod_150 -1E+17 1E+17 /end CHARACTERISTIC
/begin CHARACTERISTIC O2Cyl1Select "Select the O2 sensor mapped to cylinder 1" VALUE 0x800045AA RecordLayout_1 0 CompuMethod_152 0 1 /end CHARACTERISTIC
/begin CHARACTERISTIC O2Cyl2Select "Select the O2 sensor mapped to cylinder 2" VALUE 0x800045AB RecordLayout_1 0 CompuMethod_152 0 1 /end CHARACTERISTIC
/begin CHARACTERISTIC O2Cyl3Select "Select the O2 sensor mapped to cylinder 3" VALUE 0x800045AC RecordLayout_1 0 CompuMethod_152 0 1 /end CHARACTERISTIC
/begin CHARACTERISTIC O2Cyl4Select "Select the O2 sensor mapped to cylinder 4" VALUE 0x800045AD RecordLayout_1 0 CompuMethod_152 0 1 /end CHARACTERISTIC
/begin CHARACTERISTIC O2Cyl5Select "Select the O2 sensor mapped to cylinder 5" VALUE 0x800045AE RecordLayout_1 0 CompuMethod_152 0 1 /end CHARACTERISTIC
/begin CHARACTERISTIC O2Cyl6Select "Select the O2 sensor mapped to cylinder 6" VALUE 0x800045AF RecordLayout_1 0 CompuMethod_152 0 1 /end CHARACTERISTIC
/begin CHARACTERISTIC O2Cyl7Select "Select the O2 sensor mapped to cylinder 7" VALUE 0x800045B0 RecordLayout_1 0 CompuMethod_152 0 1 /end CHARACTERISTIC
/begin CHARACTERISTIC O2Cyl8Select "Select the O2 sensor mapped to cylinder 8" VALUE 0x800045B1 RecordLayout_1 0 CompuMethod_152 0 1 /end CHARACTERISTIC
/begin CHARACTERISTIC O2Diag_Bank2Bank_DiffAlwdMap "" MAP 0x800045B2 RecordLayout_5 0 CompuMethod_2 -1E+17 1E+17
 /begin AXIS_DESCR COM_AXIS MAP09In CompuMethod_16 9 0 1000 AXIS_PTS_REF MAP09IdxArr /end AXIS_DESCR
 /begin AXIS_DESCR COM_AXIS RPM09In CompuMethod_71 9 0 14000 AXIS_PTS_REF RPM09IdxArr /end AXIS_DESCR
/end CHARACTERISTIC
/begin CHARACTERISTIC O2Diag_Bank2Bank_MaxDesEquivRatio "" VALUE 0x800046F6 RecordLayout_5 0 CompuMethod_2 -1E+17 1E+17 /end CHARACTERISTIC
/begin CHARACTERISTIC O2Diag_Bank2Bank_MinDesEquivRatio "" VALUE 0x800046FA RecordLayout_5 0 CompuMethod_2 -1E+17 1E+17 /end CHARACTERISTIC
/begin CHARACTERISTIC O2Diag_Bank2Bank_MinECT "" VALUE 0x800046FE RecordLayout_6 0 CompuMethod_9 -32768 32767 /end CHARACTERISTIC
/begin CHARACTERISTIC O2Diag_Bank2Bank_MinRunTime "" VALUE 0x80004700 RecordLayout_5 0 CompuMethod_2 -1E+17 1E+17 /end CHARACTERISTIC
/begin CHARACTERISTIC O2Diag_Lam1_StuckInResetThresh "" VALUE 0x80004704 RecordLayout_5 0 CompuMethod_2 -1E+17 1E+17 /end CHARACTERISTIC
/begin CHARACTERISTIC O2Diag_Lam1_StuckInWarmup "" VALUE 0x80004708 RecordLayout_5 0 CompuMethod_2 -1E+17 1E+17 /end CHARACTERISTIC
/begin CHARACTERISTIC O2Diag_Lam2_StuckInWarmup "" VALUE 0x8000470C RecordLayout_5 0 CompuMethod_2 -1E+17 1E+17 /end CHARACTERISTIC
/begin CHARACTERISTIC O2Diag_Lam21_StuckInResetThresh "" VALUE 0x80004710 RecordLayout_5 0 CompuMethod_2 -1E+17 1E+17 /end CHARACTERISTIC
/begin CHARACTERISTIC O2ITermLowerLimit "Lower limit on gaseous closed loop O2 I Term." VALUE 0x8000473C RecordLayout_5 0 CompuMethod_150 -1E+17 1E+17 /end CHARACTERISTIC
/begin CHARACTERISTIC O2ITermUpperLimit "Upper limit on gaseous closed loop O2 I Term." VALUE 0x80004740 RecordLayout_5 0 CompuMethod_150 -1E+17 1E+17 /end CHARACTERISTIC
/begin CHARACTERISTIC O2LeanTimeThresh_BankA "Time limit the O2 feedback can sit below the lean switch point before flagging O2FailedLean fault" VALUE 0x80004744 RecordLayout_5 0 CompuMethod_46 -1E+17 1E+17 /end CHARACTERISTIC
/begin CHARACTERISTIC O2LeanTimeThresh_BankB "Time limit the O2 feedback can sit below the lean switch point before flagging O2FailedLean fault" VALUE 0x80004748 RecordLayout_5 0 CompuMethod_46 -1E+17 1E+17 /end CHARACTERISTIC
/begin CHARACTERISTIC O2MAFErrGainMultTbl "O2 PID controller system gain based on MAF port." CURVE 0x8000474C RecordLayout_5 0 CompuMethod_49 -1E+17 1E+17
 /begin AXIS_DESCR COM_AXIS MAFPort05In CompuMethod_29 5 0 1000000 AXIS_PTS_REF MAFPort05IdxArr /end AXIS_DESCR
/end CHARACTERISTIC
/begin CHARACTERISTIC O2NECCTErrGainMultTbl "O2 PID controller system gain based on NECCT." CURVE 0x80004760 RecordLayout_5 0 CompuMethod_49 -1E+17 1E+17
 /begin AXIS_DESCR COM_AXIS ECT09In CompuMethod_57 9 -40 200 AXIS_PTS_REF ECT09IdxArr /end AXIS_DESCR
/end CHARACTERISTIC
/begin CHARACTERISTIC O2RichTimeThresh_BankA "Time limit the O2 feedback can sit abovethe rich switch point before flagging O2FailedRich fault" VALUE 0x80004784 RecordLayout_5 0 CompuMethod_46 -1E+17 1E+17 /end CHARACTERISTIC
/begin CHARACTERISTIC O2RichTimeThresh_BankB "Time limit the O2 feedback can sit abovethe rich switch point before flagging O2FailedRich fault" VALUE 0x80004788 RecordLayout_5 0 CompuMethod_46 -1E+17 1E+17 /end CHARACTERISTIC
/begin CHARACTERISTIC OilPres_Filt "Filter time constant" VALUE 0x800047B0 RecordLayout_5 0 CompuMethod_19 -1E+17 1E+17 /end CHARACTERISTIC
/begin CHARACTERISTIC OilPres_new "Override result of linear sensor characterization, in engineering units" VALUE 0x800047B4 RecordLayout_5 0 CompuMethod_143 -1E+17 1E+17 /end CHARACTERISTIC
/begin CHARACTERISTIC OilPres_ovr "" VALUE 0x800047B8 RecordLayout_1 0 CompuMethod_5 0 1 /end CHARACTERISTIC
/begin CHARACTERISTIC OilPresDfltValue "This is the initial default value should the sensor be in fault on key-up.  Otherwise the sensors outputs the last value prior to faulting" VALUE 0x800047B9 RecordLayout_5 0 CompuMethod_143 -1E+17 1E+17 /end CHARACTERISTIC
/begin CHARACTERISTIC OilPresFilterConst "Filter time constant" VALUE 0x800047BD RecordLayout_5 0 CompuMethod_19 -1E+17 1E+17 /end CHARACTERISTIC
/begin CHARACTERISTIC OilPresGain "Scaling from A/D counts to engineering units" VALUE 0x800047C1 RecordLayout_5 0 CompuMethod_154 -1E+17 1E+17 /end CHARACTERISTIC
/begin CHARACTERISTIC OilPresInputHiFltPos "Maximum allowable input, indicating short or open circuit" VALUE 0x800047C5 RecordLayout_5 0 CompuMethod_21 -1E+17 1E+17 /end CHARACTERISTIC
/begin CHARACTERISTIC OilPresInputLoFltPos "Minimum allowable input, indicating short or open circuit" VALUE 0x800047C9 RecordLayout_5 0 CompuMethod_21 -1E+17 1E+17 /end CHARACTERISTIC
/begin CHARACTERISTIC OilPresOfst "Offset after gain in engineering units" VALUE 0x800047CD RecordLayout_5 0 CompuMethod_143 -1E+17 1E+17 /end CHARACTERISTIC
/begin CHARACTERISTIC OpenThrottleFPCScalar_ETC "Crank FPC is scaled up with throttle opening for mechanical throttle systems, this parameter sets the gain for this relationship.  CrankFPC=CrankFPC*(1+TPS/100*FPCScalar)." VALUE 0x800047D8 RecordLayout_5 0 CompuMethod_63 -1E+17 1E+17 /end CHARACTERISTIC
/begin CHARACTERISTIC OpenThrottleFPCScalar_TPS "Crank FPC is scaled up with throttle opening for mechanical throttle systems, this parameter sets the gain for this relationship.  CrankFPC=CrankFPC*(1+TPS/100*FPCScalar)." VALUE 0x800047DC RecordLayout_5 0 CompuMethod_63 -1E+17 1E+17 /end CHARACTERISTIC
/begin CHARACTERISTIC Overheat_MaxAPP "Max APP command to allow during overheat condition" VALUE 0x800047E0 RecordLayout_1 0 CompuMethod_26 0 255 /end CHARACTERISTIC
/begin CHARACTERISTIC Overheat_ScaleAPP "Scale APP by this factor when overheating" VALUE 0x800047E1 RecordLayout_5 0 CompuMethod_156 -1E+17 1E+17 /end CHARACTERISTIC
/begin CHARACTERISTIC OXYTransFuelMultTbl "Transient fuel multiplier based on OXY.  Only engaged during transient fueling" CURVE 0x800047F9 RecordLayout_5 0 CompuMethod_2 -100 100
 /begin AXIS_DESCR COM_AXIS OXY05In CompuMethod_7 5 0 100 AXIS_PTS_REF OXY05IdxArr /end AXIS_DESCR
/end CHARACTERISTIC
/begin CHARACTERISTIC PH1_FiltDecConst "Filter time constant for a decreasing signal." VALUE 0x8000482E RecordLayout_5 0 CompuMethod_19 -1E+17 1E+17 /end CHARACTERISTIC
/begin CHARACTERISTIC PH1_FiltIncConst "Filter time constant for a increasing signal." VALUE 0x80004832 RecordLayout_5 0 CompuMethod_19 -1E+17 1E+17 /end CHARACTERISTIC
/begin CHARACTERISTIC PH2_FiltDecConst "Filter time constant for a decreasing signal." VALUE 0x80004836 RecordLayout_5 0 CompuMethod_19 -1E+17 1E+17 /end CHARACTERISTIC
/begin CHARACTERISTIC PH2_FiltIncConst "Filter time constant for a increasing signal." VALUE 0x8000483A RecordLayout_5 0 CompuMethod_19 -1E+17 1E+17 /end CHARACTERISTIC
/begin CHARACTERISTIC PHI1_DefaultVal "" VALUE 0x8000483E RecordLayout_5 0 CompuMethod_2 -1E+17 1E+17 /end CHARACTERISTIC
/begin CHARACTERISTIC PHI2_DefaultVal "" VALUE 0x80004842 RecordLayout_5 0 CompuMethod_2 -1E+17 1E+17 /end CHARACTERISTIC
/begin CHARACTERISTIC RestoreNVFactoryDefaults "Restores NonVolatile Memory to Factory Defaults" VALUE 0x80004997 RecordLayout_1 0 CompuMethod_158 0 1 /end CHARACTERISTIC
/begin CHARACTERISTIC RevLimitType "Define the type of sequence to be disable when in Rev Limit" VALUE 0x8000499A RecordLayout_8 0 CompuMethod_160 -128 127 /end CHARACTERISTIC
/begin CHARACTERISTIC RichSwPtDeltaMap "If actual O2 reaches this point, switch the target to the LeanTargetDelta" MAP 0x8000499B RecordLayout_5 0 CompuMethod_42 -1E+17 1E+17
 /begin AXIS_DESCR COM_AXIS RPM09In CompuMethod_71 9 0 14000 AXIS_PTS_REF RPM09IdxArr /end AXIS_DESCR
 /begin AXIS_DESCR COM_AXIS MAP09In CompuMethod_16 9 0 1000 AXIS_PTS_REF MAP09IdxArr /end AXIS_DESCR
/end CHARACTERISTIC
/begin CHARACTERISTIC RichTargetDeltaMap "Target on the rich side for perturbation." MAP 0x80004ADF RecordLayout_5 0 CompuMethod_42 -1E+17 1E+17
 /begin AXIS_DESCR COM_AXIS RPM09In CompuMethod_71 9 0 14000 AXIS_PTS_REF RPM09IdxArr /end AXIS_DESCR
 /begin AXIS_DESCR COM_AXIS MAP09In CompuMethod_16 9 0 1000 AXIS_PTS_REF MAP09IdxArr /end AXIS_DESCR
/end CHARACTERISTIC
/begin CHARACTERISTIC Rise_Rate "" VALUE 0x80004C23 RecordLayout_5 0 CompuMethod_2 -1E+17 1E+17 /end CHARACTERISTIC
/begin CHARACTERISTIC RPMFallingFiltConst "Filter time constant" VALUE 0x80004CE7 RecordLayout_5 0 CompuMethod_19 -1E+17 1E+17 /end CHARACTERISTIC
/begin CHARACTERISTIC RPMFallingRate "The minimum rate of change in RPM that triggers RPMFalling - This should be a positive value" VALUE 0x80004CEB RecordLayout_5 0 CompuMethod_162 0 1000 /end CHARACTERISTIC
/begin CHARACTERISTIC RPMFilt_Enable "" VALUE 0x80004CEF RecordLayout_1 0 CompuMethod_37 0 255 /end CHARACTERISTIC
/begin CHARACTERISTIC RPMFilt_LowPass "Filter time constant" VALUE 0x80004CF0 RecordLayout_5 0 CompuMethod_19 -1E+17 1E+17 /end CHARACTERISTIC
/begin CHARACTERISTIC RPMFilt_RoundValue "RPM round value" VALUE 0x80004CF4 RecordLayout_4 0 CompuMethod_24 0 1000 /end CHARACTERISTIC
/begin CHARACTERISTIC SensVolt_new "Override result of linear sensor characterization, in engineering units" VALUE 0x80004CFB RecordLayout_5 0 CompuMethod_164 -1E+17 1E+17 /end CHARACTERISTIC
/begin CHARACTERISTIC SensVolt_ovr "" VALUE 0x80004CFF RecordLayout_1 0 CompuMethod_5 0 1 /end CHARACTERISTIC
/begin CHARACTERISTIC SensVoltDfltValue "This is the initial default value should the sensor be in fault on key-up.  Otherwise the sensors outputs the last value prior to faulting" VALUE 0x80004D00 RecordLayout_5 0 CompuMethod_164 -1E+17 1E+17 /end CHARACTERISTIC
/begin CHARACTERISTIC SensVoltFilterConst "Filter time constant" VALUE 0x80004D04 RecordLayout_5 0 CompuMethod_19 -1E+17 1E+17 /end CHARACTERISTIC
/begin CHARACTERISTIC SensVoltGain "Scaling from A/D counts to engineering units" VALUE 0x80004D08 RecordLayout_5 0 CompuMethod_165 -1E+17 1E+17 /end CHARACTERISTIC
/begin CHARACTERISTIC SensVoltInputHiFltPos "Maximum allowable input, indicating short or open circuit" VALUE 0x80004D0C RecordLayout_5 0 CompuMethod_21 -1E+17 1E+17 /end CHARACTERISTIC
/begin CHARACTERISTIC SensVoltInputLoFltPos "Minimum allowable input, indicating short or open circuit" VALUE 0x80004D10 RecordLayout_5 0 CompuMethod_21 -1E+17 1E+17 /end CHARACTERISTIC
/begin CHARACTERISTIC SensVoltOfst "Offset after gain in engineering units" VALUE 0x80004D14 RecordLayout_5 0 CompuMethod_164 -1E+17 1E+17 /end CHARACTERISTIC
/begin CHARACTERISTIC SoftCycle1Cyl1 "" VALUE 0x80004D1F RecordLayout_8 0 CompuMethod_125 -128 127 /end CHARACTERISTIC
/begin CHARACTERISTIC SoftCycle1Cyl2 "" VALUE 0x80004D20 RecordLayout_8 0 CompuMethod_125 -128 127 /end CHARACTERISTIC
/begin CHARACTERISTIC SoftCycle1Cyl3 "" VALUE 0x80004D21 RecordLayout_8 0 CompuMethod_125 -128 127 /end CHARACTERISTIC
/begin CHARACTERISTIC SoftCycle1Cyl4 "" VALUE 0x80004D22 RecordLayout_8 0 CompuMethod_125 -128 127 /end CHARACTERISTIC
/begin CHARACTERISTIC SoftCycle1Cyl5 "" VALUE 0x80004D23 RecordLayout_8 0 CompuMethod_125 -128 127 /end CHARACTERISTIC
/begin CHARACTERISTIC SoftCycle1Cyl6 "" VALUE 0x80004D24 RecordLayout_8 0 CompuMethod_125 -128 127 /end CHARACTERISTIC
/begin CHARACTERISTIC SoftCycle1Cyl7 "" VALUE 0x80004D25 RecordLayout_8 0 CompuMethod_125 -128 127 /end CHARACTERISTIC
/begin CHARACTERISTIC SoftCycle1Cyl8 "" VALUE 0x80004D26 RecordLayout_8 0 CompuMethod_125 -128 127 /end CHARACTERISTIC
/begin CHARACTERISTIC SoftCycle2Cyl1 "" VALUE 0x80004D27 RecordLayout_8 0 CompuMethod_125 -128 127 /end CHARACTERISTIC
/begin CHARACTERISTIC SoftCycle2Cyl2 "" VALUE 0x80004D28 RecordLayout_8 0 CompuMethod_125 -128 127 /end CHARACTERISTIC
/begin CHARACTERISTIC SoftCycle2Cyl3 "" VALUE 0x80004D29 RecordLayout_8 0 CompuMethod_125 -128 127 /end CHARACTERISTIC
/begin CHARACTERISTIC SoftCycle2Cyl4 "" VALUE 0x80004D2A RecordLayout_8 0 CompuMethod_125 -128 127 /end CHARACTERISTIC
/begin CHARACTERISTIC SoftCycle2Cyl5 "" VALUE 0x80004D2B RecordLayout_8 0 CompuMethod_125 -128 127 /end CHARACTERISTIC
/begin CHARACTERISTIC SoftCycle2Cyl6 "" VALUE 0x80004D2C RecordLayout_8 0 CompuMethod_125 -128 127 /end CHARACTERISTIC
/begin CHARACTERISTIC SoftCycle2Cyl7 "" VALUE 0x80004D2D RecordLayout_8 0 CompuMethod_125 -128 127 /end CHARACTERISTIC
/begin CHARACTERISTIC SoftCycle2Cyl8 "" VALUE 0x80004D2E RecordLayout_8 0 CompuMethod_125 -128 127 /end CHARACTERISTIC
/begin CHARACTERISTIC SoftCycle3Cyl1 "" VALUE 0x80004D2F RecordLayout_8 0 CompuMethod_125 -128 127 /end CHARACTERISTIC
/begin CHARACTERISTIC SoftCycle3Cyl2 "" VALUE 0x80004D30 RecordLayout_8 0 CompuMethod_125 -128 127 /end CHARACTERISTIC
/begin CHARACTERISTIC SoftCycle3Cyl3 "" VALUE 0x80004D31 RecordLayout_8 0 CompuMethod_125 -128 127 /end CHARACTERISTIC
/begin CHARACTERISTIC SoftCycle3Cyl4 "" VALUE 0x80004D32 RecordLayout_8 0 CompuMethod_125 -128 127 /end CHARACTERISTIC
/begin CHARACTERISTIC SoftCycle3Cyl5 "" VALUE 0x80004D33 RecordLayout_8 0 CompuMethod_125 -128 127 /end CHARACTERISTIC
/begin CHARACTERISTIC SoftCycle3Cyl6 "" VALUE 0x80004D34 RecordLayout_8 0 CompuMethod_125 -128 127 /end CHARACTERISTIC
/begin CHARACTERISTIC SoftCycle3Cyl7 "" VALUE 0x80004D35 RecordLayout_8 0 CompuMethod_125 -128 127 /end CHARACTERISTIC
/begin CHARACTERISTIC SoftCycle3Cyl8 "" VALUE 0x80004D36 RecordLayout_8 0 CompuMethod_125 -128 127 /end CHARACTERISTIC
/begin CHARACTERISTIC SoftCycle4Cyl1 "" VALUE 0x80004D37 RecordLayout_8 0 CompuMethod_125 -128 127 /end CHARACTERISTIC
/begin CHARACTERISTIC SoftCycle4Cyl2 "" VALUE 0x80004D38 RecordLayout_8 0 CompuMethod_125 -128 127 /end CHARACTERISTIC
/begin CHARACTERISTIC SoftCycle4Cyl3 "" VALUE 0x80004D39 RecordLayout_8 0 CompuMethod_125 -128 127 /end CHARACTERISTIC
/begin CHARACTERISTIC SoftCycle4Cyl4 "" VALUE 0x80004D3A RecordLayout_8 0 CompuMethod_125 -128 127 /end CHARACTERISTIC
/begin CHARACTERISTIC SoftCycle4Cyl5 "" VALUE 0x80004D3B RecordLayout_8 0 CompuMethod_125 -128 127 /end CHARACTERISTIC
/begin CHARACTERISTIC SoftCycle4Cyl6 "" VALUE 0x80004D3C RecordLayout_8 0 CompuMethod_125 -128 127 /end CHARACTERISTIC
/begin CHARACTERISTIC SoftCycle4Cyl7 "" VALUE 0x80004D3D RecordLayout_8 0 CompuMethod_125 -128 127 /end CHARACTERISTIC
/begin CHARACTERISTIC SoftCycle4Cyl8 "" VALUE 0x80004D3E RecordLayout_8 0 CompuMethod_125 -128 127 /end CHARACTERISTIC
/begin CHARACTERISTIC SOI_new "" VALUE 0x80004D3F RecordLayout_5 0 CompuMethod_2 -1E+17 1E+17 /end CHARACTERISTIC
/begin CHARACTERISTIC SOI_ovr "" VALUE 0x80004D43 RecordLayout_1 0 CompuMethod_5 0 1 /end CHARACTERISTIC
/begin CHARACTERISTIC SparkAdv_DeltaHi "Maximum increasing spark change per 5ms" VALUE 0x80004D44 RecordLayout_5 0 CompuMethod_88 0 720 /end CHARACTERISTIC
/begin CHARACTERISTIC SparkAdv_DeltaLo "Maximum decreasing spark change per 5ms" VALUE 0x80004D48 RecordLayout_5 0 CompuMethod_66 0 720 /end CHARACTERISTIC
/begin CHARACTERISTIC SparkDwell_offset "" VALUE 0x800051D4 RecordLayout_5 0 CompuMethod_2 -1E+17 1E+17 /end CHARACTERISTIC
/begin CHARACTERISTIC SparkDwell_ovr "" VALUE 0x800051D8 RecordLayout_1 0 CompuMethod_166 0 1 /end CHARACTERISTIC
/begin CHARACTERISTIC SparkStartAngle_offset "Provides a relative offset to input signal" VALUE 0x800051E6 RecordLayout_5 0 CompuMethod_66 -1E+17 1E+17 /end CHARACTERISTIC
/begin CHARACTERISTIC SparkStartAngle_ovr "Provides a relative offset to input signal" VALUE 0x800051EA RecordLayout_1 0 CompuMethod_168 0 1 /end CHARACTERISTIC
/begin CHARACTERISTIC SparkStopAngle_offset "Provides a relative offset to input signal" VALUE 0x800051EB RecordLayout_5 0 CompuMethod_66 -1E+17 1E+17 /end CHARACTERISTIC
/begin CHARACTERISTIC SparkStopAngle_ovr "Provides a relative offset to input signal" VALUE 0x800051EF RecordLayout_1 0 CompuMethod_168 0 1 /end CHARACTERISTIC
/begin CHARACTERISTIC SpkMinGovDGain "Base D-gain for the min. governor controller." VALUE 0x80005214 RecordLayout_5 0 CompuMethod_32 -1E+17 1E+17 /end CHARACTERISTIC
/begin CHARACTERISTIC SpkMinGovDGainErrorMultTbl "" CURVE 0x80005218 RecordLayout_5 0 CompuMethod_32 -1E+17 1E+17
 /begin AXIS_DESCR COM_AXIS SpkMinGovSpeedErrorIn CompuMethod_2 9 -1E+17 1E+17 AXIS_PTS_REF SpkMinGovSpeedErrorIdxArr /end AXIS_DESCR
/end CHARACTERISTIC
/begin CHARACTERISTIC SpkMinGovErrorGain "Error gain for the min governor controller. This gain is applied to the RPM error term before it is used to calculate the P, I and D terms." VALUE 0x8000523C RecordLayout_5 0 CompuMethod_32 -1E+17 1E+17 /end CHARACTERISTIC
/begin CHARACTERISTIC SpkMinGovPGain "Base P-gain for the min. governor controller." VALUE 0x80005240 RecordLayout_5 0 CompuMethod_32 -1E+17 1E+17 /end CHARACTERISTIC
/begin CHARACTERISTIC SpkMinGovPGainErrorMultTbl "" CURVE 0x80005244 RecordLayout_5 0 CompuMethod_32 -1E+17 1E+17
 /begin AXIS_DESCR COM_AXIS SpkMinGovSpeedErrorIn CompuMethod_2 9 -1E+17 1E+17 AXIS_PTS_REF SpkMinGovSpeedErrorIdxArr /end AXIS_DESCR
/end CHARACTERISTIC
/begin CHARACTERISTIC SpkMinGovPIDOutLowerLimit "Lower limit on spark min governor PID Output." VALUE 0x80005268 RecordLayout_5 0 CompuMethod_88 -1E+17 1E+17 /end CHARACTERISTIC
/begin CHARACTERISTIC SpkMinGovPIDOutUpperLimit "Upper limit on spark min governor PID Output." VALUE 0x8000526C RecordLayout_5 0 CompuMethod_88 -1E+17 1E+17 /end CHARACTERISTIC
/begin CHARACTERISTIC SSLoadDecFiltC "Filter time constant for a decreasing signal." VALUE 0x80005294 RecordLayout_5 0 CompuMethod_19 -1E+17 1E+17 /end CHARACTERISTIC
/begin CHARACTERISTIC SSLoadIncFiltC "Filter time constant for a increasing signal." VALUE 0x80005298 RecordLayout_5 0 CompuMethod_19 -1E+17 1E+17 /end CHARACTERISTIC
/begin CHARACTERISTIC SSLoadTol "Steady-State Load Tolerance" VALUE 0x8000529C RecordLayout_5 0 CompuMethod_2 -1E+17 1E+17 /end CHARACTERISTIC
/begin CHARACTERISTIC SSRPMDecFiltC "Filter time constant for a decreasing signal." VALUE 0x800052A0 RecordLayout_5 0 CompuMethod_19 -1E+17 1E+17 /end CHARACTERISTIC
/begin CHARACTERISTIC SSRPMIncFiltC "Filter time constant for a increasing signal." VALUE 0x800052A4 RecordLayout_5 0 CompuMethod_19 -1E+17 1E+17 /end CHARACTERISTIC
/begin CHARACTERISTIC SSRPMTol "Steady-State RPM Tolerance" VALUE 0x800052A8 RecordLayout_5 0 CompuMethod_71 -1E+17 1E+17 /end CHARACTERISTIC
/begin CHARACTERISTIC StoreNV "Stores RAM-Shadowed memory to serial EEPROM" VALUE 0x800052B6 RecordLayout_1 0 CompuMethod_170 0 1 /end CHARACTERISTIC
/begin CHARACTERISTIC SysVolt_new "Override result of linear sensor characterization, in engineering units" VALUE 0x800052B7 RecordLayout_5 0 CompuMethod_164 -1E+17 1E+17 /end CHARACTERISTIC
/begin CHARACTERISTIC SysVolt_ovr "" VALUE 0x800052BB RecordLayout_1 0 CompuMethod_5 0 1 /end CHARACTERISTIC
/begin CHARACTERISTIC SysVoltDfltValue "This is the initial default value should the sensor be in fault on key-up.  Otherwise the sensors outputs the last value prior to faulting" VALUE 0x800052E3 RecordLayout_5 0 CompuMethod_164 -1E+17 1E+17 /end CHARACTERISTIC
/begin CHARACTERISTIC SysVoltFilterConst "Filter time constant" VALUE 0x800052E7 RecordLayout_5 0 CompuMethod_19 -1E+17 1E+17 /end CHARACTERISTIC
/begin CHARACTERISTIC SysVoltGain "Scaling from A/D counts to engineering units" VALUE 0x800052EB RecordLayout_5 0 CompuMethod_165 -1E+17 1E+17 /end CHARACTERISTIC
/begin CHARACTERISTIC SysVoltInputHiFltPos "Maximum allowable input, indicating short or open circuit" VALUE 0x800052EF RecordLayout_5 0 CompuMethod_21 -1E+17 1E+17 /end CHARACTERISTIC
/begin CHARACTERISTIC SysVoltInputLoFltPos "Minimum allowable input, indicating short or open circuit" VALUE 0x800052F3 RecordLayout_5 0 CompuMethod_21 -1E+17 1E+17 /end CHARACTERISTIC
/begin CHARACTERISTIC SysVoltOfst "Offset after gain in engineering units" VALUE 0x800052F7 RecordLayout_5 0 CompuMethod_164 -1E+17 1E+17 /end CHARACTERISTIC
/begin CHARACTERISTIC TempOverheat_Fault "ECT limit above which fault is set." VALUE 0x800052FC RecordLayout_5 0 CompuMethod_57 -1E+17 1E+17 /end CHARACTERISTIC
/begin CHARACTERISTIC TempOverheat_Warn "ECT limit above which warning light comes on" VALUE 0x80005300 RecordLayout_5 0 CompuMethod_57 -1E+17 1E+17 /end CHARACTERISTIC
/begin CHARACTERISTIC TempOverheatSevere_Fault "ECT limit above which severe overheat fault is set." VALUE 0x80005304 RecordLayout_5 0 CompuMethod_57 -1E+17 1E+17 /end CHARACTERISTIC
/begin CHARACTERISTIC TireRadius "" VALUE 0x8000532F RecordLayout_5 0 CompuMethod_2 -1E+17 1E+17 /end CHARACTERISTIC
/begin CHARACTERISTIC TPS_Filt "Filter time constant" VALUE 0x80005333 RecordLayout_5 0 CompuMethod_19 -1E+17 1E+17 /end CHARACTERISTIC
/begin CHARACTERISTIC TPS1_new "Override result of linear sensor characterization, in engineering units" VALUE 0x8000535B RecordLayout_5 0 CompuMethod_7 -1E+17 1E+17 /end CHARACTERISTIC
/begin CHARACTERISTIC TPS1_ovr "" VALUE 0x8000535F RecordLayout_1 0 CompuMethod_5 0 1 /end CHARACTERISTIC
/begin CHARACTERISTIC TPS1_TPS2_Max_Deviation "Specifies the maximum allowable deviation between the two sensors" VALUE 0x80005360 RecordLayout_5 0 CompuMethod_35 -1E+17 1E+17 /end CHARACTERISTIC
/begin CHARACTERISTIC TPS1Adapt_Delta "Specifies the minimum deviation amount to react to." VALUE 0x80005364 RecordLayout_5 0 CompuMethod_21 -1E+17 1E+17 /end CHARACTERISTIC
/begin CHARACTERISTIC TPS1Adapt_Hi_Max "Specifies for the maximum value of the upper adapt range." VALUE 0x80005368 RecordLayout_5 0 CompuMethod_33 -1E+17 1E+17 /end CHARACTERISTIC
/begin CHARACTERISTIC TPS1Adapt_Hi_Min "Specifies for the minimum value of the upper adapt range." VALUE 0x8000536C RecordLayout_5 0 CompuMethod_33 -1E+17 1E+17 /end CHARACTERISTIC
/begin CHARACTERISTIC TPS1Adapt_Low_Max "Specifies for the maximum value of the lower adapt range." VALUE 0x80005370 RecordLayout_5 0 CompuMethod_33 -1E+17 1E+17 /end CHARACTERISTIC
/begin CHARACTERISTIC TPS1Adapt_Low_Min "Specifies for the minimum value of the lower adapt range." VALUE 0x80005374 RecordLayout_5 0 CompuMethod_33 -1E+17 1E+17 /end CHARACTERISTIC
/begin CHARACTERISTIC TPS1AdaptHiEnable "Enables or disables this adapt." VALUE 0x80005378 RecordLayout_1 0 CompuMethod_8 0 1 /end CHARACTERISTIC
/begin CHARACTERISTIC TPS1AdaptLoEnable "Enables or disables this adapt." VALUE 0x80005379 RecordLayout_1 0 CompuMethod_8 0 1 /end CHARACTERISTIC
/begin CHARACTERISTIC TPS1DfltValue "This is the initial default value should the sensor be in fault on key-up.  Otherwise the sensors outputs the last value prior to faulting" VALUE 0x8000537D RecordLayout_5 0 CompuMethod_7 -1E+17 1E+17 /end CHARACTERISTIC
/begin CHARACTERISTIC TPS1FilterConst "Filter time constant" VALUE 0x80005381 RecordLayout_5 0 CompuMethod_19 -1E+17 1E+17 /end CHARACTERISTIC
/begin CHARACTERISTIC TPS1InputHiFltPos "Hi limit of input signal which sets fault" VALUE 0x80005385 RecordLayout_5 0 CompuMethod_21 -1E+17 1E+17 /end CHARACTERISTIC
/begin CHARACTERISTIC TPS1InputLoFltPos "Low limit of input signal which sets fault" VALUE 0x80005389 RecordLayout_5 0 CompuMethod_21 -1E+17 1E+17 /end CHARACTERISTIC
/begin CHARACTERISTIC TPS1MaxLimit "Sets the upper limit on the potentiometer range." VALUE 0x8000538D RecordLayout_5 0 CompuMethod_7 -1E+17 1E+17 /end CHARACTERISTIC
/begin CHARACTERISTIC TPS1Rev_Polarity "1 = Reverse Polarity (Smaller voltage values indicate larger % travel)" VALUE 0x80005391 RecordLayout_1 0 CompuMethod_34 0 1 /end CHARACTERISTIC
/begin CHARACTERISTIC TPS2_new "Override result of linear sensor characterization, in engineering units" VALUE 0x80005392 RecordLayout_5 0 CompuMethod_7 -1E+17 1E+17 /end CHARACTERISTIC
/begin CHARACTERISTIC TPS2_ovr "" VALUE 0x80005396 RecordLayout_1 0 CompuMethod_5 0 1 /end CHARACTERISTIC
/begin CHARACTERISTIC TPS2Adapt_Delta "Specifies the minimum deviation amount to react to." VALUE 0x80005397 RecordLayout_5 0 CompuMethod_21 -1E+17 1E+17 /end CHARACTERISTIC
/begin CHARACTERISTIC TPS2Adapt_Hi_Max "Specifies for the maximum value of the upper adapt range." VALUE 0x8000539B RecordLayout_5 0 CompuMethod_33 -1E+17 1E+17 /end CHARACTERISTIC
/begin CHARACTERISTIC TPS2Adapt_Hi_Min "Specifies for the minimum value of the upper adapt range." VALUE 0x8000539F RecordLayout_5 0 CompuMethod_33 -1E+17 1E+17 /end CHARACTERISTIC
/begin CHARACTERISTIC TPS2Adapt_Low_Max "Specifies for the maximum value of the lower adapt range." VALUE 0x800053A3 RecordLayout_5 0 CompuMethod_33 -1E+17 1E+17 /end CHARACTERISTIC
/begin CHARACTERISTIC TPS2Adapt_Low_Min "Specifies for the minimum value of the lower adapt range." VALUE 0x800053A7 RecordLayout_5 0 CompuMethod_33 -1E+17 1E+17 /end CHARACTERISTIC
/begin CHARACTERISTIC TPS2AdaptHiEnable "Enables or disables this adapt." VALUE 0x800053AB RecordLayout_1 0 CompuMethod_8 0 1 /end CHARACTERISTIC
/begin CHARACTERISTIC TPS2AdaptLoEnable "Enables or disables this adapt." VALUE 0x800053AC RecordLayout_1 0 CompuMethod_8 0 1 /end CHARACTERISTIC
/begin CHARACTERISTIC TPS2DfltValue "This is the initial default value should the sensor be in fault on key-up.  Otherwise the sensors outputs the last value prior to faulting" VALUE 0x800053B0 RecordLayout_5 0 CompuMethod_7 -1E+17 1E+17 /end CHARACTERISTIC
/begin CHARACTERISTIC TPS2FilterConst "Filter time constant" VALUE 0x800053B4 RecordLayout_5 0 CompuMethod_19 -1E+17 1E+17 /end CHARACTERISTIC
/begin CHARACTERISTIC TPS2InputHiFltPos "Hi limit of input signal which sets fault" VALUE 0x800053B8 RecordLayout_5 0 CompuMethod_21 -1E+17 1E+17 /end CHARACTERISTIC
/begin CHARACTERISTIC TPS2InputLoFltPos "Low limit of input signal which sets fault" VALUE 0x800053BC RecordLayout_5 0 CompuMethod_21 -1E+17 1E+17 /end CHARACTERISTIC
/begin CHARACTERISTIC TPS2MaxLimit "Sets the upper limit on the potentiometer range." VALUE 0x800053C0 RecordLayout_5 0 CompuMethod_7 -1E+17 1E+17 /end CHARACTERISTIC
/begin CHARACTERISTIC TPS2Rev_Polarity "1 = Reverse Polarity (Smaller voltage values indicate larger % travel)" VALUE 0x800053C4 RecordLayout_1 0 CompuMethod_34 0 1 /end CHARACTERISTIC
/begin CHARACTERISTIC VEAdaptGainTblTbl "Multiplier on error for adaptation, should always be positive" CURVE 0x800053EE RecordLayout_5 0 CompuMethod_2 -1E+17 1E+17
 /begin AXIS_DESCR COM_AXIS VE_AdaptErrorIdxArrIn CompuMethod_2 10 -1E+17 1E+17 AXIS_PTS_REF VE_AdaptErrorIdxArrIdxArr /end AXIS_DESCR
/end CHARACTERISTIC
/begin CHARACTERISTIC VEAdaptMax "Determines whether the Volumetric Efficiency map will be adapted using the MAF sensor" VALUE 0x80005416 RecordLayout_5 0 CompuMethod_177 -1E+17 1E+17 /end CHARACTERISTIC
/begin CHARACTERISTIC VEAdaptMin "Determines whether the Volumetric Efficiency map will be adapted using the MAF sensor" VALUE 0x8000541A RecordLayout_5 0 CompuMethod_177 -1E+17 1E+17 /end CHARACTERISTIC
/begin CHARACTERISTIC VEAdpatSource "" VALUE 0x80005426 RecordLayout_1 0 CompuMethod_178 0 1 /end CHARACTERISTIC
/begin CHARACTERISTIC VPSD_ChangeReject "If VSPD changes by more than this per/second ignore it" VALUE 0x80005FFB RecordLayout_5 0 CompuMethod_179 -1E+17 1E+17 /end CHARACTERISTIC
/begin CHARACTERISTIC VSPD_ChangeReject_Enable "Enable for if VSPD changes by more than this per/second ignore it" VALUE 0x80005FFF RecordLayout_1 0 CompuMethod_181 0 1 /end CHARACTERISTIC
/begin CHARACTERISTIC VSPD_DigitalPresent "" VALUE 0x80006000 RecordLayout_1 0 CompuMethod_8 0 1 /end CHARACTERISTIC
/begin CHARACTERISTIC VSPD_GPSPreferred "" VALUE 0x80006005 RecordLayout_1 0 CompuMethod_8 0 1 /end CHARACTERISTIC
/begin CHARACTERISTIC VSPD_new "Override result of linear sensor characterization, in engineering units" VALUE 0x80006006 RecordLayout_5 0 CompuMethod_180 -1E+17 1E+17 /end CHARACTERISTIC
/begin CHARACTERISTIC VSPD_ovr "" VALUE 0x8000600A RecordLayout_1 0 CompuMethod_5 0 1 /end CHARACTERISTIC
/begin CHARACTERISTIC VSPD_Pin_AliasProtect "Frequency input alias detection for VSPD_Pin" VALUE 0x8000600D RecordLayout_1 0 CompuMethod_121 0 1 /end CHARACTERISTIC
/begin CHARACTERISTIC VSPD_Pin_EdgeDetect "Frequency input edge trigger for VSPD_Pin" VALUE 0x8000600E RecordLayout_1 0 CompuMethod_83 0 1 /end CHARACTERISTIC
/begin CHARACTERISTIC VSPD_Pin_Interface "Frequency input signal interface for VSPD_Pin" VALUE 0x8000600F RecordLayout_1 0 CompuMethod_122 0 1 /end CHARACTERISTIC
/begin CHARACTERISTIC VSPD_Pin_MinFrequency "Minimum expected input frequency for VSPD_Pin" VALUE 0x80006010 RecordLayout_3 0 CompuMethod_123 0.01 10000 /end CHARACTERISTIC
/begin CHARACTERISTIC VSPD_RateReject "If VSPD changes by more than this per/second ignore it" VALUE 0x80006014 RecordLayout_5 0 CompuMethod_179 -1E+17 1E+17 /end CHARACTERISTIC
/begin CHARACTERISTIC VSPD_RateReject_Enable "Enable for if VSPD changes by more than this per/second ignore it" VALUE 0x80006018 RecordLayout_1 0 CompuMethod_181 0 1 /end CHARACTERISTIC
/begin CHARACTERISTIC VSPD_RejectHoldTime "TimeToHoldLastValue" VALUE 0x80006019 RecordLayout_1 0 CompuMethod_182 0 255 /end CHARACTERISTIC
/begin CHARACTERISTIC VSPD_ZeroSpeed "What VSPD filter considers zero speed" VALUE 0x8000601A RecordLayout_5 0 CompuMethod_115 -1E+17 1E+17 /end CHARACTERISTIC
/begin CHARACTERISTIC VSPDDefault "This is the initial default value should the sensor be in fault on key-up.  Otherwise the sensors outputs the last value prior to faulting" VALUE 0x800060A2 RecordLayout_5 0 CompuMethod_180 -1E+17 1E+17 /end CHARACTERISTIC
/begin CHARACTERISTIC VSPDFiltConst "Filter time constant" VALUE 0x800060A6 RecordLayout_5 0 CompuMethod_19 -1E+17 1E+17 /end CHARACTERISTIC
/begin CHARACTERISTIC VSPDMax "Maximum allowable input, indicating short or open circuit" VALUE 0x800060BE RecordLayout_5 0 CompuMethod_98 -1E+17 1E+17 /end CHARACTERISTIC
/begin CHARACTERISTIC VSPDMin "Minimum allowable input, indicating short or open circuit" VALUE 0x800060C2 RecordLayout_5 0 CompuMethod_98 -1E+17 1E+17 /end CHARACTERISTIC
/begin CHARACTERISTIC VSPDTbl "Look up table to allownon-linear characterization of sensors" CURVE 0x800060C6 RecordLayout_5 0 CompuMethod_180 -1E+17 1E+17
 /begin AXIS_DESCR COM_AXIS VSPDADC CompuMethod_98 5 -1E+17 1E+17 AXIS_PTS_REF VSPDIdxArr /end AXIS_DESCR
/end CHARACTERISTIC
/begin CHARACTERISTIC Warmup_Time_HoldoffTbl "Time before warmup fuel multiplier active" CURVE 0x800060DA RecordLayout_5 0 CompuMethod_183 0 3
 /begin AXIS_DESCR COM_AXIS ECT05In CompuMethod_57 5 -40 200 AXIS_PTS_REF ECT05IdxArr /end AXIS_DESCR
/end CHARACTERISTIC
/begin AXIS_PTS App05IdxArr "" 0x800002D6 App05In RecordLayout_7 0 CompuMethod_2 5 -1E+17 1E+17 DEPOSIT ABSOLUTE /end AXIS_PTS
/begin AXIS_PTS ECT05IdxArr "Idex of ECT" 0x80001702 ECT05In RecordLayout_7 0 CompuMethod_57 5 -40 200 DEPOSIT ABSOLUTE /end AXIS_PTS
/begin AXIS_PTS ECT09IdxArr "Index of ECT" 0x80001732 ECT09In RecordLayout_7 0 CompuMethod_57 9 -40 200 DEPOSIT ABSOLUTE /end AXIS_PTS
/begin AXIS_PTS ETC_ErrorIdxArr "" 0x80001A7A ETC_ErrorIn RecordLayout_7 0 CompuMethod_2 10 -1E+17 1E+17 DEPOSIT ABSOLUTE /end AXIS_PTS
/begin AXIS_PTS EVAPIdxArr "Look up table to allownon-linear characterization of sensors" 0x80002280 EVAPADC RecordLayout_7 0 CompuMethod_21 13 -1E+17 1E+17 DEPOSIT ABSOLUTE /end AXIS_PTS
/begin AXIS_PTS Fuel_LvlIdxArr "Look up table to allownon-linear characterization of sensors" 0x80003301 Fuel_LvlADC RecordLayout_7 0 CompuMethod_21 5 -1E+17 1E+17 DEPOSIT ABSOLUTE /end AXIS_PTS
/begin AXIS_PTS FuelLevel_FiltConstColIdxArr "FuelLevel_FiltConst" 0x8000374E FuelLevel_FiltConstColIn RecordLayout_7 0 CompuMethod_115 7 0 1E+17 DEPOSIT ABSOLUTE /end AXIS_PTS
/begin AXIS_PTS FuelLevel_FiltConstRowIdxArr "FuelLevel_FiltConst" 0x8000382E FuelLevel_FiltConstRowIn RecordLayout_7 0 CompuMethod_19 7 0 1E+17 DEPOSIT ABSOLUTE /end AXIS_PTS
/begin AXIS_PTS IAT_KeyUp09IdxArr "Index of IAT captured at key-up." 0x8000390C IAT_KeyUp09In RecordLayout_7 0 CompuMethod_57 9 -1E+17 1E+17 DEPOSIT ABSOLUTE /end AXIS_PTS
/begin AXIS_PTS IATIdxArr "Look up table to allownon-linear characterization of sensors" 0x80003BE9 IATADC RecordLayout_7 0 CompuMethod_21 13 -1E+17 1E+17 DEPOSIT ABSOLUTE /end AXIS_PTS
/begin AXIS_PTS InjDeltaPress09IdxArr "" 0x80003C74 InjDeltaPress09In RecordLayout_7 0 CompuMethod_2 9 -1E+17 1E+17 DEPOSIT ABSOLUTE /end AXIS_PTS
/begin AXIS_PTS MAFIdxArr "Look up table to allownon-linear characterization of sensors" 0x80004072 MAFADC RecordLayout_7 0 CompuMethod_98 13 -1E+17 1E+17 DEPOSIT ABSOLUTE /end AXIS_PTS
/begin AXIS_PTS MAFPort05IdxArr "Index of MAF" 0x800040AE MAFPort05In RecordLayout_7 0 CompuMethod_29 5 0 1000000 DEPOSIT ABSOLUTE /end AXIS_PTS
/begin AXIS_PTS MAP09IdxArr "Index of MAP" 0x80004274 MAP09In RecordLayout_7 0 CompuMethod_16 9 0 1000 DEPOSIT ABSOLUTE /end AXIS_PTS
/begin AXIS_PTS MaxGovSpeedErrorIdxArr "" 0x8000441D MaxGovSpeedErrorIn RecordLayout_7 0 CompuMethod_71 9 -1E+17 1E+17 DEPOSIT ABSOLUTE /end AXIS_PTS
/begin AXIS_PTS OXY05IdxArr "Index of fuel oxygenation content" 0x800047E5 OXY05In RecordLayout_7 0 CompuMethod_7 5 0 100 DEPOSIT ABSOLUTE /end AXIS_PTS
/begin AXIS_PTS RPM05IdxArr "Index of RPM" 0x80004C27 RPM05In RecordLayout_7 0 CompuMethod_71 5 0 14000 DEPOSIT ABSOLUTE /end AXIS_PTS
/begin AXIS_PTS RPM09IdxArr "Index of RPM" 0x80004C3B RPM09In RecordLayout_7 0 CompuMethod_71 9 0 14000 DEPOSIT ABSOLUTE /end AXIS_PTS
/begin AXIS_PTS RPMAccel17IdxArr "" 0x80004CA3 RPMAccel17In RecordLayout_7 0 CompuMethod_2 17 -1E+17 1E+17 DEPOSIT ABSOLUTE /end AXIS_PTS
/begin AXIS_PTS SpkMinGovSpeedErrorIdxArr "" 0x80005270 SpkMinGovSpeedErrorIn RecordLayout_7 0 CompuMethod_2 9 -1E+17 1E+17 DEPOSIT ABSOLUTE /end AXIS_PTS
/begin AXIS_PTS SysVolt09IdxArr "Index of system voltage" 0x800052BC SysVolt09In RecordLayout_7 0 CompuMethod_164 9 0 32 DEPOSIT ABSOLUTE /end AXIS_PTS
/begin AXIS_PTS VE_AdaptErrorIdxArrIdxArr "Multiplier on error for adaptation, should always be positive" 0x800053C5 VE_AdaptErrorIdxArrIn RecordLayout_7 0 CompuMethod_2 10 -1E+17 1E+17 DEPOSIT ABSOLUTE /end AXIS_PTS
/begin AXIS_PTS VSPD09IdxArr "Index of VSPD" 0x8000603A VSPD09In RecordLayout_7 0 CompuMethod_180 9 -100 200 DEPOSIT ABSOLUTE /end AXIS_PTS
/begin AXIS_PTS VSPDIdxArr "Look up table to allownon-linear characterization of sensors" 0x800060AA VSPDADC RecordLayout_7 0 CompuMethod_98 5 -1E+17 1E+17 DEPOSIT ABSOLUTE /end AXIS_PTS
/*~~~~~~~~~ 6.3.106 RECORD_LAYOUTs ~~~~~~~~~*/
/begin RECORD_LAYOUT RecordLayout_1 FNC_VALUES 1 UBYTE ROW_DIR DIRECT /end RECORD_LAYOUT
/begin RECORD_LAYOUT RecordLayout_3 FNC_VALUES 1 ULONG ROW_DIR DIRECT /end RECORD_LAYOUT
/begin RECORD_LAYOUT RecordLayout_4 FNC_VALUES 1 UWORD ROW_DIR DIRECT /end RECORD_LAYOUT
/begin RECORD_LAYOUT RecordLayout_5 FNC_VALUES 1 FLOAT32_IEEE ROW_DIR DIRECT /end RECORD_LAYOUT
/begin RECORD_LAYOUT RecordLayout_6 FNC_VALUES 1 SWORD ROW_DIR DIRECT /end RECORD_LAYOUT
/begin RECORD_LAYOUT RecordLayout_7 AXIS_PTS_X 1 FLOAT32_IEEE /* IndexIncr */ INDEX_INCR /* Addressing */ DIRECT /end RECORD_LAYOUT
/begin RECORD_LAYOUT RecordLayout_8 FNC_VALUES 1 SBYTE ROW_DIR DIRECT /end RECORD_LAYOUT
/*~~~~~~~~~ 6.3.31 COMPU_METHODs ~~~~~~~~~*/
/begin COMPU_METHOD CompuMethod_1 "" RAT_FUNC "%3.0" "" COEFFS 0 1 0 0 0 1 /end COMPU_METHOD
/begin COMPU_METHOD CompuMethod_2 "" RAT_FUNC "%6.2" "" COEFFS 0 1 0 0 0 1 /end COMPU_METHOD
/begin COMPU_METHOD CompuMethod_4 "" RAT_FUNC "%1.0" "bool" COEFFS 0 1 0 0 0 1 /end COMPU_METHOD
/begin COMPU_METHOD CompuMethod_5 "" TAB_VERB "%1.0" "" COMPU_TAB_REF CompuVtab_1 /end COMPU_METHOD
/begin COMPU_METHOD CompuMethod_7 "" RAT_FUNC "%6.2" "%" COEFFS 0 1 0 0 0 1 /end COMPU_METHOD
/begin COMPU_METHOD CompuMethod_8 "" TAB_VERB "%1.0" "" COMPU_TAB_REF CompuVtab_2 /end COMPU_METHOD
/begin COMPU_METHOD CompuMethod_9 "" RAT_FUNC "%5.0" "" COEFFS 0 1 0 0 0 1 /end COMPU_METHOD
/begin COMPU_METHOD CompuMethod_11 "" RAT_FUNC "%1.0" "" COEFFS 0 1 0 0 0 1 /end COMPU_METHOD
/begin COMPU_METHOD CompuMethod_13 "" RAT_FUNC "%6.2" "kPaGauge" COEFFS 0 1 0 0 0 1 /end COMPU_METHOD
/begin COMPU_METHOD CompuMethod_14 "" RAT_FUNC "%6.2" "kPa Gauge" COEFFS 0 1 0 0 0 1 /end COMPU_METHOD
/begin COMPU_METHOD CompuMethod_15 "" RAT_FUNC "%6.2" "idx.frac" COEFFS 0 1 0 0 0 0.00195313 /end COMPU_METHOD
/begin COMPU_METHOD CompuMethod_16 "" RAT_FUNC "%6.2" "kPa" COEFFS 0 1 0 0 0 1 /end COMPU_METHOD
/begin COMPU_METHOD CompuMethod_17 "" RAT_FUNC "%5.0" "ADC" COEFFS 0 1 0 0 0 1 /end COMPU_METHOD
/begin COMPU_METHOD CompuMethod_19 "" RAT_FUNC "%6.2" "sec" COEFFS 0 1 0 0 0 1 /end COMPU_METHOD
/begin COMPU_METHOD CompuMethod_20 "" RAT_FUNC "%9.4" "kPa Gauge/ADC" COEFFS 0 1 0 0 0 1 /end COMPU_METHOD
/begin COMPU_METHOD CompuMethod_21 "" RAT_FUNC "%6.2" "ADC" COEFFS 0 1 0 0 0 1 /end COMPU_METHOD
/begin COMPU_METHOD CompuMethod_24 "" RAT_FUNC "%5.0" "RPM" COEFFS 0 1 0 0 0 1 /end COMPU_METHOD
/begin COMPU_METHOD CompuMethod_26 "" RAT_FUNC "%3.0" "%" COEFFS 0 1 0 0 0 1 /end COMPU_METHOD
/begin COMPU_METHOD CompuMethod_29 "" RAT_FUNC "%6.2" "g/s" COEFFS 0 1 0 0 0 1 /end COMPU_METHOD
/begin COMPU_METHOD CompuMethod_30 "" TAB_VERB "%6.2" "" COMPU_TAB_REF CompuVtab_6 /end COMPU_METHOD
/begin COMPU_METHOD CompuMethod_32 "" RAT_FUNC "%6.2" "mult" COEFFS 0 1 0 0 0 1 /end COMPU_METHOD
/begin COMPU_METHOD CompuMethod_33 "" RAT_FUNC "%6.2" "ADC Counts" COEFFS 0 1 0 0 0 1 /end COMPU_METHOD
/begin COMPU_METHOD CompuMethod_34 "" RAT_FUNC "%1.0" "boolean" COEFFS 0 1 0 0 0 1 /end COMPU_METHOD
/begin COMPU_METHOD CompuMethod_35 "" RAT_FUNC "%6.2" "Percent" COEFFS 0 1 0 0 0 1 /end COMPU_METHOD
/begin COMPU_METHOD CompuMethod_37 "" TAB_VERB "%3.0" "" COMPU_TAB_REF CompuVtab_2 /end COMPU_METHOD
/begin COMPU_METHOD CompuMethod_42 "" RAT_FUNC "%6.2" "EquivRatio" COEFFS 0 1 0 0 0 1 /end COMPU_METHOD
/begin COMPU_METHOD CompuMethod_46 "" RAT_FUNC "%6.2" "s" COEFFS 0 1 0 0 0 1 /end COMPU_METHOD
/begin COMPU_METHOD CompuMethod_47 "" TAB_VERB "%1.0" "" COMPU_TAB_REF CompuVtab_14 /end COMPU_METHOD
/begin COMPU_METHOD CompuMethod_48 "" RAT_FUNC "%5.4" "" COEFFS 0 1 0 0 0 1 /end COMPU_METHOD
/begin COMPU_METHOD CompuMethod_49 "" RAT_FUNC "%5.4" "mult" COEFFS 0 1 0 0 0 1 /end COMPU_METHOD
/begin COMPU_METHOD CompuMethod_56 "" RAT_FUNC "%8.0" "" COEFFS 0 1 0 0 0 1 /end COMPU_METHOD
/begin COMPU_METHOD CompuMethod_57 "" RAT_FUNC "%6.2" "degC" COEFFS 0 1 0 0 0 1 /end COMPU_METHOD
/begin COMPU_METHOD CompuMethod_63 "" RAT_FUNC "%6.2" "Mult" COEFFS 0 1 0 0 0 1 /end COMPU_METHOD
/begin COMPU_METHOD CompuMethod_64 "" RAT_FUNC "%5.3" "ms" COEFFS 0 1 0 0 0 1 /end COMPU_METHOD
/begin COMPU_METHOD CompuMethod_66 "" RAT_FUNC "%6.2" "degBTDC" COEFFS 0 1 0 0 0 1 /end COMPU_METHOD
/begin COMPU_METHOD CompuMethod_71 "" RAT_FUNC "%6.2" "RPM" COEFFS 0 1 0 0 0 1 /end COMPU_METHOD
/begin COMPU_METHOD CompuMethod_80 "" RAT_FUNC "%6.2" "C" COEFFS 0 1 0 0 0 1 /end COMPU_METHOD
/begin COMPU_METHOD CompuMethod_83 "" TAB_VERB "%3.0" "" COMPU_TAB_REF CompuVtab_22 /end COMPU_METHOD
/begin COMPU_METHOD CompuMethod_88 "" RAT_FUNC "%6.2" "degCA" COEFFS 0 1 0 0 0 1 /end COMPU_METHOD
/begin COMPU_METHOD CompuMethod_98 "" RAT_FUNC "%6.2" "Hz" COEFFS 0 1 0 0 0 1 /end COMPU_METHOD
/begin COMPU_METHOD CompuMethod_100 "" RAT_FUNC "%6.2" "%/s" COEFFS 0 1 0 0 0 1 /end COMPU_METHOD
/begin COMPU_METHOD CompuMethod_103 "" TAB_VERB "%1.0" "" COMPU_TAB_REF CompuVtab_29 /end COMPU_METHOD
/begin COMPU_METHOD CompuMethod_105 "" RAT_FUNC "%6.2" "%/%" COEFFS 0 1 0 0 0 1 /end COMPU_METHOD
/begin COMPU_METHOD CompuMethod_106 "" TAB_VERB "%3.0" "" COMPU_TAB_REF CompuVtab_31 /end COMPU_METHOD
/begin COMPU_METHOD CompuMethod_112 "" TAB_VERB "%3.0" "" COMPU_TAB_REF CompuVtab_37 /end COMPU_METHOD
/begin COMPU_METHOD CompuMethod_113 "" TAB_VERB "%3.0" "" COMPU_TAB_REF CompuVtab_6 /end COMPU_METHOD
/begin COMPU_METHOD CompuMethod_114 "" RAT_FUNC "%6.2" "Time const" COEFFS 0 1 0 0 0 1 /end COMPU_METHOD
/begin COMPU_METHOD CompuMethod_115 "" RAT_FUNC "%6.2" "mph" COEFFS 0 1 0 0 0 1 /end COMPU_METHOD
/begin COMPU_METHOD CompuMethod_116 "" RAT_FUNC "%6.2" "alpha" COEFFS 0 1 0 0 0 1 /end COMPU_METHOD
/begin COMPU_METHOD CompuMethod_118 "" RAT_FUNC "%8.0" "Hz" COEFFS 0 1 0 0 0 1 /end COMPU_METHOD
/begin COMPU_METHOD CompuMethod_119 "" RAT_FUNC "%9.4" "%/ADC" COEFFS 0 1 0 0 0 1 /end COMPU_METHOD
/begin COMPU_METHOD CompuMethod_121 "" TAB_VERB "%3.0" "" COMPU_TAB_REF CompuVtab_40 /end COMPU_METHOD
/begin COMPU_METHOD CompuMethod_122 "" TAB_VERB "%3.0" "" COMPU_TAB_REF CompuVtab_41 /end COMPU_METHOD
/begin COMPU_METHOD CompuMethod_123 "" RAT_FUNC "%7.2" "Hz" COEFFS 0 1 0 0 0 0.01 /end COMPU_METHOD
/begin COMPU_METHOD CompuMethod_124 "" RAT_FUNC "%5.0" "ms" COEFFS 0 1 0 0 0 1 /end COMPU_METHOD
/begin COMPU_METHOD CompuMethod_125 "" TAB_VERB "%3.0" "" COMPU_TAB_REF CompuVtab_42 /end COMPU_METHOD
/begin COMPU_METHOD CompuMethod_132 "" RAT_FUNC "%5.3" "" COEFFS 0 1 0 0 0 1 /end COMPU_METHOD
/begin COMPU_METHOD CompuMethod_133 "" RAT_FUNC "%6.4" "ms/mg" COEFFS 0 1 0 0 0 1 /end COMPU_METHOD
/begin COMPU_METHOD CompuMethod_134 "" RAT_FUNC "%7.4" "ms" COEFFS 0 1 0 0 0 1 /end COMPU_METHOD
/begin COMPU_METHOD CompuMethod_138 "" RAT_FUNC "%9.4" "kPa/ADC" COEFFS 0 1 0 0 0 1 /end COMPU_METHOD
/begin COMPU_METHOD CompuMethod_139 "" TAB_VERB "%1.0" "" COMPU_TAB_REF CompuVtab_50 /end COMPU_METHOD
/begin COMPU_METHOD CompuMethod_140 "" TAB_VERB "%1.0" "" COMPU_TAB_REF CompuVtab_51 /end COMPU_METHOD
/begin COMPU_METHOD CompuMethod_141 "" TAB_VERB "%3.0" "" COMPU_TAB_REF CompuVtab_52 /end COMPU_METHOD
/begin COMPU_METHOD CompuMethod_142 "" TAB_VERB "%3.0" "" COMPU_TAB_REF CompuVtab_53 /end COMPU_METHOD
/begin COMPU_METHOD CompuMethod_143 "" RAT_FUNC "%6.2" "psi" COEFFS 0 1 0 0 0 1 /end COMPU_METHOD
/begin COMPU_METHOD CompuMethod_146 "" TAB_VERB "%1.0" "boolean" COMPU_TAB_REF CompuVtab_55 /end COMPU_METHOD
/begin COMPU_METHOD CompuMethod_147 "" TAB_VERB "%1.0" "" COMPU_TAB_REF CompuVtab_56 /end COMPU_METHOD
/begin COMPU_METHOD CompuMethod_148 "" TAB_VERB "%1.0" "" COMPU_TAB_REF CompuVtab_57 /end COMPU_METHOD
/begin COMPU_METHOD CompuMethod_150 "" RAT_FUNC "%8.3" "mult" COEFFS 0 1 0 0 0 1 /end COMPU_METHOD
/begin COMPU_METHOD CompuMethod_152 "" TAB_VERB "%1.0" "" COMPU_TAB_REF CompuVtab_59 /end COMPU_METHOD
/begin COMPU_METHOD CompuMethod_153 "" RAT_FUNC "%6.2" "ratio" COEFFS 0 1 0 0 0 1 /end COMPU_METHOD
/begin COMPU_METHOD CompuMethod_154 "" RAT_FUNC "%9.4" "psi/ADC" COEFFS 0 1 0 0 0 1 /end COMPU_METHOD
/begin COMPU_METHOD CompuMethod_156 "" RAT_FUNC "%6.2" "multiplier" COEFFS 0 1 0 0 0 1 /end COMPU_METHOD
/begin COMPU_METHOD CompuMethod_158 "" TAB_VERB "%1.0" "" COMPU_TAB_REF CompuVtab_62 /end COMPU_METHOD
/begin COMPU_METHOD CompuMethod_159 "" TAB_VERB "%3.0" "" COMPU_TAB_REF CompuVtab_63 /end COMPU_METHOD
/begin COMPU_METHOD CompuMethod_160 "" TAB_VERB "%3.0" "" COMPU_TAB_REF CompuVtab_64 /end COMPU_METHOD
/begin COMPU_METHOD CompuMethod_161 "" TAB_VERB "%1.0" "" COMPU_TAB_REF CompuVtab_65 /end COMPU_METHOD
/begin COMPU_METHOD CompuMethod_162 "" RAT_FUNC "%6.2" "RPM/sec" COEFFS 0 1 0 0 0 1 /end COMPU_METHOD
/begin COMPU_METHOD CompuMethod_164 "" RAT_FUNC "%6.2" "Volts" COEFFS 0 1 0 0 0 1 /end COMPU_METHOD
/begin COMPU_METHOD CompuMethod_165 "" RAT_FUNC "%9.4" "Volts/ADC" COEFFS 0 1 0 0 0 1 /end COMPU_METHOD
/begin COMPU_METHOD CompuMethod_166 "" TAB_VERB "%1.0" "" COMPU_TAB_REF CompuVtab_13 /end COMPU_METHOD
/begin COMPU_METHOD CompuMethod_168 "" TAB_VERB "%1.0" "degBTDC" COMPU_TAB_REF CompuVtab_13 /end COMPU_METHOD
/begin COMPU_METHOD CompuMethod_169 "" TAB_VERB "%1.0" "" COMPU_TAB_REF CompuVtab_66 /end COMPU_METHOD
/begin COMPU_METHOD CompuMethod_170 "" TAB_VERB "%1.0" "" COMPU_TAB_REF CompuVtab_67 /end COMPU_METHOD
/begin COMPU_METHOD CompuMethod_174 "" RAT_FUNC "%6.2" "mg" COEFFS 0 1 0 0 0 1 /end COMPU_METHOD
/begin COMPU_METHOD CompuMethod_177 "" RAT_FUNC "%6.2" "bool" COEFFS 0 1 0 0 0 1 /end COMPU_METHOD
/begin COMPU_METHOD CompuMethod_178 "" TAB_VERB "%1.0" "" COMPU_TAB_REF CompuVtab_71 /end COMPU_METHOD
/begin COMPU_METHOD CompuMethod_179 "" RAT_FUNC "%6.2" "mph/s" COEFFS 0 1 0 0 0 1 /end COMPU_METHOD
/begin COMPU_METHOD CompuMethod_180 "" RAT_FUNC "%6.2" "MPH" COEFFS 0 1 0 0 0 1 /end COMPU_METHOD
/begin COMPU_METHOD CompuMethod_181 "" TAB_VERB "%1.0" "enum" COMPU_TAB_REF CompuVtab_2 /end COMPU_METHOD
/begin COMPU_METHOD CompuMethod_182 "" RAT_FUNC "%3.0" "sec" COEFFS 0 1 0 0 0 1 /end COMPU_METHOD
/begin COMPU_METHOD CompuMethod_183 "" RAT_FUNC "%4.3" "sec" COEFFS 0 1 0 0 0 1 /end COMPU_METHOD
/*~~~~~~~~~ 6.3.34 COMPU_VTABs ~~~~~~~~~*/
/begin COMPU_VTAB CompuVtab_1 "" TAB_VERB 2 0 "Pass-Through" 1 "Override" /end COMPU_VTAB
/begin COMPU_VTAB CompuVtab_2 "" TAB_VERB 2 0 "Disabled" 1 "Enabled" /end COMPU_VTAB
/begin COMPU_VTAB CompuVtab_6 "" TAB_VERB 90 0 "Normal Operation" 1 "Bad Resource ID" 2 "Hardware Not Supported" 3 "Behaviour Not Supported" 4 "Bad Attribute Data" 5 "Fail On Create" 6 "Fail On Set Attributes" 7 "Resource Not Created" 8 "Missing Attribute" 9 "Behaviour Method Not Supported" 10 "A Service Failed" 11 "Failed to destroy a resource" 12 "Resource Was Created" 13 "Resource Conflict" 14 "Invalid Encoder Type" 15 "2-Strike Not Supported" 16 "720degCA Pattern Not Supported" 17 "CAM Pattern Not Supported" 18 "Unknown CAM Pattern Supplied" 19 "Engine Speed Present" 20 "Hardware Interface Not Supported" 21 "Service Already Started" 22 "Register Write Failed to verify" 23 "Register access was denied" 24 "Out of free store memory" 25 "Software Q Overrun" 26 "Hardware Q Overrun" 27 "Feature unsupported in archive" 28 "Insufficient FW resource" 29 "OS Resource conflict" 30 "Driver Mode conflict" 31 "RTC time is illegal" 32 "FFS unmounted" 33 "Access from an ISR" 34 "FFS internal" 35 "Operation timed out" 36 "Task Kernel API Usage" 37 "Operation aborted" 38 "File not Found" 39 "Invalid characters in filename" 40 "Duplicate filename" 41 "Filename is too long" 42 "Dir not empty on remove" 43 "Dir not found" 44 "Dir name invalid" 45 "Dir exists" 46 "Dir too deep" 47 "Illegal Handle" 48 "End of File" 49 "Media Full" 50 "Media Write" 51 "Media Read" 52 "Media Write Protected" 53 "File Read Only" 54 "FS Media Changed" 55 "Internal USB" 56 "Voltage too high for USB IC" 57 "Encoder not created" 64 "TPU Chan Conflict" 65 "TPU Func Unavailable" 66 "TPU Config" 67 "TPU Primative Usage" 68 "TPU Primitive Count" 69 "TPU Restricted TPU channel" 70 "TPU Not Created" 71 "TPU Self Modify constant write err" 72 "TPU Error 0x48" 73 "TPU Error 0x49" 74 "TPU Error 0x4A" 75 "TPU Error 0x4B" 76 "TPU Error 0x4C" 77 "TPU Error 0x4D" 78 "TPU Error 0x4E" 79 "TPU Error 0x4F" 80 "TPU Error 0x50" 81 "TPU Error 0x51" 82 "TPU Error 0x52" 83 "TPU Error 0x53" 84 "TPU Error 0x54" 85 "TPU Error 0x55" 86 "TPU Error 0x56" 87 "TPU Error 0x57" 88 "TPU Error 0x58" 89 "TPU Error 0x59" 90 "TPU Error 0x5A" 91 "TPU Error 0x5B" 92 "TPU Error 0x5C" 93 "TPU Error 0x5D" 94 "TPU Error 0x5E" 95 "TPU Error 0x5F" /end COMPU_VTAB
/begin COMPU_VTAB CompuVtab_13 "" TAB_VERB 2 0 "Unlocked" 1 "Locked" /end COMPU_VTAB
/begin COMPU_VTAB CompuVtab_14 "" TAB_VERB 2 0 "Not Enabled" 1 "Enabled" /end COMPU_VTAB
/begin COMPU_VTAB CompuVtab_22 "" TAB_VERB 2 0 "Rising Edge" 1 "Falling Edge" /end COMPU_VTAB
/begin COMPU_VTAB CompuVtab_29 "" TAB_VERB 2 0 "Decreasing" 1 "Increasing" /end COMPU_VTAB
/begin COMPU_VTAB CompuVtab_31 "" TAB_VERB 154 0 "ACChargeHigh_Fault" 1 "ACChargeLow_Fault" 2 "ACPresRangeHigh" 3 "ACPresRangeLow" 4 "APP1_AdaptAdaptHiMax" 5 "APP1_AdaptAdaptHiMin" 6 "APP1_AdaptAdaptLoMax" 7 "APP1_AdaptAdaptLoMin" 8 "APP1_AdaptRangeHigh" 9 "APP1_AdaptRangeLow" 10 "APP2_AdaptAdaptHiMax" 11 "APP2_AdaptAdaptHiMin" 12 "APP2_AdaptAdaptLoMax" 13 "APP2_AdaptAdaptLoMin" 14 "APP2_AdaptRangeHigh" 15 "APP2_AdaptRangeLow" 16 "APP_Sensors_Conflict" 17 "AirflowMismatch_Fault" 18 "AltInop_Fault" 19 "Bank1_EquivRatioRangeHigh" 20 "Bank1_EquivRatioRangeLow" 21 "Bank2_EquivRatioRangeHigh" 22 "Bank2_EquivRatioRangeLow" 23 "CamEdgesFault" 24 "CamSyncFault" 25 "ClutchStuckHigh_Fault" 26 "CrankEdgesFault" 27 "CrankSyncFault" 28 "Cylinder1_HardMisfire" 29 "Cylinder2_HardMisfire" 30 "Cylinder3_HardMisfire" 31 "Cylinder4_HardMisfire" 32 "Cylinder5_HardMisfire" 33 "Cylinder6_HardMisfire" 34 "Cylinder7_HardMisfire" 35 "Cylinder8_HardMisfire" 36 "ECTOverTempFault" 37 "ECTRangeHigh" 38 "ECTRangeLow" 39 "ECTSevereOverTempFault" 40 "EST1_Open" 41 "EST1_Short" 42 "EST2_Open" 43 "EST2_Short" 44 "EST3_Open" 45 "EST3_Short" 46 "EST4_Open" 47 "EST4_Short" 48 "EST5_Open" 49 "EST5_Short" 50 "EST6_Open" 51 "EST6_Short" 52 "EST7_Open" 53 "EST7_Short" 54 "EST8_Open" 55 "EST8_Short" 56 "ETCSpringTest" 57 "ETC_Open_Fault" 58 "ETC_Sticking" 59 "EVAPRangeHigh" 60 "EVAPRangeLow" 61 "FuelAdaptRangeHi_BankA" 62 "FuelAdaptRangeHi_BankB" 63 "FuelAdaptRangeLow_BankA" 64 "FuelAdaptRangeLow_BankB" 65 "FuelPresHigh_Fault" 66 "FuelPresLow_Fault" 67 "FuelPresRangeHigh" 68 "FuelPresRangeLow" 69 "FuelSensRangeHigh" 70 "FuelSensRangeLow" 71 "Fuel_LvlRangeHigh" 72 "Fuel_LvlRangeLow" 73 "GPS_DateTime_Timeout" 74 "GPS_LatLong_Timeout" 75 "GPS_SpeedDir_Timeout" 76 "HardOverspeed" 77 "IATRangeHigh" 78 "IATRangeLow" 79 "Inj1Open" 80 "Inj2Open" 81 "Inj3Open" 82 "Inj4Open" 83 "Inj5Open" 84 "Inj6Open" 85 "Inj7Open" 86 "Inj8Open" 87 "Lambda1Error_Fault" 88 "Lambda1Fault_Fault" 89 "Lambda1HtrOpen_Fault" 90 "Lambda1HtrShort_Fault" 91 "Lambda1Overcool_Fault" 92 "Lambda1Overheat_Fault" 93 "Lambda1StuckInReset_Fault" 94 "Lambda1StuckInWarmup_Fault" 95 "Lambda1VoltHigh_Fault" 96 "Lambda1VoltLow_Fault" 97 "Lambda2Error_Fault" 98 "Lambda2Fault_Fault" 99 "Lambda2HtrOpen_Fault" 100 "Lambda2HtrShort_Fault" 101 "Lambda2Overcool_Fault" 102 "Lambda2Overheat_Fault" 103 "Lambda2StuckInReset_Fault" 104 "Lambda2StuckInWarmup_Fault" 105 "Lambda2VoltHigh_Fault" 106 "Lambda2VoltLow_Fault" 107 "Lambda_1_Timeout" 108 "Lambda_2_Timeout" 109 "Lambda_Bank2Bank_Fault" 110 "LeanProtect_Fault" 111 "MAFRangeHigh" 112 "MAFRangeLow" 113 "MAPRangeHigh" 114 "MAPRangeLow" 115 "MAPTimeRangeHigh" 116 "MAPTimeRangeLow" 117 "MAP_IR_HI" 118 "MAP_IR_LO" 119 "MAP_STICKING" 120 "MediumOverspeed" 121 "NoOil_Fault" 122 "O2FailedLean_BankA" 123 "O2FailedLean_BankB" 124 "O2FailedRich_BankA" 125 "O2FailedRich_BankB" 126 "O2NotActive_BankA" 127 "O2NotActive_BankB" 128 "OilPresRangeHigh" 129 "OilPresRangeLow" 130 "ScrambleStuckHigh_Fault" 131 "SensVoltRangeHigh" 132 "SensVoltRangeLow" 133 "SoftOverspeed" 134 "SysVoltRangeHigh" 135 "SysVoltRangeLow" 136 "TPS1AdaptHiMax" 137 "TPS1AdaptHiMin" 138 "TPS1AdaptLoMax" 139 "TPS1AdaptLoMin" 140 "TPS1RangeHigh" 141 "TPS1RangeLow" 142 "TPS2AdaptHiMax" 143 "TPS2AdaptHiMin" 144 "TPS2AdaptLoMax" 145 "TPS2AdaptLoMin" 146 "TPS2RangeHigh" 147 "TPS2RangeLow" 148 "TPS_Sensors_Conflict" 149 "VSPDRangeHigh" 150 "VSPDRangeLow" 151 "VoltLow_Fault" 152 "VoltTooHigh_Fault" 153 "(None)" /end COMPU_VTAB
/begin COMPU_VTAB CompuVtab_37 "" TAB_VERB 3 0 "Rate Limiter" 1 "Low Pass" 2 "Moving Average" /end COMPU_VTAB
/begin COMPU_VTAB CompuVtab_40 "" TAB_VERB 2 0 "No Alias Protect" 1 "Use Alias Protect" /end COMPU_VTAB
/begin COMPU_VTAB CompuVtab_41 "" TAB_VERB 2 0 "Digital Input" 1 "VR Input" /end COMPU_VTAB
/begin COMPU_VTAB CompuVtab_42 "" TAB_VERB 2 0 "Enable" 1 "Cut" /end COMPU_VTAB
/begin COMPU_VTAB CompuVtab_50 "" TAB_VERB 2 0 "Gov Enabled" 1 "Gov Disabled" /end COMPU_VTAB
/begin COMPU_VTAB CompuVtab_51 "" TAB_VERB 2 0 "ETC Req Mode" 1 "PID Mode" /end COMPU_VTAB
/begin COMPU_VTAB CompuVtab_52 "" TAB_VERB 2 0 "Hold Off" 1 "Hold On" /end COMPU_VTAB
/begin COMPU_VTAB CompuVtab_53 "" TAB_VERB 2 0 "Reset Off" 1 "Reset On" /end COMPU_VTAB
/begin COMPU_VTAB CompuVtab_55 "" TAB_VERB 2 0 "Off" 1 "On" /end COMPU_VTAB
/begin COMPU_VTAB CompuVtab_56 "" TAB_VERB 2 0 "Load saved application values on next startup" 1 "Load factory defaults on next startup" /end COMPU_VTAB
/begin COMPU_VTAB CompuVtab_57 "" TAB_VERB 7 0 "Currently loading NV from Factory FLASH to RAM" 1 "Currently loading NV from EEPROM to RAM" 2 "Currently storing NV from RAM to EEPROM" 3 "Detected new program.  Loaded Factory Defaults from FLASH" 4 "CRC failure.  Loaded Factory Defaults from FLASH" 5 "User requested refresh from Factory Defaults in FLASH." 6 "Successful refresh of EEPROM values from last shutdown" /end COMPU_VTAB
/begin COMPU_VTAB CompuVtab_59 "" TAB_VERB 2 0 "O2A" 1 "O2B" /end COMPU_VTAB
/begin COMPU_VTAB CompuVtab_62 "" TAB_VERB 2 0 "Run" 1 "Restore To Defaults" /end COMPU_VTAB
/begin COMPU_VTAB CompuVtab_63 "" TAB_VERB 4 0 "Disabled" 1 "Soft" 2 "Medium" 3 "Hard" /end COMPU_VTAB
/begin COMPU_VTAB CompuVtab_64 "" TAB_VERB 3 0 "Cut Spark" 1 "Cut Fuel" 2 "Cut Spark and Fuel" /end COMPU_VTAB
/begin COMPU_VTAB CompuVtab_65 "" TAB_VERB 2 0 "SteadyOrRising" 1 "Falling" /end COMPU_VTAB
/begin COMPU_VTAB CompuVtab_66 "" TAB_VERB 2 0 "Transient" 1 "Steady" /end COMPU_VTAB
/begin COMPU_VTAB CompuVtab_67 "" TAB_VERB 2 0 "Run" 1 "Store To EEPROM" /end COMPU_VTAB
/begin COMPU_VTAB CompuVtab_71 "" TAB_VERB 2 0 "MAF" 1 "O2" /end COMPU_VTAB
/begin FUNCTION IGain "" /begin DEF_CHARACTERISTIC ETC_IGainMultTbl ETCIGain /end DEF_CHARACTERISTIC /begin OUT_MEASUREMENT ETC_IGainMult /end OUT_MEASUREMENT /end FUNCTION
/begin FUNCTION Setpoint_Manager "" /begin DEF_CHARACTERISTIC ETC_LoAdaptRateLimit /end DEF_CHARACTERISTIC /begin SUB_FUNCTION Tuning /end SUB_FUNCTION /end FUNCTION
/begin FUNCTION ETC_Override "" /begin DEF_CHARACTERISTIC ETC_new ETC_ovr /end DEF_CHARACTERISTIC /end FUNCTION
/begin FUNCTION PGain "" /begin DEF_CHARACTERISTIC ETC_PGainMultTbl ETCPGain /end DEF_CHARACTERISTIC /begin OUT_MEASUREMENT ETC_PGainMult /end OUT_MEASUREMENT /end FUNCTION
/begin FUNCTION ETC_Adapt_Request "" /begin OUT_MEASUREMENT ETC_ShutdownSetpointMode /end OUT_MEASUREMENT /end FUNCTION
/begin FUNCTION ETC_Sticking_Fault "" /begin DEF_CHARACTERISTIC ETC_StickingThresh /end DEF_CHARACTERISTIC /end FUNCTION
/begin FUNCTION DamperSwitch "" /begin DEF_CHARACTERISTIC ETCDamperSwitchHyst ETCDamperSwitchThresh /end DEF_CHARACTERISTIC /begin OUT_MEASUREMENT ETCDamperSwtichState ETCDamperTPS ETCDamperTPSThresh /end OUT_MEASUREMENT /end FUNCTION
/begin FUNCTION ETC_PID_Config "" /begin DEF_CHARACTERISTIC ETCDamperTPSFilt ETCLwrLim ETCUprLim /end DEF_CHARACTERISTIC /end FUNCTION
/begin FUNCTION ETCReq_Override "" /begin DEF_CHARACTERISTIC ETCReq_new ETCReq_ovr /end DEF_CHARACTERISTIC /end FUNCTION
/begin FUNCTION Tuning "" /begin DEF_CHARACTERISTIC ETCTuneAmp ETCTuneEnable ETCTuneFreq ETCTuneOffset /end DEF_CHARACTERISTIC /begin SUB_FUNCTION ETCReq_Override /end SUB_FUNCTION /end FUNCTION
/begin FUNCTION ETCStallShutDown "" /begin DEF_CHARACTERISTIC ETCShutdownTimerThresh /end DEF_CHARACTERISTIC /begin OUT_MEASUREMENT ETCStallStateShutdown /end OUT_MEASUREMENT /end FUNCTION
/begin FUNCTION Ethanol_Spark_Offset "" /begin DEF_CHARACTERISTIC Ethanol_SpkOfstMultMap EthSpkModTbl /end DEF_CHARACTERISTIC /begin OUT_MEASUREMENT Ethanol_Spk_Ofst Ethanol_SpkOfstMult EthSpkMod /end OUT_MEASUREMENT /end FUNCTION
/begin FUNCTION EVAP "" /begin DEF_CHARACTERISTIC EVAPTbl /end DEF_CHARACTERISTIC /begin OUT_MEASUREMENT EVAP EVAPADC EVAPIdx EVAPRaw /end OUT_MEASUREMENT /begin SUB_FUNCTION EVAP_Override EVAP_Config /end SUB_FUNCTION /end FUNCTION
/begin FUNCTION EVAP_Override "" /begin DEF_CHARACTERISTIC EVAP_new EVAP_ovr /end DEF_CHARACTERISTIC /end FUNCTION
/begin FUNCTION EVAP_Config "" /begin DEF_CHARACTERISTIC EVAPDefault EVAPFiltConst EVAPMax EVAPMin /end DEF_CHARACTERISTIC /end FUNCTION
/begin FUNCTION Rate_Limiter "" /begin DEF_CHARACTERISTIC Fall_Rate Rise_Rate /end DEF_CHARACTERISTIC /end FUNCTION
/begin FUNCTION Filter_Options "" /begin DEF_CHARACTERISTIC Filter_Type_Selection /end DEF_CHARACTERISTIC /begin SUB_FUNCTION Rate_Limiter Moving_Average_Filter /end SUB_FUNCTION /end FUNCTION
/begin FUNCTION FuelOxygenationSensor "" /begin SUB_FUNCTION Filter_Options /end SUB_FUNCTION /end FUNCTION
/begin FUNCTION FAN1_PWM_Override "" /begin DEF_CHARACTERISTIC FAN1_PWM_new FAN1_PWM_ovr /end DEF_CHARACTERISTIC /end FUNCTION
/begin FUNCTION FAN1_PWM "" /begin OUT_MEASUREMENT FAN1_PWMDutyCycle /end OUT_MEASUREMENT /begin SUB_FUNCTION FAN1_PWM_Override FAN1_PWM_Config /end SUB_FUNCTION /end FUNCTION
/begin FUNCTION FAN_Control_2 "" /begin SUB_FUNCTION FAN1_PWM FAN2_PWM /end SUB_FUNCTION /end FUNCTION
/begin FUNCTION FAN1_PWM_Config ""
 /begin DEF_CHARACTERISTIC FAN1_PWMFrequency FAN1_PWMGain FAN1_PWMMaxLimit FAN1_PWMMinLimit FAN1_PWMOffset /end DEF_CHARACTERISTIC
/end FUNCTION
/begin FUNCTION FAN2_PWM_Override "" /begin DEF_CHARACTERISTIC FAN2_PWM_new FAN2_PWM_ovr /end DEF_CHARACTERISTIC /end FUNCTION
/begin FUNCTION FAN2_PWM "" /begin OUT_MEASUREMENT FAN2_PWMDutyCycle /end OUT_MEASUREMENT /begin SUB_FUNCTION FAN2_PWM_Override FAN2_PWM_Config /end SUB_FUNCTION /end FUNCTION
/begin FUNCTION FAN2_PWM_Config ""
 /begin DEF_CHARACTERISTIC FAN2_PWMFrequency FAN2_PWMGain FAN2_PWMMaxLimit FAN2_PWMMinLimit FAN2_PWMOffset /end DEF_CHARACTERISTIC
/end FUNCTION
/begin FUNCTION Action_Reasons ""
 /begin OUT_MEASUREMENT FaultActionReason._.CutThrottle FaultActionReason._.DFCODisable FaultActionReason._.DelayedEngineShutdown FaultActionReason._.DisableAC FaultActionReason._.DisableFanRun FaultActionReason._.DisableFanStall FaultActionReason._.DisableO2Ctrl FaultActionReason._.DisableVEAdapt FaultActionReason._.EngineProtectLED FaultActionReason._.EngineShutdown FaultActionReason._.HardRevLimit FaultActionReason._.MIL_LED FaultActionReason._.MediumRevLimit FaultActionReason._.SoftRevLimit /end OUT_MEASUREMENT
/end FUNCTION
/begin FUNCTION Gear_Estimator ""
 /begin DEF_CHARACTERISTIC FDR Gear1Ratio Gear2Ratio Gear3Ratio Gear4Ratio Gear5Ratio Gear6Ratio GearMatchHyst TireRadius /end DEF_CHARACTERISTIC
 /begin OUT_MEASUREMENT GearEstimated /end OUT_MEASUREMENT
/end FUNCTION
/begin FUNCTION Moving_Average_Filter "" /begin DEF_CHARACTERISTIC FinalGain Gain1 Gain2 Gain3 /end DEF_CHARACTERISTIC /end FUNCTION
/begin FUNCTION Dash_Message_6 "" /begin DEF_CHARACTERISTIC Flex_Filt /end DEF_CHARACTERISTIC /end FUNCTION
/begin FUNCTION Framework "" /begin OUT_MEASUREMENT FrameworkGlueErrors /end OUT_MEASUREMENT /end FUNCTION
/begin FUNCTION FrequencyIn ""
 /begin OUT_MEASUREMENT freq_in_create_FuelSensorPin freq_in_create_MAF_Pin freq_in_create_VSPD_Pin freq_in_read_FuelSensorPin freq_in_read_MAF_Pin freq_in_read_VSPD_Pin /end OUT_MEASUREMENT
/end FUNCTION
/begin FUNCTION Fuel_Economy "" /begin OUT_MEASUREMENT Fuel_Economy_Filtered Fuel_Economy_Inst /end OUT_MEASUREMENT /begin SUB_FUNCTION First_Order_Low_Pass__Tunable_ /end SUB_FUNCTION /end FUNCTION
/begin FUNCTION Fuel_Lvl "" /begin DEF_CHARACTERISTIC Fuel_LvlTbl /end DEF_CHARACTERISTIC /begin OUT_MEASUREMENT Fuel_Lvl Fuel_LvlADC Fuel_LvlIdx Fuel_LvlRaw /end OUT_MEASUREMENT /begin SUB_FUNCTION Fuel_Lvl_Override Fuel_Lvl_Config /end SUB_FUNCTION /end FUNCTION
/begin FUNCTION Fuel_Level "" /begin SUB_FUNCTION Fuel_Lvl /end SUB_FUNCTION /end FUNCTION
/begin FUNCTION Fuel_Lvl_Override "" /begin DEF_CHARACTERISTIC Fuel_Lvl_new Fuel_Lvl_ovr /end DEF_CHARACTERISTIC /end FUNCTION
/begin FUNCTION Fuel_Lvl_Config "" /begin DEF_CHARACTERISTIC Fuel_LvlDefault Fuel_LvlFiltConst Fuel_LvlMax Fuel_LvlMin /end DEF_CHARACTERISTIC /end FUNCTION
/begin FUNCTION Saturation__Tunable__1 "" /begin DEF_CHARACTERISTIC FuelAdaptError_BankALwrLim FuelAdaptError_BankAUprLim /end DEF_CHARACTERISTIC /end FUNCTION
/begin FUNCTION Saturation__Tunable_1 "" /begin DEF_CHARACTERISTIC FuelAdaptError_BankBLwrLim FuelAdaptError_BankBUprLim /end DEF_CHARACTERISTIC /end FUNCTION
/begin FUNCTION DeltaPressureIndex "" /begin OUT_MEASUREMENT FuelDeltaPress InjDeltaPress09Idx InjDeltaPress09In /end OUT_MEASUREMENT /end FUNCTION
/begin FUNCTION Injector_Characterization "" /begin DEF_CHARACTERISTIC InjdPCompTbl InjGain InjOffset InjTurnOffTbl InjTurnOnTbl /end DEF_CHARACTERISTIC
 /begin OUT_MEASUREMENT InjDC InjdPComp InjEPW InjMPW InjTurnOff InjTurnOn MaxAllowableMPW TotalFPC /end OUT_MEASUREMENT
 /begin SUB_FUNCTION DeltaPressureIndex /end SUB_FUNCTION
/end FUNCTION
/begin FUNCTION Fuel_Delta_Pressure_Calculation "" /begin OUT_MEASUREMENT FuelDeltaPressure /end OUT_MEASUREMENT /end FUNCTION
/begin FUNCTION First_Order_Low_Pass__Tunable_ "" /begin DEF_CHARACTERISTIC FuelEconomy_FilterC /end DEF_CHARACTERISTIC /end FUNCTION
/begin FUNCTION Adapt_FuelFlowComp_Map_Bank_B "" /begin DEF_CHARACTERISTIC FuelFlowCompMaxValue FuelFlowCompMinValue /end DEF_CHARACTERISTIC /end FUNCTION
/begin FUNCTION Adapt_FuelFlowComp_Map_Bank_A "" /begin DEF_CHARACTERISTIC FuelFlowCompMaxValue_BankA FuelFlowCompMinValue_BankA /end DEF_CHARACTERISTIC /end FUNCTION
/begin FUNCTION FuelLevel "" /begin DEF_CHARACTERISTIC FuelLevel_FiltConstMap FuelLevel_FuelEevntAlpha /end DEF_CHARACTERISTIC
 /begin OUT_MEASUREMENT FuelLevel_FiltConst FuelLevel_FiltConstColIdx FuelLevel_FiltConstColIn FuelLevel_FiltConstRowIdx FuelLevel_FiltConstRowIn FuelLvl_Fin FuelLvl_NVM_Prb /end OUT_MEASUREMENT
 /begin SUB_FUNCTION RefuelEvent /end SUB_FUNCTION
/end FUNCTION
/begin FUNCTION RefuelEvent "" /begin DEF_CHARACTERISTIC FuelLevel_KeyUpDelay FuelLevl_KeyUpDiff /end DEF_CHARACTERISTIC /begin OUT_MEASUREMENT FuelLevel_RefuelEvent /end OUT_MEASUREMENT /end FUNCTION
/begin FUNCTION FUELP "" /begin OUT_MEASUREMENT FUELP /end OUT_MEASUREMENT /begin SUB_FUNCTION FUELP_Override FUELP_Config /end SUB_FUNCTION /end FUNCTION
/begin FUNCTION FuelPump "" /begin SUB_FUNCTION FUELP /end SUB_FUNCTION /end FUNCTION
/begin FUNCTION FUELP_Override "" /begin DEF_CHARACTERISTIC FUELP_new FUELP_ovr /end DEF_CHARACTERISTIC /end FUNCTION
/begin FUNCTION FUELP_Config "" /begin DEF_CHARACTERISTIC FUELP_Polarity /end DEF_CHARACTERISTIC /end FUNCTION
/begin FUNCTION FuelPres "" /begin OUT_MEASUREMENT FuelPres FuelPresADC FuelPresRaw /end OUT_MEASUREMENT /begin SUB_FUNCTION FuelPres_Override FuelPres_Config /end SUB_FUNCTION /end FUNCTION
/begin FUNCTION Wrong_Fuel_Pressure_Fault_Logic "" /begin DEF_CHARACTERISTIC FuelPres_DeltaTarget FuelPres_DeltaTolerance /end DEF_CHARACTERISTIC /end FUNCTION
/begin FUNCTION Dash_Message_3 "" /begin DEF_CHARACTERISTIC FuelPres_Filt MAP_filt OilPres_Filt /end DEF_CHARACTERISTIC /end FUNCTION
/begin FUNCTION FuelPres_Override "" /begin DEF_CHARACTERISTIC FuelPres_new FuelPres_ovr /end DEF_CHARACTERISTIC /end FUNCTION
/begin FUNCTION FuelPres_Config ""
 /begin DEF_CHARACTERISTIC FuelPresDfltValue FuelPresFilterConst FuelPresGain FuelPresInputHiFltPos FuelPresInputLoFltPos FuelPresOfst /end DEF_CHARACTERISTIC
/end FUNCTION
/begin FUNCTION FuelSens "" /begin OUT_MEASUREMENT FuelSens FuelSensADC FuelSensRaw /end OUT_MEASUREMENT /begin SUB_FUNCTION FuelSens_Override FuelSens_Config /end SUB_FUNCTION /end FUNCTION
/begin FUNCTION FuelSens_Override "" /begin DEF_CHARACTERISTIC FuelSens_new FuelSens_ovr /end DEF_CHARACTERISTIC /end FUNCTION
/begin FUNCTION FuelSens_Config ""
 /begin DEF_CHARACTERISTIC FuelSensDfltValue FuelSensFilterConst FuelSensGain FuelSensInputHiFltPos FuelSensInputLoFltPos FuelSensOfst /end DEF_CHARACTERISTIC
/end FUNCTION
/begin FUNCTION Frequency_In_Config ""
 /begin DEF_CHARACTERISTIC FuelSensorPin_AliasProtect FuelSensorPin_EdgeDetect FuelSensorPin_Interface FuelSensorPin_MinFrequency MAF_Pin_AliasProtect MAF_Pin_EdgeDetect MAF_Pin_Interface MAF_Pin_MinFrequency VSPD_Pin_AliasProtect VSPD_Pin_EdgeDetect VSPD_Pin_Interface VSPD_Pin_MinFrequency /end DEF_CHARACTERISTIC
/end FUNCTION
/begin FUNCTION AEM_GPS ""
 /begin DEF_CHARACTERISTIC GPS_DateTime_Timeout GPS_LatLong_Timeout GPS_SpeedDir_Timeout /end DEF_CHARACTERISTIC
 /begin OUT_MEASUREMENT GPS_Altitude_Prb GPS_Course_Prb GPS_DayUTC_Prb GPS_HoursUTC_Prb GPS_Latitude_Prb GPS_Longitude_Prb GPS_MinutesUTC_Prb GPS_MonthUTC_Prb GPS_SatelliteCount_Prb GPS_SecondsUTC_Prb GPS_Speed_Prb GPS_Valid_Prb GPS_YearUTC_Prb /end OUT_MEASUREMENT
/end FUNCTION
/begin FUNCTION Cycle1CutPatter ""
 /begin DEF_CHARACTERISTIC HardCycle1Cyl1 HardCycle1Cyl2 HardCycle1Cyl3 HardCycle1Cyl4 HardCycle1Cyl5 HardCycle1Cyl6 HardCycle1Cyl7 HardCycle1Cyl8 /end DEF_CHARACTERISTIC
/end FUNCTION
/begin FUNCTION Hard_Cycle_Cut_Pattern ""
 /begin SUB_FUNCTION Cycle1CutPatter Cycle2CutPatter Cycle3CutPatter Cycle4CutPatter /end SUB_FUNCTION
/end FUNCTION
/begin FUNCTION SequenceCutPattern "" /begin DEF_CHARACTERISTIC RevLimitType /end DEF_CHARACTERISTIC /begin OUT_MEASUREMENT RevLimiterState /end OUT_MEASUREMENT
 /begin SUB_FUNCTION Hard_Cycle_Cut_Pattern Medium_Cycle_Cut_Pattern Soft_Cycle_Cut_Pattern /end SUB_FUNCTION
/end FUNCTION
/begin FUNCTION Cycle2CutPatter ""
 /begin DEF_CHARACTERISTIC HardCycle2Cyl1 HardCycle2Cyl2 HardCycle2Cyl3 HardCycle2Cyl4 HardCycle2Cyl5 HardCycle2Cyl6 HardCycle2Cyl7 HardCycle2Cyl8 /end DEF_CHARACTERISTIC
/end FUNCTION
/begin FUNCTION Cycle3CutPatter ""
 /begin DEF_CHARACTERISTIC HardCycle3Cyl1 HardCycle3Cyl2 HardCycle3Cyl3 HardCycle3Cyl4 HardCycle3Cyl5 HardCycle3Cyl6 HardCycle3Cyl7 HardCycle3Cyl8 /end DEF_CHARACTERISTIC
/end FUNCTION
/begin FUNCTION Cycle4CutPatter ""
 /begin DEF_CHARACTERISTIC HardCycle4Cyl1 HardCycle4Cyl2 HardCycle4Cyl3 HardCycle4Cyl4 HardCycle4Cyl5 HardCycle4Cyl6 HardCycle4Cyl7 HardCycle4Cyl8 /end DEF_CHARACTERISTIC
/end FUNCTION
/begin FUNCTION IAT "" /begin DEF_CHARACTERISTIC IATTbl /end DEF_CHARACTERISTIC /begin OUT_MEASUREMENT IAT IATADC IATIdx IATRaw /end OUT_MEASUREMENT /begin SUB_FUNCTION IAT_Override IAT_Config /end SUB_FUNCTION /end FUNCTION
/begin FUNCTION Capture_IAT_At_Startup "" /begin DEF_CHARACTERISTIC IAT_KeyUp_Count /end DEF_CHARACTERISTIC /begin OUT_MEASUREMENT IAT_KeyUp /end OUT_MEASUREMENT /end FUNCTION
/begin FUNCTION IAT_KeyUp "" /begin OUT_MEASUREMENT IAT_KeyUp09Idx IAT_KeyUp09In /end OUT_MEASUREMENT /end FUNCTION
/begin FUNCTION IAT_Override "" /begin DEF_CHARACTERISTIC IAT_new IAT_ovr /end DEF_CHARACTERISTIC /end FUNCTION
/begin FUNCTION IAT_Indexes "" /begin OUT_MEASUREMENT IAT05Idx IAT05In IAT07Idx IAT07In IAT17Idx IAT17In /end OUT_MEASUREMENT /end FUNCTION
/begin FUNCTION IAT_Config "" /begin DEF_CHARACTERISTIC IATDefault IATFiltConst IATMax IATMin /end DEF_CHARACTERISTIC /end FUNCTION
/begin FUNCTION Ramp_Air_Into_Idle_State "" /begin DEF_CHARACTERISTIC IdleEntryAirRampInFiltC /end DEF_CHARACTERISTIC /end FUNCTION
/begin FUNCTION Ramp_RPM "" /begin DEF_CHARACTERISTIC InGearRPMCtrlEntryFiltC /end DEF_CHARACTERISTIC /begin OUT_MEASUREMENT MinGovRPMSetPt /end OUT_MEASUREMENT /end FUNCTION
/begin FUNCTION InjEnable_Override "" /begin DEF_CHARACTERISTIC InjEnable_new InjEnable_ovr /end DEF_CHARACTERISTIC /end FUNCTION
/begin FUNCTION SensorVolt ""
 /begin DEF_CHARACTERISTIC Lambda1_VoltHighThresh Lambda1_VoltLowThresh Lambda2_VoltHighThresh Lambda2_VoltLowThresh /end DEF_CHARACTERISTIC
/end FUNCTION
/begin FUNCTION O2_Smart_Sensor "" /begin SUB_FUNCTION SensorVolt Bank2Bank SensorStatus /end SUB_FUNCTION /end FUNCTION
/begin FUNCTION Lean_Protect "" /begin DEF_CHARACTERISTIC LeanProtect_Threshold /end DEF_CHARACTERISTIC /end FUNCTION
/begin FUNCTION O2_Control_Switch_Point_Maps ""
 /begin DEF_CHARACTERISTIC LeanSwPtDeltaMap LeanTargetDeltaMap RichSwPtDeltaMap RichTargetDeltaMap /end DEF_CHARACTERISTIC
 /begin OUT_MEASUREMENT LeanSwPtDelta LeanTargetDelta RichSwPtDelta RichTargetDelta /end OUT_MEASUREMENT
/end FUNCTION
/begin FUNCTION O2_PID_Calibrations ""
 /begin DEF_CHARACTERISTIC O2CtrlDGain O2CtrlIGain O2CtrlPGain O2CtrlPIDOutLowerLimit O2CtrlPIDOutUpperLimit O2ITermLowerLimit O2ITermUpperLimit /end DEF_CHARACTERISTIC
 /begin SUB_FUNCTION O2_Control_Switch_Point_Maps Error_Gain_Scheduling /end SUB_FUNCTION
/end FUNCTION
/begin FUNCTION Closed_Loop_O2_PID_Controller ""
 /begin OUT_MEASUREMENT LiquidO2Control_DTerm_BankA LiquidO2Control_ErrorTerm_BankA LiquidO2Control_ITerm_BankA LiquidO2Control_PTerm_BankA /end OUT_MEASUREMENT
/end FUNCTION
/begin FUNCTION O2_PID_Controller_Bank_A "" /begin OUT_MEASUREMENT O2TargetEquivRatio_BankA /end OUT_MEASUREMENT
 /begin SUB_FUNCTION Closed_Loop_O2_PID_Controller Equivalence_Ratio_Perturbation /end SUB_FUNCTION
/end FUNCTION
/begin FUNCTION Closed_Loop_O2_PID_Controller_1 ""
 /begin OUT_MEASUREMENT LiquidO2Control_DTerm_BankB LiquidO2Control_ErrorTerm_BankB LiquidO2Control_ITerm_BankB LiquidO2Control_PTerm_BankB /end OUT_MEASUREMENT
/end FUNCTION
/begin FUNCTION O2_PID_Controller_Bank_B "" /begin OUT_MEASUREMENT O2TargetEquivRatio_BankB /end OUT_MEASUREMENT
 /begin SUB_FUNCTION Closed_Loop_O2_PID_Controller_1 Equivalence_Ratio_Perturbation_1 /end SUB_FUNCTION
/end FUNCTION
/begin FUNCTION Low_Voltage "" /begin DEF_CHARACTERISTIC LVDiag_AltInop LVDiag_VoltLow LVDiag_VoltTooHigh /end DEF_CHARACTERISTIC /end FUNCTION
/begin FUNCTION MAF "" /begin DEF_CHARACTERISTIC MAFTbl /end DEF_CHARACTERISTIC /begin OUT_MEASUREMENT MAF MAFADC MAFIdx MAFRaw /end OUT_MEASUREMENT /begin SUB_FUNCTION MAF_Override MAF_Config /end SUB_FUNCTION /end FUNCTION
/begin FUNCTION MAF_Override "" /begin DEF_CHARACTERISTIC MAF_new MAF_ovr /end DEF_CHARACTERISTIC /end FUNCTION
/begin FUNCTION MAF_Config "" /begin DEF_CHARACTERISTIC MAFDefault MAFFiltConst MAFMax MAFMin /end DEF_CHARACTERISTIC /end FUNCTION
/begin FUNCTION MAFPortIndex "" /begin OUT_MEASUREMENT MAFPort05Idx MAFPort05In /end OUT_MEASUREMENT /end FUNCTION
/begin FUNCTION MakeUp_EOI_Override "" /begin DEF_CHARACTERISTIC MakeUp_EOI_new MakeUp_EOI_ovr /end DEF_CHARACTERISTIC /end FUNCTION
/begin FUNCTION _MAP "" /begin OUT_MEASUREMENT MAP MAPADC MAPRaw /end OUT_MEASUREMENT /begin SUB_FUNCTION MAP_Override MAP_Config /end SUB_FUNCTION /end FUNCTION
/begin FUNCTION MAP_Fault_Logic ""
 /begin DEF_CHARACTERISTIC MAP_IR_HI MAP_IR_LO MAP_IR_TPS_CL MAP_IR_TPS_OP MAP_STUCK MAP_TPS_STUCK /end DEF_CHARACTERISTIC
/end FUNCTION
/begin FUNCTION MAP_Override "" /begin DEF_CHARACTERISTIC MAP_new MAP_ovr /end DEF_CHARACTERISTIC /end FUNCTION
/begin FUNCTION MAP_Indexes "" /begin OUT_MEASUREMENT MAP05Idx MAP05In MAP09Idx MAP09In MAP17Idx MAP17In /end OUT_MEASUREMENT /end FUNCTION
/begin FUNCTION MAP_Config ""
 /begin DEF_CHARACTERISTIC MAPDfltValue MAPFilterConst MAPGain MAPInputHiFltPos MAPInputLoFltPos MAPOfst /end DEF_CHARACTERISTIC
/end FUNCTION
/begin FUNCTION MAPTime "" /begin OUT_MEASUREMENT MAPTime MAPTimeADC MAPTimeRaw /end OUT_MEASUREMENT /begin SUB_FUNCTION MAPTime_Override MAPTime_Config /end SUB_FUNCTION /end FUNCTION
/begin FUNCTION MAPTime_Override "" /begin DEF_CHARACTERISTIC MAPTime_new MAPTime_ovr /end DEF_CHARACTERISTIC /end FUNCTION
/begin FUNCTION MAPTime_Config ""
 /begin DEF_CHARACTERISTIC MAPTimeDfltValue MAPTimeFilterConst MAPTimeGain MAPTimeInputHiFltPos MAPTimeInputLoFltPos MAPTimeOfst /end DEF_CHARACTERISTIC
/end FUNCTION
/begin FUNCTION Universal_PID__Tunable___Scheduled__1 ""
 /begin DEF_CHARACTERISTIC MaxGovDGain MaxGovDGainErrorMultTbl MaxGovErrorGain MaxGovIGain MaxGovIGainErrorMultTbl MaxGovITermLowerLimit MaxGovITermUpperLimit MaxGovPGain MaxGovPGainErrorMultTbl MaxGovPIDOutLowerLimit MaxGovPIDOutUpperLimit /end DEF_CHARACTERISTIC
 /begin OUT_MEASUREMENT MaxGovDGainErrorMult MaxGovDTerm MaxGovError MaxGovIGainErrorMult MaxGovITerm MaxGovPGainErrorMult MaxGovPTerm MaxGovSpeedErrorIdx MaxGovSpeedErrorIn /end OUT_MEASUREMENT
/end FUNCTION
/begin FUNCTION MaxGovernor "" /begin OUT_MEASUREMENT MaxGovOutput TPSRequestLookupAirOfst /end OUT_MEASUREMENT
 /begin SUB_FUNCTION Universal_PID__Tunable___Scheduled__1 MaxGovState I_Term_Preload Trigger_Pre_load Ramp_RPM_1 /end SUB_FUNCTION
/end FUNCTION
/begin FUNCTION MaxGovState "" /begin DEF_CHARACTERISTIC MaxGovDisable MaxGovTPSHyst /end DEF_CHARACTERISTIC /begin OUT_MEASUREMENT MaxGovETCMode MaxGovHold MaxGovReset MaxGovState /end OUT_MEASUREMENT /end FUNCTION
/begin FUNCTION I_Term_Preload "" /begin DEF_CHARACTERISTIC MaxGovPreloadITermTbl /end DEF_CHARACTERISTIC /begin OUT_MEASUREMENT MaxGovIC MaxGovPreloadITerm /end OUT_MEASUREMENT /end FUNCTION
/begin FUNCTION InGear ""
 /begin DEF_CHARACTERISTIC MaxGovInGearLowerLim MaxGovInGearRPMSetPt MaxGovInGearRPMThresh MaxGovInGearUpperLim /end DEF_CHARACTERISTIC
/end FUNCTION
/begin FUNCTION Trigger_Pre_load "" /begin SUB_FUNCTION InGear InNeutral /end SUB_FUNCTION /end FUNCTION
/begin FUNCTION InNeutral ""
 /begin DEF_CHARACTERISTIC MaxGovNtrlLowerLim MaxGovNtrlRPMSetPt MaxGovNtrlRPMThresh MaxGovNtrlUpperLim /end DEF_CHARACTERISTIC
/end FUNCTION
/begin FUNCTION Ramp_RPM_1 "" /begin DEF_CHARACTERISTIC MaxGovRPMCtrlEntryFiltC /end DEF_CHARACTERISTIC /begin OUT_MEASUREMENT MaxGovRPMSetpoint /end OUT_MEASUREMENT /end FUNCTION
/begin FUNCTION SparkAdvanceLimiter "" /begin DEF_CHARACTERISTIC MaxSparkLimitOffIdle MaxSparkLimitTbl MinSparkLimit /end DEF_CHARACTERISTIC /begin OUT_MEASUREMENT MaxSparkLimit TotalSparkAdv /end OUT_MEASUREMENT /end FUNCTION
/begin FUNCTION Mech_PW_Override "" /begin DEF_CHARACTERISTIC Mech_PW_new Mech_PW_ovr /end DEF_CHARACTERISTIC /end FUNCTION
/begin FUNCTION Cycle1CutPatter_1 ""
 /begin DEF_CHARACTERISTIC MediumCycle1Cyl1 MediumCycle1Cyl2 MediumCycle1Cyl3 MediumCycle1Cyl4 MediumCycle1Cyl5 MediumCycle1Cyl6 MediumCycle1Cyl7 MediumCycle1Cyl8 /end DEF_CHARACTERISTIC
/end FUNCTION
/begin FUNCTION Medium_Cycle_Cut_Pattern ""
 /begin SUB_FUNCTION Cycle1CutPatter_1 Cycle2CutPatter_1 Cycle3CutPatter_1 Cycle4CutPatter_1 /end SUB_FUNCTION
/end FUNCTION
/begin FUNCTION Cycle2CutPatter_1 ""
 /begin DEF_CHARACTERISTIC MediumCycle2Cyl1 MediumCycle2Cyl2 MediumCycle2Cyl3 MediumCycle2Cyl4 MediumCycle2Cyl5 MediumCycle2Cyl6 MediumCycle2Cyl7 MediumCycle2Cyl8 /end DEF_CHARACTERISTIC
/end FUNCTION
/begin FUNCTION Cycle3CutPatter_1 ""
 /begin DEF_CHARACTERISTIC MediumCycle3Cyl1 MediumCycle3Cyl2 MediumCycle3Cyl3 MediumCycle3Cyl4 MediumCycle3Cyl5 MediumCycle3Cyl6 MediumCycle3Cyl7 MediumCycle3Cyl8 /end DEF_CHARACTERISTIC
/end FUNCTION
/begin FUNCTION Cycle4CutPatter_1 ""
 /begin DEF_CHARACTERISTIC MediumCycle4Cyl1 MediumCycle4Cyl2 MediumCycle4Cyl3 MediumCycle4Cyl4 MediumCycle4Cyl5 MediumCycle4Cyl6 MediumCycle4Cyl7 MediumCycle4Cyl8 /end DEF_CHARACTERISTIC
/end FUNCTION
/begin FUNCTION Base_RPM_Set_Pt "" /begin DEF_CHARACTERISTIC MinGovClntRPMSetPtTbl /end DEF_CHARACTERISTIC /begin OUT_MEASUREMENT MinGovClntRPMSetPt /end OUT_MEASUREMENT /end FUNCTION
/begin FUNCTION Low_Oil_Pressure_Fault_Logic "" /begin DEF_CHARACTERISTIC MinOilPressure_FaultTbl MinOilPressure_WarnTbl /end DEF_CHARACTERISTIC /begin OUT_MEASUREMENT MinOilPressure_Fault MinOilPressure_Warn /end OUT_MEASUREMENT /end FUNCTION
/begin FUNCTION DetermineMisfire "" /begin DEF_CHARACTERISTIC MisfireDiag_HardMisfireThreshold /end DEF_CHARACTERISTIC /end FUNCTION
/begin FUNCTION LatchForAverage "" /begin DEF_CHARACTERISTIC MisfireDiag_StartRPMAvgCnt /end DEF_CHARACTERISTIC /end FUNCTION
/begin FUNCTION LatchForAverage1 "" /begin DEF_CHARACTERISTIC MisfireDiag_StopRPMAvgCnt /end DEF_CHARACTERISTIC /end FUNCTION
/begin FUNCTION MotoringDetection "" /begin DEF_CHARACTERISTIC MotoringDeltaRPMLimit MotoringDtctTimerLimit /end DEF_CHARACTERISTIC /begin OUT_MEASUREMENT MotoringDetectionFlag MotoringDetectionTime /end OUT_MEASUREMENT /end FUNCTION
/begin FUNCTION MPRD_Override "" /begin DEF_CHARACTERISTIC MPRD_new MPRD_ovr /end DEF_CHARACTERISTIC /end FUNCTION
/begin FUNCTION Injector_Sequence "" /begin OUT_MEASUREMENT NextCylinderToInject NextInjectorAngle /end OUT_MEASUREMENT /end FUNCTION
/begin FUNCTION General "" /begin SUB_FUNCTION Injector_Sequence Spark_Sequence /end SUB_FUNCTION /end FUNCTION
/begin FUNCTION Spark_Sequence "" /begin OUT_MEASUREMENT NextCylinderToSpark NextSparkAngle /end OUT_MEASUREMENT /end FUNCTION
/begin FUNCTION NonVolatile_Storage "" /begin DEF_CHARACTERISTIC RestoreNVFactoryDefaults StoreNV /end DEF_CHARACTERISTIC /begin OUT_MEASUREMENT NonVolatileCRC NonVolatileFormatID NonVolatileStatus /end OUT_MEASUREMENT /begin SUB_FUNCTION NonVolatile_Storage_Config /end SUB_FUNCTION /end FUNCTION
/begin FUNCTION NonVolatile_Storage_Config ""
 /begin DEF_CHARACTERISTIC NonVolatileRestoreOnFirstStartup NonVolatileRestoreOnStartup /end DEF_CHARACTERISTIC
/end FUNCTION
/begin FUNCTION Equivalence_Ratio_Perturbation ""
 /begin DEF_CHARACTERISTIC O2ActiveTimeThresh_BankA O2LeanTimeThresh_BankA O2RichTimeThresh_BankA /end DEF_CHARACTERISTIC
 /begin OUT_MEASUREMENT O2LeanTime_BankA O2NotActiveTime_BankA O2RichTime_BankA /end OUT_MEASUREMENT
/end FUNCTION
/begin FUNCTION Equivalence_Ratio_Perturbation_1 ""
 /begin DEF_CHARACTERISTIC O2ActiveTimeThresh_BankB O2LeanTimeThresh_BankB O2RichTimeThresh_BankB /end DEF_CHARACTERISTIC
 /begin OUT_MEASUREMENT O2LeanTime_BankB O2NotActiveTime_BankB O2RichTime_BankB /end OUT_MEASUREMENT
/end FUNCTION
/begin FUNCTION O2_De_lag "" /begin DEF_CHARACTERISTIC O2BankA_DelagFilterConst O2BankB_DelagFiltConst /end DEF_CHARACTERISTIC /begin OUT_MEASUREMENT O2BankA_O2Delag O2BankB_O2Delag /end OUT_MEASUREMENT /end FUNCTION
/begin FUNCTION O2_Control_Enable_Delay "" /begin DEF_CHARACTERISTIC O2CtrlAdaptDelayTime /end DEF_CHARACTERISTIC /end FUNCTION
/begin FUNCTION Map_O2_Sensors_to_V8_Cylinders ""
 /begin DEF_CHARACTERISTIC O2Cyl1Select O2Cyl2Select O2Cyl3Select O2Cyl4Select O2Cyl5Select O2Cyl6Select O2Cyl7Select O2Cyl8Select /end DEF_CHARACTERISTIC
/end FUNCTION
/begin FUNCTION Bank2Bank ""
 /begin DEF_CHARACTERISTIC O2Diag_Bank2Bank_DiffAlwdMap O2Diag_Bank2Bank_MaxDesEquivRatio O2Diag_Bank2Bank_MinDesEquivRatio O2Diag_Bank2Bank_MinECT O2Diag_Bank2Bank_MinRunTime /end DEF_CHARACTERISTIC
 /begin OUT_MEASUREMENT O2Diag_Bank2Bank_DiffAlwd /end OUT_MEASUREMENT
/end FUNCTION
/begin FUNCTION SensorStatus ""
 /begin DEF_CHARACTERISTIC O2Diag_Lam1_StuckInResetThresh O2Diag_Lam1_StuckInWarmup O2Diag_Lam2_StuckInWarmup O2Diag_Lam21_StuckInResetThresh /end DEF_CHARACTERISTIC
/end FUNCTION
/begin FUNCTION O2Arb "" /begin OUT_MEASUREMENT O2FuelMult /end OUT_MEASUREMENT /end FUNCTION
/begin FUNCTION Error_Gain_Scheduling "" /begin DEF_CHARACTERISTIC O2MAFErrGainMultTbl O2NECCTErrGainMultTbl /end DEF_CHARACTERISTIC /begin OUT_MEASUREMENT O2MAFErrGainMult O2NECCTErrGainMult /end OUT_MEASUREMENT /end FUNCTION
/begin FUNCTION OilPres "" /begin OUT_MEASUREMENT OilPres OilPresADC OilPresRaw /end OUT_MEASUREMENT /begin SUB_FUNCTION OilPres_Override OilPres_Config /end SUB_FUNCTION /end FUNCTION
/begin FUNCTION OilPres_Override "" /begin DEF_CHARACTERISTIC OilPres_new OilPres_ovr /end DEF_CHARACTERISTIC /end FUNCTION
/begin FUNCTION OilPres_Config ""
 /begin DEF_CHARACTERISTIC OilPresDfltValue OilPresFilterConst OilPresGain OilPresInputHiFltPos OilPresInputLoFltPos OilPresOfst /end DEF_CHARACTERISTIC
/end FUNCTION
/begin FUNCTION TPSEnrichment "" /begin DEF_CHARACTERISTIC OpenThrottleFPCScalar_ETC OpenThrottleFPCScalar_TPS /end DEF_CHARACTERISTIC /end FUNCTION
/begin FUNCTION CutThrottle_APP_Limiting "" /begin DEF_CHARACTERISTIC Overheat_MaxAPP Overheat_ScaleAPP /end DEF_CHARACTERISTIC /end FUNCTION
/begin FUNCTION OXY_Index "" /begin OUT_MEASUREMENT OXY05Idx OXY05In /end OUT_MEASUREMENT /end FUNCTION
/begin FUNCTION OXY_Transient_Fueling "" /begin DEF_CHARACTERISTIC OXYTransFuelMultTbl /end DEF_CHARACTERISTIC /begin OUT_MEASUREMENT OXYTransFuelMult /end OUT_MEASUREMENT /end FUNCTION
/begin FUNCTION DecreasingFilter "" /begin DEF_CHARACTERISTIC PH1_FiltDecConst /end DEF_CHARACTERISTIC /end FUNCTION
/begin FUNCTION PHI_Filt "" /begin DEF_CHARACTERISTIC PHI1_DefaultVal /end DEF_CHARACTERISTIC /begin OUT_MEASUREMENT PHI1_FiltFin /end OUT_MEASUREMENT /begin SUB_FUNCTION DecreasingFilter IncreasingFilter /end SUB_FUNCTION /end FUNCTION
/begin FUNCTION IncreasingFilter "" /begin DEF_CHARACTERISTIC PH1_FiltIncConst /end DEF_CHARACTERISTIC /end FUNCTION
/begin FUNCTION DecreasingFilter_1 "" /begin DEF_CHARACTERISTIC PH2_FiltDecConst /end DEF_CHARACTERISTIC /end FUNCTION
/begin FUNCTION PHI_Filt1 "" /begin DEF_CHARACTERISTIC PHI2_DefaultVal /end DEF_CHARACTERISTIC /begin OUT_MEASUREMENT PHI2_FiltFin /end OUT_MEASUREMENT /begin SUB_FUNCTION DecreasingFilter_1 IncreasingFilter_1 /end SUB_FUNCTION /end FUNCTION
/begin FUNCTION IncreasingFilter_1 "" /begin DEF_CHARACTERISTIC PH2_FiltIncConst /end DEF_CHARACTERISTIC /end FUNCTION
/begin FUNCTION PWM ""
 /begin OUT_MEASUREMENT pwm_create_ETCPin_PWMOutput pwm_create_FAN1Pin_PWM_PWMOutput pwm_create_FAN2Pin_PWM_PWMOutput pwm_set_ETCPin_PWMOutput pwm_set_FAN1Pin_PWM_PWMOutput pwm_set_FAN2Pin_PWM_PWMOutput /end OUT_MEASUREMENT
/end FUNCTION
/begin FUNCTION Other "" /begin OUT_MEASUREMENT resource_allocation /end OUT_MEASUREMENT /end FUNCTION
/begin FUNCTION RPM_Indexes "" /begin OUT_MEASUREMENT RPM05Idx RPM05In RPM09Idx RPM09In RPM17Idx RPM17In /end OUT_MEASUREMENT /end FUNCTION
/begin FUNCTION Determine_if_RPM_is_Falling "" /begin DEF_CHARACTERISTIC RPMFallingFiltConst RPMFallingRate /end DEF_CHARACTERISTIC /begin OUT_MEASUREMENT RPMFalling /end OUT_MEASUREMENT /end FUNCTION
/begin FUNCTION RPM_Filt "" /begin DEF_CHARACTERISTIC RPMFilt_Enable RPMFilt_LowPass RPMFilt_RoundValue /end DEF_CHARACTERISTIC /end FUNCTION
/begin FUNCTION Dash_Message_1 "" /begin DEF_CHARACTERISTIC TPS_Filt /end DEF_CHARACTERISTIC /begin SUB_FUNCTION RPM_Filt /end SUB_FUNCTION /end FUNCTION
/begin FUNCTION SensVolt "" /begin OUT_MEASUREMENT SensVolt SensVoltADC SensVoltRaw /end OUT_MEASUREMENT /begin SUB_FUNCTION SensVolt_Override SensVolt_Config /end SUB_FUNCTION /end FUNCTION
/begin FUNCTION SensVolt_Override "" /begin DEF_CHARACTERISTIC SensVolt_new SensVolt_ovr /end DEF_CHARACTERISTIC /end FUNCTION
/begin FUNCTION SensVolt_Config ""
 /begin DEF_CHARACTERISTIC SensVoltDfltValue SensVoltFilterConst SensVoltGain SensVoltInputHiFltPos SensVoltInputLoFltPos SensVoltOfst /end DEF_CHARACTERISTIC
/end FUNCTION
/begin FUNCTION Cycle1CutPatter_2 ""
 /begin DEF_CHARACTERISTIC SoftCycle1Cyl1 SoftCycle1Cyl2 SoftCycle1Cyl3 SoftCycle1Cyl4 SoftCycle1Cyl5 SoftCycle1Cyl6 SoftCycle1Cyl7 SoftCycle1Cyl8 /end DEF_CHARACTERISTIC
/end FUNCTION
/begin FUNCTION Soft_Cycle_Cut_Pattern ""
 /begin SUB_FUNCTION Cycle1CutPatter_2 Cycle2CutPatter_2 Cycle3CutPatter_2 Cycle4CutPatter_2 /end SUB_FUNCTION
/end FUNCTION
/begin FUNCTION Cycle2CutPatter_2 ""
 /begin DEF_CHARACTERISTIC SoftCycle2Cyl1 SoftCycle2Cyl2 SoftCycle2Cyl3 SoftCycle2Cyl4 SoftCycle2Cyl5 SoftCycle2Cyl6 SoftCycle2Cyl7 SoftCycle2Cyl8 /end DEF_CHARACTERISTIC
/end FUNCTION
/begin FUNCTION Cycle3CutPatter_2 ""
 /begin DEF_CHARACTERISTIC SoftCycle3Cyl1 SoftCycle3Cyl2 SoftCycle3Cyl3 SoftCycle3Cyl4 SoftCycle3Cyl5 SoftCycle3Cyl6 SoftCycle3Cyl7 SoftCycle3Cyl8 /end DEF_CHARACTERISTIC
/end FUNCTION
/begin FUNCTION Cycle4CutPatter_2 ""
 /begin DEF_CHARACTERISTIC SoftCycle4Cyl1 SoftCycle4Cyl2 SoftCycle4Cyl3 SoftCycle4Cyl4 SoftCycle4Cyl5 SoftCycle4Cyl6 SoftCycle4Cyl7 SoftCycle4Cyl8 /end DEF_CHARACTERISTIC
/end FUNCTION
/begin FUNCTION SOI_Override "" /begin DEF_CHARACTERISTIC SOI_new SOI_ovr /end DEF_CHARACTERISTIC /end FUNCTION
/begin FUNCTION Spark_Advance_Rate_Limiter "" /begin DEF_CHARACTERISTIC SparkAdv_DeltaHi SparkAdv_DeltaLo /end DEF_CHARACTERISTIC /end FUNCTION
/begin FUNCTION SparkDwell_Override "" /begin DEF_CHARACTERISTIC SparkDwell_offset SparkDwell_ovr /end DEF_CHARACTERISTIC /end FUNCTION
/begin FUNCTION SparkStartAngle_Override "" /begin DEF_CHARACTERISTIC SparkStartAngle_offset SparkStartAngle_ovr /end DEF_CHARACTERISTIC /end FUNCTION
/begin FUNCTION SparkStopAngle_Override "" /begin DEF_CHARACTERISTIC SparkStopAngle_offset SparkStopAngle_ovr /end DEF_CHARACTERISTIC /end FUNCTION
/begin FUNCTION PID_Gain_Select ""
 /begin DEF_CHARACTERISTIC SpkMinGovDGain SpkMinGovDGainErrorMultTbl SpkMinGovPGain SpkMinGovPGainErrorMultTbl /end DEF_CHARACTERISTIC
 /begin OUT_MEASUREMENT SpkMinGovDGainErrorMult SpkMinGovPGainErrorMult /end OUT_MEASUREMENT
/end FUNCTION
/begin FUNCTION Universal_PD__Tunable___Scheduled_ ""
 /begin DEF_CHARACTERISTIC SpkMinGovErrorGain SpkMinGovPIDOutLowerLimit SpkMinGovPIDOutUpperLimit /end DEF_CHARACTERISTIC
 /begin OUT_MEASUREMENT SpkMinGovDTerm SpkMinGovError SpkMinGovPTerm SpkMinGovSpeedErrorIdx SpkMinGovSpeedErrorIn /end OUT_MEASUREMENT
 /begin SUB_FUNCTION PID_Gain_Select /end SUB_FUNCTION
/end FUNCTION
/begin FUNCTION LoadBasedCalcs ""
 /begin OUT_MEASUREMENT SSEng SSLoadDirection SSLoadFilterConst SSLoadFiltered SSRPMDirection SSRPMFilterConst SSRPMFiltered /end OUT_MEASUREMENT
 /begin SUB_FUNCTION Engine_Steady_State_Flag LoadBasedCalcs_Config /end SUB_FUNCTION
/end FUNCTION
/begin FUNCTION Engine_Steady_State_Flag "" /begin DEF_CHARACTERISTIC SSLoadTol SSRPMTol /end DEF_CHARACTERISTIC /begin OUT_MEASUREMENT SSEngOpr /end OUT_MEASUREMENT /end FUNCTION
/begin FUNCTION LoadBasedCalcs_Config "" /begin DEF_CHARACTERISTIC SSLoadDecFiltC SSLoadIncFiltC SSRPMDecFiltC SSRPMIncFiltC /end DEF_CHARACTERISTIC /end FUNCTION
/begin FUNCTION SysVolt "" /begin OUT_MEASUREMENT SysVolt SysVoltADC SysVoltRaw /end OUT_MEASUREMENT /begin SUB_FUNCTION SysVolt_Override SysVolt_Config /end SUB_FUNCTION /end FUNCTION
/begin FUNCTION SysVolt_Override "" /begin DEF_CHARACTERISTIC SysVolt_new SysVolt_ovr /end DEF_CHARACTERISTIC /end FUNCTION
/begin FUNCTION SysVolt_Index "" /begin OUT_MEASUREMENT SysVolt09Idx SysVolt09In /end OUT_MEASUREMENT /end FUNCTION
/begin FUNCTION SysVolt_Config ""
 /begin DEF_CHARACTERISTIC SysVoltDfltValue SysVoltFilterConst SysVoltGain SysVoltInputHiFltPos SysVoltInputLoFltPos SysVoltOfst /end DEF_CHARACTERISTIC
/end FUNCTION
/begin FUNCTION Engine_Overheat_Fault_Logic ""
 /begin DEF_CHARACTERISTIC TempOverheat_Fault TempOverheat_Warn TempOverheatSevere_Fault /end DEF_CHARACTERISTIC
/end FUNCTION
/begin FUNCTION Time_Since_Key_On "" /begin OUT_MEASUREMENT TimeSinceKeyOn /end OUT_MEASUREMENT /end FUNCTION
/begin FUNCTION Time_Since_Run "" /begin OUT_MEASUREMENT TimeSinceRun /end OUT_MEASUREMENT /end FUNCTION
/begin FUNCTION Time_Since_Stall "" /begin OUT_MEASUREMENT TimeSinceStall /end OUT_MEASUREMENT /end FUNCTION
/begin FUNCTION TPS_Indexes "" /begin OUT_MEASUREMENT TPS09Idx TPS09In /end OUT_MEASUREMENT /end FUNCTION
/begin FUNCTION TPS1_Override "" /begin DEF_CHARACTERISTIC TPS1_new TPS1_ovr /end DEF_CHARACTERISTIC /end FUNCTION
/begin FUNCTION TPS1 ""
 /begin OUT_MEASUREMENT TPS1Adapt_Hi TPS1Adapt_Low TPS1ADC TPS1Percent TPS1PercentRaw /end OUT_MEASUREMENT
 /begin SUB_FUNCTION TPS1_Override TPS1_Config /end SUB_FUNCTION
/end FUNCTION
/begin FUNCTION TPS__Sensor_Arbitration "" /begin DEF_CHARACTERISTIC TPS1_TPS2_Max_Deviation /end DEF_CHARACTERISTIC /begin OUT_MEASUREMENT TPSFinal /end OUT_MEASUREMENT /end FUNCTION
/begin FUNCTION TPS1_Config ""
 /begin DEF_CHARACTERISTIC TPS1Adapt_Delta TPS1Adapt_Hi_Max TPS1Adapt_Hi_Min TPS1Adapt_Low_Max TPS1Adapt_Low_Min TPS1AdaptHiEnable TPS1AdaptLoEnable TPS1DfltValue TPS1FilterConst TPS1InputHiFltPos TPS1InputLoFltPos TPS1MaxLimit TPS1Rev_Polarity /end DEF_CHARACTERISTIC
/end FUNCTION
/begin FUNCTION TPS2_Override "" /begin DEF_CHARACTERISTIC TPS2_new TPS2_ovr /end DEF_CHARACTERISTIC /end FUNCTION
/begin FUNCTION TPS2 ""
 /begin OUT_MEASUREMENT TPS2Adapt_Hi TPS2Adapt_Low TPS2ADC TPS2Percent TPS2PercentRaw /end OUT_MEASUREMENT
 /begin SUB_FUNCTION TPS2_Override TPS2_Config /end SUB_FUNCTION
/end FUNCTION
/begin FUNCTION TPS2_Config ""
 /begin DEF_CHARACTERISTIC TPS2Adapt_Delta TPS2Adapt_Hi_Max TPS2Adapt_Hi_Min TPS2Adapt_Low_Max TPS2Adapt_Low_Min TPS2AdaptHiEnable TPS2AdaptLoEnable TPS2DfltValue TPS2FilterConst TPS2InputHiFltPos TPS2InputLoFltPos TPS2MaxLimit TPS2Rev_Polarity /end DEF_CHARACTERISTIC
/end FUNCTION
/begin FUNCTION Adapt_VolEff_Map "" /begin DEF_CHARACTERISTIC VEAdaptGainTblTbl VEAdaptMax VEAdaptMin /end DEF_CHARACTERISTIC
 /begin OUT_MEASUREMENT VE_AdaptErrorIdxArrIdx VE_AdaptErrorIdxArrIn VEAdaptGainTbl /end OUT_MEASUREMENT
/end FUNCTION
/begin FUNCTION VE_Adapt_Source "" /begin DEF_CHARACTERISTIC VEAdpatSource /end DEF_CHARACTERISTIC /end FUNCTION
/begin FUNCTION VSPD_Filt ""
 /begin DEF_CHARACTERISTIC VPSD_ChangeReject VSPD_ChangeReject_Enable VSPD_RateReject VSPD_RateReject_Enable VSPD_RejectHoldTime VSPD_ZeroSpeed /end DEF_CHARACTERISTIC
 /begin OUT_MEASUREMENT VSPD_DigFinal /end OUT_MEASUREMENT
/end FUNCTION
/begin FUNCTION VSPD "" /begin DEF_CHARACTERISTIC VSPDTbl /end DEF_CHARACTERISTIC /begin OUT_MEASUREMENT VSPD VSPDADC VSPDIdx VSPDRaw /end OUT_MEASUREMENT /begin SUB_FUNCTION VSPD_Override VSPD_Config /end SUB_FUNCTION /end FUNCTION
/begin FUNCTION VSPD_Selector "" /begin DEF_CHARACTERISTIC VSPD_DigitalPresent VSPD_GPSPreferred /end DEF_CHARACTERISTIC /begin OUT_MEASUREMENT VSPD_FinalFinal /end OUT_MEASUREMENT /end FUNCTION
/begin FUNCTION VSPD_Override "" /begin DEF_CHARACTERISTIC VSPD_new VSPD_ovr /end DEF_CHARACTERISTIC /end FUNCTION
/begin FUNCTION VSPD_Index "" /begin OUT_MEASUREMENT VSPD07Idx VSPD07In VSPD09Idx VSPD09In VSPD17Idx VSPD17In /end OUT_MEASUREMENT /end FUNCTION
/begin FUNCTION VSPD_Config "" /begin DEF_CHARACTERISTIC VSPDDefault VSPDFiltConst VSPDMax VSPDMin /end DEF_CHARACTERISTIC /end FUNCTION
/begin FUNCTION Warm_Up_Fuel_Holdoff "" /begin DEF_CHARACTERISTIC Warmup_Time_HoldoffTbl /end DEF_CHARACTERISTIC /begin OUT_MEASUREMENT Warmup_Time_Holdoff /end OUT_MEASUREMENT /end FUNCTION
/begin FUNCTION WarmUp_Disable "" /begin OUT_MEASUREMENT WarmUpO2AdaptEnabled /end OUT_MEASUREMENT /end FUNCTION
/end MODULE
/end PROJECT
