ASAP2_VERSION 1 51
/begin PROJECT Project ""
/begin MODULE BaseEngin_042 ""
/begin MOD_COMMON /* MOD_COMMON Comment */ "" BYTE_ORDER MSB_FIRST ALIGNMENT_BYTE 1 ALIGNMENT_FLOAT32_IEEE 1 ALIGNMENT_FLOAT64_IEEE 1 ALIGNMENT_LONG 1 ALIGNMENT_WORD 1 /end MOD_COMMON
/begin MEASUREMENT ACPresFanSpeed "" FLOAT32_IEEE CompuMethod_2 1 0 -1E+17 1E+17 ECU_ADDRESS 0x40000130 /end MEASUREMENT
/begin MEASUREMENT ACPresFanSpeed_Stall "" FLOAT32_IEEE CompuMethod_2 1 0 -1E+17 1E+17 ECU_ADDRESS 0x40000134 /end MEASUREMENT
/begin MEASUREMENT ACSw "Display output in engineering units" UBYTE CompuMethod_25 1 0 0 1 ECU_ADDRESS 0x4000013E /end MEASUREMENT
/begin MEASUREMENT ACSw_Raw "Display output in engineering units" FLOAT32_IEEE CompuMethod_21 1 0 -1E+17 1E+17 ECU_ADDRESS 0x4000013F /end MEASUREMENT
/begin MEASUREMENT AdjustedPerCylFuelRate "Desired fuel per cylinder after application of individual cylinder offsets and multipliers." FLOAT32_IEEE CompuMethod_29 1 0 -1E+17 1E+17 ECU_ADDRESS 0x40000145 MATRIX_DIM 8 1 1 /end MEASUREMENT
/begin MEASUREMENT ain_create_ACPresPin "Debug Variable" UBYTE CompuMethod_30 1 0 0 0 ECU_ADDRESS 0x40000165 /end MEASUREMENT
/begin MEASUREMENT ain_create_ACSwPin "Debug Variable" UBYTE CompuMethod_30 1 0 0 0 ECU_ADDRESS 0x40000166 /end MEASUREMENT
/begin MEASUREMENT ain_create_APP1AnalogInput "Debug Variable" UBYTE CompuMethod_30 1 0 0 0 ECU_ADDRESS 0x40000167 /end MEASUREMENT
/begin MEASUREMENT ain_create_APP2AnalogInput "Debug Variable" UBYTE CompuMethod_30 1 0 0 0 ECU_ADDRESS 0x40000168 /end MEASUREMENT
/begin MEASUREMENT ain_create_ECTSensorPin "Debug Variable" UBYTE CompuMethod_30 1 0 0 0 ECU_ADDRESS 0x40000169 /end MEASUREMENT
/begin MEASUREMENT ain_create_ECUP "Debug Variable" UBYTE CompuMethod_30 1 0 0 0 ECU_ADDRESS 0x4000016A /end MEASUREMENT
/begin MEASUREMENT ain_create_EVAPSensorPin "Debug Variable" UBYTE CompuMethod_30 1 0 0 0 ECU_ADDRESS 0x4000016B /end MEASUREMENT
/begin MEASUREMENT ain_create_FuelLvlSensorPin "Debug Variable" UBYTE CompuMethod_30 1 0 0 0 ECU_ADDRESS 0x4000016C /end MEASUREMENT
/begin MEASUREMENT ain_create_FuelPresPin "Debug Variable" UBYTE CompuMethod_30 1 0 0 0 ECU_ADDRESS 0x4000016D /end MEASUREMENT
/begin MEASUREMENT ain_create_IATSensorPin "Debug Variable" UBYTE CompuMethod_30 1 0 0 0 ECU_ADDRESS 0x4000016E /end MEASUREMENT
/begin MEASUREMENT ain_create_MAPSensorPin "Debug Variable" UBYTE CompuMethod_30 1 0 0 0 ECU_ADDRESS 0x4000016F /end MEASUREMENT
/begin MEASUREMENT ain_create_OilPresPin "Debug Variable" UBYTE CompuMethod_30 1 0 0 0 ECU_ADDRESS 0x40000170 /end MEASUREMENT
/begin MEASUREMENT ain_create_SensVoltSensorPin "Debug Variable" UBYTE CompuMethod_30 1 0 0 0 ECU_ADDRESS 0x40000171 /end MEASUREMENT
/begin MEASUREMENT ain_create_SysVoltage "Debug Variable" UBYTE CompuMethod_30 1 0 0 0 ECU_ADDRESS 0x40000172 /end MEASUREMENT
/begin MEASUREMENT ain_create_TPS1AnalogInput "Debug Variable" UBYTE CompuMethod_30 1 0 0 0 ECU_ADDRESS 0x40000173 /end MEASUREMENT
/begin MEASUREMENT ain_create_TPS2AnalogInput "Debug Variable" UBYTE CompuMethod_30 1 0 0 0 ECU_ADDRESS 0x40000174 /end MEASUREMENT
/begin MEASUREMENT ain_read_ACPresPin "Debug Variable" UBYTE CompuMethod_30 1 0 0 0 ECU_ADDRESS 0x40000175 /end MEASUREMENT
/begin MEASUREMENT ain_read_ACSwPin "Debug Variable" UBYTE CompuMethod_30 1 0 0 0 ECU_ADDRESS 0x40000176 /end MEASUREMENT
/begin MEASUREMENT ain_read_APP1AnalogInput "Debug Variable" UBYTE CompuMethod_30 1 0 0 0 ECU_ADDRESS 0x40000177 /end MEASUREMENT
/begin MEASUREMENT ain_read_APP2AnalogInput "Debug Variable" UBYTE CompuMethod_30 1 0 0 0 ECU_ADDRESS 0x40000178 /end MEASUREMENT
/begin MEASUREMENT ain_read_ECTSensorPin "Debug Variable" UBYTE CompuMethod_30 1 0 0 0 ECU_ADDRESS 0x40000179 /end MEASUREMENT
/begin MEASUREMENT ain_read_ECUP "Debug Variable" UBYTE CompuMethod_30 1 0 0 0 ECU_ADDRESS 0x4000017A /end MEASUREMENT
/begin MEASUREMENT ain_read_EVAPSensorPin "Debug Variable" UBYTE CompuMethod_30 1 0 0 0 ECU_ADDRESS 0x4000017B /end MEASUREMENT
/begin MEASUREMENT ain_read_FuelLvlSensorPin "Debug Variable" UBYTE CompuMethod_30 1 0 0 0 ECU_ADDRESS 0x4000017C /end MEASUREMENT
/begin MEASUREMENT ain_read_FuelPresPin "Debug Variable" UBYTE CompuMethod_30 1 0 0 0 ECU_ADDRESS 0x4000017D /end MEASUREMENT
/begin MEASUREMENT ain_read_IATSensorPin "Debug Variable" UBYTE CompuMethod_30 1 0 0 0 ECU_ADDRESS 0x4000017E /end MEASUREMENT
/begin MEASUREMENT ain_read_MAPSensorPin "Debug Variable" UBYTE CompuMethod_30 1 0 0 0 ECU_ADDRESS 0x4000017F /end MEASUREMENT
/begin MEASUREMENT ain_read_OilPresPin "Debug Variable" UBYTE CompuMethod_30 1 0 0 0 ECU_ADDRESS 0x40000180 /end MEASUREMENT
/begin MEASUREMENT ain_read_SensVoltSensorPin "Debug Variable" UBYTE CompuMethod_30 1 0 0 0 ECU_ADDRESS 0x40000181 /end MEASUREMENT
/begin MEASUREMENT ain_read_SysVoltage "Debug Variable" UBYTE CompuMethod_30 1 0 0 0 ECU_ADDRESS 0x40000182 /end MEASUREMENT
/begin MEASUREMENT ain_read_TPS1AnalogInput "Debug Variable" UBYTE CompuMethod_30 1 0 0 0 ECU_ADDRESS 0x40000183 /end MEASUREMENT
/begin MEASUREMENT ain_read_TPS2AnalogInput "Debug Variable" UBYTE CompuMethod_30 1 0 0 0 ECU_ADDRESS 0x40000184 /end MEASUREMENT
/begin MEASUREMENT AirflowMimatchThresh "" SBYTE CompuMethod_1 1 0 -128 127 ECU_ADDRESS 0x40000185 /end MEASUREMENT
/begin MEASUREMENT AirMinGovDGainErrorMult "" FLOAT32_IEEE CompuMethod_32 1 0 -1E+17 1E+17 ECU_ADDRESS 0x40000186 /end MEASUREMENT
/begin MEASUREMENT AirMinGovDTerm "Air min governor D term" FLOAT32_IEEE CompuMethod_2 1 0 -1E+17 1E+17 ECU_ADDRESS 0x4000018A /end MEASUREMENT
/begin MEASUREMENT AirMinGovError "Air min governor P term" FLOAT32_IEEE CompuMethod_2 1 0 -1E+17 1E+17 ECU_ADDRESS 0x4000018E /end MEASUREMENT
/begin MEASUREMENT AirMinGovIGainErrorMult "" FLOAT32_IEEE CompuMethod_32 1 0 -1E+17 1E+17 ECU_ADDRESS 0x40000192 /end MEASUREMENT
/begin MEASUREMENT AirMinGovITerm "Air min governor I term" FLOAT32_IEEE CompuMethod_2 1 0 -1E+17 1E+17 ECU_ADDRESS 0x40000196 /end MEASUREMENT
/begin MEASUREMENT AirMinGovPGainErrorMult "" FLOAT32_IEEE CompuMethod_32 1 0 -1E+17 1E+17 ECU_ADDRESS 0x4000019E /end MEASUREMENT
/begin MEASUREMENT AirMinGovPTerm "Air min governor P term" FLOAT32_IEEE CompuMethod_2 1 0 -1E+17 1E+17 ECU_ADDRESS 0x400001A2 /end MEASUREMENT
/begin MEASUREMENT AirMinGovSpeedErrorIdx "" UWORD CompuMethod_15 1 0 0 127.998 ECU_ADDRESS 0x400001A6 /end MEASUREMENT
/begin MEASUREMENT AirMinGovSpeedErrorIn "" FLOAT32_IEEE CompuMethod_2 1 0 -1E+17 1E+17 ECU_ADDRESS 0x400001A8 /end MEASUREMENT
/begin MEASUREMENT App05Idx "" UWORD CompuMethod_15 1 0 0 127.998 ECU_ADDRESS 0x400001AC /end MEASUREMENT
/begin MEASUREMENT App05In "" FLOAT32_IEEE CompuMethod_2 1 0 -1E+17 1E+17 ECU_ADDRESS 0x400001AE /end MEASUREMENT
/begin MEASUREMENT APP1_AdaptAdapt_Hi "" FLOAT32_IEEE CompuMethod_2 1 0 -1E+17 1E+17 ECU_ADDRESS 0x400001B2 /end MEASUREMENT
/begin MEASUREMENT APP1_AdaptAdapt_Low "" FLOAT32_IEEE CompuMethod_2 1 0 -1E+17 1E+17 ECU_ADDRESS 0x400001B6 /end MEASUREMENT
/begin MEASUREMENT APP1_AdaptADC "" FLOAT32_IEEE CompuMethod_2 1 0 -1E+17 1E+17 ECU_ADDRESS 0x400001BA /end MEASUREMENT
/begin MEASUREMENT APP1_AdaptPercent "" FLOAT32_IEEE CompuMethod_2 1 0 -1E+17 1E+17 ECU_ADDRESS 0x400001BE /end MEASUREMENT
/begin MEASUREMENT APP1_AdaptPercentRaw "" FLOAT32_IEEE CompuMethod_2 1 0 -1E+17 1E+17 ECU_ADDRESS 0x400001C2 /end MEASUREMENT
/begin MEASUREMENT APP17Idx "Index of APP for driver demand" UWORD CompuMethod_15 1 0 0 127.998 ECU_ADDRESS 0x400001C6 /end MEASUREMENT
/begin MEASUREMENT APP17In "Index of APP for driver demand" FLOAT32_IEEE CompuMethod_7 1 0 -1E+17 1E+17 ECU_ADDRESS 0x400001C8 /end MEASUREMENT
/begin MEASUREMENT APP2_AdaptAdapt_Hi "" FLOAT32_IEEE CompuMethod_2 1 0 -1E+17 1E+17 ECU_ADDRESS 0x400001CC /end MEASUREMENT
/begin MEASUREMENT APP2_AdaptAdapt_Low "" FLOAT32_IEEE CompuMethod_2 1 0 -1E+17 1E+17 ECU_ADDRESS 0x400001D0 /end MEASUREMENT
/begin MEASUREMENT APP2_AdaptADC "" FLOAT32_IEEE CompuMethod_2 1 0 -1E+17 1E+17 ECU_ADDRESS 0x400001D4 /end MEASUREMENT
/begin MEASUREMENT APP2_AdaptPercent "" FLOAT32_IEEE CompuMethod_2 1 0 -1E+17 1E+17 ECU_ADDRESS 0x400001D8 /end MEASUREMENT
/begin MEASUREMENT APP2_AdaptPercentRaw "" FLOAT32_IEEE CompuMethod_2 1 0 -1E+17 1E+17 ECU_ADDRESS 0x400001DC /end MEASUREMENT
/begin MEASUREMENT ApplicationInitStatus "Shows how far the module initialization has progressed" UBYTE CompuMethod_36 1 0 3 5 ECU_ADDRESS 0x400001E0 /end MEASUREMENT
/begin MEASUREMENT ApplicationStopReason "Indicates the reason for an application stop" ULONG CompuMethod_40 1 0 0 5 ECU_ADDRESS 0x400001E1 /end MEASUREMENT
/begin MEASUREMENT ApplicationStopReasonBlock "Indicates the block that caused the application stop" ULONG CompuMethod_41 1 0 0 5 ECU_ADDRESS 0x400001E5 /end MEASUREMENT
/begin MEASUREMENT APPPcnt "APP used in controller (after power curve and CutThrottle limiting" FLOAT32_IEEE CompuMethod_7 1 0 -1E+17 1E+17 ECU_ADDRESS 0x400001E9 /end MEASUREMENT
/begin MEASUREMENT Bank1_DataValidState_Prb "" UBYTE CompuMethod_11 1 0 0 1 ECU_ADDRESS 0x400001ED /end MEASUREMENT
/begin MEASUREMENT Bank1_EquivRatio "Final value after Linear Sensor Characterization" FLOAT32_IEEE CompuMethod_42 1 0 -1E+17 1E+17 ECU_ADDRESS 0x400001EE /end MEASUREMENT
/begin MEASUREMENT Bank1_EquivRatioADC "Singal measured directly from sensor" FLOAT32_IEEE CompuMethod_42 1 0 -1E+17 1E+17 ECU_ADDRESS 0x400001F2 /end MEASUREMENT
/begin MEASUREMENT Bank1_EquivRatioRaw "After conversion to engineering units, before range checking" FLOAT32_IEEE CompuMethod_42 1 0 -1E+17 1E+17 ECU_ADDRESS 0x400001F6 /end MEASUREMENT
/begin MEASUREMENT Bank1_HeaterVolts_Prb "" FLOAT32_IEEE CompuMethod_2 1 0 -1E+17 1E+17 ECU_ADDRESS 0x400001FA /end MEASUREMENT
/begin MEASUREMENT Bank1_Lambda_Prb "" FLOAT32_IEEE CompuMethod_2 1 0 -1E+17 1E+17 ECU_ADDRESS 0x400001FE /end MEASUREMENT
/begin MEASUREMENT Bank1_OxygenConcentration_Prb "" FLOAT32_IEEE CompuMethod_2 1 0 -1E+17 1E+17 ECU_ADDRESS 0x40000202 /end MEASUREMENT
/begin MEASUREMENT Bank1_SensorDetectedStatus_Prb "" UBYTE CompuMethod_11 1 0 0 1 ECU_ADDRESS 0x40000206 /end MEASUREMENT
/begin MEASUREMENT Bank1_SensorFaultState_Prb "" UBYTE CompuMethod_11 1 0 0 1 ECU_ADDRESS 0x40000207 /end MEASUREMENT
/begin MEASUREMENT Bank1_SensorStatus_Prb "" UBYTE CompuMethod_44 1 0 0 255 ECU_ADDRESS 0x40000208 /end MEASUREMENT
/begin MEASUREMENT Bank1_SystemVolts_Prb "" FLOAT32_IEEE CompuMethod_2 1 0 -1E+17 1E+17 ECU_ADDRESS 0x40000209 /end MEASUREMENT
/begin MEASUREMENT Bank1_UsingFreeAreCalState_Prb "" UBYTE CompuMethod_11 1 0 0 1 ECU_ADDRESS 0x4000020D /end MEASUREMENT
/begin MEASUREMENT Bank2_DataValidState_Prb "" UBYTE CompuMethod_11 1 0 0 1 ECU_ADDRESS 0x4000020E /end MEASUREMENT
/begin MEASUREMENT Bank2_EquivRatio "Final value after Linear Sensor Characterization" FLOAT32_IEEE CompuMethod_42 1 0 -1E+17 1E+17 ECU_ADDRESS 0x4000020F /end MEASUREMENT
/begin MEASUREMENT Bank2_EquivRatioADC "Singal measured directly from sensor" FLOAT32_IEEE CompuMethod_42 1 0 -1E+17 1E+17 ECU_ADDRESS 0x40000213 /end MEASUREMENT
/begin MEASUREMENT Bank2_EquivRatioRaw "After conversion to engineering units, before range checking" FLOAT32_IEEE CompuMethod_42 1 0 -1E+17 1E+17 ECU_ADDRESS 0x40000217 /end MEASUREMENT
/begin MEASUREMENT Bank2_HeaterVolts_Prb "" FLOAT32_IEEE CompuMethod_2 1 0 -1E+17 1E+17 ECU_ADDRESS 0x4000021B /end MEASUREMENT
/begin MEASUREMENT Bank2_Lambda_Prb "" FLOAT32_IEEE CompuMethod_2 1 0 -1E+17 1E+17 ECU_ADDRESS 0x4000021F /end MEASUREMENT
/begin MEASUREMENT Bank2_OxygenConcentration_Prb "" FLOAT32_IEEE CompuMethod_2 1 0 -1E+17 1E+17 ECU_ADDRESS 0x40000223 /end MEASUREMENT
/begin MEASUREMENT Bank2_SensorDetectedStatus_Prb "" UBYTE CompuMethod_11 1 0 0 1 ECU_ADDRESS 0x40000227 /end MEASUREMENT
/begin MEASUREMENT Bank2_SensorFaultState_Prb "" UBYTE CompuMethod_11 1 0 0 1 ECU_ADDRESS 0x40000228 /end MEASUREMENT
/begin MEASUREMENT Bank2_SensorStatus_Prb "" UBYTE CompuMethod_44 1 0 0 255 ECU_ADDRESS 0x40000229 /end MEASUREMENT
/begin MEASUREMENT Bank2_SystemVolts_Prb "" FLOAT32_IEEE CompuMethod_2 1 0 -1E+17 1E+17 ECU_ADDRESS 0x4000022A /end MEASUREMENT
/begin MEASUREMENT Bank2_UsingFreeAreCalState_Prb "" UBYTE CompuMethod_11 1 0 0 1 ECU_ADDRESS 0x4000022E /end MEASUREMENT
/begin MEASUREMENT BARO "" FLOAT32_IEEE CompuMethod_16 1 0 -1E+17 1E+17 ECU_ADDRESS 0x4000022F /end MEASUREMENT
/begin MEASUREMENT BARO09Idx "" UWORD CompuMethod_15 1 0 0 127.998 ECU_ADDRESS 0x40000233 /end MEASUREMENT
/begin MEASUREMENT BaroDelayTime "" FLOAT32_IEEE CompuMethod_46 1 0 -1E+17 1E+17 ECU_ADDRESS 0x40000235 /end MEASUREMENT
/begin MEASUREMENT BaseAirflowAdaptEnabled "" UBYTE CompuMethod_47 1 0 0 1 ECU_ADDRESS 0x40000239 /end MEASUREMENT
/begin MEASUREMENT BaseEquivRatio "Base equivalence ratio for selected fuel system." FLOAT32_IEEE CompuMethod_2 1 0 -1E+17 1E+17 ECU_ADDRESS 0x40000242 /end MEASUREMENT
/begin MEASUREMENT BaseSparkEnergy "Spark energy - Run state" FLOAT32_IEEE CompuMethod_51 1 0 -1E+17 1E+17 ECU_ADDRESS 0x40000246 /end MEASUREMENT
/begin MEASUREMENT BgndAngTaskStatus "Background Time Scheduler Status" UBYTE CompuMethod_52 1 0 0 0 ECU_ADDRESS 0x4000024A /end MEASUREMENT
/begin MEASUREMENT BgndStackMinBytesFree "Min bytes observed on the Background Stack" ULONG CompuMethod_53 1 0 0 0 ECU_ADDRESS 0x4000024B /end MEASUREMENT
/begin MEASUREMENT BgndTimeTaskStatus "Background Time Scheduler Status" UBYTE CompuMethod_54 1 0 0 0 ECU_ADDRESS 0x4000024F /end MEASUREMENT
/begin MEASUREMENT CAN_1_ext_handled_count "Total number of handled ext CAN messages on bus CAN_1" ULONG CompuMethod_56 1 0 0 4294970000 ECU_ADDRESS 0x40000250 /end MEASUREMENT
/begin MEASUREMENT CAN_1_ext_last_unhandled_id "Last received ext CAN message on bus CAN_1, which was unhandled" ULONG CompuMethod_56 1 0 0 4294970000 ECU_ADDRESS 0x40000254 /end MEASUREMENT
/begin MEASUREMENT CAN_1_ext_receive_count "Total number of received ext CAN messages on bus CAN_1" ULONG CompuMethod_56 1 0 0 4294970000 ECU_ADDRESS 0x40000258 /end MEASUREMENT
/begin MEASUREMENT can_create_CAN_1 "Debug Variable" UBYTE CompuMethod_30 1 0 0 0 ECU_ADDRESS 0x4000025C /end MEASUREMENT
/begin MEASUREMENT can_create_CAN_2 "Debug Variable" UBYTE CompuMethod_30 1 0 0 0 ECU_ADDRESS 0x4000025D /end MEASUREMENT
/begin MEASUREMENT can_tx_err_CAN_1_0 "Debug Variable" UBYTE CompuMethod_30 1 0 0 0 ECU_ADDRESS 0x4000025E /end MEASUREMENT
/begin MEASUREMENT can_tx_err_CAN_1_0_54 "Debug Variable" UBYTE CompuMethod_30 1 0 0 0 ECU_ADDRESS 0x4000025F /end MEASUREMENT
/begin MEASUREMENT can_tx_err_CAN_2_0 "Debug Variable" UBYTE CompuMethod_30 1 0 0 0 ECU_ADDRESS 0x40000260 /end MEASUREMENT
/begin MEASUREMENT can_tx_err_CAN_2_0_55 "Debug Variable" UBYTE CompuMethod_30 1 0 0 0 ECU_ADDRESS 0x40000261 /end MEASUREMENT
/begin MEASUREMENT CAT_SpkOfst "CAT spark offset" FLOAT32_IEEE CompuMethod_2 1 0 -1E+17 1E+17 ECU_ADDRESS 0x40000262 /end MEASUREMENT
/begin MEASUREMENT CAT_SpkOfstMult "Multiplier on IAT2 spark offset table." FLOAT32_IEEE CompuMethod_32 1 0 -1E+17 1E+17 ECU_ADDRESS 0x40000266 /end MEASUREMENT
/begin MEASUREMENT CAT05Idx "Index of charge air temperature" UWORD CompuMethod_15 1 0 0 127.998 ECU_ADDRESS 0x4000026A /end MEASUREMENT
/begin MEASUREMENT CAT05In "Index of charge air temperature" FLOAT32_IEEE CompuMethod_57 1 0 -1E+17 1E+17 ECU_ADDRESS 0x4000026C /end MEASUREMENT
/begin MEASUREMENT CCP_CCP1_Access.CCP_CCP1_CAL "Calibration Authentication Status for CCP Handler CCP1" UBYTE CompuMethod_58 1 0 0 1 ECU_ADDRESS 0x40000270 BIT_MASK 0x00000001 /end MEASUREMENT
/begin MEASUREMENT CCP_CCP1_Access.CCP_CCP1_DAQ "Data Acquisition Authentication Status for CCP Handler CCP1" UBYTE CompuMethod_59 1 0 0 1 ECU_ADDRESS 0x40000270 BIT_MASK 0x00000002 /end MEASUREMENT
/begin MEASUREMENT CCP_CCP1_Access.CCP_CCP1_PGM "Programming Authentication Status for CCP Handler CCP1" UBYTE CompuMethod_60 1 0 0 1 ECU_ADDRESS 0x40000270 BIT_MASK 0x00000040 /end MEASUREMENT
/begin MEASUREMENT CCP_CCP1_Access "Current Access Code for CCP Handler CCP1" UBYTE CompuMethod_2 1 0 0 255 ECU_ADDRESS 0x40000270 /end MEASUREMENT
/begin MEASUREMENT CCP_CCP1_ConnectionStatus "CCP Handler CCP1 connection status" UBYTE CompuMethod_61 1 0 0 255 ECU_ADDRESS 0x40000271 /end MEASUREMENT
/begin MEASUREMENT ChargeAirTempEnrichment "Requsted base eq. ratio as a function of CAT and MAP" FLOAT32_IEEE CompuMethod_62 1 0 -1E+17 1E+17 ECU_ADDRESS 0x40000272 /end MEASUREMENT
/begin MEASUREMENT CoilDwell "Required spark dwell to give the desired spark energy." FLOAT32_IEEE CompuMethod_65 1 0 -1E+17 1E+17 ECU_ADDRESS 0x40000276 /end MEASUREMENT
/begin MEASUREMENT CoilEnabled "Enable sate for coils." UBYTE CompuMethod_4 1 0 0 1 ECU_ADDRESS 0x4000027A MATRIX_DIM 8 1 1 /end MEASUREMENT
/begin MEASUREMENT CoilStartAngle "StartAngle for coils to establish dwell." FLOAT32_IEEE CompuMethod_66 1 0 -1E+17 1E+17 ECU_ADDRESS 0x40000282 /end MEASUREMENT
/begin MEASUREMENT CoilStopAngle "Stop angle for coils to establish dwell." FLOAT32_IEEE CompuMethod_66 1 0 -1E+17 1E+17 ECU_ADDRESS 0x40000286 /end MEASUREMENT
/begin MEASUREMENT CPUIdlePcent "Percentage of the CPU time spent servicing idle priority work." UWORD CompuMethod_67 1 0 0 99.9999 ECU_ADDRESS 0x4000030E /end MEASUREMENT
/begin MEASUREMENT CPUTime_AppISR "Percentage of the CPU time spent executing the periodic timer interrupt" UWORD CompuMethod_67 1 0 0 99.9999 ECU_ADDRESS 0x40000310 /end MEASUREMENT
/begin MEASUREMENT CPUTime_Bgnd "Percentage of the CPU time spent servicing background priority tasks" UWORD CompuMethod_67 1 0 0 99.9999 ECU_ADDRESS 0x40000312 /end MEASUREMENT
/begin MEASUREMENT CPUTime_CAN "Percentage of the CPU time spent executing CAN interrupts" UWORD CompuMethod_67 1 0 0 99.9999 ECU_ADDRESS 0x40000314 /end MEASUREMENT
/begin MEASUREMENT CPUTime_FgndAngle "Percentage of the CPU time spent executing application callbacks due to framework events" UWORD CompuMethod_67 1 0 0 99.9999 ECU_ADDRESS 0x40000316 /end MEASUREMENT
/begin MEASUREMENT CPUTime_FgndTime "Percentage of the CPU time spent servicing background priority tasks" UWORD CompuMethod_67 1 0 0 99.9999 ECU_ADDRESS 0x40000318 /end MEASUREMENT
/begin MEASUREMENT CPUTime_MIOS "Percentage of the CPU time spent executing MIOS interrupts" UWORD CompuMethod_67 1 0 0 99.9999 ECU_ADDRESS 0x4000031A /end MEASUREMENT
/begin MEASUREMENT CPUTime_Serial "Percentage of the CPU time spent executing serial interrupts" UWORD CompuMethod_67 1 0 0 99.9999 ECU_ADDRESS 0x4000031C /end MEASUREMENT
/begin MEASUREMENT CPUTime_TimerISR "Percentage of the CPU time spent executing the periodic timer interrupt" UWORD CompuMethod_67 1 0 0 99.9999 ECU_ADDRESS 0x4000031E /end MEASUREMENT
/begin MEASUREMENT CPUTime_TPU "Percentage of the CPU time spent executing TPU interrupts" UWORD CompuMethod_67 1 0 0 99.9999 ECU_ADDRESS 0x40000320 /end MEASUREMENT
/begin MEASUREMENT CrankAirflowSetPt "ETC setpoint during cranking." FLOAT32_IEEE CompuMethod_7 1 0 -1E+17 1E+17 ECU_ADDRESS 0x40000322 /end MEASUREMENT
/begin MEASUREMENT CrankECT05Idx "ECT pre-lookup for crank maps." UWORD CompuMethod_15 1 0 0 127.998 ECU_ADDRESS 0x40000326 /end MEASUREMENT
/begin MEASUREMENT CrankFPC "Liquid fuel supplied during crank." FLOAT32_IEEE CompuMethod_70 1 0 -1E+17 1E+17 ECU_ADDRESS 0x40000328 /end MEASUREMENT
/begin MEASUREMENT CrankFPC_IATMult "Crank fuel IAT ultiplier" FLOAT32_IEEE CompuMethod_2 1 0 -1E+17 1E+17 ECU_ADDRESS 0x4000032C /end MEASUREMENT
/begin MEASUREMENT CrankFPC_OXYMult "Crank fuel oxygentation multiplier" FLOAT32_IEEE CompuMethod_2 1 0 -1E+17 1E+17 ECU_ADDRESS 0x40000330 /end MEASUREMENT
/begin MEASUREMENT CrankIAT05Idx "IAT pre-lookup for crank maps." UWORD CompuMethod_15 1 0 0 127.998 ECU_ADDRESS 0x40000334 /end MEASUREMENT
/begin MEASUREMENT CrankMakeUpEOI "Start of injection during cranking." FLOAT32_IEEE CompuMethod_66 1 0 -1E+17 1E+17 ECU_ADDRESS 0x40000336 /end MEASUREMENT
/begin MEASUREMENT CrankOXY05Idx "OXY pre-lookup for crank maps." UWORD CompuMethod_15 1 0 0 127.998 ECU_ADDRESS 0x4000033A /end MEASUREMENT
/begin MEASUREMENT CrankOXY05In "OXY pre-lookup for crank maps." FLOAT32_IEEE CompuMethod_7 1 0 -1E+17 1E+17 ECU_ADDRESS 0x4000033C /end MEASUREMENT
/begin MEASUREMENT CrankPulse "" FLOAT32_IEEE CompuMethod_2 1 0 -1E+17 1E+17 ECU_ADDRESS 0x40000340 /end MEASUREMENT
/begin MEASUREMENT CrankRPM05Idx "RPM pre-lookup for crank maps" UWORD CompuMethod_15 1 0 0 127.998 ECU_ADDRESS 0x40000344 /end MEASUREMENT
/begin MEASUREMENT CrankRPM05In "RPM pre-lookup for crank maps" FLOAT32_IEEE CompuMethod_71 1 0 -1E+17 1E+17 ECU_ADDRESS 0x40000346 /end MEASUREMENT
/begin MEASUREMENT CrankSOI "Start of injection during cranking." FLOAT32_IEEE CompuMethod_66 1 0 -1E+17 1E+17 ECU_ADDRESS 0x4000034A /end MEASUREMENT
/begin MEASUREMENT CrankSpark "Spark adv during cranking." FLOAT32_IEEE CompuMethod_66 1 0 -1E+17 1E+17 ECU_ADDRESS 0x4000034E /end MEASUREMENT
/begin MEASUREMENT CrankSpkEnergy "Spark energy during cranking." FLOAT32_IEEE CompuMethod_72 1 0 -1E+17 1E+17 ECU_ADDRESS 0x40000352 /end MEASUREMENT
/begin MEASUREMENT CrankTDCs "" UBYTE CompuMethod_1 1 0 0 255 ECU_ADDRESS 0x40000356 /end MEASUREMENT
/begin MEASUREMENT CrankTrans "" UBYTE CompuMethod_11 1 0 0 1 ECU_ADDRESS 0x40000357 /end MEASUREMENT
/begin MEASUREMENT DeltaMAP "" FLOAT32_IEEE CompuMethod_2 1 0 -1E+17 1E+17 ECU_ADDRESS 0x40000358 /end MEASUREMENT
/begin MEASUREMENT DeltaMAP_Mult "Transient Fueling Multiplier for adjustment based on delta MAP" FLOAT32_IEEE CompuMethod_32 1 0 -1E+17 1E+17 ECU_ADDRESS 0x4000035C /end MEASUREMENT
/begin MEASUREMENT DeltaMAP17Idx "" UWORD CompuMethod_15 1 0 0 127.998 ECU_ADDRESS 0x40000360 /end MEASUREMENT
/begin MEASUREMENT DeltaMAP17In "" FLOAT32_IEEE CompuMethod_2 1 0 -1E+17 1E+17 ECU_ADDRESS 0x40000362 /end MEASUREMENT
/begin MEASUREMENT DeltaTPS "" FLOAT32_IEEE CompuMethod_2 1 0 -1E+17 1E+17 ECU_ADDRESS 0x40000366 /end MEASUREMENT
/begin MEASUREMENT DeltaTPS_Mult "Transient Fueling Multiplier for adjustment based on delta TPS" FLOAT32_IEEE CompuMethod_32 1 0 -1E+17 1E+17 ECU_ADDRESS 0x4000036A /end MEASUREMENT
/begin MEASUREMENT DeltaTPS17Idx "" UWORD CompuMethod_15 1 0 0 127.998 ECU_ADDRESS 0x4000036E /end MEASUREMENT
/begin MEASUREMENT DeltaTPS17In "" FLOAT32_IEEE CompuMethod_2 1 0 -1E+17 1E+17 ECU_ADDRESS 0x40000370 /end MEASUREMENT
/begin MEASUREMENT DesAFRatio "" FLOAT32_IEEE CompuMethod_74 1 0 -1E+17 1E+17 ECU_ADDRESS 0x40000374 /end MEASUREMENT
/begin MEASUREMENT DesAFRatioIdx "" UWORD CompuMethod_15 1 0 0 127.998 ECU_ADDRESS 0x40000378 /end MEASUREMENT
/begin MEASUREMENT DesAFRatioIn "" FLOAT32_IEEE CompuMethod_75 1 0 -1E+17 1E+17 ECU_ADDRESS 0x4000037A /end MEASUREMENT
/begin MEASUREMENT DesEqRatio09Idx "Desired Equivalence Ratio breakpoints" UWORD CompuMethod_15 1 0 0 127.998 ECU_ADDRESS 0x4000037E /end MEASUREMENT
/begin MEASUREMENT DesEqRatio09In "Desired Equivalence Ratio breakpoints" FLOAT32_IEEE CompuMethod_76 1 0 -1E+17 1E+17 ECU_ADDRESS 0x40000380 /end MEASUREMENT
/begin MEASUREMENT DesEquivInRange "" UBYTE CompuMethod_8 1 0 0 1 ECU_ADDRESS 0x40000384 /end MEASUREMENT
/begin MEASUREMENT DesEquivRatio "Desired liquid equivalence ratio." FLOAT32_IEEE CompuMethod_2 1 0 -1E+17 1E+17 ECU_ADDRESS 0x40000385 /end MEASUREMENT
/begin MEASUREMENT Desired_AF_Ratio "Desired Air to Fuel Ratio based on Ethanol Percentage" FLOAT32_IEEE CompuMethod_77 1 0 -1E+17 1E+17 ECU_ADDRESS 0x40000389 /end MEASUREMENT
/begin MEASUREMENT DFCOActive "DFCO state" UBYTE CompuMethod_11 1 0 0 1 ECU_ADDRESS 0x4000038D /end MEASUREMENT
/begin MEASUREMENT DFCODesEquivRatio "DFCO commanded equiv ratio" FLOAT32_IEEE CompuMethod_2 1 0 -1E+17 1E+17 ECU_ADDRESS 0x4000038E /end MEASUREMENT
/begin MEASUREMENT DFCODesSparkOutOfst "DFCO spark output" FLOAT32_IEEE CompuMethod_66 1 0 -1E+17 1E+17 ECU_ADDRESS 0x40000392 /end MEASUREMENT
/begin MEASUREMENT DFCOEnterCond "Conditions are correct for DFCO" UBYTE CompuMethod_11 1 0 0 1 ECU_ADDRESS 0x40000396 /end MEASUREMENT
/begin MEASUREMENT DFCOEntryRPM "" FLOAT32_IEEE CompuMethod_2 1 0 -1E+17 1E+17 ECU_ADDRESS 0x40000397 /end MEASUREMENT
/begin MEASUREMENT DFCOExitRPM "" FLOAT32_IEEE CompuMethod_2 1 0 -1E+17 1E+17 ECU_ADDRESS 0x4000039B /end MEASUREMENT
/begin MEASUREMENT din_create_ESTOPPin "Debug Variable" UBYTE CompuMethod_30 1 0 0 0 ECU_ADDRESS 0x4000039F /end MEASUREMENT
/begin MEASUREMENT din_read_ESTOPPin "Debug Variable" UBYTE CompuMethod_30 1 0 0 0 ECU_ADDRESS 0x400003A0 /end MEASUREMENT
/begin MEASUREMENT dout_create_DOut10438p0009 "Debug Variable" UBYTE CompuMethod_30 1 0 0 0 ECU_ADDRESS 0x400003A1 /end MEASUREMENT
/begin MEASUREMENT dout_create_DOut11990p0005 "Debug Variable" UBYTE CompuMethod_30 1 0 0 0 ECU_ADDRESS 0x400003A2 /end MEASUREMENT
/begin MEASUREMENT dout_create_DOut9613p0006 "Debug Variable" UBYTE CompuMethod_30 1 0 0 0 ECU_ADDRESS 0x400003A3 /end MEASUREMENT
/begin MEASUREMENT ECT "Final value after Linear Sensor Characterization" FLOAT32_IEEE CompuMethod_80 1 0 -1E+17 1E+17 ECU_ADDRESS 0x400003A4 /end MEASUREMENT
/begin MEASUREMENT ECT_KeyUp "" FLOAT32_IEEE CompuMethod_80 1 0 -1E+17 1E+17 ECU_ADDRESS 0x400003A8 /end MEASUREMENT
/begin MEASUREMENT ECT_KeyUp09Idx "Index of ECT captured at key-up." UWORD CompuMethod_15 1 0 0 127.998 ECU_ADDRESS 0x400003AC /end MEASUREMENT
/begin MEASUREMENT ECT_KeyUp09In "Index of ECT captured at key-up." FLOAT32_IEEE CompuMethod_57 1 0 -1E+17 1E+17 ECU_ADDRESS 0x400003AE /end MEASUREMENT
/begin MEASUREMENT ECT_SpkOfst "ECT spark offset" FLOAT32_IEEE CompuMethod_66 1 0 -1E+17 1E+17 ECU_ADDRESS 0x400003B2 /end MEASUREMENT
/begin MEASUREMENT ECT_SpkOfstMult "Multiplier on ECT spark offset table." FLOAT32_IEEE CompuMethod_2 1 0 -1E+17 1E+17 ECU_ADDRESS 0x400003B6 /end MEASUREMENT
/begin MEASUREMENT ECT05Idx "Idex of ECT" UWORD CompuMethod_15 1 0 0 127.998 ECU_ADDRESS 0x400003BA /end MEASUREMENT
/begin MEASUREMENT ECT05In "Idex of ECT" FLOAT32_IEEE CompuMethod_57 1 0 -1E+17 1E+17 ECU_ADDRESS 0x400003BC /end MEASUREMENT
/begin MEASUREMENT ECT07Idx "Index of ECT" UWORD CompuMethod_15 1 0 0 127.998 ECU_ADDRESS 0x400003C0 /end MEASUREMENT
/begin MEASUREMENT ECT07In "Index of ECT" FLOAT32_IEEE CompuMethod_57 1 0 -1E+17 1E+17 ECU_ADDRESS 0x400003C2 /end MEASUREMENT
/begin MEASUREMENT ECT09Idx "Index of ECT" UWORD CompuMethod_15 1 0 0 127.998 ECU_ADDRESS 0x400003C6 /end MEASUREMENT
/begin MEASUREMENT ECT09In "Index of ECT" FLOAT32_IEEE CompuMethod_57 1 0 -1E+17 1E+17 ECU_ADDRESS 0x400003C8 /end MEASUREMENT
/begin MEASUREMENT ECTADC "Signal measured directly from sensor" UWORD CompuMethod_17 1 0 0 65535 ECU_ADDRESS 0x400003CC /end MEASUREMENT
/begin MEASUREMENT ECTFanSpeed "" FLOAT32_IEEE CompuMethod_2 1 0 -1E+17 1E+17 ECU_ADDRESS 0x400003CE /end MEASUREMENT
/begin MEASUREMENT ECTFanSpeed_Stall "" FLOAT32_IEEE CompuMethod_2 1 0 -1E+17 1E+17 ECU_ADDRESS 0x400003D2 /end MEASUREMENT
/begin MEASUREMENT ECTIdx "Look up table to allownon-linear characterization of sensors" UWORD CompuMethod_15 1 0 0 127.998 ECU_ADDRESS 0x400003D6 /end MEASUREMENT
/begin MEASUREMENT ECTRaw "After conversion to engineering units, before range checking" FLOAT32_IEEE CompuMethod_80 1 0 -1E+17 1E+17 ECU_ADDRESS 0x400003D8 /end MEASUREMENT
/begin MEASUREMENT ECTTransFuelMult "Transient fuel multiplier based on ECT.  Only engaged during transient fueling" FLOAT32_IEEE CompuMethod_2 1 0 -1E+17 1E+17 ECU_ADDRESS 0x400003DC /end MEASUREMENT
/begin MEASUREMENT ECUP_Enabled "" UBYTE CompuMethod_8 1 0 0 1 ECU_ADDRESS 0x400003E0 /end MEASUREMENT
/begin MEASUREMENT encoder_create "Debug Variable" UBYTE CompuMethod_30 1 0 0 0 ECU_ADDRESS 0x400003E1 /end MEASUREMENT
/begin MEASUREMENT EncoderFault "" UBYTE CompuMethod_84 1 0 0 255 ECU_ADDRESS 0x400003E2 /end MEASUREMENT
/begin MEASUREMENT EncoderFaultCount "" ULONG CompuMethod_56 1 0 0 4294970000 ECU_ADDRESS 0x400003E3 /end MEASUREMENT
/begin MEASUREMENT EncoderState "" UBYTE CompuMethod_85 1 0 0 255 ECU_ADDRESS 0x400003E7 /end MEASUREMENT
/begin MEASUREMENT EncoderTDCOrder "Order of TDC angles (0 means unused)" SBYTE CompuMethod_86 1 0 -1 127 ECU_ADDRESS 0x400003E8 MATRIX_DIM 8 1 1 /end MEASUREMENT
/begin MEASUREMENT EngineAccel "Acceleration rate of engine" FLOAT32_IEEE CompuMethod_87 1 0 -1E+17 1E+17 ECU_ADDRESS 0x400003F0 /end MEASUREMENT
/begin MEASUREMENT EngineStateRaw "" UBYTE CompuMethod_1 1 0 0 255 ECU_ADDRESS 0x400003F4 /end MEASUREMENT
/begin MEASUREMENT EnginSteadyState "" UBYTE CompuMethod_8 1 0 0 1 ECU_ADDRESS 0x400003F5 /end MEASUREMENT
/begin MEASUREMENT EqRatio_SpkOfsMult "Speed and Load Multiplier to the Equivalence Ratio Spark Offset table." FLOAT32_IEEE CompuMethod_32 1 0 -1E+17 1E+17 ECU_ADDRESS 0x400003F6 /end MEASUREMENT
/begin MEASUREMENT EqRatio_SpkOfst "Spark offset based on desired equivalence ratio (also muliplied by a speed load factor)" FLOAT32_IEEE CompuMethod_88 1 0 -1E+17 1E+17 ECU_ADDRESS 0x400003FA /end MEASUREMENT
/begin MEASUREMENT EST_DiagDwell "Dwell time used to diagnose ESTs during run-state." UWORD CompuMethod_90 1 0 0 65535 ECU_ADDRESS 0x400003FE MATRIX_DIM 8 1 1 /end MEASUREMENT
/begin MEASUREMENT EST_Spark "Debug Variable" UBYTE CompuMethod_30 1 0 0 0 ECU_ADDRESS 0x4000040E /end MEASUREMENT
/begin MEASUREMENT EST_SparkCreate "Debug Variable" UBYTE CompuMethod_30 1 0 0 0 ECU_ADDRESS 0x4000040F /end MEASUREMENT
/begin MEASUREMENT EST_TDCEnabled "" SBYTE CompuMethod_37 1 0 -128 127 ECU_ADDRESS 0x40000410 /end MEASUREMENT
/begin MEASUREMENT ESTOP "Display output in engineering units" UBYTE CompuMethod_25 1 0 0 1 ECU_ADDRESS 0x40000411 /end MEASUREMENT
/begin MEASUREMENT ESTOP_Raw "Display output in engineering units" UBYTE CompuMethod_25 1 0 0 1 ECU_ADDRESS 0x40000412 /end MEASUREMENT
/begin MEASUREMENT ESTOpenADC "ADC counts of measured voltage feedback for diagnosing the ESTs during stall state." UWORD CompuMethod_9 1 0 0 65535 ECU_ADDRESS 0x40000413 MATRIX_DIM 8 1 1 /end MEASUREMENT
/begin MEASUREMENT ETB_Curr_Flt "" UBYTE CompuMethod_11 1 0 0 1 ECU_ADDRESS 0x40000423 /end MEASUREMENT
/begin MEASUREMENT ETC_Current "Current output of ETC duty cycle." SWORD CompuMethod_94 1 0 -32768 32767 ECU_ADDRESS 0x40000424 /end MEASUREMENT
/begin MEASUREMENT ETC_DutyCycle "Actual duty cycle of actuator" FLOAT32_IEEE CompuMethod_7 1 0 -1E+17 1E+17 ECU_ADDRESS 0x40000426 /end MEASUREMENT
/begin MEASUREMENT ETC_ECUPState "" UBYTE CompuMethod_11 1 0 0 1 ECU_ADDRESS 0x4000042A /end MEASUREMENT
/begin MEASUREMENT ETC_ErrorIdx "" UWORD CompuMethod_15 1 0 0 127.998 ECU_ADDRESS 0x4000042B /end MEASUREMENT
/begin MEASUREMENT ETC_ErrorIn "" FLOAT32_IEEE CompuMethod_2 1 0 -1E+17 1E+17 ECU_ADDRESS 0x4000042D /end MEASUREMENT
/begin MEASUREMENT ETC_Setpoint "Commanded electronic throttle position" FLOAT32_IEEE CompuMethod_7 1 0 -1E+17 1E+17 ECU_ADDRESS 0x40000439 /end MEASUREMENT
/begin MEASUREMENT ETC_SetpointIdx "" UWORD CompuMethod_15 1 0 0 127.998 ECU_ADDRESS 0x4000043D /end MEASUREMENT
/begin MEASUREMENT ETC_SetpointIn "" FLOAT32_IEEE CompuMethod_2 1 0 -1E+17 1E+17 ECU_ADDRESS 0x4000043F /end MEASUREMENT
/begin MEASUREMENT ETC_ShutDownTimer "" FLOAT32_IEEE CompuMethod_2 1 0 -1E+17 1E+17 ECU_ADDRESS 0x40000444 /end MEASUREMENT
/begin MEASUREMENT ETC_VoltageComp "Gain on ETC duty cycle based on DRVP" FLOAT32_IEEE CompuMethod_2 1 0 -1E+17 1E+17 ECU_ADDRESS 0x40000448 /end MEASUREMENT
/begin MEASUREMENT ETCDampTerm "PID Damper Term" FLOAT32_IEEE CompuMethod_7 1 0 -1E+17 1E+17 ECU_ADDRESS 0x40000455 /end MEASUREMENT
/begin MEASUREMENT ETCDCOffset "Duty cycle offset based on desired ETC position." FLOAT32_IEEE CompuMethod_7 1 0 -1E+17 1E+17 ECU_ADDRESS 0x40000459 /end MEASUREMENT
/begin MEASUREMENT ETCDTerm "PID Derivative Term" FLOAT32_IEEE CompuMethod_7 1 0 -1E+17 1E+17 ECU_ADDRESS 0x4000045D /end MEASUREMENT
/begin MEASUREMENT ETCError "PID Error Term" FLOAT32_IEEE CompuMethod_7 1 0 -1E+17 1E+17 ECU_ADDRESS 0x40000461 /end MEASUREMENT
/begin MEASUREMENT ETCITerm "PID Integrator Term" FLOAT32_IEEE CompuMethod_7 1 0 -1E+17 1E+17 ECU_ADDRESS 0x40000465 /end MEASUREMENT
/begin MEASUREMENT ETCOut "PID Final Output" FLOAT32_IEEE CompuMethod_7 1 0 -1E+17 1E+17 ECU_ADDRESS 0x40000469 /end MEASUREMENT
/begin MEASUREMENT ETCPTerm "PID Proportional Term" FLOAT32_IEEE CompuMethod_7 1 0 -1E+17 1E+17 ECU_ADDRESS 0x4000046D /end MEASUREMENT
/begin MEASUREMENT ETCReqFallRate "Limits fall rate of ETCRequestFiltered." FLOAT32_IEEE CompuMethod_102 1 0 -1E+17 1E+17 ECU_ADDRESS 0x40000471 /end MEASUREMENT
/begin MEASUREMENT ETCReqFilterConst "" FLOAT32_IEEE CompuMethod_2 1 0 -1E+17 1E+17 ECU_ADDRESS 0x40000475 /end MEASUREMENT
/begin MEASUREMENT ETCReqRiseRate "Limits rise rate of ETCRequestFiltered." FLOAT32_IEEE CompuMethod_102 1 0 -1E+17 1E+17 ECU_ADDRESS 0x40000479 /end MEASUREMENT
/begin MEASUREMENT ETCRequest "Driver demand table" FLOAT32_IEEE CompuMethod_7 1 0 -1E+17 1E+17 ECU_ADDRESS 0x4000047D /end MEASUREMENT
/begin MEASUREMENT ETCRequestDirection "" UBYTE CompuMethod_103 1 0 0 1 ECU_ADDRESS 0x40000481 /end MEASUREMENT
/begin MEASUREMENT ETCRequestFinal "Final ETC request sent to ETC controller from Run state." FLOAT32_IEEE CompuMethod_50 1 0 -1E+17 1E+17 ECU_ADDRESS 0x40000482 /end MEASUREMENT
/begin MEASUREMENT ETCStallReq "" FLOAT32_IEEE CompuMethod_7 1 0 -1E+17 1E+17 ECU_ADDRESS 0x40000486 /end MEASUREMENT
/begin MEASUREMENT Fan1Cmd "FAN 1 final request" FLOAT32_IEEE CompuMethod_7 1 0 -1E+17 1E+17 ECU_ADDRESS 0x400004A7 /end MEASUREMENT
/begin MEASUREMENT Fan2Cmd "Fan 2 final command" FLOAT32_IEEE CompuMethod_7 1 0 -1E+17 1E+17 ECU_ADDRESS 0x400004AF /end MEASUREMENT
/begin MEASUREMENT FgndAngleStackMinBytesFree "Min bytes observed on the Foreground Angle Stack (may not exist depending onapplication)" ULONG CompuMethod_53 1 0 0 0 ECU_ADDRESS 0x400004C4 /end MEASUREMENT
/begin MEASUREMENT FgndAngTaskStatus "Foreground Time Scheduler Status" UBYTE CompuMethod_52 1 0 0 0 ECU_ADDRESS 0x400004C8 /end MEASUREMENT
/begin MEASUREMENT FgndTimeStackMinBytesFree "Min bytes observed on the Foreground Time Stack" ULONG CompuMethod_53 1 0 0 0 ECU_ADDRESS 0x400004C9 /end MEASUREMENT
/begin MEASUREMENT FilteredETCRequest "Final ETC request" FLOAT32_IEEE CompuMethod_7 1 0 -1E+17 1E+17 ECU_ADDRESS 0x400004CD /end MEASUREMENT
/begin MEASUREMENT ForcedShutDownTimer "" FLOAT32_IEEE CompuMethod_2 1 0 -1E+17 1E+17 ECU_ADDRESS 0x400004D1 /end MEASUREMENT
/begin MEASUREMENT FuelAdapt_Error_BankA "Error in fuel flow at the current operating point, as compared to O2 sensor" FLOAT32_IEEE CompuMethod_2 1 0 -1E+17 1E+17 ECU_ADDRESS 0x40000529 /end MEASUREMENT
/begin MEASUREMENT FuelAdapt_Error_BankB "Error in fuel flow at the current operating point, as compared to O2 sensor" FLOAT32_IEEE CompuMethod_2 1 0 -1E+17 1E+17 ECU_ADDRESS 0x4000052D /end MEASUREMENT
/begin MEASUREMENT FuelAdaptEnabled "Indicates whether FuelFlowComp map adapting is enabled" UBYTE CompuMethod_47 1 0 0 1 ECU_ADDRESS 0x40000531 /end MEASUREMENT
/begin MEASUREMENT FuelAdaptGain_BankA "Gain for updating FuelFlowComp map.  This fraction of the error is added to the map every 5ms." FLOAT32_IEEE CompuMethod_48 1 0 -1E+17 1E+17 ECU_ADDRESS 0x40000532 /end MEASUREMENT
/begin MEASUREMENT FuelAdaptGain_BankB "Gain for updating FuelFlowComp map.  This fraction of the error is added to the map every 5ms." FLOAT32_IEEE CompuMethod_48 1 0 -1E+17 1E+17 ECU_ADDRESS 0x40000536 /end MEASUREMENT
/begin MEASUREMENT FuelFlowComp "Fuel Flow Compensation Multiplier - gain to adjust modelling errors in mechanical fuel system." FLOAT32_IEEE CompuMethod_32 1 0 -1E+17 1E+17 ECU_ADDRESS 0x40000542 /end MEASUREMENT
/begin MEASUREMENT FuelFlowCompAdapt_BankA "Adapt map based on O2 ITerm that is multiplied into FuelFlowComp." FLOAT32_IEEE CompuMethod_32 1 0 -1E+17 1E+17 ECU_ADDRESS 0x40000546 /end MEASUREMENT
/begin MEASUREMENT FuelFlowCompAdapt_BankB "Adapt map based on O2 ITerm that is multiplied into FuelFlowComp." FLOAT32_IEEE CompuMethod_32 1 0 -1E+17 1E+17 ECU_ADDRESS 0x4000054A /end MEASUREMENT
/begin MEASUREMENT FuelPulseStatePrb "" UBYTE CompuMethod_117 1 0 0 255 ECU_ADDRESS 0x40000572 /end MEASUREMENT
/begin MEASUREMENT FuelPumpTSE "" FLOAT32_IEEE CompuMethod_2 1 0 -1E+17 1E+17 ECU_ADDRESS 0x40000573 /end MEASUREMENT
/begin MEASUREMENT GlobalBaseFuelRate "Liquid fuel rate based on airflow and target equivalence ratio" FLOAT32_IEEE CompuMethod_29 1 0 -1E+17 1E+17 ECU_ADDRESS 0x40000584 /end MEASUREMENT
/begin MEASUREMENT IAT_SpkOfst "IAT spark offset" FLOAT32_IEEE CompuMethod_66 1 0 -1E+17 1E+17 ECU_ADDRESS 0x400005B3 /end MEASUREMENT
/begin MEASUREMENT IAT_SpkOfstMult "Multiplier on IAT spark offset table." FLOAT32_IEEE CompuMethod_2 1 0 -1E+17 1E+17 ECU_ADDRESS 0x400005B7 /end MEASUREMENT
/begin MEASUREMENT IATFanSpeed "" FLOAT32_IEEE CompuMethod_2 1 0 -1E+17 1E+17 ECU_ADDRESS 0x400005CF /end MEASUREMENT
/begin MEASUREMENT IATFanSpeed_Stall "" FLOAT32_IEEE CompuMethod_2 1 0 -1E+17 1E+17 ECU_ADDRESS 0x400005D3 /end MEASUREMENT
/begin MEASUREMENT IdleStackMinBytesFree "Min bytes observed on the Idle Stack" ULONG CompuMethod_53 1 0 0 0 ECU_ADDRESS 0x400005E1 /end MEASUREMENT
/begin MEASUREMENT IdleState "The idle governor may be one of: Flaring, OnIdle, OffIdle" UBYTE CompuMethod_128 1 0 0 255 ECU_ADDRESS 0x400005E5 /end MEASUREMENT
/begin MEASUREMENT INJ_InjectorCreate "Debug Variable" UBYTE CompuMethod_30 1 0 0 0 ECU_ADDRESS 0x400005E6 /end MEASUREMENT
/begin MEASUREMENT InjectorsEnabled "Enable state for injectors." UBYTE CompuMethod_4 1 0 0 1 ECU_ADDRESS 0x40000611 MATRIX_DIM 8 1 1 /end MEASUREMENT
/begin MEASUREMENT InjTransitionCount "" UBYTE CompuMethod_1 1 0 0 255 ECU_ADDRESS 0x4000063D MATRIX_DIM 8 1 1 /end MEASUREMENT
/begin MEASUREMENT IntakeAirTempEnrichment "Requested on base eq. ratio as a function of IAT and MAP" FLOAT32_IEEE CompuMethod_62 1 0 -1E+17 1E+17 ECU_ADDRESS 0x4000064D /end MEASUREMENT
/begin MEASUREMENT InterruptStackMinBytesFree "Minimum observed stack free for use by the interrupts" UWORD CompuMethod_135 1 0 0 65535 ECU_ADDRESS 0x40000651 /end MEASUREMENT
/begin MEASUREMENT LastOSError "Monitor of Internal OS Errors" UBYTE CompuMethod_136 1 0 0 0 ECU_ADDRESS 0x40000653 /end MEASUREMENT
/begin MEASUREMENT MAF09Idx "" UWORD CompuMethod_15 1 0 0 127.998 ECU_ADDRESS 0x40000681 /end MEASUREMENT
/begin MEASUREMENT MAF09In "" FLOAT32_IEEE CompuMethod_2 1 0 -1E+17 1E+17 ECU_ADDRESS 0x40000683 /end MEASUREMENT
/begin MEASUREMENT MAFFinal "Air mass flow rate at the intake manifold - Used by the fueling algorithm" FLOAT32_IEEE CompuMethod_29 1 0 -1E+17 1E+17 ECU_ADDRESS 0x4000068B /end MEASUREMENT
/begin MEASUREMENT MakeUpEOI "End of injection timing for transient makeup fuel pulse" FLOAT32_IEEE CompuMethod_66 1 0 -1E+17 1E+17 ECU_ADDRESS 0x4000069B /end MEASUREMENT
/begin MEASUREMENT MaxETCSetPtLimit "Maximum allowable ETC position." FLOAT32_IEEE CompuMethod_7 1 0 -1E+17 1E+17 ECU_ADDRESS 0x4000071B /end MEASUREMENT
/begin MEASUREMENT MinETCSetPtLimit "Min allowable ETC position." FLOAT32_IEEE CompuMethod_7 1 0 -1E+17 1E+17 ECU_ADDRESS 0x40000759 /end MEASUREMENT
/begin MEASUREMENT MisfireDiag_AverageStartRPM "" UWORD CompuMethod_9 1 0 0 65535 ECU_ADDRESS 0x4000076C /end MEASUREMENT
/begin MEASUREMENT MisfireDiag_AverageStartRPMDR "" UBYTE CompuMethod_11 1 0 0 1 ECU_ADDRESS 0x4000076E /end MEASUREMENT
/begin MEASUREMENT MisfireDiag_AverageStopRPM "" UWORD CompuMethod_9 1 0 0 65535 ECU_ADDRESS 0x4000076F /end MEASUREMENT
/begin MEASUREMENT MisfireDiag_AverageStopRPMDR "" UBYTE CompuMethod_11 1 0 0 1 ECU_ADDRESS 0x40000771 /end MEASUREMENT
/begin MEASUREMENT MisfireDiag_EncoderAngle "" SWORD CompuMethod_9 1 0 -32768 32767 ECU_ADDRESS 0x40000772 /end MEASUREMENT
/begin MEASUREMENT O2_BankA_EquivRatio_Out "" FLOAT32_IEEE CompuMethod_2 1 0 -1E+17 1E+17 ECU_ADDRESS 0x40000903 /end MEASUREMENT
/begin MEASUREMENT O2Calibration "" UBYTE CompuMethod_8 1 0 0 1 ECU_ADDRESS 0x4000090F /end MEASUREMENT
/begin MEASUREMENT O2CtrlMode "" UBYTE CompuMethod_151 1 0 0 1 ECU_ADDRESS 0x40000910 /end MEASUREMENT
/begin MEASUREMENT O2FaultDisable "" UBYTE CompuMethod_11 1 0 0 1 ECU_ADDRESS 0x40000915 /end MEASUREMENT
/begin MEASUREMENT O2ITerm_BankAIdx "Index for O2 ITerm." UWORD CompuMethod_15 1 0 0 127.998 ECU_ADDRESS 0x40000936 /end MEASUREMENT
/begin MEASUREMENT O2ITerm_BankAIn "Index for O2 ITerm." FLOAT32_IEEE CompuMethod_32 1 0 -1E+17 1E+17 ECU_ADDRESS 0x40000938 /end MEASUREMENT
/begin MEASUREMENT O2ITerm_BankBIdx "Index for O2 ITerm." UWORD CompuMethod_15 1 0 0 127.998 ECU_ADDRESS 0x4000093C /end MEASUREMENT
/begin MEASUREMENT O2ITerm_BankBIn "Index for O2 ITerm." FLOAT32_IEEE CompuMethod_32 1 0 -1E+17 1E+17 ECU_ADDRESS 0x4000093E /end MEASUREMENT
/begin MEASUREMENT O2SensorFaults "" UBYTE CompuMethod_8 1 0 0 1 ECU_ADDRESS 0x40000962 /end MEASUREMENT
/begin MEASUREMENT O2StartUpDelay "Delay O2 enable until TimeSinceRun is greater than this time." FLOAT32_IEEE CompuMethod_46 1 0 -1E+17 1E+17 ECU_ADDRESS 0x40000963 /end MEASUREMENT
/begin MEASUREMENT O2TimeDelay "" UBYTE CompuMethod_8 1 0 0 1 ECU_ADDRESS 0x4000096F /end MEASUREMENT
/begin MEASUREMENT OSErrorCnt "Number of errors observed by the OS" UBYTE CompuMethod_1 1 0 0 255 ECU_ADDRESS 0x4000097A /end MEASUREMENT
/begin MEASUREMENT OSStatus "" UBYTE CompuMethod_155 1 0 0 0 ECU_ADDRESS 0x4000097B /end MEASUREMENT
/begin MEASUREMENT PeakHeapBytesUsed "The peak number of bytes seen on the heap." ULONG CompuMethod_9 1 0 0 0 ECU_ADDRESS 0x400009AE /end MEASUREMENT
/begin MEASUREMENT PerCylBaseFuelRate "Liquid fuel mass flow rate based on airflow and target equivalence ratio per cylinder." FLOAT32_IEEE CompuMethod_29 1 0 -1E+17 1E+17 ECU_ADDRESS 0x400009B2 /end MEASUREMENT
/begin MEASUREMENT PrimarySOI "Injection timing for primary fuel pulse - SOI or EOI depending on Inj Config" FLOAT32_IEEE CompuMethod_66 1 0 -1E+17 1E+17 ECU_ADDRESS 0x400009BE /end MEASUREMENT
/begin MEASUREMENT protocol_register_CAN_1 "Debug Variable" UBYTE CompuMethod_30 1 0 0 0 ECU_ADDRESS 0x400009C2 /end MEASUREMENT
/begin MEASUREMENT protocol_register_CAN_2 "Debug Variable" UBYTE CompuMethod_30 1 0 0 0 ECU_ADDRESS 0x400009C3 /end MEASUREMENT
/begin MEASUREMENT RPM "" FLOAT32_IEEE CompuMethod_2 1 0 -1E+17 1E+17 ECU_ADDRESS 0x400009D4 /end MEASUREMENT
/begin MEASUREMENT RPMAccel17Idx "" UWORD CompuMethod_15 1 0 0 127.998 ECU_ADDRESS 0x400009EA /end MEASUREMENT
/begin MEASUREMENT RPMAccel17In "" FLOAT32_IEEE CompuMethod_2 1 0 -1E+17 1E+17 ECU_ADDRESS 0x400009EC /end MEASUREMENT
/begin MEASUREMENT RPMCtrlMode "" UBYTE CompuMethod_11 1 0 0 1 ECU_ADDRESS 0x400009F0 /end MEASUREMENT
/begin MEASUREMENT RPMInst "" FLOAT32_IEEE CompuMethod_2 1 0 -1E+17 1E+17 ECU_ADDRESS 0x400009F2 /end MEASUREMENT
/begin MEASUREMENT Spark_Adv_Prb "" FLOAT32_IEEE CompuMethod_2 1 0 -1E+17 1E+17 ECU_ADDRESS 0x40000A00 /end MEASUREMENT
/begin MEASUREMENT SparkAdv "Base spark advance map." FLOAT32_IEEE CompuMethod_66 1 0 -1E+17 1E+17 ECU_ADDRESS 0x40000A04 /end MEASUREMENT
/begin MEASUREMENT SparkDwell "Total electrical spark dwell time" FLOAT32_IEEE CompuMethod_65 1 0 -1E+17 1E+17 ECU_ADDRESS 0x40000A08 /end MEASUREMENT
/begin MEASUREMENT SparkEnabled "Enabled when spark energy is greater than zero" UBYTE CompuMethod_34 1 0 0 1 ECU_ADDRESS 0x40000A0C /end MEASUREMENT
/begin MEASUREMENT SparkEnergyMonitor "Commanded spark energy, before conversion to dwell time" FLOAT32_IEEE CompuMethod_51 1 0 -1E+17 1E+17 ECU_ADDRESS 0x40000A0D /end MEASUREMENT
/begin MEASUREMENT SpkEnergy09Idx "" UWORD CompuMethod_15 1 0 0 127.998 ECU_ADDRESS 0x40000A11 /end MEASUREMENT
/begin MEASUREMENT SpkEnergy09In "" FLOAT32_IEEE CompuMethod_2 1 0 -1E+17 1E+17 ECU_ADDRESS 0x40000A13 /end MEASUREMENT
/begin MEASUREMENT SpkOfstTempFnl "Total Spark Offset based on ECT, IAT, CAT, engine speed and load" FLOAT32_IEEE CompuMethod_66 1 0 -1E+17 1E+17 ECU_ADDRESS 0x40000A35 /end MEASUREMENT
/begin MEASUREMENT SWISRCurrQueueSize "Current size of the Software ISR Queue" UBYTE CompuMethod_171 1 0 0 255 ECU_ADDRESS 0x40000A4D /end MEASUREMENT
/begin MEASUREMENT TDCCount "Number of TDC events counted after stall.  This will reset once in Crank and Run." UBYTE CompuMethod_1 1 0 0 255 ECU_ADDRESS 0x40000A62 /end MEASUREMENT
/begin MEASUREMENT TDCCountThreshEnabled "" UBYTE CompuMethod_8 1 0 0 1 ECU_ADDRESS 0x40000A63 /end MEASUREMENT
/begin MEASUREMENT TimeSinceRun09Idx "" UWORD CompuMethod_15 1 0 0 127.998 ECU_ADDRESS 0x40000A6C /end MEASUREMENT
/begin MEASUREMENT TimeSinceRun09In "" FLOAT32_IEEE CompuMethod_2 1 0 -1E+17 1E+17 ECU_ADDRESS 0x40000A6E /end MEASUREMENT
/begin MEASUREMENT Tot_EqRatio_SpkOfst "Total Spark Offset based on Desired Equivalence Ratio, engine speed and load" FLOAT32_IEEE CompuMethod_88 1 0 -1E+17 1E+17 ECU_ADDRESS 0x40000A76 /end MEASUREMENT
/begin MEASUREMENT TransFuel_MAPFilt "" FLOAT32_IEEE CompuMethod_2 1 0 -1E+17 1E+17 ECU_ADDRESS 0x40000AD6 /end MEASUREMENT
/begin MEASUREMENT TransFuel_TPSFilt "" FLOAT32_IEEE CompuMethod_2 1 0 -1E+17 1E+17 ECU_ADDRESS 0x40000ADA /end MEASUREMENT
/begin MEASUREMENT VEAdaptAmnt "Volumetric efficiency adapt amount at the given speed and load" FLOAT32_IEEE CompuMethod_7 1 0 -1E+17 1E+17 ECU_ADDRESS 0x40000AE5 /end MEASUREMENT
/begin MEASUREMENT VEAdapting "Indicates whether the volumetric efficiency map is currently being adjusted" UBYTE CompuMethod_176 1 0 0 1 ECU_ADDRESS 0x40000AED /end MEASUREMENT
/begin MEASUREMENT VEBaroCorr "Vol Eff compensation based on BARO." FLOAT32_IEEE CompuMethod_2 1 0 -1E+17 1E+17 ECU_ADDRESS 0x40000AEE /end MEASUREMENT
/begin MEASUREMENT VEFin "Final volumentric efficiency after adapt table" FLOAT32_IEEE CompuMethod_29 1 0 -1E+17 1E+17 ECU_ADDRESS 0x40000AF2 /end MEASUREMENT
/begin MEASUREMENT VEIdealMAF "Air Mass Flow Rate - ideal" FLOAT32_IEEE CompuMethod_29 1 0 -1E+17 1E+17 ECU_ADDRESS 0x40000AF6 /end MEASUREMENT
/begin MEASUREMENT VEMapIdx "Index of MAP for VE calculations" UWORD CompuMethod_15 1 0 0 127.998 ECU_ADDRESS 0x40000AFA /end MEASUREMENT
/begin MEASUREMENT VEMapIn "Index of MAP for VE calculations" FLOAT32_IEEE CompuMethod_16 1 0 -1E+17 1E+17 ECU_ADDRESS 0x40000AFC /end MEASUREMENT
/begin MEASUREMENT VEModelMAF "Air Mass Flow Rate - Port Total" FLOAT32_IEEE CompuMethod_29 1 0 -1E+17 1E+17 ECU_ADDRESS 0x40000B00 /end MEASUREMENT
/begin MEASUREMENT VETempCorr "" FLOAT32_IEEE CompuMethod_7 1 0 -1E+17 1E+17 ECU_ADDRESS 0x40000B04 /end MEASUREMENT
/begin MEASUREMENT VolEff "Volumetric efficiency table for speed density mode" FLOAT32_IEEE CompuMethod_7 1 0 -1E+17 1E+17 ECU_ADDRESS 0x40000B08 /end MEASUREMENT
/begin MEASUREMENT VolEffAdapt "Volumetric efficiency adapt table" FLOAT32_IEEE CompuMethod_7 1 0 -1E+17 1E+17 ECU_ADDRESS 0x40000B0C /end MEASUREMENT
/begin MEASUREMENT WarmUpEqRatio "Requested eq. ratio as a function of ECT and MAP." FLOAT32_IEEE CompuMethod_62 1 0 -1E+17 1E+17 ECU_ADDRESS 0x40000B3C /end MEASUREMENT
/begin MEASUREMENT WarmUpTimeRatio "Requested eq. ratio as a function of TimeSinceRun and ECT. Use for cold temps" FLOAT32_IEEE CompuMethod_62 1 0 -1E+17 1E+17 ECU_ADDRESS 0x40000B41 /end MEASUREMENT
/begin CHARACTERISTIC ACPresDfltValue "This is the initial default value should the sensor be in fault on key-up.  Otherwise the sensors outputs the last value prior to faulting" VALUE 0x800000B0 RecordLayout_5 0 CompuMethod_14 -1E+17 1E+17 /end CHARACTERISTIC
/begin CHARACTERISTIC ACPresFanOff "AC pressure when the fan turns off" VALUE 0x800000B4 RecordLayout_5 0 CompuMethod_18 -1E+17 1E+17 /end CHARACTERISTIC
/begin CHARACTERISTIC ACPresFanOn "AC pressure when the fan turns on" VALUE 0x800000B8 RecordLayout_5 0 CompuMethod_18 -1E+17 1E+17 /end CHARACTERISTIC
/begin CHARACTERISTIC ACPresFanSpeed_StallTbl "" CURVE 0x800000BC RecordLayout_5 0 CompuMethod_2 -1E+17 1E+17
 /begin AXIS_DESCR COM_AXIS ACPres05In CompuMethod_16 5 -150 10000 AXIS_PTS_REF ACPres05IdxArr /end AXIS_DESCR
/end CHARACTERISTIC
/begin CHARACTERISTIC ACPresFanSpeedMap "" MAP 0x800000D0 RecordLayout_5 0 CompuMethod_2 -1E+17 1E+17
 /begin AXIS_DESCR COM_AXIS VSPD07In CompuMethod_180 7 -100 200 AXIS_PTS_REF VSPD07IdxArr /end AXIS_DESCR
 /begin AXIS_DESCR COM_AXIS ACPres07In CompuMethod_16 7 -150 10000 AXIS_PTS_REF ACPres07IdxArr /end AXIS_DESCR
/end CHARACTERISTIC
/begin CHARACTERISTIC ACPresFilterConst "Filter time constant" VALUE 0x80000194 RecordLayout_5 0 CompuMethod_19 -1E+17 1E+17 /end CHARACTERISTIC
/begin CHARACTERISTIC ACPresGain "Scaling from A/D counts to engineering units" VALUE 0x80000198 RecordLayout_5 0 CompuMethod_20 -1E+17 1E+17 /end CHARACTERISTIC
/begin CHARACTERISTIC ACPresInputHiFltPos "Maximum allowable input, indicating short or open circuit" VALUE 0x8000019C RecordLayout_5 0 CompuMethod_21 -1E+17 1E+17 /end CHARACTERISTIC
/begin CHARACTERISTIC ACPresInputLoFltPos "Minimum allowable input, indicating short or open circuit" VALUE 0x800001A0 RecordLayout_5 0 CompuMethod_21 -1E+17 1E+17 /end CHARACTERISTIC
/begin CHARACTERISTIC ACPresOfst "Offset after gain in engineering units" VALUE 0x800001A4 RecordLayout_5 0 CompuMethod_14 -1E+17 1E+17 /end CHARACTERISTIC
/begin CHARACTERISTIC ACPresPin "Analog input pin selection for ACPresPin" VALUE 0x800001A8 RecordLayout_6 0 CompuMethod_22 -32768 32767 /end CHARACTERISTIC
/begin CHARACTERISTIC ACPresPin_ref "Reference Voltage Selection" VALUE 0x800001AA RecordLayout_1 0 CompuMethod_23 0 255 /end CHARACTERISTIC
/begin CHARACTERISTIC ACSw_new "Override actuator, in engineering units" VALUE 0x800001B3 RecordLayout_1 0 CompuMethod_25 0 1 /end CHARACTERISTIC
/begin CHARACTERISTIC ACSw_ovr "" VALUE 0x800001B4 RecordLayout_1 0 CompuMethod_5 0 1 /end CHARACTERISTIC
/begin CHARACTERISTIC ACSwFanSpeed "Fan speed % req for AC Sw 0 to disable" VALUE 0x800001B5 RecordLayout_1 0 CompuMethod_26 0 100 /end CHARACTERISTIC
/begin CHARACTERISTIC ACSwFanSpeed_Stall "Fan speed % req for AC Sw 0 to disable" VALUE 0x800001B6 RecordLayout_5 0 CompuMethod_7 0 100 /end CHARACTERISTIC
/begin CHARACTERISTIC ACSwPin "Analog input pin selection for ACSwPin" VALUE 0x800001BA RecordLayout_6 0 CompuMethod_22 -32768 32767 /end CHARACTERISTIC
/begin CHARACTERISTIC ACSwPin_ref "Reference Voltage Selection" VALUE 0x800001BC RecordLayout_1 0 CompuMethod_23 0 255 /end CHARACTERISTIC
/begin CHARACTERISTIC ACSwPolarity "0 = High True    1 = Low True" VALUE 0x800001BD RecordLayout_1 0 CompuMethod_4 0 1 /end CHARACTERISTIC
/begin CHARACTERISTIC ACSwSwitchPt "Defines switch point in ADC units boolean conversion" VALUE 0x800001BE RecordLayout_5 0 CompuMethod_21 -1E+17 1E+17 /end CHARACTERISTIC
/begin CHARACTERISTIC AdaptEnable "Determines whether the FuelFlowComp map will be adapted using the MAF sensor" VALUE 0x800001CE RecordLayout_1 0 CompuMethod_28 0 1 /end CHARACTERISTIC
/begin CHARACTERISTIC AirControlSource "Selects source of idle air control" VALUE 0x800001CF RecordLayout_1 0 CompuMethod_31 0 1 /end CHARACTERISTIC
/begin CHARACTERISTIC AirflowDiag_MAPIRDiagEnable "" VALUE 0x800001D0 RecordLayout_1 0 CompuMethod_8 0 1 /end CHARACTERISTIC
/begin CHARACTERISTIC AirflowMimatchThreshMap "" MAP 0x800001D1 RecordLayout_8 0 CompuMethod_1 -128 127
 /begin AXIS_DESCR COM_AXIS MAP09In CompuMethod_16 9 0 1000 AXIS_PTS_REF MAP09IdxArr /end AXIS_DESCR
 /begin AXIS_DESCR COM_AXIS RPM09In CompuMethod_71 9 0 14000 AXIS_PTS_REF RPM09IdxArr /end AXIS_DESCR
/end CHARACTERISTIC
/begin CHARACTERISTIC AirMinGovDGain "Base D-gain for the min. governor controller." VALUE 0x80000222 RecordLayout_5 0 CompuMethod_32 -1E+17 1E+17 /end CHARACTERISTIC
/begin CHARACTERISTIC AirMinGovDGainErrorMultTbl "" CURVE 0x80000226 RecordLayout_5 0 CompuMethod_32 -1E+17 1E+17
 /begin AXIS_DESCR COM_AXIS AirMinGovSpeedErrorIn CompuMethod_2 9 -1E+17 1E+17 AXIS_PTS_REF AirMinGovSpeedErrorIdxArr /end AXIS_DESCR
/end CHARACTERISTIC
/begin CHARACTERISTIC AirMinGovErrorGain "Error gain for the min governor controller. This gain is applied to the RPM error term before it is used to calculate the P, I and D terms." VALUE 0x8000024A RecordLayout_5 0 CompuMethod_32 -1E+17 1E+17 /end CHARACTERISTIC
/begin CHARACTERISTIC AirMinGovIGain "Base I-gain for the min. governor controller." VALUE 0x8000024E RecordLayout_5 0 CompuMethod_32 -1E+17 1E+17 /end CHARACTERISTIC
/begin CHARACTERISTIC AirMinGovIGainErrorMultTbl "" CURVE 0x80000252 RecordLayout_5 0 CompuMethod_32 -1E+17 1E+17
 /begin AXIS_DESCR COM_AXIS AirMinGovSpeedErrorIn CompuMethod_2 9 -1E+17 1E+17 AXIS_PTS_REF AirMinGovSpeedErrorIdxArr /end AXIS_DESCR
/end CHARACTERISTIC
/begin CHARACTERISTIC AirMinGovITermLowerLimit "Lower limit on Air Min Governor I-term value." VALUE 0x80000276 RecordLayout_5 0 CompuMethod_7 -1E+17 1E+17 /end CHARACTERISTIC
/begin CHARACTERISTIC AirMinGovITermUpperLimit "Upper limit on Air Min Governor I-term value." VALUE 0x8000027A RecordLayout_5 0 CompuMethod_7 -1E+17 1E+17 /end CHARACTERISTIC
/begin CHARACTERISTIC AirMinGovPGain "Base P-gain for the min. governor controller." VALUE 0x8000027E RecordLayout_5 0 CompuMethod_32 -1E+17 1E+17 /end CHARACTERISTIC
/begin CHARACTERISTIC AirMinGovPGainErrorMultTbl "" CURVE 0x80000282 RecordLayout_5 0 CompuMethod_32 -1E+17 1E+17
 /begin AXIS_DESCR COM_AXIS AirMinGovSpeedErrorIn CompuMethod_2 9 -1E+17 1E+17 AXIS_PTS_REF AirMinGovSpeedErrorIdxArr /end AXIS_DESCR
/end CHARACTERISTIC
/begin CHARACTERISTIC AirMinGovPIDOutLowerLimit "Lower limit on air min governor PID Output." VALUE 0x800002A6 RecordLayout_5 0 CompuMethod_7 -1E+17 1E+17 /end CHARACTERISTIC
/begin CHARACTERISTIC AirMinGovPIDOutUpperLimit "Upper limit on air min governor PID Output." VALUE 0x800002AA RecordLayout_5 0 CompuMethod_7 -1E+17 1E+17 /end CHARACTERISTIC
/begin CHARACTERISTIC APP_Filt "Filter time constant" VALUE 0x800002D2 RecordLayout_5 0 CompuMethod_19 -1E+17 1E+17 /end CHARACTERISTIC
/begin CHARACTERISTIC APP1_Adapt_new "Override result of linear sensor characterization, in engineering units" VALUE 0x800002EA RecordLayout_5 0 CompuMethod_7 -1E+17 1E+17 /end CHARACTERISTIC
/begin CHARACTERISTIC APP1_Adapt_ovr "" VALUE 0x800002EE RecordLayout_1 0 CompuMethod_5 0 1 /end CHARACTERISTIC
/begin CHARACTERISTIC APP1_AdaptAdapt_Delta "Specifies the minimum deviation amount to react to." VALUE 0x800002EF RecordLayout_5 0 CompuMethod_21 -1E+17 1E+17 /end CHARACTERISTIC
/begin CHARACTERISTIC APP1_AdaptAdapt_Hi_Max "Specifies for the maximum value of the upper adapt range." VALUE 0x800002F3 RecordLayout_5 0 CompuMethod_33 -1E+17 1E+17 /end CHARACTERISTIC
/begin CHARACTERISTIC APP1_AdaptAdapt_Hi_Min "Specifies for the minimum value of the upper adapt range." VALUE 0x800002F7 RecordLayout_5 0 CompuMethod_33 -1E+17 1E+17 /end CHARACTERISTIC
/begin CHARACTERISTIC APP1_AdaptAdapt_Low_Max "Specifies for the maximum value of the lower adapt range." VALUE 0x800002FB RecordLayout_5 0 CompuMethod_33 -1E+17 1E+17 /end CHARACTERISTIC
/begin CHARACTERISTIC APP1_AdaptAdapt_Low_Min "Specifies for the minimum value of the lower adapt range." VALUE 0x800002FF RecordLayout_5 0 CompuMethod_33 -1E+17 1E+17 /end CHARACTERISTIC
/begin CHARACTERISTIC APP1_AdaptAdaptHiEnable "Enables or disables this adapt." VALUE 0x80000303 RecordLayout_1 0 CompuMethod_8 0 1 /end CHARACTERISTIC
/begin CHARACTERISTIC APP1_AdaptAdaptLoEnable "Enables or disables this adapt." VALUE 0x80000304 RecordLayout_1 0 CompuMethod_8 0 1 /end CHARACTERISTIC
/begin CHARACTERISTIC APP1_AdaptDfltValue "This is the initial default value should the sensor be in fault on key-up.  Otherwise the sensors outputs the last value prior to faulting" VALUE 0x80000305 RecordLayout_5 0 CompuMethod_7 -1E+17 1E+17 /end CHARACTERISTIC
/begin CHARACTERISTIC APP1_AdaptFilterConst "Filter time constant" VALUE 0x80000309 RecordLayout_5 0 CompuMethod_19 -1E+17 1E+17 /end CHARACTERISTIC
/begin CHARACTERISTIC APP1_AdaptInputHiFltPos "Hi limit of input signal which sets fault" VALUE 0x8000030D RecordLayout_5 0 CompuMethod_21 -1E+17 1E+17 /end CHARACTERISTIC
/begin CHARACTERISTIC APP1_AdaptInputLoFltPos "Low limit of input signal which sets fault" VALUE 0x80000311 RecordLayout_5 0 CompuMethod_21 -1E+17 1E+17 /end CHARACTERISTIC
/begin CHARACTERISTIC APP1_AdaptMaxLimit "Sets the upper limit on the potentiometer range." VALUE 0x80000315 RecordLayout_5 0 CompuMethod_7 -1E+17 1E+17 /end CHARACTERISTIC
/begin CHARACTERISTIC APP1_AdaptRev_Polarity "1 = Reverse Polarity (Smaller voltage values indicate larger % travel)" VALUE 0x80000319 RecordLayout_1 0 CompuMethod_34 0 1 /end CHARACTERISTIC
/begin CHARACTERISTIC APP1_AlwaysAdapt "" VALUE 0x8000031A RecordLayout_1 0 CompuMethod_8 0 1 /end CHARACTERISTIC
/begin CHARACTERISTIC APP1_APP2_Max_Deviation "Specifies the maximum allowable deviation between the two sensors" VALUE 0x8000031B RecordLayout_5 0 CompuMethod_35 -1E+17 1E+17 /end CHARACTERISTIC
/begin CHARACTERISTIC APP1AnalogInput "Analog input pin selection for APP1AnalogInput" VALUE 0x80000363 RecordLayout_6 0 CompuMethod_22 -32768 32767 /end CHARACTERISTIC
/begin CHARACTERISTIC APP1AnalogInput_ref "Reference Voltage Selection" VALUE 0x80000365 RecordLayout_1 0 CompuMethod_23 0 255 /end CHARACTERISTIC
/begin CHARACTERISTIC APP1HiAdaptADCThresh "Sets the ADC limit above which a high-side adapt will be captured on key-up." VALUE 0x80000366 RecordLayout_5 0 CompuMethod_21 -1E+17 1E+17 /end CHARACTERISTIC
/begin CHARACTERISTIC APP1LowAdaptADCThresh "Sets the ADC limit below which a low-side adapt will be captured on key-up." VALUE 0x8000036A RecordLayout_5 0 CompuMethod_21 -1E+17 1E+17 /end CHARACTERISTIC
/begin CHARACTERISTIC APP2_Adapt_new "Override result of linear sensor characterization, in engineering units" VALUE 0x8000036E RecordLayout_5 0 CompuMethod_7 -1E+17 1E+17 /end CHARACTERISTIC
/begin CHARACTERISTIC APP2_Adapt_ovr "" VALUE 0x80000372 RecordLayout_1 0 CompuMethod_5 0 1 /end CHARACTERISTIC
/begin CHARACTERISTIC APP2_AdaptAdapt_Delta "Specifies the minimum deviation amount to react to." VALUE 0x80000373 RecordLayout_5 0 CompuMethod_21 -1E+17 1E+17 /end CHARACTERISTIC
/begin CHARACTERISTIC APP2_AdaptAdapt_Hi_Max "Specifies for the maximum value of the upper adapt range." VALUE 0x80000377 RecordLayout_5 0 CompuMethod_33 -1E+17 1E+17 /end CHARACTERISTIC
/begin CHARACTERISTIC APP2_AdaptAdapt_Hi_Min "Specifies for the minimum value of the upper adapt range." VALUE 0x8000037B RecordLayout_5 0 CompuMethod_33 -1E+17 1E+17 /end CHARACTERISTIC
/begin CHARACTERISTIC APP2_AdaptAdapt_Low_Max "Specifies for the maximum value of the lower adapt range." VALUE 0x8000037F RecordLayout_5 0 CompuMethod_33 -1E+17 1E+17 /end CHARACTERISTIC
/begin CHARACTERISTIC APP2_AdaptAdapt_Low_Min "Specifies for the minimum value of the lower adapt range." VALUE 0x80000383 RecordLayout_5 0 CompuMethod_33 -1E+17 1E+17 /end CHARACTERISTIC
/begin CHARACTERISTIC APP2_AdaptAdaptHiEnable "Enables or disables this adapt." VALUE 0x80000387 RecordLayout_1 0 CompuMethod_8 0 1 /end CHARACTERISTIC
/begin CHARACTERISTIC APP2_AdaptAdaptLoEnable "Enables or disables this adapt." VALUE 0x80000388 RecordLayout_1 0 CompuMethod_8 0 1 /end CHARACTERISTIC
/begin CHARACTERISTIC APP2_AdaptDfltValue "This is the initial default value should the sensor be in fault on key-up.  Otherwise the sensors outputs the last value prior to faulting" VALUE 0x80000389 RecordLayout_5 0 CompuMethod_7 -1E+17 1E+17 /end CHARACTERISTIC
/begin CHARACTERISTIC APP2_AdaptFilterConst "Filter time constant" VALUE 0x8000038D RecordLayout_5 0 CompuMethod_19 -1E+17 1E+17 /end CHARACTERISTIC
/begin CHARACTERISTIC APP2_AdaptInputHiFltPos "Hi limit of input signal which sets fault" VALUE 0x80000391 RecordLayout_5 0 CompuMethod_21 -1E+17 1E+17 /end CHARACTERISTIC
/begin CHARACTERISTIC APP2_AdaptInputLoFltPos "Low limit of input signal which sets fault" VALUE 0x80000395 RecordLayout_5 0 CompuMethod_21 -1E+17 1E+17 /end CHARACTERISTIC
/begin CHARACTERISTIC APP2_AdaptMaxLimit "Sets the upper limit on the potentiometer range." VALUE 0x80000399 RecordLayout_5 0 CompuMethod_7 -1E+17 1E+17 /end CHARACTERISTIC
/begin CHARACTERISTIC APP2_AdaptRev_Polarity "1 = Reverse Polarity (Smaller voltage values indicate larger % travel)" VALUE 0x8000039D RecordLayout_1 0 CompuMethod_34 0 1 /end CHARACTERISTIC
/begin CHARACTERISTIC APP2_AlwaysAdapt "" VALUE 0x8000039E RecordLayout_1 0 CompuMethod_8 0 1 /end CHARACTERISTIC
/begin CHARACTERISTIC APP2AnalogInput "Analog input pin selection for APP2AnalogInput" VALUE 0x8000039F RecordLayout_6 0 CompuMethod_22 -32768 32767 /end CHARACTERISTIC
/begin CHARACTERISTIC APP2AnalogInput_ref "Reference Voltage Selection" VALUE 0x800003A1 RecordLayout_1 0 CompuMethod_23 0 255 /end CHARACTERISTIC
/begin CHARACTERISTIC APP2HiAdaptADCThresh "Sets the ADC limit above which a high-side adapt will be captured on key-up." VALUE 0x800003A2 RecordLayout_5 0 CompuMethod_21 -1E+17 1E+17 /end CHARACTERISTIC
/begin CHARACTERISTIC APP2LowAdaptADCThresh "Sets the ADC limit below which a low-side adapt will be captured on key-up." VALUE 0x800003A6 RecordLayout_5 0 CompuMethod_21 -1E+17 1E+17 /end CHARACTERISTIC
/begin CHARACTERISTIC ApplicationMonitorEnable "Enables runtime checking of stack, heap, CPU, and OS errors.  Stops the application on error." VALUE 0x800003AA RecordLayout_1 0 CompuMethod_37 0 1 /end CHARACTERISTIC
/begin CHARACTERISTIC ApplicationPausePoint "Selects the startup pause point, for debugging.  Can be moved forward to step through the initialization" VALUE 0x800003AB RecordLayout_1 0 CompuMethod_38 0 3 /end CHARACTERISTIC
/begin CHARACTERISTIC ApplicationStatus "View and set the application runtime status" VALUE 0x800003AC RecordLayout_1 0 CompuMethod_39 1 3 /end CHARACTERISTIC
/begin CHARACTERISTIC Bank1_EquivRatio_new "Override result of linear sensor characterization, in engineering units" VALUE 0x800003AD RecordLayout_5 0 CompuMethod_42 -1E+17 1E+17 /end CHARACTERISTIC
/begin CHARACTERISTIC Bank1_EquivRatio_ovr "" VALUE 0x800003B1 RecordLayout_1 0 CompuMethod_5 0 1 /end CHARACTERISTIC
/begin CHARACTERISTIC Bank1_EquivRatioDfltValue "This is the initial default value should the sensor be in fault on key-up.  Otherwise the sensors outputs the last value prior to faulting" VALUE 0x800003B2 RecordLayout_5 0 CompuMethod_42 -1E+17 1E+17 /end CHARACTERISTIC
/begin CHARACTERISTIC Bank1_EquivRatioFilterConst "Filter time constant" VALUE 0x800003B6 RecordLayout_5 0 CompuMethod_19 -1E+17 1E+17 /end CHARACTERISTIC
/begin CHARACTERISTIC Bank1_EquivRatioGain "Scaling from A/D counts to engineering units" VALUE 0x800003BA RecordLayout_5 0 CompuMethod_43 -1E+17 1E+17 /end CHARACTERISTIC
/begin CHARACTERISTIC Bank1_EquivRatioInputHiFltPos "Maximum allowable input, indicating short or open circuit" VALUE 0x800003BE RecordLayout_5 0 CompuMethod_42 -1E+17 1E+17 /end CHARACTERISTIC
/begin CHARACTERISTIC Bank1_EquivRatioInputLoFltPos "Minimum allowable input, indicating short or open circuit" VALUE 0x800003C2 RecordLayout_5 0 CompuMethod_42 -1E+17 1E+17 /end CHARACTERISTIC
/begin CHARACTERISTIC Bank1_EquivRatioOfst "Offset after gain in engineering units" VALUE 0x800003C6 RecordLayout_5 0 CompuMethod_42 -1E+17 1E+17 /end CHARACTERISTIC
/begin CHARACTERISTIC Bank2_EquivRatio_new "Override result of linear sensor characterization, in engineering units" VALUE 0x800003CA RecordLayout_5 0 CompuMethod_42 -1E+17 1E+17 /end CHARACTERISTIC
/begin CHARACTERISTIC Bank2_EquivRatio_ovr "" VALUE 0x800003CE RecordLayout_1 0 CompuMethod_5 0 1 /end CHARACTERISTIC
/begin CHARACTERISTIC Bank2_EquivRatioDfltValue "This is the initial default value should the sensor be in fault on key-up.  Otherwise the sensors outputs the last value prior to faulting" VALUE 0x800003CF RecordLayout_5 0 CompuMethod_42 -1E+17 1E+17 /end CHARACTERISTIC
/begin CHARACTERISTIC Bank2_EquivRatioFilterConst "Filter time constant" VALUE 0x800003D3 RecordLayout_5 0 CompuMethod_19 -1E+17 1E+17 /end CHARACTERISTIC
/begin CHARACTERISTIC Bank2_EquivRatioGain "Scaling from A/D counts to engineering units" VALUE 0x800003D7 RecordLayout_5 0 CompuMethod_43 -1E+17 1E+17 /end CHARACTERISTIC
/begin CHARACTERISTIC Bank2_EquivRatioInputHiFltPos "Maximum allowable input, indicating short or open circuit" VALUE 0x800003DB RecordLayout_5 0 CompuMethod_42 -1E+17 1E+17 /end CHARACTERISTIC
/begin CHARACTERISTIC Bank2_EquivRatioInputLoFltPos "Minimum allowable input, indicating short or open circuit" VALUE 0x800003DF RecordLayout_5 0 CompuMethod_42 -1E+17 1E+17 /end CHARACTERISTIC
/begin CHARACTERISTIC Bank2_EquivRatioOfst "Offset after gain in engineering units" VALUE 0x800003E3 RecordLayout_5 0 CompuMethod_42 -1E+17 1E+17 /end CHARACTERISTIC
/begin CHARACTERISTIC BankB_Avg_Enable "" VALUE 0x800003E7 RecordLayout_1 0 CompuMethod_8 0 1 /end CHARACTERISTIC
/begin CHARACTERISTIC BankB_Enbl "" VALUE 0x800003E8 RecordLayout_1 0 CompuMethod_8 0 1 /end CHARACTERISTIC
/begin CHARACTERISTIC BARO_Count "Number of samples to average at key-up to produce signal value" VALUE 0x800003E9 RecordLayout_8 0 CompuMethod_1 -128 127 /end CHARACTERISTIC
/begin CHARACTERISTIC BARO_offset "Provides an override to the input by adding this amount to either the locked or running value" VALUE 0x800003EA RecordLayout_5 0 CompuMethod_16 -1E+17 1E+17 /end CHARACTERISTIC
/begin CHARACTERISTIC BARO_ovr "Provides an override to the input by adding this amount to either the locked or running value" VALUE 0x800003EE RecordLayout_1 0 CompuMethod_45 0 1 /end CHARACTERISTIC
/begin CHARACTERISTIC BaroLearn_MAP "" VALUE 0x80000413 RecordLayout_5 0 CompuMethod_16 0 100 /end CHARACTERISTIC
/begin CHARACTERISTIC BaroLearn_Tm "" VALUE 0x80000417 RecordLayout_5 0 CompuMethod_19 0 100 /end CHARACTERISTIC
/begin CHARACTERISTIC BaroLearn_TPSPos "" VALUE 0x8000041B RecordLayout_5 0 CompuMethod_7 0 100 /end CHARACTERISTIC
/begin CHARACTERISTIC BaroRunStallDelay "Delay time after transitioning from Run to Stall before resampling baro." VALUE 0x8000041F RecordLayout_5 0 CompuMethod_46 -1E+17 1E+17 /end CHARACTERISTIC
/begin CHARACTERISTIC BaseAirflowAdaptDelayTime "Idle Control must be enabled for this amount of time before fuel adaption is enabled" VALUE 0x80000423 RecordLayout_5 0 CompuMethod_46 0 1E+17 /end CHARACTERISTIC
/begin CHARACTERISTIC BaseAirflowAdaptDelta "Air PID Iterm must be less than this delta to adapt the BaseAirflow table." VALUE 0x80000427 RecordLayout_5 0 CompuMethod_32 -1E+17 1E+17 /end CHARACTERISTIC
/begin CHARACTERISTIC BaseAirflowAdaptEnable "Determines whether the BaseAirflow table will be adapted using the air PID Iterm." VALUE 0x8000042B RecordLayout_1 0 CompuMethod_28 0 1 /end CHARACTERISTIC
/begin CHARACTERISTIC BaseAirflowAdaptErrorLwrLim "Lower Limit Value" VALUE 0x8000042C RecordLayout_5 0 CompuMethod_48 -1E+17 1E+17 /end CHARACTERISTIC
/begin CHARACTERISTIC BaseAirflowAdaptErrorUprLim "Upper Limit Value" VALUE 0x80000430 RecordLayout_5 0 CompuMethod_48 -1E+17 1E+17 /end CHARACTERISTIC
/begin CHARACTERISTIC BaseAirflowAdaptGain "Gain for updating BaseAirflow table.  This fraction of the error is added to the map every 5ms." VALUE 0x80000434 RecordLayout_5 0 CompuMethod_49 -1E+17 1E+17 /end CHARACTERISTIC
/begin CHARACTERISTIC BaseAirflowOfstMaxValue "Maximum value that can be adapted into the BaseAirflowOfst table." VALUE 0x80000438 RecordLayout_5 0 CompuMethod_7 -1E+17 1E+17 /end CHARACTERISTIC
/begin CHARACTERISTIC BaseAirflowOfstMinValue "Minimum value that can be adapted into the BaseAirflowOfst table." VALUE 0x8000043C RecordLayout_5 0 CompuMethod_7 -1E+17 1E+17 /end CHARACTERISTIC
/begin CHARACTERISTIC BaseRevLimit "Maximum RPM allowed, before any action is taken" VALUE 0x80000454 RecordLayout_6 0 CompuMethod_24 0 32767 /end CHARACTERISTIC
/begin CHARACTERISTIC BaseSparkEnergyMap "Spark energy - Run state" MAP 0x80000456 RecordLayout_5 0 CompuMethod_51 -1E+17 1E+17
 /begin AXIS_DESCR COM_AXIS RPM09In CompuMethod_71 9 0 14000 AXIS_PTS_REF RPM09IdxArr /end AXIS_DESCR
 /begin AXIS_DESCR COM_AXIS MAP09In CompuMethod_16 9 0 1000 AXIS_PTS_REF MAP09IdxArr /end AXIS_DESCR
/end CHARACTERISTIC
/begin CHARACTERISTIC BGND_BASE_Multiple "Base rate of the BGND_BASE_PERIODIC event, as a multiple of FGND_RTI_Period" VALUE 0x8000059A RecordLayout_4 0 CompuMethod_9 0 65535 /end CHARACTERISTIC
/begin CHARACTERISTIC BGND_BASE_PERIODIC_RunCnt "The number of times to execute BGND_BASE_PERIODIC before pausing.  -1 means run forever" VALUE 0x8000059C RecordLayout_9 0 CompuMethod_9 -1 2147480000 /end CHARACTERISTIC
/begin CHARACTERISTIC BGND_BASEx10_PERIODIC_RunCnt "The number of times to execute BGND_BASEx10_PERIODIC before pausing.  -1 means run forever" VALUE 0x800005A0 RecordLayout_9 0 CompuMethod_9 -1 2147480000 /end CHARACTERISTIC
/begin CHARACTERISTIC BGND_BASEx2_PERIODIC_RunCnt "The number of times to execute BGND_BASEx2_PERIODIC before pausing.  -1 means run forever" VALUE 0x800005A4 RecordLayout_9 0 CompuMethod_9 -1 2147480000 /end CHARACTERISTIC
/begin CHARACTERISTIC BgndStackMargin "When the available stack space drops below this threshold, the application performs a safety stop" VALUE 0x800005A8 RecordLayout_4 0 CompuMethod_9 0 1024 /end CHARACTERISTIC
/begin CHARACTERISTIC CAMDelay "Delay between the rising edge of the actual CAM signal and the rising edge of the ideal CAM.  If it leads the ideal CAM by one tooth (60-6 system) then the delay would be 6 degCA and 714 degCA if it lagged.  Applicable if crank encoder has >1 sync pts" VALUE 0x800005AA RecordLayout_4 0 CompuMethod_55 0 720 /end CHARACTERISTIC
/begin CHARACTERISTIC CAT_SpkOfstMultMap "Multiplier on IAT2 spark offset table." MAP 0x800005AC RecordLayout_5 0 CompuMethod_32 -1E+17 1E+17
 /begin AXIS_DESCR COM_AXIS RPM09In CompuMethod_71 9 0 14000 AXIS_PTS_REF RPM09IdxArr /end AXIS_DESCR
 /begin AXIS_DESCR COM_AXIS MAP09In CompuMethod_16 9 0 1000 AXIS_PTS_REF MAP09IdxArr /end AXIS_DESCR
/end CHARACTERISTIC
/begin CHARACTERISTIC CAT_SpkOfstTbl "CAT spark offset" CURVE 0x800006F0 RecordLayout_5 0 CompuMethod_2 -50 50
 /begin AXIS_DESCR COM_AXIS CAT05In CompuMethod_57 5 -40 300 AXIS_PTS_REF CAT05IdxArr /end AXIS_DESCR
/end CHARACTERISTIC
/begin CHARACTERISTIC CCP1_StationAddr "Station ID for CCP handler: CCP1" VALUE 0x80000718 RecordLayout_4 0 CompuMethod_9 0 65535 /end CHARACTERISTIC
/begin CHARACTERISTIC CCP1RxID "Receive CAN ID for CCP handler: CCP1" VALUE 0x8000071A RecordLayout_3 0 CompuMethod_56 0 4294970000 /end CHARACTERISTIC
/begin CHARACTERISTIC CCP1RxIDMask "Receive CAN ID Mask for CCP handler: CCP1" VALUE 0x8000071E RecordLayout_3 0 CompuMethod_56 0 4294970000 /end CHARACTERISTIC
/begin CHARACTERISTIC CCP1TxID "Transmit CAN ID for CCP handler: CCP1" VALUE 0x80000722 RecordLayout_3 0 CompuMethod_56 0 4294970000 /end CHARACTERISTIC
/begin CHARACTERISTIC ChargeAirTempEnrichmentMap "Requsted base eq. ratio as a function of CAT and MAP" MAP 0x80000726 RecordLayout_5 0 CompuMethod_62 0 1E+17
 /begin AXIS_DESCR COM_AXIS CAT05In CompuMethod_57 5 -40 300 AXIS_PTS_REF CAT05IdxArr /end AXIS_DESCR
 /begin AXIS_DESCR COM_AXIS MAP05In CompuMethod_16 5 0 1000 AXIS_PTS_REF MAP05IdxArr /end AXIS_DESCR
/end CHARACTERISTIC
/begin CHARACTERISTIC CityID_CAN_1 "City ID for CAN bus CAN_1" VALUE 0x8000078A RecordLayout_1 0 CompuMethod_1 0 255 /end CHARACTERISTIC
/begin CHARACTERISTIC CityID_CAN_2 "City ID for CAN bus CAN_2" VALUE 0x8000078B RecordLayout_1 0 CompuMethod_1 0 255 /end CHARACTERISTIC
/begin CHARACTERISTIC ClearFloodThreshold "In crank mode, throttle commands greater than this threshold will disable crank fueling." VALUE 0x8000078C RecordLayout_5 0 CompuMethod_63 -1E+17 1E+17 /end CHARACTERISTIC
/begin CHARACTERISTIC CoilDrvrDlyTime "Coil driver delay time between receipt of EST signal and initiation of coil dwell." VALUE 0x80000790 RecordLayout_5 0 CompuMethod_64 -1E+17 1E+17 /end CHARACTERISTIC
/begin CHARACTERISTIC CoilDwellMap "Required spark dwell to give the desired spark energy." MAP 0x80000794 RecordLayout_5 0 CompuMethod_65 -1E+17 1E+17
 /begin AXIS_DESCR COM_AXIS SysVolt09In CompuMethod_164 9 0 32 AXIS_PTS_REF SysVolt09IdxArr /end AXIS_DESCR
 /begin AXIS_DESCR COM_AXIS SpkEnergy09In CompuMethod_2 9 -1E+17 1E+17 AXIS_PTS_REF SpkEnergy09IdxArr /end AXIS_DESCR
/end CHARACTERISTIC
/begin CHARACTERISTIC CombEventsPerRev "Number of conbustion events per engine revolution. For example, for a four-stroke, eight cylinder engine the value would be 4." VALUE 0x800008D8 RecordLayout_1 0 CompuMethod_1 0.5 255 /end CHARACTERISTIC
/begin CHARACTERISTIC Constant_Fuel_Pump "" VALUE 0x800008D9 RecordLayout_1 0 CompuMethod_11 0 1 /end CHARACTERISTIC
/begin CHARACTERISTIC CPUMargin "When the available CPU idle time drops below this threshold, the application performs a safety stop" VALUE 0x800008DA RecordLayout_4 0 CompuMethod_68 0 100 /end CHARACTERISTIC
/begin CHARACTERISTIC CrankAirflowSetPtTbl "ETC setpoint during cranking." CURVE 0x800008DC RecordLayout_5 0 CompuMethod_7 -1E+17 1E+17
 /begin AXIS_DESCR COM_AXIS ECT CompuMethod_57 5 -1E+17 1E+17 AXIS_PTS_REF CrankECT05IdxArr /end AXIS_DESCR
/end CHARACTERISTIC
/begin CHARACTERISTIC CrankDegrees_pertooth "Crank Angle Degree per wheel tooth" VALUE 0x800008F0 RecordLayout_3 0 CompuMethod_69 0 4294970000 /end CHARACTERISTIC
/begin CHARACTERISTIC CrankFPC_IATMultTbl "Crank fuel IAT ultiplier" CURVE 0x80000908 RecordLayout_5 0 CompuMethod_2 0 100
 /begin AXIS_DESCR COM_AXIS IAT CompuMethod_57 5 -1E+17 1E+17 AXIS_PTS_REF CrankIAT05IdxArr /end AXIS_DESCR
/end CHARACTERISTIC
/begin CHARACTERISTIC CrankFPC_OXYMultTbl "Crank fuel oxygentation multiplier" CURVE 0x8000091C RecordLayout_5 0 CompuMethod_2 0 100
 /begin AXIS_DESCR COM_AXIS CrankOXY05In CompuMethod_7 5 -1E+17 1E+17 AXIS_PTS_REF CrankOXY05IdxArr /end AXIS_DESCR
/end CHARACTERISTIC
/begin CHARACTERISTIC CrankFPCMap "Liquid fuel supplied during crank." MAP 0x80000930 RecordLayout_5 0 CompuMethod_70 0 1E+17
 /begin AXIS_DESCR COM_AXIS CrankRPM05In CompuMethod_71 5 -1E+17 1E+17 AXIS_PTS_REF CrankRPM05IdxArr /end AXIS_DESCR
 /begin AXIS_DESCR COM_AXIS ECT CompuMethod_57 5 -1E+17 1E+17 AXIS_PTS_REF CrankECT05IdxArr /end AXIS_DESCR
/end CHARACTERISTIC
/begin CHARACTERISTIC CrankMakeUpEOITbl "Start of injection during cranking." CURVE 0x800009A8 RecordLayout_5 0 CompuMethod_66 -920 920
 /begin AXIS_DESCR COM_AXIS CrankRPM05In CompuMethod_71 5 -1E+17 1E+17 AXIS_PTS_REF CrankRPM05IdxArr /end AXIS_DESCR
/end CHARACTERISTIC
/begin CHARACTERISTIC CrankPulseTbl "" CURVE 0x800009D0 RecordLayout_5 0 CompuMethod_2 -1E+17 1E+17
 /begin AXIS_DESCR COM_AXIS ECT CompuMethod_57 5 -1E+17 1E+17 AXIS_PTS_REF CrankECT05IdxArr /end AXIS_DESCR
/end CHARACTERISTIC
/begin CHARACTERISTIC CrankSOITbl "Start of injection during cranking." CURVE 0x800009F8 RecordLayout_5 0 CompuMethod_66 -920 920
 /begin AXIS_DESCR COM_AXIS CrankRPM05In CompuMethod_71 5 -1E+17 1E+17 AXIS_PTS_REF CrankRPM05IdxArr /end AXIS_DESCR
/end CHARACTERISTIC
/begin CHARACTERISTIC CrankSparkMap "Spark adv during cranking." MAP 0x80000A0C RecordLayout_5 0 CompuMethod_66 -100 100
 /begin AXIS_DESCR COM_AXIS CrankRPM05In CompuMethod_71 5 -1E+17 1E+17 AXIS_PTS_REF CrankRPM05IdxArr /end AXIS_DESCR
 /begin AXIS_DESCR COM_AXIS ECT CompuMethod_57 5 -1E+17 1E+17 AXIS_PTS_REF CrankECT05IdxArr /end AXIS_DESCR
/end CHARACTERISTIC
/begin CHARACTERISTIC CrankSpkEnergyMap "Spark energy during cranking." MAP 0x80000A70 RecordLayout_5 0 CompuMethod_72 0 1E+17
 /begin AXIS_DESCR COM_AXIS CrankRPM05In CompuMethod_71 5 -1E+17 1E+17 AXIS_PTS_REF CrankRPM05IdxArr /end AXIS_DESCR
 /begin AXIS_DESCR COM_AXIS ECT CompuMethod_57 5 -1E+17 1E+17 AXIS_PTS_REF CrankECT05IdxArr /end AXIS_DESCR
/end CHARACTERISTIC
/begin CHARACTERISTIC CrankToRunRPMThresh "RPM above which RUN mode can be entered from CRANK mode." VALUE 0x80000AD4 RecordLayout_4 0 CompuMethod_24 0 65535 /end CHARACTERISTIC
/begin CHARACTERISTIC CylSweptVol "Cylinder swept volume for a single cylinder." VALUE 0x80000AD6 RecordLayout_5 0 CompuMethod_73 0 1E+17 /end CHARACTERISTIC
/begin CHARACTERISTIC DeltaMAP_FiltConst "Filter time constant" VALUE 0x80000ADA RecordLayout_5 0 CompuMethod_19 -1E+17 1E+17 /end CHARACTERISTIC
/begin CHARACTERISTIC DeltaMAP_MultMap "Transient Fueling Multiplier for adjustment based on delta MAP" MAP 0x80000ADE RecordLayout_5 0 CompuMethod_32 -1E+17 1E+17
 /begin AXIS_DESCR COM_AXIS DeltaMAP17In CompuMethod_2 17 -1E+17 1E+17 AXIS_PTS_REF DeltaMAP17IdxArr /end AXIS_DESCR
 /begin AXIS_DESCR COM_AXIS MAF09In CompuMethod_2 9 -1E+17 1E+17 AXIS_PTS_REF MAF09IdxArr /end AXIS_DESCR
/end CHARACTERISTIC
/begin CHARACTERISTIC DeltaTPS_FiltConst "Filter time constant" VALUE 0x80000D86 RecordLayout_5 0 CompuMethod_19 -1E+17 1E+17 /end CHARACTERISTIC
/begin CHARACTERISTIC DeltaTPS_MultMap "Transient Fueling Multiplier for adjustment based on delta TPS" MAP 0x80000D8A RecordLayout_5 0 CompuMethod_32 -1E+17 1E+17
 /begin AXIS_DESCR COM_AXIS DeltaTPS17In CompuMethod_2 17 -1E+17 1E+17 AXIS_PTS_REF DeltaTPS17IdxArr /end AXIS_DESCR
 /begin AXIS_DESCR COM_AXIS MAF09In CompuMethod_2 9 -1E+17 1E+17 AXIS_PTS_REF MAF09IdxArr /end AXIS_DESCR
/end CHARACTERISTIC
/begin CHARACTERISTIC DeltaTPSFuelingEnable "Enable Delta TPS transient fuel algorithm" VALUE 0x80001032 RecordLayout_1 0 CompuMethod_8 0 1 /end CHARACTERISTIC
/begin CHARACTERISTIC DesAFRatioTbl "" CURVE 0x8000105F RecordLayout_5 0 CompuMethod_74 0 20
 /begin AXIS_DESCR COM_AXIS DesAFRatioIn CompuMethod_75 11 0 100 AXIS_PTS_REF DesAFRatioIdxArr /end AXIS_DESCR
/end CHARACTERISTIC
/begin CHARACTERISTIC DesEquivRatioMap "Desired liquid equivalence ratio." MAP 0x800010AF RecordLayout_5 0 CompuMethod_2 0 1E+17
 /begin AXIS_DESCR COM_AXIS RPM17In CompuMethod_71 17 0 14000 AXIS_PTS_REF RPM17IdxArr /end AXIS_DESCR
 /begin AXIS_DESCR COM_AXIS MAP17In CompuMethod_16 17 0 1000 AXIS_PTS_REF MAP17IdxArr /end AXIS_DESCR
/end CHARACTERISTIC
/begin CHARACTERISTIC DFCODelayTime "DFCO delay enter time" VALUE 0x80001533 RecordLayout_5 0 CompuMethod_19 0 1000000 /end CHARACTERISTIC
/begin CHARACTERISTIC DFCOEnable "" VALUE 0x80001537 RecordLayout_1 0 CompuMethod_8 0 1 /end CHARACTERISTIC
/begin CHARACTERISTIC DFCOEnterIdleSpeed "DFCO entry above idle speed setpoint" VALUE 0x80001538 RecordLayout_6 0 CompuMethod_24 0 7000 /end CHARACTERISTIC
/begin CHARACTERISTIC DFCOEnterRampTime "DFCO enter ramp time" VALUE 0x8000153A RecordLayout_5 0 CompuMethod_19 -1E+17 1E+17 /end CHARACTERISTIC
/begin CHARACTERISTIC DFCOEntryAPP "DFCO APP entry threshold" VALUE 0x8000153E RecordLayout_5 0 CompuMethod_7 0 100 /end CHARACTERISTIC
/begin CHARACTERISTIC DFCOEntryMAP "DFCO MAP entry threshold" VALUE 0x80001542 RecordLayout_1 0 CompuMethod_78 0 255 /end CHARACTERISTIC
/begin CHARACTERISTIC DFCOEntryRPMTbl "" CURVE 0x80001543 RecordLayout_5 0 CompuMethod_2 -1E+17 1E+17
 /begin AXIS_DESCR COM_AXIS ECT05In CompuMethod_57 5 -40 200 AXIS_PTS_REF ECT05IdxArr /end AXIS_DESCR
/end CHARACTERISTIC
/begin CHARACTERISTIC DFCOExitAPP "DFCO exit APP threshold" VALUE 0x80001557 RecordLayout_5 0 CompuMethod_7 0 100 /end CHARACTERISTIC
/begin CHARACTERISTIC DFCOExitIdleSpeed "DFCO exit offset from desired idle speed" VALUE 0x8000155B RecordLayout_6 0 CompuMethod_24 0 7000 /end CHARACTERISTIC
/begin CHARACTERISTIC DFCOExitMAP "DFCO exit MAP threhsold" VALUE 0x8000155D RecordLayout_1 0 CompuMethod_78 0 255 /end CHARACTERISTIC
/begin CHARACTERISTIC DFCOExitRampTime "DFCO exit ramp time" VALUE 0x8000155E RecordLayout_5 0 CompuMethod_19 -1E+17 1E+17 /end CHARACTERISTIC
/begin CHARACTERISTIC DFCOExitRPMTbl "" CURVE 0x80001562 RecordLayout_5 0 CompuMethod_2 -1E+17 1E+17
 /begin AXIS_DESCR COM_AXIS ECT05In CompuMethod_57 5 -40 200 AXIS_PTS_REF ECT05IdxArr /end AXIS_DESCR
/end CHARACTERISTIC
/begin CHARACTERISTIC DFCOExitSparkRet "DFCO exit spark retard" VALUE 0x80001576 RecordLayout_6 0 CompuMethod_79 -100 100 /end CHARACTERISTIC
/begin CHARACTERISTIC DigDiag_ClutchStuckTime "" VALUE 0x80001578 RecordLayout_5 0 CompuMethod_2 -1E+17 1E+17 /end CHARACTERISTIC
/begin CHARACTERISTIC DigDiag_ScrambleStuckTime "" VALUE 0x8000157C RecordLayout_5 0 CompuMethod_2 -1E+17 1E+17 /end CHARACTERISTIC
/begin CHARACTERISTIC ECT_KeyUp_Count "Number of samples to average at key-up to produce signal value" VALUE 0x80001580 RecordLayout_8 0 CompuMethod_1 -128 127 /end CHARACTERISTIC
/begin CHARACTERISTIC ECT_new "Override result of linear sensor characterization, in engineering units" VALUE 0x800015A5 RecordLayout_5 0 CompuMethod_80 -1E+17 1E+17 /end CHARACTERISTIC
/begin CHARACTERISTIC ECT_ovr "" VALUE 0x800015A9 RecordLayout_1 0 CompuMethod_5 0 1 /end CHARACTERISTIC
/begin CHARACTERISTIC ECT_SpkOfstMultMap "Multiplier on ECT spark offset table." MAP 0x800015AA RecordLayout_5 0 CompuMethod_2 -100 100
 /begin AXIS_DESCR COM_AXIS RPM09In CompuMethod_71 9 0 14000 AXIS_PTS_REF RPM09IdxArr /end AXIS_DESCR
 /begin AXIS_DESCR COM_AXIS MAP09In CompuMethod_16 9 0 1000 AXIS_PTS_REF MAP09IdxArr /end AXIS_DESCR
/end CHARACTERISTIC
/begin CHARACTERISTIC ECT_SpkOfstTbl "ECT spark offset" CURVE 0x800016EE RecordLayout_5 0 CompuMethod_66 -50 50
 /begin AXIS_DESCR COM_AXIS ECT05In CompuMethod_57 5 -40 200 AXIS_PTS_REF ECT05IdxArr /end AXIS_DESCR
/end CHARACTERISTIC
/begin CHARACTERISTIC ECTDefault "This is the initial default value should the sensor be in fault on key-up.  Otherwise the sensors outputs the last value prior to faulting" VALUE 0x80001756 RecordLayout_5 0 CompuMethod_80 -1E+17 1E+17 /end CHARACTERISTIC
/begin CHARACTERISTIC ECTFanOff "ECT temp when the fan turns off" VALUE 0x8000175A RecordLayout_5 0 CompuMethod_57 -1E+17 1E+17 /end CHARACTERISTIC
/begin CHARACTERISTIC ECTFanOn "ECT temp when the fan turns on" VALUE 0x8000175E RecordLayout_5 0 CompuMethod_57 -1E+17 1E+17 /end CHARACTERISTIC
/begin CHARACTERISTIC ECTFanSpeed_StallTbl "" CURVE 0x80001762 RecordLayout_5 0 CompuMethod_2 -1E+17 1E+17
 /begin AXIS_DESCR COM_AXIS ECT05In CompuMethod_57 5 -40 200 AXIS_PTS_REF ECT05IdxArr /end AXIS_DESCR
/end CHARACTERISTIC
/begin CHARACTERISTIC ECTFanSpeedMap "" MAP 0x80001776 RecordLayout_5 0 CompuMethod_2 -1E+17 1E+17
 /begin AXIS_DESCR COM_AXIS VSPD07In CompuMethod_180 7 -100 200 AXIS_PTS_REF VSPD07IdxArr /end AXIS_DESCR
 /begin AXIS_DESCR COM_AXIS ECT07In CompuMethod_57 7 -40 200 AXIS_PTS_REF ECT07IdxArr /end AXIS_DESCR
/end CHARACTERISTIC
/begin CHARACTERISTIC ECTFiltConst "Filter time constant" VALUE 0x8000183A RecordLayout_5 0 CompuMethod_19 -1E+17 1E+17 /end CHARACTERISTIC
/begin CHARACTERISTIC ECTMax "Maximum allowable input, indicating short or open circuit" VALUE 0x80001872 RecordLayout_5 0 CompuMethod_21 -1E+17 1E+17 /end CHARACTERISTIC
/begin CHARACTERISTIC ECTMin "Minimum allowable input, indicating short or open circuit" VALUE 0x80001876 RecordLayout_5 0 CompuMethod_21 -1E+17 1E+17 /end CHARACTERISTIC
/begin CHARACTERISTIC ECTSensorPin "Analog input pin selection for ECTSensorPin" VALUE 0x8000187A RecordLayout_6 0 CompuMethod_22 -32768 32767 /end CHARACTERISTIC
/begin CHARACTERISTIC ECTSensorPin_ref "Reference Voltage Selection" VALUE 0x8000187C RecordLayout_1 0 CompuMethod_23 0 255 /end CHARACTERISTIC
/begin CHARACTERISTIC ECTTbl "Look up table to allownon-linear characterization of sensors" CURVE 0x8000187D RecordLayout_5 0 CompuMethod_80 -1E+17 1E+17
 /begin AXIS_DESCR COM_AXIS ECTADC CompuMethod_21 13 -1E+17 1E+17 AXIS_PTS_REF ECTIdxArr /end AXIS_DESCR
/end CHARACTERISTIC
/begin CHARACTERISTIC ECTTransFuelMultTbl "Transient fuel multiplier based on ECT.  Only engaged during transient fueling" CURVE 0x800018B1 RecordLayout_5 0 CompuMethod_2 -1E+17 1E+17
 /begin AXIS_DESCR COM_AXIS ECT05In CompuMethod_57 5 -40 200 AXIS_PTS_REF ECT05IdxArr /end AXIS_DESCR
/end CHARACTERISTIC
/begin CHARACTERISTIC ECUP_Threshold "ADC voltage threshold above which ECU is considered powered" VALUE 0x800018C5 RecordLayout_4 0 CompuMethod_81 0 1023 /end CHARACTERISTIC
/begin CHARACTERISTIC ECUVolt_Filt "Filter time constant" VALUE 0x800018C7 RecordLayout_5 0 CompuMethod_19 -1E+17 1E+17 /end CHARACTERISTIC
/begin CHARACTERISTIC Elec_PW_new "" VALUE 0x800018CB RecordLayout_5 0 CompuMethod_2 -1E+17 1E+17 /end CHARACTERISTIC
/begin CHARACTERISTIC Elec_PW_ovr "" VALUE 0x800018CF RecordLayout_1 0 CompuMethod_5 0 1 /end CHARACTERISTIC
/begin CHARACTERISTIC EnableRPMFalling "If disabled, Min Gov will enable immediately after cranking without waiting for falling RPM." VALUE 0x800018D0 RecordLayout_1 0 CompuMethod_4 0 1 /end CHARACTERISTIC
/begin CHARACTERISTIC EncoderCamPullup "Selects the pullup conditioning applied to the Cam Input" VALUE 0x800018D1 RecordLayout_1 0 CompuMethod_82 0 1 /end CHARACTERISTIC
/begin CHARACTERISTIC EncoderCamSyncEdge "Selects which edge of a digital signal represents the synchronous edge of the CAM tooth.  It has no meaning for a variable reluctance type sensor" VALUE 0x800018D2 RecordLayout_1 0 CompuMethod_83 0 1 /end CHARACTERISTIC
/begin CHARACTERISTIC EncoderCrankPullup "Selects the pullup conditioning applied to the Crank Input" VALUE 0x800018D3 RecordLayout_1 0 CompuMethod_82 0 1 /end CHARACTERISTIC
/begin CHARACTERISTIC EncoderCrankTeethAfterCam "The number of crank teeth between the synchronizing edge of the cam and the first tooth in the crank pattern.  May be -1 to disable explicit tooth counting." VALUE 0x800018D4 RecordLayout_6 0 CompuMethod_9 -1 32766 /end CHARACTERISTIC
/begin CHARACTERISTIC EncoderNumCylinders "Number of cylinders" VALUE 0x800018D6 RecordLayout_1 0 CompuMethod_1 1 8 /end CHARACTERISTIC
/begin CHARACTERISTIC EncoderSyncEdge "Selects which edge of a digital signal represents the synchronous edge of the tooth.  It has no meaning for a variable reluctance type sensor" VALUE 0x800018D7 RecordLayout_1 0 CompuMethod_83 0 1 /end CHARACTERISTIC
/begin CHARACTERISTIC EncoderTDCAngles "TDC angle of each cylinder in degrees after TDC1" VAL_BLK 0x800018D8 RecordLayout_6 0 CompuMethod_55 0 720 MATRIX_DIM 8 1 1 /end CHARACTERISTIC
/begin CHARACTERISTIC EngineAccelFiltConst "Filter time constant" VALUE 0x800018E8 RecordLayout_5 0 CompuMethod_19 -1E+17 1E+17 /end CHARACTERISTIC
/begin CHARACTERISTIC EngineShutdownDelayTime "Delays the engine shutdown when DelayedEngineShutdown fault-action is active." VALUE 0x800018EC RecordLayout_5 0 CompuMethod_46 0 1E+17 /end CHARACTERISTIC
/begin CHARACTERISTIC EngineToEncoderOffset "" VALUE 0x800018F0 RecordLayout_5 0 CompuMethod_2 -1E+17 1E+17 /end CHARACTERISTIC
/begin CHARACTERISTIC EqRatio_SpkOfsMultMap "Speed and Load Multiplier to the Equivalence Ratio Spark Offset table." MAP 0x800018F4 RecordLayout_5 0 CompuMethod_32 -1E+17 1E+17
 /begin AXIS_DESCR COM_AXIS RPM09In CompuMethod_71 9 0 14000 AXIS_PTS_REF RPM09IdxArr /end AXIS_DESCR
 /begin AXIS_DESCR COM_AXIS MAP09In CompuMethod_16 9 0 1000 AXIS_PTS_REF MAP09IdxArr /end AXIS_DESCR
/end CHARACTERISTIC
/begin CHARACTERISTIC EqRatio_SpkOfstTbl "Spark offset based on desired equivalence ratio (also muliplied by a speed load factor)" CURVE 0x80001A38 RecordLayout_5 0 CompuMethod_88 -1E+17 1E+17
 /begin AXIS_DESCR COM_AXIS DesEqRatio09In CompuMethod_76 9 0 1E+17 AXIS_PTS_REF DesEqRatio09IdxArr /end AXIS_DESCR
/end CHARACTERISTIC
/begin CHARACTERISTIC EquivRatio_new "" VALUE 0x80001A5C RecordLayout_5 0 CompuMethod_2 -1E+17 1E+17 /end CHARACTERISTIC
/begin CHARACTERISTIC EquivRatio_ovr "" VALUE 0x80001A60 RecordLayout_1 0 CompuMethod_5 0 1 /end CHARACTERISTIC
/begin CHARACTERISTIC EquivRatioDelta "Equivalence ratio has to be with this band of 1 to achieve close loop." VALUE 0x80001A61 RecordLayout_5 0 CompuMethod_89 -1E+17 1E+17 /end CHARACTERISTIC
/begin CHARACTERISTIC ESTOP_FuelInj_Ovr_new "" VALUE 0x80001A6A RecordLayout_1 0 CompuMethod_11 0 1 /end CHARACTERISTIC
/begin CHARACTERISTIC ESTOP_FuelInj_Ovr_ovr "" VALUE 0x80001A6B RecordLayout_1 0 CompuMethod_5 0 1 /end CHARACTERISTIC
/begin CHARACTERISTIC ESTOP_new "Override actuator, in engineering units" VALUE 0x80001A6C RecordLayout_1 0 CompuMethod_25 0 1 /end CHARACTERISTIC
/begin CHARACTERISTIC ESTOP_ovr "" VALUE 0x80001A6D RecordLayout_1 0 CompuMethod_5 0 1 /end CHARACTERISTIC
/begin CHARACTERISTIC ESTOPPin "Digital input pin selection for ESTOPPin" VALUE 0x80001A6E RecordLayout_6 0 CompuMethod_93 -32768 32767 /end CHARACTERISTIC
/begin CHARACTERISTIC ESTOPPolarity "0 = High True    1 = Low True" VALUE 0x80001A70 RecordLayout_1 0 CompuMethod_4 0 1 /end CHARACTERISTIC
/begin CHARACTERISTIC ETC_CutPower_ETC "Cut power to ETC if ETC request is less than this" VALUE 0x80001A71 RecordLayout_5 0 CompuMethod_95 0 100 /end CHARACTERISTIC
/begin CHARACTERISTIC ETC_CutPower_Permitted "Cut power to ETC after ESTOP or long stalled period" VALUE 0x80001A75 RecordLayout_1 0 CompuMethod_96 0 1 /end CHARACTERISTIC
/begin CHARACTERISTIC ETC_CutPower_StallTime "Cut power to ETC after stalled this long" VALUE 0x80001A76 RecordLayout_5 0 CompuMethod_97 0 100 /end CHARACTERISTIC
/begin CHARACTERISTIC ETC_Frequency "Frequency of PWM output" VALUE 0x80001AA2 RecordLayout_5 0 CompuMethod_98 7.63 1E+17 /end CHARACTERISTIC
/begin CHARACTERISTIC ETC_I_MIN "H-bridge open circuit fault:  ETC current must exceed this when ETC duty cycle is > ETC_OC_MIN, otherwise an open circuit fault may exist." VALUE 0x80001AA6 RecordLayout_5 0 CompuMethod_99 0 1E+17 /end CHARACTERISTIC
/begin CHARACTERISTIC ETC_IceBreakEnblTm "" VALUE 0x80001AAA RecordLayout_5 0 CompuMethod_19 0 10 /end CHARACTERISTIC
/begin CHARACTERISTIC ETC_IceBreakHoldTm "" VALUE 0x80001AAE RecordLayout_5 0 CompuMethod_19 0 10 /end CHARACTERISTIC
/begin CHARACTERISTIC ETC_IceBreakPos "" VALUE 0x80001AB2 RecordLayout_5 0 CompuMethod_7 0 100 /end CHARACTERISTIC
/begin CHARACTERISTIC ETC_OC_MIN "H-bridge open circuit fault:  ETC duty cycle must exceed this to enable open circuit fault detection." VALUE 0x80001AE6 RecordLayout_5 0 CompuMethod_7 0 1E+17 /end CHARACTERISTIC
/begin CHARACTERISTIC ETC_Offset "Offset from engineering units to PWM duty cycle" VALUE 0x80001AEA RecordLayout_5 0 CompuMethod_7 -1E+17 1E+17 /end CHARACTERISTIC
/begin CHARACTERISTIC ETC_ShutdownLoAdaptError "Drive ETC closed until this error has been achieved in order to catch lo side adapt point." VALUE 0x80001B67 RecordLayout_5 0 CompuMethod_7 -1E+17 1E+17 /end CHARACTERISTIC
/begin CHARACTERISTIC ETC_SpringTestHiThresh "Before initiating spring test during shutdown, open the ETC to this setpoint. When achieved, the ETC controller will release the ETC to have the spring close the valve." VALUE 0x80001B6B RecordLayout_5 0 CompuMethod_7 -1E+17 1E+17 /end CHARACTERISTIC
/begin CHARACTERISTIC ETC_SpringTestLoThresh "Spring test timer will measure time of travel between ETC_SpringTestHiThresh and ETC_SpringTestLoThresh." VALUE 0x80001B6F RecordLayout_5 0 CompuMethod_7 -1E+17 1E+17 /end CHARACTERISTIC
/begin CHARACTERISTIC ETC_SpringTestTimerThresh "During spring test at shutdown, TPS must fall to 0% within this time to prevent fault." VALUE 0x80001B73 RecordLayout_5 0 CompuMethod_46 -1E+17 1E+17 /end CHARACTERISTIC
/begin CHARACTERISTIC ETC_StallAppOvrThesh "" VALUE 0x80001B77 RecordLayout_5 0 CompuMethod_7 0 100 /end CHARACTERISTIC
/begin CHARACTERISTIC ETC_StallAppOvrTm "" VALUE 0x80001B7B RecordLayout_5 0 CompuMethod_19 0 10 /end CHARACTERISTIC
/begin CHARACTERISTIC ETC_VoltageCompTbl "Gain on ETC duty cycle based on DRVP" CURVE 0x80001B83 RecordLayout_5 0 CompuMethod_2 -1E+17 1E+17
 /begin AXIS_DESCR COM_AXIS SysVolt09In CompuMethod_164 9 0 32 AXIS_PTS_REF SysVolt09IdxArr /end AXIS_DESCR
/end CHARACTERISTIC
/begin CHARACTERISTIC ETCDampGainDown "PID Damper Gain - Down Direction" VALUE 0x80001BB3 RecordLayout_5 0 CompuMethod_32 -1E+17 1E+17 /end CHARACTERISTIC
/begin CHARACTERISTIC ETCDampGainUp "PID Damper Gain - Up Direction" VALUE 0x80001BB7 RecordLayout_5 0 CompuMethod_32 -1E+17 1E+17 /end CHARACTERISTIC
/begin CHARACTERISTIC ETCDCOffsetTbl "Duty cycle offset based on desired ETC position." CURVE 0x80001BBB RecordLayout_5 0 CompuMethod_7 -1E+17 1E+17
 /begin AXIS_DESCR COM_AXIS ETC_SetpointIn CompuMethod_2 20 -1E+17 1E+17 AXIS_PTS_REF ETC_SetpointIdxArr /end AXIS_DESCR
/end CHARACTERISTIC
/begin CHARACTERISTIC ETCDGain "PID Derivative Gain" VALUE 0x80001C0B RecordLayout_5 0 CompuMethod_32 -1E+17 1E+17 /end CHARACTERISTIC
/begin CHARACTERISTIC ETCErrorGain "PID Error Gain" VALUE 0x80001C0F RecordLayout_5 0 CompuMethod_32 -1E+17 1E+17 /end CHARACTERISTIC
/begin CHARACTERISTIC ETCIMax "PID Integrator Upper Limit" VALUE 0x80001C17 RecordLayout_5 0 CompuMethod_7 -1E+17 1E+17 /end CHARACTERISTIC
/begin CHARACTERISTIC ETCIMin "PID Integrator Lower Limit" VALUE 0x80001C1B RecordLayout_5 0 CompuMethod_7 -1E+17 1E+17 /end CHARACTERISTIC
/begin CHARACTERISTIC ETCReq_Filt "Filter time constant" VALUE 0x80001C29 RecordLayout_5 0 CompuMethod_19 -1E+17 1E+17 /end CHARACTERISTIC
/begin CHARACTERISTIC ETCReqDecFiltC "Filter time constant for a decreasing ETC Request signal." VALUE 0x80001C32 RecordLayout_5 0 CompuMethod_19 -1E+17 1E+17 /end CHARACTERISTIC
/begin CHARACTERISTIC ETCReqFallRateTbl "Limits fall rate of ETCRequestFiltered." CURVE 0x80001C36 RecordLayout_5 0 CompuMethod_102 -10000 0
 /begin AXIS_DESCR COM_AXIS TPS09In CompuMethod_7 9 0 100 AXIS_PTS_REF TPS09IdxArr /end AXIS_DESCR
/end CHARACTERISTIC
/begin CHARACTERISTIC ETCReqIncFiltC "Filter time constant for a decreasing ETC Request signal." VALUE 0x80001C5A RecordLayout_5 0 CompuMethod_19 -1E+17 1E+17 /end CHARACTERISTIC
/begin CHARACTERISTIC ETCReqRiseRateTbl "Limits rise rate of ETCRequestFiltered." CURVE 0x80001C5E RecordLayout_5 0 CompuMethod_102 0 10000
 /begin AXIS_DESCR COM_AXIS TPS09In CompuMethod_7 9 0 100 AXIS_PTS_REF TPS09IdxArr /end AXIS_DESCR
/end CHARACTERISTIC
/begin CHARACTERISTIC ETCRequestMap "Driver demand table" MAP 0x80001C82 RecordLayout_5 0 CompuMethod_7 0 100
 /begin AXIS_DESCR COM_AXIS APP17In CompuMethod_7 17 0 100 AXIS_PTS_REF APP17IdxArr /end AXIS_DESCR
 /begin AXIS_DESCR COM_AXIS VSPD17In CompuMethod_180 17 -100 200 AXIS_PTS_REF VSPD17IdxArr /end AXIS_DESCR
/end CHARACTERISTIC
/begin CHARACTERISTIC EVAPSensorPin "Analog input pin selection for EVAPSensorPin" VALUE 0x800022BC RecordLayout_6 0 CompuMethod_22 -32768 32767 /end CHARACTERISTIC
/begin CHARACTERISTIC EVAPSensorPin_ref "Reference Voltage Selection" VALUE 0x800022BE RecordLayout_1 0 CompuMethod_23 0 255 /end CHARACTERISTIC
/begin CHARACTERISTIC FAN_Mode "" VALUE 0x800022F7 RecordLayout_1 0 CompuMethod_104 0 1 /end CHARACTERISTIC
/begin CHARACTERISTIC Fan1ACPres "Fan Enabler" VALUE 0x80002311 RecordLayout_1 0 CompuMethod_8 0 1 /end CHARACTERISTIC
/begin CHARACTERISTIC Fan1ACSw "Fan Enabler" VALUE 0x80002312 RecordLayout_1 0 CompuMethod_8 0 1 /end CHARACTERISTIC
/begin CHARACTERISTIC Fan1ECT "Fan Enabler" VALUE 0x80002313 RecordLayout_1 0 CompuMethod_8 0 1 /end CHARACTERISTIC
/begin CHARACTERISTIC Fan1IAT "Fan Enabler" VALUE 0x80002314 RecordLayout_1 0 CompuMethod_8 0 1 /end CHARACTERISTIC
/begin CHARACTERISTIC Fan2ACPres "Fan Enabler" VALUE 0x80002330 RecordLayout_1 0 CompuMethod_8 0 1 /end CHARACTERISTIC
/begin CHARACTERISTIC Fan2ACSw "Fan Enabler" VALUE 0x80002331 RecordLayout_1 0 CompuMethod_8 0 1 /end CHARACTERISTIC
/begin CHARACTERISTIC Fan2ECT "Fan Enabler" VALUE 0x80002332 RecordLayout_1 0 CompuMethod_8 0 1 /end CHARACTERISTIC
/begin CHARACTERISTIC Fan2IAT "Fan Enabler" VALUE 0x80002333 RecordLayout_1 0 CompuMethod_8 0 1 /end CHARACTERISTIC
/begin CHARACTERISTIC FGND_20XRTI_PERIODIC_RunCnt "The number of times to execute FGND_20XRTI_PERIODIC before pausing.  -1 means run forever" VALUE 0x800032C5 RecordLayout_9 0 CompuMethod_9 -1 2147480000 /end CHARACTERISTIC
/begin CHARACTERISTIC FGND_5XRTI_PERIODIC_RunCnt "The number of times to execute FGND_5XRTI_PERIODIC before pausing.  -1 means run forever" VALUE 0x800032C9 RecordLayout_9 0 CompuMethod_9 -1 2147480000 /end CHARACTERISTIC
/begin CHARACTERISTIC FGND_HIRES_RunCnt "The number of times to execute FGND_HIRES before pausing.  -1 means run forever" VALUE 0x800032CD RecordLayout_9 0 CompuMethod_9 -1 2147480000 /end CHARACTERISTIC
/begin CHARACTERISTIC FGND_MID_TDC_EVENT_RunCnt "The number of times to execute FGND_MID_TDC_EVENT before pausing.  -1 means run forever" VALUE 0x800032D1 RecordLayout_9 0 CompuMethod_9 -1 2147480000 /end CHARACTERISTIC
/begin CHARACTERISTIC FGND_RTI_Period "Base rate of the FGND_RTI_PERIODIC event" VALUE 0x800032D5 RecordLayout_4 0 CompuMethod_90 0 65535 /end CHARACTERISTIC
/begin CHARACTERISTIC FGND_RTI_PERIODIC_RunCnt "The number of times to execute FGND_RTI_PERIODIC before pausing.  -1 means run forever" VALUE 0x800032D7 RecordLayout_9 0 CompuMethod_9 -1 2147480000 /end CHARACTERISTIC
/begin CHARACTERISTIC FGND_TDC_EVENT_RunCnt "The number of times to execute FGND_TDC_EVENT before pausing.  -1 means run forever" VALUE 0x800032DB RecordLayout_9 0 CompuMethod_9 -1 2147480000 /end CHARACTERISTIC
/begin CHARACTERISTIC FGND_TDC1_EVENT_RunCnt "The number of times to execute FGND_TDC1_EVENT before pausing.  -1 means run forever" VALUE 0x800032DF RecordLayout_9 0 CompuMethod_9 -1 2147480000 /end CHARACTERISTIC
/begin CHARACTERISTIC FgndAngleStackMargin "When the available stack space drops below this threshold, the application performs a safety stop" VALUE 0x800032E3 RecordLayout_4 0 CompuMethod_9 0 1024 /end CHARACTERISTIC
/begin CHARACTERISTIC FgndTimeStackMargin "When the available stack space drops below this threshold, the application performs a safety stop" VALUE 0x800032E5 RecordLayout_4 0 CompuMethod_9 0 4096 /end CHARACTERISTIC
/begin CHARACTERISTIC ForcedShutDownTimerThresh "If ECUP is off for this time and application has not turned off, then force a shutdown routine." VALUE 0x800032F0 RecordLayout_5 0 CompuMethod_19 0 1023 /end CHARACTERISTIC
/begin CHARACTERISTIC FuelAdaptDelta "O2_Error must be less than this delta to adapt the FuelFlowComp map" VALUE 0x80003331 RecordLayout_5 0 CompuMethod_32 0 2 /end CHARACTERISTIC
/begin CHARACTERISTIC FuelAdaptEnable "Determines whether the FuelFlowComp map will be adapted using the MAF sensor" VALUE 0x80003335 RecordLayout_1 0 CompuMethod_28 0 1 /end CHARACTERISTIC
/begin CHARACTERISTIC FuelAdaptGain_BankATbl "Gain for updating FuelFlowComp map.  This fraction of the error is added to the map every 5ms." CURVE 0x80003346 RecordLayout_5 0 CompuMethod_48 -1E+17 1E+17
 /begin AXIS_DESCR COM_AXIS O2ITerm_BankAIn CompuMethod_32 5 -1E+17 1E+17 AXIS_PTS_REF O2ITerm_BankAIdxArr /end AXIS_DESCR
/end CHARACTERISTIC
/begin CHARACTERISTIC FuelAdaptGain_BankBTbl "Gain for updating FuelFlowComp map.  This fraction of the error is added to the map every 5ms." CURVE 0x8000335A RecordLayout_5 0 CompuMethod_48 -1E+17 1E+17
 /begin AXIS_DESCR COM_AXIS O2ITerm_BankBIn CompuMethod_32 5 -1E+17 1E+17 AXIS_PTS_REF O2ITerm_BankBIdxArr /end AXIS_DESCR
/end CHARACTERISTIC
/begin CHARACTERISTIC FuelFlowCompAdapt_BankAMap "Adapt map based on O2 ITerm that is multiplied into FuelFlowComp." MAP 0x80003372 RecordLayout_5 0 CompuMethod_32 -1E+17 1E+17
 /begin AXIS_DESCR COM_AXIS RPM09In CompuMethod_71 9 0 14000 AXIS_PTS_REF RPM09IdxArr /end AXIS_DESCR
 /begin AXIS_DESCR COM_AXIS MAP09In CompuMethod_16 9 0 1000 AXIS_PTS_REF MAP09IdxArr /end AXIS_DESCR
/end CHARACTERISTIC
/begin CHARACTERISTIC FuelFlowCompAdapt_BankBMap "Adapt map based on O2 ITerm that is multiplied into FuelFlowComp." MAP 0x800034B6 RecordLayout_5 0 CompuMethod_32 -1E+17 1E+17
 /begin AXIS_DESCR COM_AXIS RPM09In CompuMethod_71 9 0 14000 AXIS_PTS_REF RPM09IdxArr /end AXIS_DESCR
 /begin AXIS_DESCR COM_AXIS MAP09In CompuMethod_16 9 0 1000 AXIS_PTS_REF MAP09IdxArr /end AXIS_DESCR
/end CHARACTERISTIC
/begin CHARACTERISTIC FuelFlowCompMap "Fuel Flow Compensation Multiplier - gain to adjust modelling errors in mechanical fuel system." MAP 0x800035FA RecordLayout_5 0 CompuMethod_32 -1E+17 1E+17
 /begin AXIS_DESCR COM_AXIS RPM09In CompuMethod_71 9 0 14000 AXIS_PTS_REF RPM09IdxArr /end AXIS_DESCR
 /begin AXIS_DESCR COM_AXIS MAP09In CompuMethod_16 9 0 1000 AXIS_PTS_REF MAP09IdxArr /end AXIS_DESCR
/end CHARACTERISTIC
/begin CHARACTERISTIC FuelLvlSensorPin "Analog input pin selection for FuelLvlSensorPin" VALUE 0x80003856 RecordLayout_6 0 CompuMethod_22 -32768 32767 /end CHARACTERISTIC
/begin CHARACTERISTIC FuelLvlSensorPin_ref "Reference Voltage Selection" VALUE 0x80003858 RecordLayout_1 0 CompuMethod_23 0 255 /end CHARACTERISTIC
/begin CHARACTERISTIC FuelPresPin "Analog input pin selection for FuelPresPin" VALUE 0x80003885 RecordLayout_6 0 CompuMethod_22 -32768 32767 /end CHARACTERISTIC
/begin CHARACTERISTIC FuelPresPin_ref "Reference Voltage Selection" VALUE 0x80003887 RecordLayout_1 0 CompuMethod_23 0 255 /end CHARACTERISTIC
/begin CHARACTERISTIC FuelPulseTime "" VALUE 0x80003888 RecordLayout_5 0 CompuMethod_2 -1E+17 1E+17 /end CHARACTERISTIC
/begin CHARACTERISTIC FuelPumpStartTime "The length of time for the Fuel Pump relay to be enabled at startup" VALUE 0x8000388E RecordLayout_5 0 CompuMethod_19 0 100 /end CHARACTERISTIC
/begin CHARACTERISTIC FuelSensorPin "Frequency input pin selection for FuelSensorPin" VALUE 0x800038AF RecordLayout_6 0 CompuMethod_120 -32768 32767 /end CHARACTERISTIC
/begin CHARACTERISTIC HardRevOffset "RPM rev limit for hard action to be taken" VALUE 0x80003906 RecordLayout_6 0 CompuMethod_24 0 32767 /end CHARACTERISTIC
/begin CHARACTERISTIC HeapMargin "When the available heap drops below this threshold, the application performs a safety stop" VALUE 0x80003908 RecordLayout_4 0 CompuMethod_9 0 4480 /end CHARACTERISTIC
/begin CHARACTERISTIC IACTypeCal "" VALUE 0x8000390A RecordLayout_1 0 CompuMethod_126 0 255 /end CHARACTERISTIC
/begin CHARACTERISTIC IAT_SpkOfstMultMap "Multiplier on IAT spark offset table." MAP 0x80003935 RecordLayout_5 0 CompuMethod_2 -100 100
 /begin AXIS_DESCR COM_AXIS RPM09In CompuMethod_71 9 0 14000 AXIS_PTS_REF RPM09IdxArr /end AXIS_DESCR
 /begin AXIS_DESCR COM_AXIS MAP09In CompuMethod_16 9 0 1000 AXIS_PTS_REF MAP09IdxArr /end AXIS_DESCR
/end CHARACTERISTIC
/begin CHARACTERISTIC IAT_SpkOfstTbl "IAT spark offset" CURVE 0x80003A79 RecordLayout_5 0 CompuMethod_66 -50 50
 /begin AXIS_DESCR COM_AXIS IAT05In CompuMethod_57 5 -40 300 AXIS_PTS_REF IAT05IdxArr /end AXIS_DESCR
/end CHARACTERISTIC
/begin CHARACTERISTIC IATFanOff "IAT temp when the fan turns off" VALUE 0x80003B05 RecordLayout_5 0 CompuMethod_57 -1E+17 1E+17 /end CHARACTERISTIC
/begin CHARACTERISTIC IATFanOn "IAT temp when the fan turns on" VALUE 0x80003B09 RecordLayout_5 0 CompuMethod_57 -1E+17 1E+17 /end CHARACTERISTIC
/begin CHARACTERISTIC IATFanSpeed_StallTbl "" CURVE 0x80003B0D RecordLayout_5 0 CompuMethod_2 -1E+17 1E+17
 /begin AXIS_DESCR COM_AXIS IAT05In CompuMethod_57 5 -40 300 AXIS_PTS_REF IAT05IdxArr /end AXIS_DESCR
/end CHARACTERISTIC
/begin CHARACTERISTIC IATFanSpeedMap "" MAP 0x80003B21 RecordLayout_5 0 CompuMethod_2 -1E+17 1E+17
 /begin AXIS_DESCR COM_AXIS VSPD07In CompuMethod_180 7 -100 200 AXIS_PTS_REF VSPD07IdxArr /end AXIS_DESCR
 /begin AXIS_DESCR COM_AXIS IAT07In CompuMethod_57 7 -40 300 AXIS_PTS_REF IAT07IdxArr /end AXIS_DESCR
/end CHARACTERISTIC
/begin CHARACTERISTIC IATSensorPin "Analog input pin selection for IATSensorPin" VALUE 0x80003C25 RecordLayout_6 0 CompuMethod_22 -32768 32767 /end CHARACTERISTIC
/begin CHARACTERISTIC IATSensorPin_ref "Reference Voltage Selection" VALUE 0x80003C27 RecordLayout_1 0 CompuMethod_23 0 255 /end CHARACTERISTIC
/begin CHARACTERISTIC IDLE_EVENT_RunCnt "The number of times to execute IDLE_EVENT before pausing.  -1 means run forever" VALUE 0x80003C5C RecordLayout_9 0 CompuMethod_9 -1 2147480000 /end CHARACTERISTIC
/begin CHARACTERISTIC IdleStackMargin "When the available stack space drops below this threshold, the application performs a safety stop" VALUE 0x80003C68 RecordLayout_4 0 CompuMethod_9 0 1024 /end CHARACTERISTIC
/begin CHARACTERISTIC InGearMinGovEntryRPMDelta "RPM above setpoint where Min Gov will enable when RPM is falling into idle." VALUE 0x80003C6A RecordLayout_6 0 CompuMethod_24 -32768 32767 /end CHARACTERISTIC
/begin CHARACTERISTIC InjectiorMinDuration "Fuel injector min pulsewidth" VALUE 0x80003CBC RecordLayout_5 0 CompuMethod_65 -1E+17 1E+17 /end CHARACTERISTIC
/begin CHARACTERISTIC Injector1Enable "" VALUE 0x80003CC0 RecordLayout_1 0 CompuMethod_8 0 1 /end CHARACTERISTIC
/begin CHARACTERISTIC Injector2Enable "" VALUE 0x80003CC1 RecordLayout_1 0 CompuMethod_8 0 1 /end CHARACTERISTIC
/begin CHARACTERISTIC Injector3Enable "" VALUE 0x80003CC2 RecordLayout_1 0 CompuMethod_8 0 1 /end CHARACTERISTIC
/begin CHARACTERISTIC Injector4Enable "" VALUE 0x80003CC3 RecordLayout_1 0 CompuMethod_8 0 1 /end CHARACTERISTIC
/begin CHARACTERISTIC Injector5Enable "" VALUE 0x80003CC4 RecordLayout_1 0 CompuMethod_8 0 1 /end CHARACTERISTIC
/begin CHARACTERISTIC Injector6Enable "" VALUE 0x80003CC5 RecordLayout_1 0 CompuMethod_8 0 1 /end CHARACTERISTIC
/begin CHARACTERISTIC Injector7Enable "" VALUE 0x80003CC6 RecordLayout_1 0 CompuMethod_8 0 1 /end CHARACTERISTIC
/begin CHARACTERISTIC Injector8Enable "" VALUE 0x80003CC7 RecordLayout_1 0 CompuMethod_8 0 1 /end CHARACTERISTIC
/begin CHARACTERISTIC InjectorMaxDuration "Maximum duration for an injector pulse.  Must be a multiple of 5ms" VALUE 0x80003CC8 RecordLayout_5 0 CompuMethod_65 -1E+17 1E+17 /end CHARACTERISTIC
/begin CHARACTERISTIC IntakeAirTempEnrichmentMap "Requested on base eq. ratio as a function of IAT and MAP" MAP 0x80003D25 RecordLayout_5 0 CompuMethod_62 0 10
 /begin AXIS_DESCR COM_AXIS IAT05In CompuMethod_57 5 -40 300 AXIS_PTS_REF IAT05IdxArr /end AXIS_DESCR
 /begin AXIS_DESCR COM_AXIS MAP05In CompuMethod_16 5 0 1000 AXIS_PTS_REF MAP05IdxArr /end AXIS_DESCR
/end CHARACTERISTIC
/begin CHARACTERISTIC InterruptStackMargin "When the available stack space drops below this threshold, the application performs a safety stop" VALUE 0x80003D89 RecordLayout_4 0 CompuMethod_9 0 1152 /end CHARACTERISTIC
/begin CHARACTERISTIC Lambda_1_Timeout "" VALUE 0x80003D8B RecordLayout_4 0 CompuMethod_124 0 65535 /end CHARACTERISTIC
/begin CHARACTERISTIC Lambda_2_Timeout "" VALUE 0x80003D8D RecordLayout_4 0 CompuMethod_124 0 65535 /end CHARACTERISTIC
/begin CHARACTERISTIC MAF_Pin "Frequency input pin selection for MAF_Pin" VALUE 0x8000403C RecordLayout_6 0 CompuMethod_120 -32768 32767 /end CHARACTERISTIC
/begin CHARACTERISTIC MAF_Source "Selects the source for the fueling algorithm" VALUE 0x80004045 RecordLayout_1 0 CompuMethod_137 0 255 /end CHARACTERISTIC
/begin CHARACTERISTIC MakeUpEOIMap "End of injection timing for transient makeup fuel pulse" MAP 0x800040FB RecordLayout_5 0 CompuMethod_66 -1000 1000
 /begin AXIS_DESCR COM_AXIS RPM09In CompuMethod_71 9 0 14000 AXIS_PTS_REF RPM09IdxArr /end AXIS_DESCR
 /begin AXIS_DESCR COM_AXIS MAP09In CompuMethod_16 9 0 1000 AXIS_PTS_REF MAP09IdxArr /end AXIS_DESCR
/end CHARACTERISTIC
/begin CHARACTERISTIC MAPSensorPin "Analog input pin selection for MAPSensorPin" VALUE 0x800042F4 RecordLayout_6 0 CompuMethod_22 -32768 32767 /end CHARACTERISTIC
/begin CHARACTERISTIC MAPSensorPin_ref "Reference Voltage Selection" VALUE 0x800042F6 RecordLayout_1 0 CompuMethod_23 0 255 /end CHARACTERISTIC
/begin CHARACTERISTIC MaxETCSetPtLimitTbl "Maximum allowable ETC position." CURVE 0x80004314 RecordLayout_5 0 CompuMethod_7 0 100
 /begin AXIS_DESCR COM_AXIS RPM09In CompuMethod_71 9 0 14000 AXIS_PTS_REF RPM09IdxArr /end AXIS_DESCR
/end CHARACTERISTIC
/begin CHARACTERISTIC MediumRevOffset "RPM rev limit for medium action to be taken" VALUE 0x800044AE RecordLayout_6 0 CompuMethod_24 0 32767 /end CHARACTERISTIC
/begin CHARACTERISTIC MinETCSetPtLimitTbl "Min allowable ETC position." CURVE 0x800044B0 RecordLayout_5 0 CompuMethod_7 0 100
 /begin AXIS_DESCR COM_AXIS RPM09In CompuMethod_71 9 0 14000 AXIS_PTS_REF RPM09IdxArr /end AXIS_DESCR
/end CHARACTERISTIC
/begin CHARACTERISTIC MinGovAirPcntHyst "Hysteresis around MinGovEntryAirPcnt where Min Gov will disable." VALUE 0x800044D4 RecordLayout_5 0 CompuMethod_7 -1E+17 1E+17 /end CHARACTERISTIC
/begin CHARACTERISTIC MinGovEntryAirPcnt "Percent air (TPS or APP) position where below which Min Gov will enable." VALUE 0x800044E2 RecordLayout_5 0 CompuMethod_7 -1E+17 1E+17 /end CHARACTERISTIC
/begin CHARACTERISTIC MinGovEntryAirTimeThresh "If entry AirPcnt condition is satisfied, but RPM is high, Min Gov will enable if this time is exceeded." VALUE 0x800044E6 RecordLayout_5 0 CompuMethod_46 -1E+17 1E+17 /end CHARACTERISTIC
/begin CHARACTERISTIC MinMakeUpPW "Minimum change in injector pulse width that will trigger a make-up pulse." VALUE 0x800044EA RecordLayout_5 0 CompuMethod_65 -1E+17 1E+17 /end CHARACTERISTIC
/begin CHARACTERISTIC MisfireDiag_AngleHyst "" VALUE 0x8000453A RecordLayout_4 0 CompuMethod_9 0 65535 /end CHARACTERISTIC
/begin CHARACTERISTIC MisfireDiag_ECTHighEnbl "" VALUE 0x8000453C RecordLayout_6 0 CompuMethod_9 -32768 32767 /end CHARACTERISTIC
/begin CHARACTERISTIC MisfireDiag_ECTLowEnbl "" VALUE 0x8000453E RecordLayout_6 0 CompuMethod_9 -32768 32767 /end CHARACTERISTIC
/begin CHARACTERISTIC MisfireDiag_Enbl "" VALUE 0x80004540 RecordLayout_1 0 CompuMethod_8 0 1 /end CHARACTERISTIC
/begin CHARACTERISTIC MisfireDiag_EncoderExtrap_MPC5XX "" VALUE 0x80004541 RecordLayout_1 0 CompuMethod_8 0 1 /end CHARACTERISTIC
/begin CHARACTERISTIC MisfireDiag_MAPHighEnbl "" VALUE 0x80004546 RecordLayout_6 0 CompuMethod_9 -32768 32767 /end CHARACTERISTIC
/begin CHARACTERISTIC MisfireDiag_MAPIRDiagEnable "" VALUE 0x80004548 RecordLayout_1 0 CompuMethod_8 0 1 /end CHARACTERISTIC
/begin CHARACTERISTIC MisfireDiag_MAPLowEnbl "" VALUE 0x80004549 RecordLayout_6 0 CompuMethod_9 -32768 32767 /end CHARACTERISTIC
/begin CHARACTERISTIC MisfireDiag_RPMHighEnbl "" VALUE 0x8000454B RecordLayout_6 0 CompuMethod_9 -32768 32767 /end CHARACTERISTIC
/begin CHARACTERISTIC MisfireDiag_RPMLowEnbl "" VALUE 0x8000454D RecordLayout_6 0 CompuMethod_9 -32768 32767 /end CHARACTERISTIC
/begin CHARACTERISTIC MisfireDiag_StartAngles "" VAL_BLK 0x8000454F RecordLayout_4 0 CompuMethod_9 0 65535 MATRIX_DIM 8 1 1 /end CHARACTERISTIC
/begin CHARACTERISTIC MisfireDiag_StopAngles "" VAL_BLK 0x80004560 RecordLayout_4 0 CompuMethod_9 0 65535 MATRIX_DIM 8 1 1 /end CHARACTERISTIC
/begin CHARACTERISTIC MisfireDiag_TimeSinceRunEnbl "" VALUE 0x80004571 RecordLayout_6 0 CompuMethod_9 -32768 32767 /end CHARACTERISTIC
/begin CHARACTERISTIC MotoTuneSerialBaudRate "The default baud rate that the serial MotoTune protocol will use for connections." VALUE 0x80004579 RecordLayout_3 0 CompuMethod_9 9600 57600 /end CHARACTERISTIC
/begin CHARACTERISTIC O2ControlEnable "Enables O2 control" VALUE 0x80004591 RecordLayout_1 0 CompuMethod_149 0 1 /end CHARACTERISTIC
/begin CHARACTERISTIC O2StartUpDelayTbl "Delay O2 enable until TimeSinceRun is greater than this time." CURVE 0x8000478C RecordLayout_5 0 CompuMethod_46 -1E+17 1E+17
 /begin AXIS_DESCR COM_AXIS ECT_KeyUp09In CompuMethod_57 9 -1E+17 1E+17 AXIS_PTS_REF ECT_KeyUp09IdxArr /end AXIS_DESCR
/end CHARACTERISTIC
/begin CHARACTERISTIC OilPresPin "Analog input pin selection for OilPresPin" VALUE 0x800047D1 RecordLayout_6 0 CompuMethod_22 -32768 32767 /end CHARACTERISTIC
/begin CHARACTERISTIC OilPresPin_ref "Reference Voltage Selection" VALUE 0x800047D3 RecordLayout_1 0 CompuMethod_23 0 255 /end CHARACTERISTIC
/begin CHARACTERISTIC ONE_SECOND_EVENT_RunCnt "The number of times to execute ONE_SECOND_EVENT before pausing.  -1 means run forever" VALUE 0x800047D4 RecordLayout_9 0 CompuMethod_9 -1 2147480000 /end CHARACTERISTIC
/begin CHARACTERISTIC Placeholder_CAT "" VALUE 0x80004846 RecordLayout_5 0 CompuMethod_2 -1E+17 1E+17 /end CHARACTERISTIC
/begin CHARACTERISTIC Placeholder_CATRaw "" VALUE 0x8000484A RecordLayout_5 0 CompuMethod_2 -1E+17 1E+17 /end CHARACTERISTIC
/begin CHARACTERISTIC Placeholder_ClutchSw "" VALUE 0x8000484E RecordLayout_1 0 CompuMethod_11 0 1 /end CHARACTERISTIC
/begin CHARACTERISTIC Placeholder_Scramble "" VALUE 0x8000484F RecordLayout_1 0 CompuMethod_11 0 1 /end CHARACTERISTIC
/begin CHARACTERISTIC PrimarySOIMap "Injection timing for primary fuel pulse - SOI or EOI depending on Inj Config" MAP 0x80004850 RecordLayout_5 0 CompuMethod_66 -1000 1000
 /begin AXIS_DESCR COM_AXIS RPM09In CompuMethod_71 9 0 14000 AXIS_PTS_REF RPM09IdxArr /end AXIS_DESCR
 /begin AXIS_DESCR COM_AXIS MAP09In CompuMethod_16 9 0 1000 AXIS_PTS_REF MAP09IdxArr /end AXIS_DESCR
/end CHARACTERISTIC
/begin CHARACTERISTIC ProcessorReboot "Reboots the processor when set." VALUE 0x80004994 RecordLayout_1 0 CompuMethod_157 0 1 /end CHARACTERISTIC
/begin CHARACTERISTIC PseudoRPM "" VALUE 0x80004995 RecordLayout_4 0 CompuMethod_9 0 65535 /end CHARACTERISTIC
/begin CHARACTERISTIC RevLimitHyst "Hysteresis applied to MaxRPM once rev limit threshold is satisfied" VALUE 0x80004998 RecordLayout_6 0 CompuMethod_24 0 12000 /end CHARACTERISTIC
/begin CHARACTERISTIC RPMFiltConst "Filter time constant" VALUE 0x80004CF6 RecordLayout_5 0 CompuMethod_19 -1E+17 1E+17 /end CHARACTERISTIC
/begin CHARACTERISTIC RunLatchTDCs "Number of TDCs required to be above CrankToRunRPMThresh before the RUN mode is invoked." VALUE 0x80004CFA RecordLayout_1 0 CompuMethod_163 0 255 /end CHARACTERISTIC
/begin CHARACTERISTIC SensVoltSensorPin "Analog input pin selection for SensVoltSensorPin" VALUE 0x80004D18 RecordLayout_6 0 CompuMethod_22 -32768 32767 /end CHARACTERISTIC
/begin CHARACTERISTIC SensVoltSensorPin_ref "Reference Voltage Selection" VALUE 0x80004D1A RecordLayout_1 0 CompuMethod_23 0 255 /end CHARACTERISTIC
/begin CHARACTERISTIC Shutdown_Delay "ECU calibrateable shutdown delay" VALUE 0x80004D1B RecordLayout_5 0 CompuMethod_27 0 1E+17 /end CHARACTERISTIC
/begin CHARACTERISTIC SparkAdv_Filt "Filter time constant" VALUE 0x80004D4C RecordLayout_5 0 CompuMethod_19 -1E+17 1E+17 /end CHARACTERISTIC
/begin CHARACTERISTIC SparkAdvMap "Base spark advance map." MAP 0x80004D50 RecordLayout_5 0 CompuMethod_66 -1E+17 1E+17
 /begin AXIS_DESCR COM_AXIS RPM17In CompuMethod_71 17 0 14000 AXIS_PTS_REF RPM17IdxArr /end AXIS_DESCR
 /begin AXIS_DESCR COM_AXIS MAP17In CompuMethod_16 17 0 1000 AXIS_PTS_REF MAP17IdxArr /end AXIS_DESCR
/end CHARACTERISTIC
/begin CHARACTERISTIC SparkEnableCyl1 "Disable spark to particular cylinder." VALUE 0x800051D9 RecordLayout_1 0 CompuMethod_167 0 1 /end CHARACTERISTIC
/begin CHARACTERISTIC SparkEnableCyl2 "Disable spark to particular cylinder." VALUE 0x800051DA RecordLayout_1 0 CompuMethod_167 0 1 /end CHARACTERISTIC
/begin CHARACTERISTIC SparkEnableCyl3 "Disable spark to particular cylinder." VALUE 0x800051DB RecordLayout_1 0 CompuMethod_167 0 1 /end CHARACTERISTIC
/begin CHARACTERISTIC SparkEnableCyl4 "Disable spark to particular cylinder." VALUE 0x800051DC RecordLayout_1 0 CompuMethod_167 0 1 /end CHARACTERISTIC
/begin CHARACTERISTIC SparkEnableCyl5 "Disable spark to particular cylinder." VALUE 0x800051DD RecordLayout_1 0 CompuMethod_167 0 1 /end CHARACTERISTIC
/begin CHARACTERISTIC SparkEnableCyl6 "Disable spark to particular cylinder." VALUE 0x800051DE RecordLayout_1 0 CompuMethod_167 0 1 /end CHARACTERISTIC
/begin CHARACTERISTIC SparkEnableCyl7 "Disable spark to particular cylinder." VALUE 0x800051DF RecordLayout_1 0 CompuMethod_167 0 1 /end CHARACTERISTIC
/begin CHARACTERISTIC SparkEnableCyl8 "Disable spark to particular cylinder." VALUE 0x800051E0 RecordLayout_1 0 CompuMethod_167 0 1 /end CHARACTERISTIC
/begin CHARACTERISTIC SparkEnableTDCCounts "Do not enable spark until this many TDCs have occurred in order to guarantee cam synchronization. This number should typically be 2." VALUE 0x800051E1 RecordLayout_1 0 CompuMethod_1 0 255 /end CHARACTERISTIC
/begin CHARACTERISTIC SparkMaxDuration "Maximum duration for a spark pulse.  Must be a multiple of 5ms" VALUE 0x800051E2 RecordLayout_5 0 CompuMethod_65 -1E+17 1E+17 /end CHARACTERISTIC
/begin CHARACTERISTIC StallRPMMinThreshold "Min. RPM Threshold below which engine state transition to STALL." VALUE 0x800052AC RecordLayout_4 0 CompuMethod_24 0 65535 /end CHARACTERISTIC
/begin CHARACTERISTIC StallRPMThresholdHyst "Hysteresis used in conjunction with Min. RPM Threshold to determine when engine state transition to STALL. " VALUE 0x800052AE RecordLayout_4 0 CompuMethod_24 0 65535 /end CHARACTERISTIC
/begin CHARACTERISTIC StallSaverDeltaRPM "RPM delta below setpoint where Min Gov will enable to prevent engine stalls." VALUE 0x800052B0 RecordLayout_6 0 CompuMethod_24 -32768 32767 /end CHARACTERISTIC
/begin CHARACTERISTIC STARTUP_EVENT_RunCnt "The number of times to execute STARTUP_EVENT before pausing.  -1 means run forever" VALUE 0x800052B2 RecordLayout_9 0 CompuMethod_9 -1 2147480000 /end CHARACTERISTIC
/begin CHARACTERISTIC SysVoltage "Analog input pin selection for SysVoltage" VALUE 0x800052E0 RecordLayout_6 0 CompuMethod_22 -32768 32767 /end CHARACTERISTIC
/begin CHARACTERISTIC SysVoltage_ref "Reference Voltage Selection" VALUE 0x800052E2 RecordLayout_1 0 CompuMethod_23 0 255 /end CHARACTERISTIC
/begin CHARACTERISTIC TeethBeforeSyncAllowed "The number of teeth that must be observed before the encoder will allow synchronization to occur." VALUE 0x800052FB RecordLayout_1 0 CompuMethod_1 0 255 /end CHARACTERISTIC
/begin CHARACTERISTIC ThrottleSource "Selects source of throttle command" VALUE 0x80005308 RecordLayout_1 0 CompuMethod_173 0 1 /end CHARACTERISTIC
/begin CHARACTERISTIC TimeBeforeSyncAllowed "The amount of time that must be observed after initial encoder activity before the encoder will allow synchronization to occur." VALUE 0x80005309 RecordLayout_4 0 CompuMethod_124 0 65535 /end CHARACTERISTIC
/begin CHARACTERISTIC TPS1AnalogInput "Analog input pin selection for TPS1AnalogInput" VALUE 0x8000537A RecordLayout_6 0 CompuMethod_22 -32768 32767 /end CHARACTERISTIC
/begin CHARACTERISTIC TPS1AnalogInput_ref "Reference Voltage Selection" VALUE 0x8000537C RecordLayout_1 0 CompuMethod_23 0 255 /end CHARACTERISTIC
/begin CHARACTERISTIC TPS2AnalogInput "Analog input pin selection for TPS2AnalogInput" VALUE 0x800053AD RecordLayout_6 0 CompuMethod_22 -32768 32767 /end CHARACTERISTIC
/begin CHARACTERISTIC TPS2AnalogInput_ref "Reference Voltage Selection" VALUE 0x800053AF RecordLayout_1 0 CompuMethod_23 0 255 /end CHARACTERISTIC
/begin CHARACTERISTIC VEAdaptEnable "Determines whether the Volumetric Efficiency map will be adapted using the MAF sensor" VALUE 0x800053ED RecordLayout_1 0 CompuMethod_28 0 1 /end CHARACTERISTIC
/begin CHARACTERISTIC VEAdaptTemp "Engine Coolant Temp Must be higher than this to Adapt VE" VALUE 0x8000541E RecordLayout_5 0 CompuMethod_57 -40 200 /end CHARACTERISTIC
/begin CHARACTERISTIC VEAdaptTime "Engine Run Time must be greater than this to Adapt VE" VALUE 0x80005422 RecordLayout_5 0 CompuMethod_19 0 200 /end CHARACTERISTIC
/begin CHARACTERISTIC VEBaroCorrTbl "Vol Eff compensation based on BARO." CURVE 0x80005427 RecordLayout_5 0 CompuMethod_2 -1E+17 1E+17
 /begin AXIS_DESCR COM_AXIS BARO CompuMethod_2 9 -1E+17 1E+17 AXIS_PTS_REF BARO09IdxArr /end AXIS_DESCR
/end CHARACTERISTIC
/begin CHARACTERISTIC VETempCorrMap "" MAP 0x8000548F RecordLayout_5 0 CompuMethod_7 -1E+17 1E+17
 /begin AXIS_DESCR COM_AXIS ECT09In CompuMethod_57 9 -40 200 AXIS_PTS_REF ECT09IdxArr /end AXIS_DESCR
 /begin AXIS_DESCR COM_AXIS IAT17In CompuMethod_57 17 -40 300 AXIS_PTS_REF IAT17IdxArr /end AXIS_DESCR
/end CHARACTERISTIC
/begin CHARACTERISTIC VolEffAdaptMap "Volumetric efficiency adapt table" MAP 0x800056F3 RecordLayout_5 0 CompuMethod_7 -1000 1000
 /begin AXIS_DESCR COM_AXIS RPM17In CompuMethod_71 17 0 14000 AXIS_PTS_REF RPM17IdxArr /end AXIS_DESCR
 /begin AXIS_DESCR COM_AXIS VEMapIn CompuMethod_16 17 -1E+17 1E+17 AXIS_PTS_REF VEMapIdxArr /end AXIS_DESCR
/end CHARACTERISTIC
/begin CHARACTERISTIC VolEffMap "Volumetric efficiency table for speed density mode" MAP 0x80005B77 RecordLayout_5 0 CompuMethod_7 0 1000
 /begin AXIS_DESCR COM_AXIS RPM17In CompuMethod_71 17 0 14000 AXIS_PTS_REF RPM17IdxArr /end AXIS_DESCR
 /begin AXIS_DESCR COM_AXIS VEMapIn CompuMethod_16 17 -1E+17 1E+17 AXIS_PTS_REF VEMapIdxArr /end AXIS_DESCR
/end CHARACTERISTIC
/begin CHARACTERISTIC VSPD_Filt "Filter time constant" VALUE 0x80006001 RecordLayout_5 0 CompuMethod_19 -1E+17 1E+17 /end CHARACTERISTIC
/begin CHARACTERISTIC VSPD_Pin "Frequency input pin selection for VSPD_Pin" VALUE 0x8000600B RecordLayout_6 0 CompuMethod_120 -32768 32767 /end CHARACTERISTIC
/begin CHARACTERISTIC WarmUpEqRatioMap "Requested eq. ratio as a function of ECT and MAP." MAP 0x800060EE RecordLayout_5 0 CompuMethod_62 0 10
 /begin AXIS_DESCR COM_AXIS ECT09In CompuMethod_57 9 -40 200 AXIS_PTS_REF ECT09IdxArr /end AXIS_DESCR
 /begin AXIS_DESCR COM_AXIS MAP05In CompuMethod_16 5 0 1000 AXIS_PTS_REF MAP05IdxArr /end AXIS_DESCR
/end CHARACTERISTIC
/begin CHARACTERISTIC WarmUpTimeRatioMap "Requested eq. ratio as a function of TimeSinceRun and ECT. Use for cold temps" MAP 0x800061A2 RecordLayout_5 0 CompuMethod_62 0 10
 /begin AXIS_DESCR COM_AXIS ECT05In CompuMethod_57 5 -40 200 AXIS_PTS_REF ECT05IdxArr /end AXIS_DESCR
 /begin AXIS_DESCR COM_AXIS TimeSinceRun09In CompuMethod_2 9 -1E+17 1E+17 AXIS_PTS_REF TimeSinceRun09IdxArr /end AXIS_DESCR
/end CHARACTERISTIC
/*~~~~~~~~~ 6.3.17 AXIS_PTS ~~~~~~~~~*/
/begin AXIS_PTS ACPres05IdxArr "Index of AC system high side pressure" 0x80000080 ACPres05In RecordLayout_7 0 CompuMethod_16 5 -150 10000 DEPOSIT ABSOLUTE /end AXIS_PTS
/begin AXIS_PTS ACPres07IdxArr "Index of AC system high side pressure" 0x80000094 ACPres07In RecordLayout_7 0 CompuMethod_16 7 -150 10000 DEPOSIT ABSOLUTE /end AXIS_PTS
/begin AXIS_PTS AirMinGovSpeedErrorIdxArr "" 0x800002AE AirMinGovSpeedErrorIn RecordLayout_7 0 CompuMethod_2 9 -1E+17 1E+17 DEPOSIT ABSOLUTE /end AXIS_PTS
/begin AXIS_PTS APP17IdxArr "Index of APP for driver demand" 0x8000031F APP17In RecordLayout_7 0 CompuMethod_7 17 0 100 DEPOSIT ABSOLUTE /end AXIS_PTS
/begin AXIS_PTS BARO09IdxArr "" 0x800003EF BARO RecordLayout_7 0 CompuMethod_2 9 -1E+17 1E+17 DEPOSIT ABSOLUTE /end AXIS_PTS
/begin AXIS_PTS CAT05IdxArr "Index of charge air temperature" 0x80000704 CAT05In RecordLayout_7 0 CompuMethod_57 5 -40 300 DEPOSIT ABSOLUTE /end AXIS_PTS
/begin AXIS_PTS CrankECT05IdxArr "ECT pre-lookup for crank maps." 0x800008F4 ECT RecordLayout_7 0 CompuMethod_57 5 -1E+17 1E+17 DEPOSIT ABSOLUTE /end AXIS_PTS
/begin AXIS_PTS CrankIAT05IdxArr "IAT pre-lookup for crank maps." 0x80000994 IAT RecordLayout_7 0 CompuMethod_57 5 -1E+17 1E+17 DEPOSIT ABSOLUTE /end AXIS_PTS
/begin AXIS_PTS CrankOXY05IdxArr "OXY pre-lookup for crank maps." 0x800009BC CrankOXY05In RecordLayout_7 0 CompuMethod_7 5 -1E+17 1E+17 DEPOSIT ABSOLUTE /end AXIS_PTS
/begin AXIS_PTS CrankRPM05IdxArr "RPM pre-lookup for crank maps" 0x800009E4 CrankRPM05In RecordLayout_7 0 CompuMethod_71 5 -1E+17 1E+17 DEPOSIT ABSOLUTE /end AXIS_PTS
/begin AXIS_PTS DeltaMAP17IdxArr "" 0x80000D42 DeltaMAP17In RecordLayout_7 0 CompuMethod_2 17 -1E+17 1E+17 DEPOSIT ABSOLUTE /end AXIS_PTS
/begin AXIS_PTS DeltaTPS17IdxArr "" 0x80000FEE DeltaTPS17In RecordLayout_7 0 CompuMethod_2 17 -1E+17 1E+17 DEPOSIT ABSOLUTE /end AXIS_PTS
/begin AXIS_PTS DesAFRatioIdxArr "" 0x80001033 DesAFRatioIn RecordLayout_7 0 CompuMethod_75 11 0 100 DEPOSIT ABSOLUTE /end AXIS_PTS
/begin AXIS_PTS DesEqRatio09IdxArr "Desired Equivalence Ratio breakpoints" 0x8000108B DesEqRatio09In RecordLayout_7 0 CompuMethod_76 9 0 1E+17 DEPOSIT ABSOLUTE /end AXIS_PTS
/begin AXIS_PTS ECT_KeyUp09IdxArr "Index of ECT captured at key-up." 0x80001581 ECT_KeyUp09In RecordLayout_7 0 CompuMethod_57 9 -1E+17 1E+17 DEPOSIT ABSOLUTE /end AXIS_PTS
/begin AXIS_PTS ECT05IdxArr "Idex of ECT" 0x80001702 ECT05In RecordLayout_7 0 CompuMethod_57 5 -40 200 DEPOSIT ABSOLUTE /end AXIS_PTS
/begin AXIS_PTS ECT07IdxArr "Index of ECT" 0x80001716 ECT07In RecordLayout_7 0 CompuMethod_57 7 -40 200 DEPOSIT ABSOLUTE /end AXIS_PTS
/begin AXIS_PTS ECT09IdxArr "Index of ECT" 0x80001732 ECT09In RecordLayout_7 0 CompuMethod_57 9 -40 200 DEPOSIT ABSOLUTE /end AXIS_PTS
/begin AXIS_PTS ECTIdxArr "Look up table to allownon-linear characterization of sensors" 0x8000183E ECTADC RecordLayout_7 0 CompuMethod_21 13 -1E+17 1E+17 DEPOSIT ABSOLUTE /end AXIS_PTS
/begin AXIS_PTS ETC_SetpointIdxArr "" 0x80001B17 ETC_SetpointIn RecordLayout_7 0 CompuMethod_2 20 -1E+17 1E+17 DEPOSIT ABSOLUTE /end AXIS_PTS
/begin AXIS_PTS IAT05IdxArr "Index of IAT" 0x80003A8D IAT05In RecordLayout_7 0 CompuMethod_57 5 -40 300 DEPOSIT ABSOLUTE /end AXIS_PTS
/begin AXIS_PTS IAT07IdxArr "Index of IAT" 0x80003AA1 IAT07In RecordLayout_7 0 CompuMethod_57 7 -40 300 DEPOSIT ABSOLUTE /end AXIS_PTS
/begin AXIS_PTS IAT17IdxArr "Index of IAT" 0x80003ABD IAT17In RecordLayout_7 0 CompuMethod_57 17 -40 300 DEPOSIT ABSOLUTE /end AXIS_PTS
/begin AXIS_PTS MAF09IdxArr "" 0x80004046 MAF09In RecordLayout_7 0 CompuMethod_2 9 -1E+17 1E+17 DEPOSIT ABSOLUTE /end AXIS_PTS
/begin AXIS_PTS MAP05IdxArr "Index of MAP" 0x80004260 MAP05In RecordLayout_7 0 CompuMethod_16 5 0 1000 DEPOSIT ABSOLUTE /end AXIS_PTS
/begin AXIS_PTS MAP09IdxArr "Index of MAP" 0x80004274 MAP09In RecordLayout_7 0 CompuMethod_16 9 0 1000 DEPOSIT ABSOLUTE /end AXIS_PTS
/begin AXIS_PTS MAP17IdxArr "Index of MAP" 0x80004298 MAP17In RecordLayout_7 0 CompuMethod_16 17 0 1000 DEPOSIT ABSOLUTE /end AXIS_PTS
/begin AXIS_PTS O2ITerm_BankAIdxArr "Index for O2 ITerm." 0x80004714 O2ITerm_BankAIn RecordLayout_7 0 CompuMethod_32 5 -1E+17 1E+17 DEPOSIT ABSOLUTE /end AXIS_PTS
/begin AXIS_PTS O2ITerm_BankBIdxArr "Index for O2 ITerm." 0x80004728 O2ITerm_BankBIn RecordLayout_7 0 CompuMethod_32 5 -1E+17 1E+17 DEPOSIT ABSOLUTE /end AXIS_PTS
/begin AXIS_PTS RPM09IdxArr "Index of RPM" 0x80004C3B RPM09In RecordLayout_7 0 CompuMethod_71 9 0 14000 DEPOSIT ABSOLUTE /end AXIS_PTS
/begin AXIS_PTS RPM17IdxArr "Index of RPM" 0x80004C5F RPM17In RecordLayout_7 0 CompuMethod_71 17 0 14000 DEPOSIT ABSOLUTE /end AXIS_PTS
/begin AXIS_PTS SpkEnergy09IdxArr "" 0x800051F0 SpkEnergy09In RecordLayout_7 0 CompuMethod_2 9 -1E+17 1E+17 DEPOSIT ABSOLUTE /end AXIS_PTS
/begin AXIS_PTS SysVolt09IdxArr "Index of system voltage" 0x800052BC SysVolt09In RecordLayout_7 0 CompuMethod_164 9 0 32 DEPOSIT ABSOLUTE /end AXIS_PTS
/begin AXIS_PTS TimeSinceRun09IdxArr "" 0x8000530B TimeSinceRun09In RecordLayout_7 0 CompuMethod_2 9 -1E+17 1E+17 DEPOSIT ABSOLUTE /end AXIS_PTS
/begin AXIS_PTS TPS09IdxArr "Index of TPS" 0x80005337 TPS09In RecordLayout_7 0 CompuMethod_7 9 0 100 DEPOSIT ABSOLUTE /end AXIS_PTS
/begin AXIS_PTS VEMapIdxArr "Index of MAP for VE calculations" 0x8000544B VEMapIn RecordLayout_7 0 CompuMethod_16 17 -1E+17 1E+17 DEPOSIT ABSOLUTE /end AXIS_PTS
/begin AXIS_PTS VSPD07IdxArr "Index of VSPD" 0x8000601E VSPD07In RecordLayout_7 0 CompuMethod_180 7 -100 200 DEPOSIT ABSOLUTE /end AXIS_PTS
/begin AXIS_PTS VSPD17IdxArr "Index of VSPD" 0x8000605E VSPD17In RecordLayout_7 0 CompuMethod_180 17 -100 200 DEPOSIT ABSOLUTE /end AXIS_PTS
/*~~~~~~~~~ 6.3.106 RECORD_LAYOUTs ~~~~~~~~~*/
/begin RECORD_LAYOUT RecordLayout_1 FNC_VALUES 1 UBYTE ROW_DIR DIRECT /end RECORD_LAYOUT
/begin RECORD_LAYOUT RecordLayout_3 FNC_VALUES 1 ULONG ROW_DIR DIRECT /end RECORD_LAYOUT
/begin RECORD_LAYOUT RecordLayout_4 FNC_VALUES 1 UWORD ROW_DIR DIRECT /end RECORD_LAYOUT
/begin RECORD_LAYOUT RecordLayout_5 FNC_VALUES 1 FLOAT32_IEEE ROW_DIR DIRECT /end RECORD_LAYOUT
/begin RECORD_LAYOUT RecordLayout_6 FNC_VALUES 1 SWORD ROW_DIR DIRECT /end RECORD_LAYOUT
/begin RECORD_LAYOUT RecordLayout_7 AXIS_PTS_X 1 FLOAT32_IEEE /* IndexIncr */ INDEX_INCR /* Addressing */ DIRECT /end RECORD_LAYOUT
/begin RECORD_LAYOUT RecordLayout_8 FNC_VALUES 1 SBYTE ROW_DIR DIRECT /end RECORD_LAYOUT
/begin RECORD_LAYOUT RecordLayout_9 FNC_VALUES 1 SLONG ROW_DIR DIRECT /end RECORD_LAYOUT
/*~~~~~~~~~ 6.3.31 COMPU_METHODs ~~~~~~~~~*/
/begin COMPU_METHOD CompuMethod_1 "" RAT_FUNC "%3.0" "" COEFFS 0 1 0 0 0 1 /end COMPU_METHOD
/begin COMPU_METHOD CompuMethod_2 "" RAT_FUNC "%6.2" "" COEFFS 0 1 0 0 0 1 /end COMPU_METHOD
/begin COMPU_METHOD CompuMethod_4 "" RAT_FUNC "%1.0" "bool" COEFFS 0 1 0 0 0 1 /end COMPU_METHOD
/begin COMPU_METHOD CompuMethod_5 "" TAB_VERB "%1.0" "" COMPU_TAB_REF CompuVtab_1 /end COMPU_METHOD
/begin COMPU_METHOD CompuMethod_7 "" RAT_FUNC "%6.2" "%" COEFFS 0 1 0 0 0 1 /end COMPU_METHOD
/begin COMPU_METHOD CompuMethod_8 "" TAB_VERB "%1.0" "" COMPU_TAB_REF CompuVtab_2 /end COMPU_METHOD
/begin COMPU_METHOD CompuMethod_9 "" RAT_FUNC "%5.0" "" COEFFS 0 1 0 0 0 1 /end COMPU_METHOD
/begin COMPU_METHOD CompuMethod_11 "" RAT_FUNC "%1.0" "" COEFFS 0 1 0 0 0 1 /end COMPU_METHOD
/begin COMPU_METHOD CompuMethod_14 "" RAT_FUNC "%6.2" "kPa Gauge" COEFFS 0 1 0 0 0 1 /end COMPU_METHOD
/begin COMPU_METHOD CompuMethod_15 "" RAT_FUNC "%6.2" "idx.frac" COEFFS 0 1 0 0 0 0.00195313 /end COMPU_METHOD
/begin COMPU_METHOD CompuMethod_16 "" RAT_FUNC "%6.2" "kPa" COEFFS 0 1 0 0 0 1 /end COMPU_METHOD
/begin COMPU_METHOD CompuMethod_17 "" RAT_FUNC "%5.0" "ADC" COEFFS 0 1 0 0 0 1 /end COMPU_METHOD
/begin COMPU_METHOD CompuMethod_18 "" RAT_FUNC "%6.2" "kpa" COEFFS 0 1 0 0 0 1 /end COMPU_METHOD
/begin COMPU_METHOD CompuMethod_19 "" RAT_FUNC "%6.2" "sec" COEFFS 0 1 0 0 0 1 /end COMPU_METHOD
/begin COMPU_METHOD CompuMethod_20 "" RAT_FUNC "%9.4" "kPa Gauge/ADC" COEFFS 0 1 0 0 0 1 /end COMPU_METHOD
/begin COMPU_METHOD CompuMethod_21 "" RAT_FUNC "%6.2" "ADC" COEFFS 0 1 0 0 0 1 /end COMPU_METHOD
/begin COMPU_METHOD CompuMethod_22 "" TAB_VERB "%5.0" "" COMPU_TAB_REF CompuVtab_4 /end COMPU_METHOD
/begin COMPU_METHOD CompuMethod_23 "" TAB_VERB "%3.0" "" COMPU_TAB_REF CompuVtab_5 /end COMPU_METHOD
/begin COMPU_METHOD CompuMethod_24 "" RAT_FUNC "%5.0" "RPM" COEFFS 0 1 0 0 0 1 /end COMPU_METHOD
/begin COMPU_METHOD CompuMethod_25 "" RAT_FUNC "%1.0" "Boolean" COEFFS 0 1 0 0 0 1 /end COMPU_METHOD
/begin COMPU_METHOD CompuMethod_26 "" RAT_FUNC "%3.0" "%" COEFFS 0 1 0 0 0 1 /end COMPU_METHOD
/begin COMPU_METHOD CompuMethod_27 "" RAT_FUNC "%6.2" "Seconds" COEFFS 0 1 0 0 0 1 /end COMPU_METHOD
/begin COMPU_METHOD CompuMethod_28 "" TAB_VERB "%1.0" "bool" COMPU_TAB_REF CompuVtab_2 /end COMPU_METHOD
/begin COMPU_METHOD CompuMethod_29 "" RAT_FUNC "%6.2" "g/s" COEFFS 0 1 0 0 0 1 /end COMPU_METHOD
/begin COMPU_METHOD CompuMethod_30 "" TAB_VERB "%6.2" "" COMPU_TAB_REF CompuVtab_6 /end COMPU_METHOD
/begin COMPU_METHOD CompuMethod_31 "" TAB_VERB "%1.0" "" COMPU_TAB_REF CompuVtab_7 /end COMPU_METHOD
/begin COMPU_METHOD CompuMethod_32 "" RAT_FUNC "%6.2" "mult" COEFFS 0 1 0 0 0 1 /end COMPU_METHOD
/begin COMPU_METHOD CompuMethod_33 "" RAT_FUNC "%6.2" "ADC Counts" COEFFS 0 1 0 0 0 1 /end COMPU_METHOD
/begin COMPU_METHOD CompuMethod_34 "" RAT_FUNC "%1.0" "boolean" COEFFS 0 1 0 0 0 1 /end COMPU_METHOD
/begin COMPU_METHOD CompuMethod_35 "" RAT_FUNC "%6.2" "Percent" COEFFS 0 1 0 0 0 1 /end COMPU_METHOD
/begin COMPU_METHOD CompuMethod_36 "" TAB_VERB "%1.0" "" COMPU_TAB_REF CompuVtab_8 /end COMPU_METHOD
/begin COMPU_METHOD CompuMethod_37 "" TAB_VERB "%3.0" "" COMPU_TAB_REF CompuVtab_2 /end COMPU_METHOD
/begin COMPU_METHOD CompuMethod_38 "" TAB_VERB "%3.0" "" COMPU_TAB_REF CompuVtab_8 /end COMPU_METHOD
/begin COMPU_METHOD CompuMethod_39 "" TAB_VERB "%1.0" "" COMPU_TAB_REF CompuVtab_9 /end COMPU_METHOD
/begin COMPU_METHOD CompuMethod_40 "" TAB_VERB "%1.0" "" COMPU_TAB_REF CompuVtab_10 /end COMPU_METHOD
/begin COMPU_METHOD CompuMethod_41 "" TAB_VERB "%1.0" "" COMPU_TAB_REF CompuVtab_11 /end COMPU_METHOD
/begin COMPU_METHOD CompuMethod_42 "" RAT_FUNC "%6.2" "EquivRatio" COEFFS 0 1 0 0 0 1 /end COMPU_METHOD
/begin COMPU_METHOD CompuMethod_43 "" RAT_FUNC "%9.4" "EquivRatio/ADC" COEFFS 0 1 0 0 0 1 /end COMPU_METHOD
/begin COMPU_METHOD CompuMethod_44 "" TAB_VERB "%3.0" "" COMPU_TAB_REF CompuVtab_12 /end COMPU_METHOD
/begin COMPU_METHOD CompuMethod_45 "" TAB_VERB "%1.0" "kPa" COMPU_TAB_REF CompuVtab_13 /end COMPU_METHOD
/begin COMPU_METHOD CompuMethod_46 "" RAT_FUNC "%6.2" "s" COEFFS 0 1 0 0 0 1 /end COMPU_METHOD
/begin COMPU_METHOD CompuMethod_47 "" TAB_VERB "%1.0" "" COMPU_TAB_REF CompuVtab_14 /end COMPU_METHOD
/begin COMPU_METHOD CompuMethod_48 "" RAT_FUNC "%5.4" "" COEFFS 0 1 0 0 0 1 /end COMPU_METHOD
/begin COMPU_METHOD CompuMethod_49 "" RAT_FUNC "%5.4" "mult" COEFFS 0 1 0 0 0 1 /end COMPU_METHOD
/begin COMPU_METHOD CompuMethod_50 "" RAT_FUNC "%7.2" "%" COEFFS 0 1 0 0 0 1 /end COMPU_METHOD
/begin COMPU_METHOD CompuMethod_51 "" RAT_FUNC "%6.2" "mJ" COEFFS 0 1 0 0 0 1 /end COMPU_METHOD
/begin COMPU_METHOD CompuMethod_52 "" TAB_VERB "%3.0" "" COMPU_TAB_REF CompuVtab_15 /end COMPU_METHOD
/begin COMPU_METHOD CompuMethod_53 "" RAT_FUNC "%4.0" "" COEFFS 0 1 0 0 0 1 /end COMPU_METHOD
/begin COMPU_METHOD CompuMethod_54 "" TAB_VERB "%3.0" "" COMPU_TAB_REF CompuVtab_16 /end COMPU_METHOD
/begin COMPU_METHOD CompuMethod_55 "" RAT_FUNC "%5.0" "degCA" COEFFS 0 1 0 0 0 0.0625 /end COMPU_METHOD
/begin COMPU_METHOD CompuMethod_56 "" RAT_FUNC "%8.0" "" COEFFS 0 1 0 0 0 1 /end COMPU_METHOD
/begin COMPU_METHOD CompuMethod_57 "" RAT_FUNC "%6.2" "degC" COEFFS 0 1 0 0 0 1 /end COMPU_METHOD
/begin COMPU_METHOD CompuMethod_58 "" TAB_VERB "%1.0" "" COMPU_TAB_REF CompuVtab_17 /end COMPU_METHOD
/begin COMPU_METHOD CompuMethod_59 "" TAB_VERB "%1.0" "" COMPU_TAB_REF CompuVtab_18 /end COMPU_METHOD
/begin COMPU_METHOD CompuMethod_60 "" TAB_VERB "%1.0" "" COMPU_TAB_REF CompuVtab_19 /end COMPU_METHOD
/begin COMPU_METHOD CompuMethod_61 "" TAB_VERB "%1.0" "" COMPU_TAB_REF CompuVtab_20 /end COMPU_METHOD
/begin COMPU_METHOD CompuMethod_62 "" RAT_FUNC "%6.2" "phi" COEFFS 0 1 0 0 0 1 /end COMPU_METHOD
/begin COMPU_METHOD CompuMethod_63 "" RAT_FUNC "%6.2" "Mult" COEFFS 0 1 0 0 0 1 /end COMPU_METHOD
/begin COMPU_METHOD CompuMethod_64 "" RAT_FUNC "%5.3" "ms" COEFFS 0 1 0 0 0 1 /end COMPU_METHOD
/begin COMPU_METHOD CompuMethod_65 "" RAT_FUNC "%6.2" "ms" COEFFS 0 1 0 0 0 1 /end COMPU_METHOD
/begin COMPU_METHOD CompuMethod_66 "" RAT_FUNC "%6.2" "degBTDC" COEFFS 0 1 0 0 0 1 /end COMPU_METHOD
/begin COMPU_METHOD CompuMethod_67 "" RAT_FUNC "%6.2" "%" COEFFS 0 1 0 0 0 0.0015259 /end COMPU_METHOD
/begin COMPU_METHOD CompuMethod_68 "" RAT_FUNC "%3.0" "" COEFFS 0 1 0 0 0 0.0015259 /end COMPU_METHOD
/begin COMPU_METHOD CompuMethod_69 "" RAT_FUNC "%8.0" "deg/tooth" COEFFS 0 1 0 0 0 1 /end COMPU_METHOD
/begin COMPU_METHOD CompuMethod_70 "" RAT_FUNC "%6.2" "mg/cyl" COEFFS 0 1 0 0 0 1 /end COMPU_METHOD
/begin COMPU_METHOD CompuMethod_71 "" RAT_FUNC "%6.2" "RPM" COEFFS 0 1 0 0 0 1 /end COMPU_METHOD
/begin COMPU_METHOD CompuMethod_72 "" RAT_FUNC "%6.2" "MJ" COEFFS 0 1 0 0 0 1 /end COMPU_METHOD
/begin COMPU_METHOD CompuMethod_73 "" RAT_FUNC "%6.2" "cm3" COEFFS 0 1 0 0 0 1 /end COMPU_METHOD
/begin COMPU_METHOD CompuMethod_74 "" RAT_FUNC "%6.2" "AFRatio" COEFFS 0 1 0 0 0 1 /end COMPU_METHOD
/begin COMPU_METHOD CompuMethod_75 "" RAT_FUNC "%6.2" "Ethanol%" COEFFS 0 1 0 0 0 1 /end COMPU_METHOD
/begin COMPU_METHOD CompuMethod_76 "" RAT_FUNC "%6.2" "F/A" COEFFS 0 1 0 0 0 1 /end COMPU_METHOD
/begin COMPU_METHOD CompuMethod_77 "" RAT_FUNC "%7.2" "ratio" COEFFS 0 1 0 0 0 1 /end COMPU_METHOD
/begin COMPU_METHOD CompuMethod_78 "" RAT_FUNC "%3.0" "kPa" COEFFS 0 1 0 0 0 1 /end COMPU_METHOD
/begin COMPU_METHOD CompuMethod_79 "" RAT_FUNC "%5.0" "degBTDC" COEFFS 0 1 0 0 0 1 /end COMPU_METHOD
/begin COMPU_METHOD CompuMethod_80 "" RAT_FUNC "%6.2" "C" COEFFS 0 1 0 0 0 1 /end COMPU_METHOD
/begin COMPU_METHOD CompuMethod_81 "" RAT_FUNC "%5.0" "ADC_counts" COEFFS 0 1 0 0 0 1 /end COMPU_METHOD
/begin COMPU_METHOD CompuMethod_82 "" TAB_VERB "%3.0" "" COMPU_TAB_REF CompuVtab_21 /end COMPU_METHOD
/begin COMPU_METHOD CompuMethod_83 "" TAB_VERB "%3.0" "" COMPU_TAB_REF CompuVtab_22 /end COMPU_METHOD
/begin COMPU_METHOD CompuMethod_84 "" TAB_VERB "%3.0" "" COMPU_TAB_REF CompuVtab_23 /end COMPU_METHOD
/begin COMPU_METHOD CompuMethod_85 "" TAB_VERB "%3.0" "" COMPU_TAB_REF CompuVtab_24 /end COMPU_METHOD
/begin COMPU_METHOD CompuMethod_86 "" RAT_FUNC "%3.0" "cyl#" COEFFS 0 1 -1 0 0 1 /end COMPU_METHOD
/begin COMPU_METHOD CompuMethod_87 "" RAT_FUNC "%6.2" "RPM/s" COEFFS 0 1 0 0 0 1 /end COMPU_METHOD
/begin COMPU_METHOD CompuMethod_88 "" RAT_FUNC "%6.2" "degCA" COEFFS 0 1 0 0 0 1 /end COMPU_METHOD
/begin COMPU_METHOD CompuMethod_89 "" RAT_FUNC "%8.3" "EquivRatio" COEFFS 0 1 0 0 0 1 /end COMPU_METHOD
/begin COMPU_METHOD CompuMethod_90 "" RAT_FUNC "%5.0" "us" COEFFS 0 1 0 0 0 1 /end COMPU_METHOD
/begin COMPU_METHOD CompuMethod_93 "" TAB_VERB "%5.0" "" COMPU_TAB_REF CompuVtab_27 /end COMPU_METHOD
/begin COMPU_METHOD CompuMethod_94 "" RAT_FUNC "%5.0" "mA" COEFFS 0 1 0 0 0 1 /end COMPU_METHOD
/begin COMPU_METHOD CompuMethod_95 "" RAT_FUNC "%5.3" "%" COEFFS 0 1 0 0 0 1 /end COMPU_METHOD
/begin COMPU_METHOD CompuMethod_96 "" RAT_FUNC "%5.3" "flag" COEFFS 0 1 0 0 0 1 /end COMPU_METHOD
/begin COMPU_METHOD CompuMethod_97 "" RAT_FUNC "%5.3" "s" COEFFS 0 1 0 0 0 1 /end COMPU_METHOD
/begin COMPU_METHOD CompuMethod_98 "" RAT_FUNC "%6.2" "Hz" COEFFS 0 1 0 0 0 1 /end COMPU_METHOD
/begin COMPU_METHOD CompuMethod_99 "" RAT_FUNC "%6.2" "mA" COEFFS 0 1 0 0 0 1 /end COMPU_METHOD
/begin COMPU_METHOD CompuMethod_102 "" RAT_FUNC "%6.2" "%/sec" COEFFS 0 1 0 0 0 1 /end COMPU_METHOD
/begin COMPU_METHOD CompuMethod_103 "" TAB_VERB "%1.0" "" COMPU_TAB_REF CompuVtab_29 /end COMPU_METHOD
/begin COMPU_METHOD CompuMethod_104 "" TAB_VERB "%1.0" "" COMPU_TAB_REF CompuVtab_30 /end COMPU_METHOD
/begin COMPU_METHOD CompuMethod_117 "" TAB_VERB "%3.0" "" COMPU_TAB_REF CompuVtab_38 /end COMPU_METHOD
/begin COMPU_METHOD CompuMethod_120 "" TAB_VERB "%5.0" "" COMPU_TAB_REF CompuVtab_39 /end COMPU_METHOD
/begin COMPU_METHOD CompuMethod_124 "" RAT_FUNC "%5.0" "ms" COEFFS 0 1 0 0 0 1 /end COMPU_METHOD
/begin COMPU_METHOD CompuMethod_126 "" TAB_VERB "%3.0" "" COMPU_TAB_REF CompuVtab_43 /end COMPU_METHOD
/begin COMPU_METHOD CompuMethod_128 "" TAB_VERB "%3.0" "" COMPU_TAB_REF CompuVtab_44 /end COMPU_METHOD
/begin COMPU_METHOD CompuMethod_135 "" RAT_FUNC "%5.0" "bytes" COEFFS 0 1 0 0 0 1 /end COMPU_METHOD
/begin COMPU_METHOD CompuMethod_136 "" TAB_VERB "%6.2" "" COMPU_TAB_REF CompuVtab_48 /end COMPU_METHOD
/begin COMPU_METHOD CompuMethod_137 "" TAB_VERB "%3.0" "" COMPU_TAB_REF CompuVtab_49 /end COMPU_METHOD
/begin COMPU_METHOD CompuMethod_149 "" TAB_VERB "%8.3" "bool" COMPU_TAB_REF CompuVtab_2 /end COMPU_METHOD
/begin COMPU_METHOD CompuMethod_151 "" TAB_VERB "%1.0" "" COMPU_TAB_REF CompuVtab_58 /end COMPU_METHOD
/begin COMPU_METHOD CompuMethod_155 "" TAB_VERB "%6.2" "" COMPU_TAB_REF CompuVtab_60 /end COMPU_METHOD
/begin COMPU_METHOD CompuMethod_157 "" TAB_VERB "%1.0" "" COMPU_TAB_REF CompuVtab_61 /end COMPU_METHOD
/begin COMPU_METHOD CompuMethod_163 "" RAT_FUNC "%3.0" "TDCs" COEFFS 0 1 0 0 0 1 /end COMPU_METHOD
/begin COMPU_METHOD CompuMethod_164 "" RAT_FUNC "%6.2" "Volts" COEFFS 0 1 0 0 0 1 /end COMPU_METHOD
/begin COMPU_METHOD CompuMethod_167 "" TAB_VERB "%1.0" "boolean" COMPU_TAB_REF CompuVtab_2 /end COMPU_METHOD
/begin COMPU_METHOD CompuMethod_171 "" RAT_FUNC "%2.0" "ISRs" COEFFS 0 1 0 0 0 1 /end COMPU_METHOD
/begin COMPU_METHOD CompuMethod_173 "" TAB_VERB "%1.0" "" COMPU_TAB_REF CompuVtab_68 /end COMPU_METHOD
/begin COMPU_METHOD CompuMethod_176 "" TAB_VERB "%1.0" "" COMPU_TAB_REF CompuVtab_70 /end COMPU_METHOD
/begin COMPU_METHOD CompuMethod_180 "" RAT_FUNC "%6.2" "MPH" COEFFS 0 1 0 0 0 1 /end COMPU_METHOD
/*~~~~~~~~~ 6.3.34 COMPU_VTABs ~~~~~~~~~*/
/begin COMPU_VTAB CompuVtab_1 "" TAB_VERB 2 0 "Pass-Through" 1 "Override" /end COMPU_VTAB
/begin COMPU_VTAB CompuVtab_2 "" TAB_VERB 2 0 "Disabled" 1 "Enabled" /end COMPU_VTAB
/begin COMPU_VTAB CompuVtab_4 "" TAB_VERB 26 -1 "(None)" 53 "ECUP" 54 "DRVP" 55 "XDRP" 56 "AN1M" 57 "AN2M" 58 "AN3M" 59 "AN4M" 60 "AN5M" 61 "AN6M" 62 "AN7M" 63 "AN8M" 64 "AN9M" 65 "AN10M" 66 "AN11M" 67 "AN12M" 68 "AN13M" 69 "AN14M" 70 "AN15M" 71 "AN16M" 72 "AN17M" 73 "AN18M" 74 "AN19M" 90 "O2A" 91 "O2B" 92 "XDRP_B" /end COMPU_VTAB
/begin COMPU_VTAB CompuVtab_5 "" TAB_VERB 2 0 "5V" 1 "2.7V" /end COMPU_VTAB
/begin COMPU_VTAB CompuVtab_6 "" TAB_VERB 90 0 "Normal Operation" 1 "Bad Resource ID" 2 "Hardware Not Supported" 3 "Behaviour Not Supported" 4 "Bad Attribute Data" 5 "Fail On Create" 6 "Fail On Set Attributes" 7 "Resource Not Created" 8 "Missing Attribute" 9 "Behaviour Method Not Supported" 10 "A Service Failed" 11 "Failed to destroy a resource" 12 "Resource Was Created" 13 "Resource Conflict" 14 "Invalid Encoder Type" 15 "2-Strike Not Supported" 16 "720degCA Pattern Not Supported" 17 "CAM Pattern Not Supported" 18 "Unknown CAM Pattern Supplied" 19 "Engine Speed Present" 20 "Hardware Interface Not Supported" 21 "Service Already Started" 22 "Register Write Failed to verify" 23 "Register access was denied" 24 "Out of free store memory" 25 "Software Q Overrun" 26 "Hardware Q Overrun" 27 "Feature unsupported in archive" 28 "Insufficient FW resource" 29 "OS Resource conflict" 30 "Driver Mode conflict" 31 "RTC time is illegal" 32 "FFS unmounted" 33 "Access from an ISR" 34 "FFS internal" 35 "Operation timed out" 36 "Task Kernel API Usage" 37 "Operation aborted" 38 "File not Found" 39 "Invalid characters in filename" 40 "Duplicate filename" 41 "Filename is too long" 42 "Dir not empty on remove" 43 "Dir not found" 44 "Dir name invalid" 45 "Dir exists" 46 "Dir too deep" 47 "Illegal Handle" 48 "End of File" 49 "Media Full" 50 "Media Write" 51 "Media Read" 52 "Media Write Protected" 53 "File Read Only" 54 "FS Media Changed" 55 "Internal USB" 56 "Voltage too high for USB IC" 57 "Encoder not created" 64 "TPU Chan Conflict" 65 "TPU Func Unavailable" 66 "TPU Config" 67 "TPU Primative Usage" 68 "TPU Primitive Count" 69 "TPU Restricted TPU channel" 70 "TPU Not Created" 71 "TPU Self Modify constant write err" 72 "TPU Error 0x48" 73 "TPU Error 0x49" 74 "TPU Error 0x4A" 75 "TPU Error 0x4B" 76 "TPU Error 0x4C" 77 "TPU Error 0x4D" 78 "TPU Error 0x4E" 79 "TPU Error 0x4F" 80 "TPU Error 0x50" 81 "TPU Error 0x51" 82 "TPU Error 0x52" 83 "TPU Error 0x53" 84 "TPU Error 0x54" 85 "TPU Error 0x55" 86 "TPU Error 0x56" 87 "TPU Error 0x57" 88 "TPU Error 0x58" 89 "TPU Error 0x59" 90 "TPU Error 0x5A" 91 "TPU Error 0x5B" 92 "TPU Error 0x5C" 93 "TPU Error 0x5D" 94 "TPU Error 0x5E" 95 "TPU Error 0x5F" /end COMPU_VTAB
/begin COMPU_VTAB CompuVtab_7 "" TAB_VERB 2 0 "ETC" 1 "IAC" /end COMPU_VTAB
/begin COMPU_VTAB CompuVtab_8 "" TAB_VERB 4 0 "Before Model Initialize" 1 "After Model Init - Before STARTUP Event" 2 "After STARTUP Event - Before Run" 3 "Run" /end COMPU_VTAB
/begin COMPU_VTAB CompuVtab_9 "" TAB_VERB 4 0 "Initializing" 1 "Run" 2 "Pause" 3 "Stop" /end COMPU_VTAB
/begin COMPU_VTAB CompuVtab_10 "" TAB_VERB 9 0 "Running normally" 1 "Requested by user" 2 "Foreground stack margin violation" 3 "Background stack margin violation" 4 "Idle stack margin violation" 5 "Interrupt stack margin violation" 6 "Heap margin violation" 7 "Idle CPU margin violation" 8 "OS error detected" /end COMPU_VTAB
/begin COMPU_VTAB CompuVtab_11 "" TAB_VERB 9 0 "-" 1 "-" 2 "Application Monitor" 3 "Application Monitor" 4 "Application Monitor" 5 "Application Monitor" 6 "Application Monitor" 7 "Application Monitor" 8 "Application Monitor" /end COMPU_VTAB
/begin COMPU_VTAB CompuVtab_12 "" TAB_VERB 21 0 "Reset" 1 "WarmingUp" 2 " Stabilizing" 3 "ReadingNerstPumpImpedance" 4 "Equalizing" 5 "ReadingRcalValue" 6 "Run" 7 "Overheat" 8 "Overcool" 9 "HeaterShortCircuit" 10 "HeaterOpenCircuit" 11 "StartFreeAirCal" 12 "PerformingFreeAirCal" 13 "DetectingSensor" 14 "ReadingJunctionImpedance" 15 "EvapStartup" 16 "DeterminingSensorType" 17 "PreparingToRun" 18 "SaveSensor" 19 "NeedsNewFreeAirCal" 20 "Error" /end COMPU_VTAB
/begin COMPU_VTAB CompuVtab_13 "" TAB_VERB 2 0 "Unlocked" 1 "Locked" /end COMPU_VTAB
/begin COMPU_VTAB CompuVtab_14 "" TAB_VERB 2 0 "Not Enabled" 1 "Enabled" /end COMPU_VTAB
/begin COMPU_VTAB CompuVtab_15 "" TAB_VERB 11 0 "None Late" 1 "720 Late" 2 "360 Late" 4 "180 Late" 6 "360, 180 Late" 8 "120 Late" 16 "90 Late" 32 "60 Late" 64 "30 Late" 128 "HIRES Late" 192 "HIRES, 30 Late" /end COMPU_VTAB
/begin COMPU_VTAB CompuVtab_16 "" TAB_VERB 8 0 "None Late" 1 "x1 Late" 2 "x2 Late" 3 "x1, x2 Late" 4 "x10 Late" 5 "x1, x10 Late" 6 "x2, x10 Late" 7 "x1, 2, 10 Late" /end COMPU_VTAB
/begin COMPU_VTAB CompuVtab_17 "" TAB_VERB 2 0 "Calibration Locked" 1 "Calibration Unlocked" /end COMPU_VTAB
/begin COMPU_VTAB CompuVtab_18 "" TAB_VERB 2 0 "Data Acquisition Locked" 1 "Data Acquisition Unlocked" /end COMPU_VTAB
/begin COMPU_VTAB CompuVtab_19 "" TAB_VERB 2 0 "Programming Locked" 1 "Programming Unlocked" /end COMPU_VTAB
/begin COMPU_VTAB CompuVtab_20 "" TAB_VERB 2 0 "Not Connected" 1 "Connected" /end COMPU_VTAB
/begin COMPU_VTAB CompuVtab_21 "" TAB_VERB 2 0 "Weak Pullup" 1 "Strong Pullup" /end COMPU_VTAB
/begin COMPU_VTAB CompuVtab_22 "" TAB_VERB 2 0 "Rising Edge" 1 "Falling Edge" /end COMPU_VTAB
/begin COMPU_VTAB CompuVtab_23 "" TAB_VERB 6 0 "No Fault" 1 "Crank Sync Fault" 2 "Reverse Rotation Fault" 3 "No Crank Edges Fault" 4 "No CAM edges fault" 5 "Cam Sync Fault" /end COMPU_VTAB
/begin COMPU_VTAB CompuVtab_24 "" TAB_VERB 5 0 "zero" 1 "ZERO_SPEED" 2 "POSN_UNKNOWN" 3 "ENC_SYNC_CAM_UNKNOWN" 4 "ENC_SYNC_CAM_SYNC" /end COMPU_VTAB
/begin COMPU_VTAB CompuVtab_27 "" TAB_VERB 26 -1 "(None)" 56 "AN1M" 57 "AN2M" 58 "AN3M" 59 "AN4M" 60 "AN5M" 61 "AN6M" 62 "AN7M" 63 "AN8M" 64 "AN9M" 65 "AN10M" 66 "AN11M" 67 "AN12M" 68 "AN13M" 69 "AN14M" 70 "AN15M" 71 "AN16M" 72 "AN17M" 73 "AN18M" 74 "AN19M" 90 "O2A" 91 "O2B" 93 "DG1M" 94 "DG2M" 96 "DG4M" 97 "ESTOP" /end COMPU_VTAB
/begin COMPU_VTAB CompuVtab_29 "" TAB_VERB 2 0 "Decreasing" 1 "Increasing" /end COMPU_VTAB
/begin COMPU_VTAB CompuVtab_30 "" TAB_VERB 2 0 "PWM" 1 "OnOff" /end COMPU_VTAB
/begin COMPU_VTAB CompuVtab_38 "" TAB_VERB 3 0 "NotReady" 1 "Ready" 2 "Completed" /end COMPU_VTAB
/begin COMPU_VTAB CompuVtab_39 "" TAB_VERB 5 -1 "(None)" 93 "DG1M" 94 "DG2M" 96 "DG4M" 100 "CNK" /end COMPU_VTAB
/begin COMPU_VTAB CompuVtab_43 "" TAB_VERB 2 0 "2-Wire" 1 "3-Wire" /end COMPU_VTAB
/begin COMPU_VTAB CompuVtab_44 "" TAB_VERB 4 0 "Unknown" 1 "Flaring" 2 "OnIdle" 3 "OffIdle" /end COMPU_VTAB
/begin COMPU_VTAB CompuVtab_48 "" TAB_VERB 74 0 "NO_OS_ERROR" 1 "PROSAK_TPU_ALLOCATE" 2 "PROSAK_DEADLOCK_PROT" 3 "QSPI_SEND_SIZE_ZERO" 4 "QSPI_SEND_SIZE_TOO_BIG" 5 "QSPI_RD_SIZE_TOO_BIG" 6 "QSPI_RD_SIZE_ZERO" 7 "QSPI_WR_SIZE_TOO_BIG" 8 "QSPI_WR_SIZE_ZERO" 9 "QSPI_CMD_SIZE_TOO_BIG" 10 "QSPI_CMD_SIZE_ZERO" 11 "IGN_DIAG_MDA_ALLOCATE" 12 "EEDataDirSizeMisMatch" 13 "EE_WRITE_QUEUE_OVFLOW" 14 "ESC_HBRIDGE_MDA_ALLOCATE" 15 "ETC_DIAG_MDA_ALLOCATE" 16 "DFLT_ENCODER_CREATE_ERR" 17 "ADC_TPU_ALLOCATE" 18 "SWISR_QUEUE_OVERFLOW" 19 "WATCHDOG_RESET" 20 "CHECKSTOP_RESET" 21 "SPIEE_WR_STAT_REG_ERR" 22 "SPIEE_QUEUE_OVFL_STATUS" 23 "SPIEE_WRITE_FAIL_ERR" 24 "Requested TPU Func not in mask" 25 "Unable to allocate QSPI knock" 26 "Stack has overflowed!" 27 "TPU Limits not setup" 28 "INVALID TPU MASK" 29 "TPU Mask Corrupt" 30 "Sequence Create with No Encoder" 31 "Illegal Sequence ISR" 32 "TPU Mask Version is insufficient" 33 "MUX PSP requested for 2-Stroke" 34 "Ext Flash Acc Denied" 35 "Ext Flash Erase Fail" 36 "Ext Flash Write Fail" 37 "Ext Flash Allign Error" 38 "EXT_FLASH_WR_ZERO_SIZE" 39 "Illegal Ext Flash Addr" 40 "Error: Write to non-existent Flash" 41 "Too many Logs want to be active" 42 "Bank Seq Destroy Problem" 43 "Transient Seq Destroy Problem" 44 "Transient Seq Update Problem" 45 "SPIEE System had a memory problem" 46 "Spent too long waiting for a sync return" 47 "TPUC Mask does not pair with TPUA/B mask" 48 "The Module Configuration was not available" 49 "Diagnostic Mux did not create" 50 "FGND Angle event queue overflow" 51 "FGND Time event queue overflow" 52 "EEPROM write to CAMDelay failed" 53 "SleepTask call from in ISR" 54 "Bad Kernel API call detected" 55 "Kernel Internal" 56 "SPIEE Device create" 57 "NAND Flash timeout on Write" 58 "NAND Flash timeout on Erase" 59 "NAND Flash WP" 60 "NAND Flash RDY/BUSYb" 61 "NAND Flash Access" 62 "NAND Flash Device" 63 "USB Core Stack Initialisation" 64 "USB Stack Assert" 65 "EXT_EE_ACCESS" 66 "VARCAM_PATTERN_SETUP" 67 "FP Divide by Zero" 68 "Unable to allocate requested memory on heap" 69 "Unable create Fgnd Angle task" 70 "FP Denormalized number" 71 "RPMVector Buffers Full" 72 "RPMVector Overrun" 73 "Failed to Write TPU Self Modify Parameter" /end COMPU_VTAB
/begin COMPU_VTAB CompuVtab_49 "" TAB_VERB 2 0 "Model from MAP" 1 "Use MAF sensor directly" /end COMPU_VTAB
/begin COMPU_VTAB CompuVtab_58 "" TAB_VERB 2 0 "Open-Loop" 1 "Closed-Loop" /end COMPU_VTAB
/begin COMPU_VTAB CompuVtab_60 "" TAB_VERB 2 0 "Abnormal Operation!" 1 "Operating Normally" /end COMPU_VTAB
/begin COMPU_VTAB CompuVtab_61 "" TAB_VERB 2 0 "Run" 1 "Reboot" /end COMPU_VTAB
/begin COMPU_VTAB CompuVtab_68 "" TAB_VERB 2 0 "APP1" 1 "NORMAL" /end COMPU_VTAB
/begin COMPU_VTAB CompuVtab_70 "" TAB_VERB 2 0 "Not adapting" 1 "Adapting" /end COMPU_VTAB
/begin FUNCTION ACPres_Config ""
 /begin DEF_CHARACTERISTIC ACPresDfltValue ACPresFilterConst ACPresGain ACPresInputHiFltPos ACPresInputLoFltPos ACPresOfst /end DEF_CHARACTERISTIC
/end FUNCTION
/begin FUNCTION FAN_Control ""
 /begin DEF_CHARACTERISTIC ACPresFanOff ACPresFanOn ACPresFanSpeed_StallTbl ACSwFanSpeed_Stall ECTFanOff ECTFanOn ECTFanSpeed_StallTbl FAN_Mode Fan1ACPres Fan1ACSw Fan1ECT Fan1IAT Fan2ACPres Fan2ACSw Fan2ECT Fan2IAT IATFanOff IATFanOn IATFanSpeed_StallTbl /end DEF_CHARACTERISTIC
 /begin OUT_MEASUREMENT ACPresFanSpeed_Stall ECTFanSpeed_Stall IATFanSpeed_Stall /end OUT_MEASUREMENT
/end FUNCTION
/begin FUNCTION Stall "" /begin SUB_FUNCTION FAN_Control Fuel_Pump_at_Startup Stall_Throttle /end SUB_FUNCTION /end FUNCTION
/begin FUNCTION FAN_Control_1 ""
 /begin DEF_CHARACTERISTIC ACPresFanSpeedMap ACSwFanSpeed ECTFanSpeedMap IATFanSpeedMap /end DEF_CHARACTERISTIC
 /begin OUT_MEASUREMENT ACPresFanSpeed ECTFanSpeed Fan1Cmd Fan2Cmd IATFanSpeed /end OUT_MEASUREMENT
/end FUNCTION
/begin FUNCTION Inputs_Config ""
 /begin DEF_CHARACTERISTIC ACPresPin ACPresPin_ref ACSwPin ACSwPin_ref APP1AnalogInput APP1AnalogInput_ref APP2AnalogInput APP2AnalogInput_ref ECTSensorPin ECTSensorPin_ref ESTOPPin EVAPSensorPin EVAPSensorPin_ref FuelLvlSensorPin FuelLvlSensorPin_ref FuelPresPin FuelPresPin_ref FuelSensorPin IATSensorPin IATSensorPin_ref MAF_Pin MAPSensorPin MAPSensorPin_ref OilPresPin OilPresPin_ref SensVoltSensorPin SensVoltSensorPin_ref SysVoltage SysVoltage_ref TPS1AnalogInput TPS1AnalogInput_ref TPS2AnalogInput TPS2AnalogInput_ref VSPD_Pin /end DEF_CHARACTERISTIC
/end FUNCTION
/begin FUNCTION ACSw "" /begin OUT_MEASUREMENT ACSw ACSw_Raw /end OUT_MEASUREMENT /begin SUB_FUNCTION ACSw_Override ACSw_Config /end SUB_FUNCTION /end FUNCTION
/begin FUNCTION Digital "" /begin DEF_CHARACTERISTIC Placeholder_ClutchSw Placeholder_Scramble /end DEF_CHARACTERISTIC /begin SUB_FUNCTION ACSw ESTOP MAF VSPD_Filt VSPD /end SUB_FUNCTION /end FUNCTION
/begin FUNCTION ACSw_Override "" /begin DEF_CHARACTERISTIC ACSw_new ACSw_ovr /end DEF_CHARACTERISTIC /end FUNCTION
/begin FUNCTION ACSw_Config "" /begin DEF_CHARACTERISTIC ACSwPolarity ACSwSwitchPt /end DEF_CHARACTERISTIC /end FUNCTION
/begin FUNCTION O2_Fuel_Adapt ""
 /begin DEF_CHARACTERISTIC AdaptEnable FuelAdaptDelta FuelAdaptEnable FuelAdaptGain_BankATbl FuelAdaptGain_BankBTbl FuelFlowCompAdapt_BankAMap FuelFlowCompAdapt_BankBMap FuelFlowCompMap /end DEF_CHARACTERISTIC
 /begin OUT_MEASUREMENT FuelAdapt_Error_BankA FuelAdapt_Error_BankB FuelAdaptEnabled FuelAdaptGain_BankA FuelAdaptGain_BankB FuelFlowComp FuelFlowCompAdapt_BankA FuelFlowCompAdapt_BankB O2ITerm_BankAIdx O2ITerm_BankAIn O2ITerm_BankBIdx O2ITerm_BankBIn /end OUT_MEASUREMENT
 /begin SUB_FUNCTION Saturation__Tunable__1 Saturation__Tunable_1 Adapt_FuelFlowComp_Map_Bank_B Adapt_FuelFlowComp_Map_Bank_A O2_Control_Enable_Delay WarmUp_Disable /end SUB_FUNCTION
/end FUNCTION
/begin FUNCTION Fuel_System_Manager "" /begin SUB_FUNCTION O2_Fuel_Adapt Fuel_Calculation Injector_Manager /end SUB_FUNCTION /end FUNCTION
/begin FUNCTION Fuel_Calculation ""
 /begin OUT_MEASUREMENT AdjustedPerCylFuelRate GlobalBaseFuelRate PerCylBaseFuelRate /end OUT_MEASUREMENT
 /begin SUB_FUNCTION Calculate_Fuel_Flow /end SUB_FUNCTION
/end FUNCTION
/begin FUNCTION AnalogIn ""
 /begin OUT_MEASUREMENT ain_create_ACPresPin ain_create_ACSwPin ain_create_APP1AnalogInput ain_create_APP2AnalogInput ain_create_ECTSensorPin ain_create_ECUP ain_create_EVAPSensorPin ain_create_FuelLvlSensorPin ain_create_FuelPresPin ain_create_IATSensorPin ain_create_MAPSensorPin ain_create_OilPresPin ain_create_SensVoltSensorPin ain_create_SysVoltage ain_create_TPS1AnalogInput ain_create_TPS2AnalogInput ain_read_ACPresPin ain_read_ACSwPin ain_read_APP1AnalogInput ain_read_APP2AnalogInput ain_read_ECTSensorPin ain_read_ECUP ain_read_EVAPSensorPin ain_read_FuelLvlSensorPin ain_read_FuelPresPin ain_read_IATSensorPin ain_read_MAPSensorPin ain_read_OilPresPin ain_read_SensVoltSensorPin ain_read_SysVoltage ain_read_TPS1AnalogInput ain_read_TPS2AnalogInput /end OUT_MEASUREMENT
/end FUNCTION
/begin FUNCTION Resources ""
 /begin SUB_FUNCTION AnalogIn CAN_1 DigitalInput DiscreteOut Encoder SequenceOut FrequencyIn PWM Other /end SUB_FUNCTION
/end FUNCTION
/begin FUNCTION Debug ""
 /begin SUB_FUNCTION Resources Application_Monitor Application_Monitor_Config Event_Pause_Counters General /end SUB_FUNCTION
/end FUNCTION
/begin FUNCTION AirFlow_Manager ""
 /begin DEF_CHARACTERISTIC AirControlSource IACTypeCal MaxETCSetPtLimitTbl MinETCSetPtLimitTbl ThrottleSource /end DEF_CHARACTERISTIC
 /begin OUT_MEASUREMENT ETCRequestFinal MaxETCSetPtLimit MinETCSetPtLimit /end OUT_MEASUREMENT
/end FUNCTION
/begin FUNCTION AirFlow "" /begin DEF_CHARACTERISTIC AirflowDiag_MAPIRDiagEnable AirflowMimatchThreshMap /end DEF_CHARACTERISTIC /begin OUT_MEASUREMENT AirflowMimatchThresh /end OUT_MEASUREMENT /end FUNCTION
/begin FUNCTION PID_Gain_Select1 ""
 /begin DEF_CHARACTERISTIC AirMinGovDGain AirMinGovDGainErrorMultTbl AirMinGovIGain AirMinGovIGainErrorMultTbl AirMinGovPGain AirMinGovPGainErrorMultTbl /end DEF_CHARACTERISTIC
 /begin OUT_MEASUREMENT AirMinGovDGainErrorMult AirMinGovIGainErrorMult AirMinGovPGainErrorMult /end OUT_MEASUREMENT
/end FUNCTION
/begin FUNCTION Universal_PID__Tunable___Scheduled_ ""
 /begin OUT_MEASUREMENT AirMinGovDTerm AirMinGovError AirMinGovITerm AirMinGovPTerm AirMinGovSpeedErrorIdx AirMinGovSpeedErrorIn /end OUT_MEASUREMENT
 /begin SUB_FUNCTION PID_Gain_Select1 /end SUB_FUNCTION
/end FUNCTION
/begin FUNCTION Air_PID_Config ""
 /begin DEF_CHARACTERISTIC AirMinGovErrorGain AirMinGovITermLowerLimit AirMinGovITermUpperLimit AirMinGovPIDOutLowerLimit AirMinGovPIDOutUpperLimit /end DEF_CHARACTERISTIC
/end FUNCTION
/begin FUNCTION Dash_Message_DBW "" /begin DEF_CHARACTERISTIC APP_Filt ETCReq_Filt /end DEF_CHARACTERISTIC /end FUNCTION
/begin FUNCTION AEM_Infinity_Dash ""
 /begin SUB_FUNCTION Dash_Message_DBW Dash_Message_2 Dash_Message_6 Dash_Message_3 Dash_Message_1 /end SUB_FUNCTION
/end FUNCTION
/begin FUNCTION Virtual_Indexes ""
 /begin OUT_MEASUREMENT App05Idx App05In RPMAccel17Idx RPMAccel17In TimeSinceRun09Idx TimeSinceRun09In /end OUT_MEASUREMENT
 /begin SUB_FUNCTION ECT_KeyUp IAT_KeyUp MAFPortIndex /end SUB_FUNCTION
/end FUNCTION
/begin FUNCTION APP1_Adapt_Override "" /begin DEF_CHARACTERISTIC APP1_Adapt_new APP1_Adapt_ovr /end DEF_CHARACTERISTIC /end FUNCTION
/begin FUNCTION APP1_Adapt ""
 /begin OUT_MEASUREMENT APP1_AdaptAdapt_Hi APP1_AdaptAdapt_Low APP1_AdaptADC APP1_AdaptPercent APP1_AdaptPercentRaw /end OUT_MEASUREMENT
 /begin SUB_FUNCTION APP1_Adapt_Override APP1_Adapt_Config /end SUB_FUNCTION
/end FUNCTION
/begin FUNCTION PotentiometerSensors ""
 /begin SUB_FUNCTION APP1_Adapt APP1ForcedAdapt APP2_Adapt APP2ForcedAdapt TPS1 TPS2 /end SUB_FUNCTION
/end FUNCTION
/begin FUNCTION APP1_Adapt_Config ""
 /begin DEF_CHARACTERISTIC APP1_AdaptAdapt_Delta APP1_AdaptAdapt_Hi_Max APP1_AdaptAdapt_Hi_Min APP1_AdaptAdapt_Low_Max APP1_AdaptAdapt_Low_Min APP1_AdaptAdaptHiEnable APP1_AdaptAdaptLoEnable APP1_AdaptDfltValue APP1_AdaptFilterConst APP1_AdaptInputHiFltPos APP1_AdaptInputLoFltPos APP1_AdaptMaxLimit APP1_AdaptRev_Polarity /end DEF_CHARACTERISTIC
/end FUNCTION
/begin FUNCTION Function_Call_Subsystem "" /begin DEF_CHARACTERISTIC APP1_AlwaysAdapt /end DEF_CHARACTERISTIC /end FUNCTION
/begin FUNCTION APP1ForcedAdapt "" /begin DEF_CHARACTERISTIC APP1HiAdaptADCThresh APP1LowAdaptADCThresh /end DEF_CHARACTERISTIC /begin SUB_FUNCTION Function_Call_Subsystem /end SUB_FUNCTION /end FUNCTION
/begin FUNCTION APP__Sensor_Arbitration1 "" /begin DEF_CHARACTERISTIC APP1_APP2_Max_Deviation /end DEF_CHARACTERISTIC /end FUNCTION
/begin FUNCTION RawProcessed "" /begin OUT_MEASUREMENT APPPcnt ECT_KeyUp /end OUT_MEASUREMENT
 /begin SUB_FUNCTION APP__Sensor_Arbitration1 Base_TPS_Request EngineState Capture_ECT_At_Startup Engine_Accel Gear_Estimator Fuel_Delta_Pressure_Calculation Capture_IAT_At_Startup O2_De_lag CutThrottle_APP_Limiting Time_Since_Key_On Time_Since_Run Time_Since_Stall TPS__Sensor_Arbitration VSPD_Selector /end SUB_FUNCTION
/end FUNCTION
/begin FUNCTION Base_TPS_Request ""
 /begin DEF_CHARACTERISTIC ETCReqDecFiltC ETCReqFallRateTbl ETCReqIncFiltC ETCReqRiseRateTbl ETCRequestMap /end DEF_CHARACTERISTIC
 /begin OUT_MEASUREMENT APP17Idx APP17In ETCReqFallRate ETCReqFilterConst ETCReqRiseRate ETCRequest ETCRequestDirection FilteredETCRequest /end OUT_MEASUREMENT
/end FUNCTION
/begin FUNCTION APP2_Adapt_Override "" /begin DEF_CHARACTERISTIC APP2_Adapt_new APP2_Adapt_ovr /end DEF_CHARACTERISTIC /end FUNCTION
/begin FUNCTION APP2_Adapt ""
 /begin OUT_MEASUREMENT APP2_AdaptAdapt_Hi APP2_AdaptAdapt_Low APP2_AdaptADC APP2_AdaptPercent APP2_AdaptPercentRaw /end OUT_MEASUREMENT
 /begin SUB_FUNCTION APP2_Adapt_Override APP2_Adapt_Config /end SUB_FUNCTION
/end FUNCTION
/begin FUNCTION APP2_Adapt_Config ""
 /begin DEF_CHARACTERISTIC APP2_AdaptAdapt_Delta APP2_AdaptAdapt_Hi_Max APP2_AdaptAdapt_Hi_Min APP2_AdaptAdapt_Low_Max APP2_AdaptAdapt_Low_Min APP2_AdaptAdaptHiEnable APP2_AdaptAdaptLoEnable APP2_AdaptDfltValue APP2_AdaptFilterConst APP2_AdaptInputHiFltPos APP2_AdaptInputLoFltPos APP2_AdaptMaxLimit APP2_AdaptRev_Polarity /end DEF_CHARACTERISTIC
/end FUNCTION
/begin FUNCTION Function_Call_Subsystem_1 "" /begin DEF_CHARACTERISTIC APP2_AlwaysAdapt /end DEF_CHARACTERISTIC /end FUNCTION
/begin FUNCTION APP2ForcedAdapt "" /begin DEF_CHARACTERISTIC APP2HiAdaptADCThresh APP2LowAdaptADCThresh /end DEF_CHARACTERISTIC /begin SUB_FUNCTION Function_Call_Subsystem_1 /end SUB_FUNCTION /end FUNCTION
/begin FUNCTION Application_Monitor "" /begin DEF_CHARACTERISTIC ApplicationStatus /end DEF_CHARACTERISTIC
 /begin OUT_MEASUREMENT ApplicationInitStatus ApplicationStopReason ApplicationStopReasonBlock /end OUT_MEASUREMENT
/end FUNCTION
/begin FUNCTION Application_Monitor_Config ""
 /begin DEF_CHARACTERISTIC ApplicationMonitorEnable ApplicationPausePoint BgndStackMargin CPUMargin FgndAngleStackMargin FgndTimeStackMargin HeapMargin IdleStackMargin InterruptStackMargin /end DEF_CHARACTERISTIC
/end FUNCTION
/begin FUNCTION AEM_X_Lambda "" /begin DEF_CHARACTERISTIC BankB_Avg_Enable Lambda_1_Timeout Lambda_2_Timeout /end DEF_CHARACTERISTIC
 /begin OUT_MEASUREMENT Bank1_DataValidState_Prb Bank1_HeaterVolts_Prb Bank1_Lambda_Prb Bank1_OxygenConcentration_Prb Bank1_SensorDetectedStatus_Prb Bank1_SensorFaultState_Prb Bank1_SensorStatus_Prb Bank1_SystemVolts_Prb Bank1_UsingFreeAreCalState_Prb Bank2_DataValidState_Prb Bank2_HeaterVolts_Prb Bank2_Lambda_Prb Bank2_OxygenConcentration_Prb Bank2_SensorDetectedStatus_Prb Bank2_SensorFaultState_Prb Bank2_SensorStatus_Prb Bank2_SystemVolts_Prb Bank2_UsingFreeAreCalState_Prb O2_BankA_EquivRatio_Out /end OUT_MEASUREMENT
 /begin SUB_FUNCTION Bank1_EquivRatio Bank2_EquivRatio /end SUB_FUNCTION
/end FUNCTION
/begin FUNCTION CAN "" /begin SUB_FUNCTION AEM_X_Lambda AEM_GPS /end SUB_FUNCTION /end FUNCTION
/begin FUNCTION Bank1_EquivRatio "" /begin OUT_MEASUREMENT Bank1_EquivRatio Bank1_EquivRatioADC Bank1_EquivRatioRaw /end OUT_MEASUREMENT /begin SUB_FUNCTION Bank1_EquivRatio_Override Bank1_EquivRatio_Config /end SUB_FUNCTION /end FUNCTION
/begin FUNCTION Bank1_EquivRatio_Override "" /begin DEF_CHARACTERISTIC Bank1_EquivRatio_new Bank1_EquivRatio_ovr /end DEF_CHARACTERISTIC /end FUNCTION
/begin FUNCTION Bank1_EquivRatio_Config ""
 /begin DEF_CHARACTERISTIC Bank1_EquivRatioDfltValue Bank1_EquivRatioFilterConst Bank1_EquivRatioGain Bank1_EquivRatioInputHiFltPos Bank1_EquivRatioInputLoFltPos Bank1_EquivRatioOfst /end DEF_CHARACTERISTIC
/end FUNCTION
/begin FUNCTION Bank2_EquivRatio "" /begin OUT_MEASUREMENT Bank2_EquivRatio Bank2_EquivRatioADC Bank2_EquivRatioRaw /end OUT_MEASUREMENT /begin SUB_FUNCTION Bank2_EquivRatio_Override Bank2_EquivRatio_Config /end SUB_FUNCTION /end FUNCTION
/begin FUNCTION Bank2_EquivRatio_Override "" /begin DEF_CHARACTERISTIC Bank2_EquivRatio_new Bank2_EquivRatio_ovr /end DEF_CHARACTERISTIC /end FUNCTION
/begin FUNCTION Bank2_EquivRatio_Config ""
 /begin DEF_CHARACTERISTIC Bank2_EquivRatioDfltValue Bank2_EquivRatioFilterConst Bank2_EquivRatioGain Bank2_EquivRatioInputHiFltPos Bank2_EquivRatioInputLoFltPos Bank2_EquivRatioOfst /end DEF_CHARACTERISTIC
/end FUNCTION
/begin FUNCTION O2Disable "" /begin DEF_CHARACTERISTIC BankB_Enbl /end DEF_CHARACTERISTIC /begin OUT_MEASUREMENT O2FaultDisable /end OUT_MEASUREMENT /end FUNCTION
/begin FUNCTION O2_Control ""
 /begin SUB_FUNCTION O2Disable O2_Control_State_Determination O2_PID_Calibrations O2_PID_Controller_Bank_A O2_PID_Controller_Bank_B Map_O2_Sensors_to_V8_Cylinders O2Arb /end SUB_FUNCTION
/end FUNCTION
/begin FUNCTION AirCalcs "" /begin DEF_CHARACTERISTIC BaroRunStallDelay /end DEF_CHARACTERISTIC /begin OUT_MEASUREMENT BARO BaroDelayTime /end OUT_MEASUREMENT
 /begin SUB_FUNCTION Capture_Signal_At_Startup BARO_Override Speed_Density___MAP_Referenced___Adaptive Running_Baro_Learn /end SUB_FUNCTION
/end FUNCTION
/begin FUNCTION Capture_Signal_At_Startup "" /begin DEF_CHARACTERISTIC BARO_Count /end DEF_CHARACTERISTIC /end FUNCTION
/begin FUNCTION BARO_Override "" /begin DEF_CHARACTERISTIC BARO_offset BARO_ovr /end DEF_CHARACTERISTIC /end FUNCTION
/begin FUNCTION Speed_Density___MAP_Referenced___Adaptive ""
 /begin DEF_CHARACTERISTIC CombEventsPerRev CylSweptVol MAF_Source VEAdaptEnable VEAdaptTemp VEAdaptTime VEBaroCorrTbl VETempCorrMap VolEffAdaptMap VolEffMap /end DEF_CHARACTERISTIC
 /begin OUT_MEASUREMENT BARO09Idx MAFFinal VEAdaptAmnt VEAdapting VEBaroCorr VEFin VEIdealMAF VEMapIdx VEMapIn VEModelMAF VETempCorr VolEff VolEffAdapt /end OUT_MEASUREMENT
 /begin SUB_FUNCTION Adapt_VolEff_Map VE_Adapt_Source /end SUB_FUNCTION
/end FUNCTION
/begin FUNCTION Running_Baro_Learn "" /begin DEF_CHARACTERISTIC BaroLearn_MAP BaroLearn_Tm BaroLearn_TPSPos /end DEF_CHARACTERISTIC /end FUNCTION
/begin FUNCTION Idle_Control_Enable_Delay "" /begin DEF_CHARACTERISTIC BaseAirflowAdaptDelayTime /end DEF_CHARACTERISTIC /end FUNCTION
/begin FUNCTION Base_Airflow_Table_Adapt ""
 /begin DEF_CHARACTERISTIC BaseAirflowAdaptDelta BaseAirflowAdaptEnable BaseAirflowAdaptGain /end DEF_CHARACTERISTIC
 /begin OUT_MEASUREMENT BaseAirflowAdaptEnabled /end OUT_MEASUREMENT
 /begin SUB_FUNCTION Idle_Control_Enable_Delay Saturation__Tunable_ Adapt_Base_Airflow_Table /end SUB_FUNCTION
/end FUNCTION
/begin FUNCTION Saturation__Tunable_ "" /begin DEF_CHARACTERISTIC BaseAirflowAdaptErrorLwrLim BaseAirflowAdaptErrorUprLim /end DEF_CHARACTERISTIC /end FUNCTION
/begin FUNCTION Adapt_Base_Airflow_Table "" /begin DEF_CHARACTERISTIC BaseAirflowOfstMaxValue BaseAirflowOfstMinValue /end DEF_CHARACTERISTIC /end FUNCTION
/begin FUNCTION Base_Equiv_Ratio ""
 /begin DEF_CHARACTERISTIC ChargeAirTempEnrichmentMap DesEquivRatioMap IntakeAirTempEnrichmentMap WarmUpEqRatioMap WarmUpTimeRatioMap /end DEF_CHARACTERISTIC
 /begin OUT_MEASUREMENT BaseEquivRatio ChargeAirTempEnrichment DesEquivRatio IntakeAirTempEnrichment WarmUpEqRatio WarmUpTimeRatio /end OUT_MEASUREMENT
 /begin SUB_FUNCTION EquivRatio_Override Warm_Up_Fuel_Holdoff /end SUB_FUNCTION
/end FUNCTION
/begin FUNCTION BaseRevLimit "" /begin DEF_CHARACTERISTIC BaseRevLimit HardRevOffset MediumRevOffset RevLimitHyst /end DEF_CHARACTERISTIC /end FUNCTION
/begin FUNCTION Overspeed_Protection "" /begin SUB_FUNCTION BaseRevLimit /end SUB_FUNCTION /end FUNCTION
/begin FUNCTION Spark_Manager "" /begin DEF_CHARACTERISTIC BaseSparkEnergyMap SparkAdvMap /end DEF_CHARACTERISTIC /begin OUT_MEASUREMENT BaseSparkEnergy Spark_Adv_Prb SparkAdv /end OUT_MEASUREMENT
 /begin SUB_FUNCTION Temp_Comp_Offset Desired_Eq_Ratio_Offset Ethanol_Spark_Offset SparkAdvanceLimiter Spark_Advance_Rate_Limiter /end SUB_FUNCTION
/end FUNCTION
/begin FUNCTION Trigger_Config "" /begin DEF_CHARACTERISTIC BGND_BASE_Multiple FGND_RTI_Period /end DEF_CHARACTERISTIC /end FUNCTION
/begin FUNCTION Event_Pause_Counters ""
 /begin DEF_CHARACTERISTIC BGND_BASE_PERIODIC_RunCnt BGND_BASEx10_PERIODIC_RunCnt BGND_BASEx2_PERIODIC_RunCnt FGND_20XRTI_PERIODIC_RunCnt FGND_5XRTI_PERIODIC_RunCnt FGND_HIRES_RunCnt FGND_MID_TDC_EVENT_RunCnt FGND_RTI_PERIODIC_RunCnt FGND_TDC_EVENT_RunCnt FGND_TDC1_EVENT_RunCnt IDLE_EVENT_RunCnt ONE_SECOND_EVENT_RunCnt STARTUP_EVENT_RunCnt /end DEF_CHARACTERISTIC
/end FUNCTION
/begin FUNCTION OS ""
 /begin OUT_MEASUREMENT BgndAngTaskStatus BgndStackMinBytesFree BgndTimeTaskStatus FgndAngleStackMinBytesFree FgndAngTaskStatus FgndTimeStackMinBytesFree IdleStackMinBytesFree InterruptStackMinBytesFree LastOSError OSErrorCnt OSStatus PeakHeapBytesUsed SWISRCurrQueueSize /end OUT_MEASUREMENT
/end FUNCTION
/begin FUNCTION Encoder_Config ""
 /begin DEF_CHARACTERISTIC CAMDelay EncoderCamPullup EncoderCamSyncEdge EncoderCrankPullup EncoderCrankTeethAfterCam EncoderNumCylinders EncoderSyncEdge EncoderTDCAngles TeethBeforeSyncAllowed TimeBeforeSyncAllowed /end DEF_CHARACTERISTIC
/end FUNCTION
/begin FUNCTION EngineSpeed "" /begin DEF_CHARACTERISTIC EngineToEncoderOffset PseudoRPM RPMFiltConst /end DEF_CHARACTERISTIC /begin OUT_MEASUREMENT EncoderState EncoderTDCOrder RPM RPMInst /end OUT_MEASUREMENT /begin SUB_FUNCTION Encoder_Config Encoder_Diagnostics /end SUB_FUNCTION /end FUNCTION
/begin FUNCTION CAN_1 ""
 /begin OUT_MEASUREMENT CAN_1_ext_handled_count CAN_1_ext_last_unhandled_id CAN_1_ext_receive_count can_create_CAN_1 can_create_CAN_2 can_tx_err_CAN_1_0 can_tx_err_CAN_1_0_54 can_tx_err_CAN_2_0 can_tx_err_CAN_2_0_55 protocol_register_CAN_1 protocol_register_CAN_2 /end OUT_MEASUREMENT
/end FUNCTION
/begin FUNCTION Temp_Comp_Offset ""
 /begin DEF_CHARACTERISTIC CAT_SpkOfstMultMap CAT_SpkOfstTbl ECT_SpkOfstMultMap ECT_SpkOfstTbl IAT_SpkOfstMultMap IAT_SpkOfstTbl /end DEF_CHARACTERISTIC
 /begin OUT_MEASUREMENT CAT_SpkOfst CAT_SpkOfstMult ECT_SpkOfst ECT_SpkOfstMult IAT_SpkOfst IAT_SpkOfstMult SpkOfstTempFnl /end OUT_MEASUREMENT
/end FUNCTION
/begin FUNCTION CAT_Index "" /begin OUT_MEASUREMENT CAT05Idx CAT05In /end OUT_MEASUREMENT /end FUNCTION
/begin FUNCTION CCP1 "" /begin DEF_CHARACTERISTIC CCP1_StationAddr CCP1RxID CCP1RxIDMask CCP1TxID /end DEF_CHARACTERISTIC
 /begin OUT_MEASUREMENT CCP_CCP1_Access CCP_CCP1_Access.CCP_CCP1_CAL CCP_CCP1_Access.CCP_CCP1_DAQ CCP_CCP1_Access.CCP_CCP1_PGM CCP_CCP1_ConnectionStatus /end OUT_MEASUREMENT
/end FUNCTION
/begin FUNCTION CCP "" /begin SUB_FUNCTION CCP1 /end SUB_FUNCTION /end FUNCTION
/begin FUNCTION Communication_Config "" /begin DEF_CHARACTERISTIC CityID_CAN_1 CityID_CAN_2 MotoTuneSerialBaudRate /end DEF_CHARACTERISTIC /end FUNCTION
/begin FUNCTION CrankFueling ""
 /begin DEF_CHARACTERISTIC ClearFloodThreshold CrankFPC_IATMultTbl CrankFPC_OXYMultTbl CrankFPCMap /end DEF_CHARACTERISTIC
 /begin OUT_MEASUREMENT CrankFPC CrankFPC_IATMult CrankFPC_OXYMult /end OUT_MEASUREMENT
 /begin SUB_FUNCTION FuelPulse TPSEnrichment /end SUB_FUNCTION
/end FUNCTION
/begin FUNCTION Crank ""
 /begin DEF_CHARACTERISTIC CrankAirflowSetPtTbl CrankMakeUpEOITbl CrankSOITbl CrankSparkMap CrankSpkEnergyMap /end DEF_CHARACTERISTIC
 /begin OUT_MEASUREMENT CrankAirflowSetPt CrankECT05Idx CrankIAT05Idx CrankMakeUpEOI CrankOXY05Idx CrankOXY05In CrankRPM05Idx CrankRPM05In CrankSOI CrankSpark CrankSpkEnergy /end OUT_MEASUREMENT
 /begin SUB_FUNCTION CrankFueling /end SUB_FUNCTION
/end FUNCTION
/begin FUNCTION Spark_Coil_Characterization "" /begin DEF_CHARACTERISTIC CoilDrvrDlyTime CoilDwellMap /end DEF_CHARACTERISTIC
 /begin OUT_MEASUREMENT CoilDwell SparkDwell SparkEnabled SparkEnergyMonitor SpkEnergy09Idx SpkEnergy09In /end OUT_MEASUREMENT
 /begin SUB_FUNCTION SparkDwell_Override /end SUB_FUNCTION
/end FUNCTION
/begin FUNCTION ActuatorCharacterization ""
 /begin SUB_FUNCTION Spark_Coil_Characterization Electronic_Throttle_Controller Injector_Characterization SequenceCutPattern /end SUB_FUNCTION
/end FUNCTION
/begin FUNCTION Coil_Control "" /begin DEF_CHARACTERISTIC SparkMaxDuration /end DEF_CHARACTERISTIC /begin OUT_MEASUREMENT CoilEnabled CoilStartAngle CoilStopAngle /end OUT_MEASUREMENT
 /begin SUB_FUNCTION EST_Fault_Management Coil_Enable_Manager SparkStartAngle_Override SparkStopAngle_Override /end SUB_FUNCTION
/end FUNCTION
/begin FUNCTION Fuel_Pump_at_Startup "" /begin DEF_CHARACTERISTIC Constant_Fuel_Pump FuelPumpStartTime /end DEF_CHARACTERISTIC /begin OUT_MEASUREMENT FuelPumpTSE /end OUT_MEASUREMENT /end FUNCTION
/begin FUNCTION Performance ""
 /begin OUT_MEASUREMENT CPUIdlePcent CPUTime_AppISR CPUTime_Bgnd CPUTime_CAN CPUTime_FgndAngle CPUTime_FgndTime CPUTime_MIOS CPUTime_Serial CPUTime_TimerISR CPUTime_TPU /end OUT_MEASUREMENT
/end FUNCTION
/begin FUNCTION EncoderAngle_wExtrap "" /begin DEF_CHARACTERISTIC CrankDegrees_pertooth /end DEF_CHARACTERISTIC /end FUNCTION
/begin FUNCTION EncoderAngleArb "" /begin DEF_CHARACTERISTIC MisfireDiag_EncoderExtrap_MPC5XX /end DEF_CHARACTERISTIC /begin SUB_FUNCTION EncoderAngle_wExtrap /end SUB_FUNCTION /end FUNCTION
/begin FUNCTION StoreRPMData ""
 /begin DEF_CHARACTERISTIC MisfireDiag_AngleHyst MisfireDiag_StartAngles MisfireDiag_StopAngles /end DEF_CHARACTERISTIC
 /begin OUT_MEASUREMENT MisfireDiag_AverageStartRPM MisfireDiag_AverageStartRPMDR MisfireDiag_AverageStopRPM MisfireDiag_AverageStopRPMDR MisfireDiag_EncoderAngle /end OUT_MEASUREMENT
 /begin SUB_FUNCTION EncoderAngleArb LatchForAverage LatchForAverage1 /end SUB_FUNCTION
/end FUNCTION
/begin FUNCTION MisfireDiagFunc "" /begin SUB_FUNCTION StoreRPMData DetermineMisfire /end SUB_FUNCTION /end FUNCTION
/begin FUNCTION MisfireDiagSub "" /begin SUB_FUNCTION MisfireDiagFunc /end SUB_FUNCTION /end FUNCTION
/begin FUNCTION MISFIRE ""
 /begin DEF_CHARACTERISTIC MisfireDiag_ECTHighEnbl MisfireDiag_ECTLowEnbl MisfireDiag_Enbl MisfireDiag_MAPHighEnbl MisfireDiag_MAPIRDiagEnable MisfireDiag_MAPLowEnbl MisfireDiag_RPMHighEnbl MisfireDiag_RPMLowEnbl MisfireDiag_TimeSinceRunEnbl /end DEF_CHARACTERISTIC
 /begin SUB_FUNCTION MisfireDiagSub /end SUB_FUNCTION
/end FUNCTION
/begin FUNCTION FuelPulse "" /begin DEF_CHARACTERISTIC CrankPulseTbl FuelPulseTime /end DEF_CHARACTERISTIC /begin OUT_MEASUREMENT CrankPulse /end OUT_MEASUREMENT /end FUNCTION
/begin FUNCTION TDC_Counter "" /begin OUT_MEASUREMENT CrankTDCs /end OUT_MEASUREMENT /end FUNCTION
/begin FUNCTION EngineState ""
 /begin DEF_CHARACTERISTIC CrankToRunRPMThresh RunLatchTDCs StallRPMMinThreshold StallRPMThresholdHyst /end DEF_CHARACTERISTIC
 /begin OUT_MEASUREMENT CrankTrans EngineStateRaw FuelPulseStatePrb /end OUT_MEASUREMENT
 /begin SUB_FUNCTION TDC_Counter /end SUB_FUNCTION
/end FUNCTION
/begin FUNCTION Delta_TPS_Transient_Fueling ""
 /begin DEF_CHARACTERISTIC DeltaMAP_FiltConst DeltaMAP_MultMap DeltaTPS_FiltConst DeltaTPS_MultMap /end DEF_CHARACTERISTIC
 /begin OUT_MEASUREMENT DeltaMAP DeltaMAP_Mult DeltaMAP17Idx DeltaMAP17In DeltaTPS DeltaTPS_Mult DeltaTPS17Idx DeltaTPS17In MAF09Idx MAF09In TransFuel_MAPFilt TransFuel_TPSFilt /end OUT_MEASUREMENT
 /begin SUB_FUNCTION ECT_Transient_Fueling OXY_Transient_Fueling /end SUB_FUNCTION
/end FUNCTION
/begin FUNCTION Injector_Manager "" /begin DEF_CHARACTERISTIC DeltaTPSFuelingEnable MakeUpEOIMap PrimarySOIMap /end DEF_CHARACTERISTIC /begin OUT_MEASUREMENT MakeUpEOI PrimarySOI /end OUT_MEASUREMENT /begin SUB_FUNCTION Delta_TPS_Transient_Fueling /end SUB_FUNCTION /end FUNCTION
/begin FUNCTION Calculate_A_F_Ratio "" /begin DEF_CHARACTERISTIC DesAFRatioTbl /end DEF_CHARACTERISTIC /begin OUT_MEASUREMENT DesAFRatio DesAFRatioIdx DesAFRatioIn /end OUT_MEASUREMENT /end FUNCTION
/begin FUNCTION Calculate_Fuel_Flow "" /begin OUT_MEASUREMENT Desired_AF_Ratio /end OUT_MEASUREMENT /begin SUB_FUNCTION Calculate_A_F_Ratio /end SUB_FUNCTION /end FUNCTION
/begin FUNCTION Desired_Eq_Ratio_Offset "" /begin DEF_CHARACTERISTIC EqRatio_SpkOfsMultMap EqRatio_SpkOfstTbl /end DEF_CHARACTERISTIC
 /begin OUT_MEASUREMENT DesEqRatio09Idx DesEqRatio09In EqRatio_SpkOfsMult EqRatio_SpkOfst Tot_EqRatio_SpkOfst /end OUT_MEASUREMENT
/end FUNCTION
/begin FUNCTION O2_Control_State_Determination "" /begin DEF_CHARACTERISTIC EquivRatioDelta O2ControlEnable O2StartUpDelayTbl /end DEF_CHARACTERISTIC
 /begin OUT_MEASUREMENT DesEquivInRange EnginSteadyState O2Calibration O2CtrlMode O2SensorFaults O2StartUpDelay O2TimeDelay /end OUT_MEASUREMENT
/end FUNCTION
/begin FUNCTION DesEquivRatioMod ""
 /begin DEF_CHARACTERISTIC DFCODelayTime DFCOEnable DFCOEnterIdleSpeed DFCOEnterRampTime DFCOEntryAPP DFCOEntryMAP DFCOEntryRPMTbl DFCOExitAPP DFCOExitIdleSpeed DFCOExitMAP DFCOExitRampTime DFCOExitRPMTbl DFCOExitSparkRet /end DEF_CHARACTERISTIC
 /begin OUT_MEASUREMENT DFCOActive DFCODesEquivRatio DFCODesSparkOutOfst DFCOEnterCond DFCOEntryRPM DFCOExitRPM /end OUT_MEASUREMENT
/end FUNCTION
/begin FUNCTION DFCO "" /begin SUB_FUNCTION DesEquivRatioMod /end SUB_FUNCTION /end FUNCTION
/begin FUNCTION Digital_Sensors "" /begin DEF_CHARACTERISTIC DigDiag_ClutchStuckTime DigDiag_ScrambleStuckTime /end DEF_CHARACTERISTIC /end FUNCTION
/begin FUNCTION DigitalInput "" /begin OUT_MEASUREMENT din_create_ESTOPPin din_read_ESTOPPin /end OUT_MEASUREMENT /end FUNCTION
/begin FUNCTION DiscreteOut ""
 /begin OUT_MEASUREMENT dout_create_DOut10438p0009 dout_create_DOut11990p0005 dout_create_DOut9613p0006 /end OUT_MEASUREMENT
/end FUNCTION
/begin FUNCTION ECT "" /begin DEF_CHARACTERISTIC ECTTbl /end DEF_CHARACTERISTIC /begin OUT_MEASUREMENT ECT ECTADC ECTIdx ECTRaw /end OUT_MEASUREMENT /begin SUB_FUNCTION ECT_Override ECT_Config /end SUB_FUNCTION /end FUNCTION
/begin FUNCTION Temp_Sensors "" /begin SUB_FUNCTION ECT EVAP IAT /end SUB_FUNCTION /end FUNCTION
/begin FUNCTION NonLinearSensors "" /begin DEF_CHARACTERISTIC Placeholder_CAT Placeholder_CATRaw /end DEF_CHARACTERISTIC /begin SUB_FUNCTION Temp_Sensors Fuel_Level /end SUB_FUNCTION /end FUNCTION
/begin FUNCTION Capture_ECT_At_Startup "" /begin DEF_CHARACTERISTIC ECT_KeyUp_Count /end DEF_CHARACTERISTIC /end FUNCTION
/begin FUNCTION ECT_KeyUp "" /begin OUT_MEASUREMENT ECT_KeyUp09Idx ECT_KeyUp09In /end OUT_MEASUREMENT /end FUNCTION
/begin FUNCTION ECT_Override "" /begin DEF_CHARACTERISTIC ECT_new ECT_ovr /end DEF_CHARACTERISTIC /end FUNCTION
/begin FUNCTION ECT_Index "" /begin OUT_MEASUREMENT ECT05Idx ECT05In ECT07Idx ECT07In ECT09Idx ECT09In /end OUT_MEASUREMENT /end FUNCTION
/begin FUNCTION ECT_Config "" /begin DEF_CHARACTERISTIC ECTDefault ECTFiltConst ECTMax ECTMin /end DEF_CHARACTERISTIC /end FUNCTION
/begin FUNCTION ECT_Transient_Fueling "" /begin DEF_CHARACTERISTIC ECTTransFuelMultTbl /end DEF_CHARACTERISTIC /begin OUT_MEASUREMENT ECTTransFuelMult /end OUT_MEASUREMENT /end FUNCTION
/begin FUNCTION Main_Power_Relay "" /begin DEF_CHARACTERISTIC ProcessorReboot /end DEF_CHARACTERISTIC /begin OUT_MEASUREMENT ECUP_Enabled ForcedShutDownTimer /end OUT_MEASUREMENT /begin SUB_FUNCTION Main_Power_Relay_Config MPRD_Override /end SUB_FUNCTION /end FUNCTION
/begin FUNCTION Main_Power_Relay_Config "" /begin DEF_CHARACTERISTIC ECUP_Threshold ForcedShutDownTimerThresh Shutdown_Delay /end DEF_CHARACTERISTIC /end FUNCTION
/begin FUNCTION Dash_Message_2 "" /begin DEF_CHARACTERISTIC ECUVolt_Filt SparkAdv_Filt VSPD_Filt /end DEF_CHARACTERISTIC /begin SUB_FUNCTION PHI_Filt PHI_Filt1 /end SUB_FUNCTION /end FUNCTION
/begin FUNCTION Elec_PW_Override "" /begin DEF_CHARACTERISTIC Elec_PW_new Elec_PW_ovr /end DEF_CHARACTERISTIC /end FUNCTION
/begin FUNCTION Injector_Control "" /begin DEF_CHARACTERISTIC InjectiorMinDuration InjectorMaxDuration MinMakeUpPW /end DEF_CHARACTERISTIC /begin OUT_MEASUREMENT InjectorsEnabled InjTransitionCount /end OUT_MEASUREMENT
 /begin SUB_FUNCTION Elec_PW_Override Injector_Enable_Manager ESTOP_FuelInj_Ovr_Override InjEnable_Override MakeUp_EOI_Override Mech_PW_Override SOI_Override /end SUB_FUNCTION
/end FUNCTION
/begin FUNCTION Idle_State_Determination ""
 /begin DEF_CHARACTERISTIC EnableRPMFalling InGearMinGovEntryRPMDelta MinGovAirPcntHyst MinGovEntryAirPcnt MinGovEntryAirTimeThresh StallSaverDeltaRPM /end DEF_CHARACTERISTIC
 /begin OUT_MEASUREMENT IdleState RPMCtrlMode /end OUT_MEASUREMENT
 /begin SUB_FUNCTION Determine_if_RPM_is_Falling /end SUB_FUNCTION
/end FUNCTION
/begin FUNCTION Encoder "" /begin OUT_MEASUREMENT encoder_create /end OUT_MEASUREMENT /end FUNCTION
/begin FUNCTION Encoder_Diagnostics "" /begin OUT_MEASUREMENT EncoderFault EncoderFaultCount /end OUT_MEASUREMENT /end FUNCTION
/begin FUNCTION Engine_Accel "" /begin DEF_CHARACTERISTIC EngineAccelFiltConst /end DEF_CHARACTERISTIC /begin OUT_MEASUREMENT EngineAccel /end OUT_MEASUREMENT /end FUNCTION
/begin FUNCTION Injector_Enable_Manager ""
 /begin DEF_CHARACTERISTIC EngineShutdownDelayTime Injector1Enable Injector2Enable Injector3Enable Injector4Enable Injector5Enable Injector6Enable Injector7Enable Injector8Enable /end DEF_CHARACTERISTIC
/end FUNCTION
/begin FUNCTION EquivRatio_Override "" /begin DEF_CHARACTERISTIC EquivRatio_new EquivRatio_ovr /end DEF_CHARACTERISTIC /end FUNCTION
/begin FUNCTION EST_Fault_Management "" /begin OUT_MEASUREMENT EST_DiagDwell ESTOpenADC /end OUT_MEASUREMENT /end FUNCTION
/begin FUNCTION SequenceOut "" /begin OUT_MEASUREMENT EST_Spark EST_SparkCreate INJ_InjectorCreate /end OUT_MEASUREMENT /end FUNCTION
/begin FUNCTION EST_Enable_TDC_Counter "" /begin DEF_CHARACTERISTIC SparkEnableTDCCounts /end DEF_CHARACTERISTIC /begin OUT_MEASUREMENT EST_TDCEnabled TDCCount TDCCountThreshEnabled /end OUT_MEASUREMENT /end FUNCTION
/begin FUNCTION Coil_Enable_Manager ""
 /begin DEF_CHARACTERISTIC SparkEnableCyl1 SparkEnableCyl2 SparkEnableCyl3 SparkEnableCyl4 SparkEnableCyl5 SparkEnableCyl6 SparkEnableCyl7 SparkEnableCyl8 /end DEF_CHARACTERISTIC
 /begin SUB_FUNCTION EST_Enable_TDC_Counter /end SUB_FUNCTION
/end FUNCTION
/begin FUNCTION ESTOP "" /begin OUT_MEASUREMENT ESTOP ESTOP_Raw /end OUT_MEASUREMENT /begin SUB_FUNCTION ESTOP_Override ESTOP_Config /end SUB_FUNCTION /end FUNCTION
/begin FUNCTION ESTOP_FuelInj_Ovr_Override "" /begin DEF_CHARACTERISTIC ESTOP_FuelInj_Ovr_new ESTOP_FuelInj_Ovr_ovr /end DEF_CHARACTERISTIC /end FUNCTION
/begin FUNCTION ESTOP_Override "" /begin DEF_CHARACTERISTIC ESTOP_new ESTOP_ovr /end DEF_CHARACTERISTIC /end FUNCTION
/begin FUNCTION ESTOP_Config "" /begin DEF_CHARACTERISTIC ESTOPPolarity /end DEF_CHARACTERISTIC /end FUNCTION
/begin FUNCTION HBridge ""
 /begin DEF_CHARACTERISTIC ETC_CutPower_Permitted ETC_Frequency ETC_I_MIN ETC_OC_MIN ETC_Offset ETC_VoltageCompTbl /end DEF_CHARACTERISTIC
 /begin OUT_MEASUREMENT ETB_Curr_Flt ETC_Current ETC_DutyCycle ETC_VoltageComp /end OUT_MEASUREMENT
 /begin SUB_FUNCTION ETC_Override /end SUB_FUNCTION
/end FUNCTION
/begin FUNCTION ETC_CutPower "" /begin DEF_CHARACTERISTIC ETC_CutPower_ETC ETC_CutPower_StallTime /end DEF_CHARACTERISTIC /end FUNCTION
/begin FUNCTION State__Manager "" /begin OUT_MEASUREMENT ETC_ECUPState ETC_ShutDownTimer /end OUT_MEASUREMENT /end FUNCTION
/begin FUNCTION Electronic_Throttle_Controller ""
 /begin DEF_CHARACTERISTIC ETC_ShutdownLoAdaptError ETC_SpringTestHiThresh ETC_SpringTestLoThresh ETC_SpringTestTimerThresh /end DEF_CHARACTERISTIC
 /begin SUB_FUNCTION State__Manager PID_With_Damper_Terms__Tunable_ Setpoint_Manager ETC_Adapt_Request ETC_Sticking_Fault ETC_PID_Config ETCStallShutDown /end SUB_FUNCTION
/end FUNCTION
/begin FUNCTION PID_With_Damper_Terms__Tunable_ ""
 /begin DEF_CHARACTERISTIC ETCDampGainDown ETCDampGainUp ETCDCOffsetTbl ETCDGain ETCErrorGain ETCIMax ETCIMin /end DEF_CHARACTERISTIC
 /begin OUT_MEASUREMENT ETC_ErrorIdx ETC_ErrorIn ETC_Setpoint ETC_SetpointIdx ETC_SetpointIn ETCDampTerm ETCDCOffset ETCDTerm ETCError ETCITerm ETCOut ETCPTerm /end OUT_MEASUREMENT
 /begin SUB_FUNCTION IGain PGain DamperSwitch /end SUB_FUNCTION
/end FUNCTION
/begin FUNCTION Stall_Throttle ""
 /begin DEF_CHARACTERISTIC ETC_IceBreakEnblTm ETC_IceBreakHoldTm ETC_IceBreakPos ETC_StallAppOvrThesh ETC_StallAppOvrTm /end DEF_CHARACTERISTIC
 /begin OUT_MEASUREMENT ETCStallReq /end OUT_MEASUREMENT
/end FUNCTION
/end MODULE
/end PROJECT
