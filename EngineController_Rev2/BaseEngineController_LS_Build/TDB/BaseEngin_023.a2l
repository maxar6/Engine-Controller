ASAP2_VERSION 1 51
/begin PROJECT Project ""
/begin MODULE BaseEngin_023 ""
/begin MOD_COMMON /* MOD_COMMON Comment */ "" BYTE_ORDER MSB_FIRST ALIGNMENT_BYTE 1 ALIGNMENT_FLOAT32_IEEE 1 ALIGNMENT_FLOAT64_IEEE 1 ALIGNMENT_LONG 1 ALIGNMENT_WORD 1 /end MOD_COMMON
/begin MEASUREMENT Bank2_EquivRatio "Final value after Linear Sensor Characterization" FLOAT32_IEEE CompuMethod_44 1 0 -1E+17 1E+17 ECU_ADDRESS 0x40000259 /end MEASUREMENT
/begin MEASUREMENT Bank2_EquivRatioADC "Singal measured directly from sensor" FLOAT32_IEEE CompuMethod_44 1 0 -1E+17 1E+17 ECU_ADDRESS 0x4000025D /end MEASUREMENT
/begin MEASUREMENT Bank2_EquivRatioRaw "After conversion to engineering units, before range checking" FLOAT32_IEEE CompuMethod_44 1 0 -1E+17 1E+17 ECU_ADDRESS 0x40000261 /end MEASUREMENT
/begin MEASUREMENT BARO "" FLOAT32_IEEE CompuMethod_8 1 0 -1E+17 1E+17 ECU_ADDRESS 0x40000289 /end MEASUREMENT
/begin MEASUREMENT BARO09Idx "" UWORD CompuMethod_15 1 0 0 127.998 ECU_ADDRESS 0x4000028D /end MEASUREMENT
/begin MEASUREMENT BaroDelayTime "" FLOAT32_IEEE CompuMethod_10 1 0 -1E+17 1E+17 ECU_ADDRESS 0x4000028F /end MEASUREMENT
/begin MEASUREMENT BaseAirflowAdaptEnabled "" UBYTE CompuMethod_47 1 0 0 1 ECU_ADDRESS 0x40000293 /end MEASUREMENT
/begin MEASUREMENT BaseEquivRatio "Base equivalence ratio for selected fuel system." FLOAT32_IEEE CompuMethod_2 1 0 -1E+17 1E+17 ECU_ADDRESS 0x4000029C /end MEASUREMENT
/begin MEASUREMENT BaseSparkEnergy "Spark energy - Run state" FLOAT32_IEEE CompuMethod_51 1 0 -1E+17 1E+17 ECU_ADDRESS 0x400002A0 /end MEASUREMENT
/begin MEASUREMENT BgndAngTaskStatus "Background Time Scheduler Status" UBYTE CompuMethod_53 1 0 0 0 ECU_ADDRESS 0x400002A4 /end MEASUREMENT
/begin MEASUREMENT BgndStackMinBytesFree "Min bytes observed on the Background Stack" ULONG CompuMethod_54 1 0 0 0 ECU_ADDRESS 0x400002A5 /end MEASUREMENT
/begin MEASUREMENT BgndTimeTaskStatus "Background Time Scheduler Status" UBYTE CompuMethod_55 1 0 0 0 ECU_ADDRESS 0x400002A9 /end MEASUREMENT
/begin MEASUREMENT BoostControlAdaptEnabled "" UBYTE CompuMethod_47 1 0 0 1 ECU_ADDRESS 0x400002AA /end MEASUREMENT
/begin MEASUREMENT BoostControlBase "Base boost duty cycle table for feed forward" FLOAT32_IEEE CompuMethod_57 1 0 -1E+17 1E+17 ECU_ADDRESS 0x400002AB /end MEASUREMENT
/begin MEASUREMENT BoostControlBase_Adapt "Base boost duty cycle table for feed forward" FLOAT32_IEEE CompuMethod_57 1 0 -1E+17 1E+17 ECU_ADDRESS 0x400002AF /end MEASUREMENT
/begin MEASUREMENT BoostControlDutyCycleFF "" FLOAT32_IEEE CompuMethod_2 1 0 -1E+17 1E+17 ECU_ADDRESS 0x400002B3 /end MEASUREMENT
/begin MEASUREMENT BoostControlDutyCycleOut "Boost controller final duty cycle out" FLOAT32_IEEE CompuMethod_57 1 0 -1E+17 1E+17 ECU_ADDRESS 0x400002B7 /end MEASUREMENT
/begin MEASUREMENT BoostControlPID "Boost controller PID output" FLOAT32_IEEE CompuMethod_57 1 0 -1E+17 1E+17 ECU_ADDRESS 0x400002BB /end MEASUREMENT
/begin MEASUREMENT BoostControlPID_ITerm "Boost controller PID I term" FLOAT32_IEEE CompuMethod_2 1 0 -1E+17 1E+17 ECU_ADDRESS 0x400002BF /end MEASUREMENT
/begin MEASUREMENT BoostControlTarget "Final boost target" FLOAT32_IEEE CompuMethod_56 1 0 -1E+17 1E+17 ECU_ADDRESS 0x400002C3 /end MEASUREMENT
/begin MEASUREMENT BoostCtlDGainErrorMult "" FLOAT32_IEEE CompuMethod_33 1 0 -1E+17 1E+17 ECU_ADDRESS 0x400002C7 /end MEASUREMENT
/begin MEASUREMENT BoostCtlDTerm "Air min governor D term" FLOAT32_IEEE CompuMethod_2 1 0 -1E+17 1E+17 ECU_ADDRESS 0x400002CB /end MEASUREMENT
/begin MEASUREMENT BoostCtlError "Air min governor P term" FLOAT32_IEEE CompuMethod_2 1 0 -1E+17 1E+17 ECU_ADDRESS 0x400002CF /end MEASUREMENT
/begin MEASUREMENT BoostCtlIGainErrorMult "" FLOAT32_IEEE CompuMethod_33 1 0 -1E+17 1E+17 ECU_ADDRESS 0x400002D3 /end MEASUREMENT
/begin MEASUREMENT BoostCtlITerm "Air min governor I term" FLOAT32_IEEE CompuMethod_2 1 0 -1E+17 1E+17 ECU_ADDRESS 0x400002D7 /end MEASUREMENT
/begin MEASUREMENT BoostCtlPGainErrorMult "" FLOAT32_IEEE CompuMethod_33 1 0 -1E+17 1E+17 ECU_ADDRESS 0x400002DB /end MEASUREMENT
/begin MEASUREMENT BoostCtlPTerm "Air min governor P term" FLOAT32_IEEE CompuMethod_2 1 0 -1E+17 1E+17 ECU_ADDRESS 0x400002DF /end MEASUREMENT
/begin MEASUREMENT BoostCtlSpeedErrorIdx "" UWORD CompuMethod_15 1 0 0 127.998 ECU_ADDRESS 0x400002E3 /end MEASUREMENT
/begin MEASUREMENT BoostCtlSpeedErrorIn "" FLOAT32_IEEE CompuMethod_2 1 0 -1E+17 1E+17 ECU_ADDRESS 0x400002E5 /end MEASUREMENT
/begin MEASUREMENT BoostECTLimit "Boost limit as a function of ECT" FLOAT32_IEEE CompuMethod_56 1 0 -1E+17 1E+17 ECU_ADDRESS 0x400002E9 /end MEASUREMENT
/begin MEASUREMENT BoostIATLimit "Boost limit as a function of IAT" FLOAT32_IEEE CompuMethod_56 1 0 -1E+17 1E+17 ECU_ADDRESS 0x400002ED /end MEASUREMENT
/begin MEASUREMENT BoostTarget "Target boost as a function of RPM and VSPD" FLOAT32_IEEE CompuMethod_56 1 0 -1E+17 1E+17 ECU_ADDRESS 0x400002F1 /end MEASUREMENT
/begin MEASUREMENT BoostTarget_TwoStep "Boost target with repsect to RPM when on two step" FLOAT32_IEEE CompuMethod_56 1 0 -1E+17 1E+17 ECU_ADDRESS 0x400002F5 /end MEASUREMENT
/begin MEASUREMENT BoostTargetIdx "" UWORD CompuMethod_15 1 0 0 127.998 ECU_ADDRESS 0x400002F9 /end MEASUREMENT
/begin MEASUREMENT BoostTargetIn "" FLOAT32_IEEE CompuMethod_2 1 0 -1E+17 1E+17 ECU_ADDRESS 0x400002FB /end MEASUREMENT
/begin MEASUREMENT CAN_1_ext_handled_count "Total number of handled ext CAN messages on bus CAN_1" ULONG CompuMethod_60 1 0 0 4294970000 ECU_ADDRESS 0x400002FF /end MEASUREMENT
/begin MEASUREMENT CAN_1_ext_last_unhandled_id "Last received ext CAN message on bus CAN_1, which was unhandled" ULONG CompuMethod_60 1 0 0 4294970000 ECU_ADDRESS 0x40000303 /end MEASUREMENT
/begin MEASUREMENT CAN_1_ext_receive_count "Total number of received ext CAN messages on bus CAN_1" ULONG CompuMethod_60 1 0 0 4294970000 ECU_ADDRESS 0x40000307 /end MEASUREMENT
/begin MEASUREMENT can_create_CAN_1 "Debug Variable" UBYTE CompuMethod_31 1 0 0 0 ECU_ADDRESS 0x4000030B /end MEASUREMENT
/begin MEASUREMENT can_create_CAN_2 "Debug Variable" UBYTE CompuMethod_31 1 0 0 0 ECU_ADDRESS 0x4000030C /end MEASUREMENT
/begin MEASUREMENT can_tx_err_CAN_1_0 "Debug Variable" UBYTE CompuMethod_31 1 0 0 0 ECU_ADDRESS 0x4000030D /end MEASUREMENT
/begin MEASUREMENT can_tx_err_CAN_1_0_50 "Debug Variable" UBYTE CompuMethod_31 1 0 0 0 ECU_ADDRESS 0x4000030E /end MEASUREMENT
/begin MEASUREMENT can_tx_err_CAN_2_0 "Debug Variable" UBYTE CompuMethod_31 1 0 0 0 ECU_ADDRESS 0x4000030F /end MEASUREMENT
/begin MEASUREMENT can_tx_err_CAN_2_0_51 "Debug Variable" UBYTE CompuMethod_31 1 0 0 0 ECU_ADDRESS 0x40000310 /end MEASUREMENT
/begin MEASUREMENT CAT "Final value after Linear Sensor Characterization" FLOAT32_IEEE CompuMethod_61 1 0 -1E+17 1E+17 ECU_ADDRESS 0x40000311 /end MEASUREMENT
/begin MEASUREMENT CAT_SpkOfst "CAT spark offset" FLOAT32_IEEE CompuMethod_2 1 0 -1E+17 1E+17 ECU_ADDRESS 0x40000315 /end MEASUREMENT
/begin MEASUREMENT CAT_SpkOfstMult "Multiplier on IAT2 spark offset table." FLOAT32_IEEE CompuMethod_33 1 0 -1E+17 1E+17 ECU_ADDRESS 0x40000319 /end MEASUREMENT
/begin MEASUREMENT CAT05Idx "Index of charge air temperature" UWORD CompuMethod_15 1 0 0 127.998 ECU_ADDRESS 0x4000031D /end MEASUREMENT
/begin MEASUREMENT CAT05In "Index of charge air temperature" FLOAT32_IEEE CompuMethod_27 1 0 -1E+17 1E+17 ECU_ADDRESS 0x4000031F /end MEASUREMENT
/begin MEASUREMENT CATADC "Signal measured directly from sensor" UWORD CompuMethod_16 1 0 0 65535 ECU_ADDRESS 0x40000323 /end MEASUREMENT
/begin MEASUREMENT CATIdx "Look up table to allownon-linear characterization of sensors" UWORD CompuMethod_15 1 0 0 127.998 ECU_ADDRESS 0x40000325 /end MEASUREMENT
/begin MEASUREMENT CATRaw "After conversion to engineering units, before range checking" FLOAT32_IEEE CompuMethod_61 1 0 -1E+17 1E+17 ECU_ADDRESS 0x40000327 /end MEASUREMENT
/begin MEASUREMENT CCP_CCP1_Access.CCP_CCP1_CAL "Calibration Authentication Status for CCP Handler CCP1" UBYTE CompuMethod_62 1 0 0 1 ECU_ADDRESS 0x4000032B BIT_MASK 0x00000001 /end MEASUREMENT
/begin MEASUREMENT CCP_CCP1_Access.CCP_CCP1_DAQ "Data Acquisition Authentication Status for CCP Handler CCP1" UBYTE CompuMethod_63 1 0 0 1 ECU_ADDRESS 0x4000032B BIT_MASK 0x00000002 /end MEASUREMENT
/begin MEASUREMENT CCP_CCP1_Access.CCP_CCP1_PGM "Programming Authentication Status for CCP Handler CCP1" UBYTE CompuMethod_64 1 0 0 1 ECU_ADDRESS 0x4000032B BIT_MASK 0x00000040 /end MEASUREMENT
/begin MEASUREMENT CCP_CCP1_Access "Current Access Code for CCP Handler CCP1" UBYTE CompuMethod_2 1 0 0 255 ECU_ADDRESS 0x4000032B /end MEASUREMENT
/begin MEASUREMENT CCP_CCP1_ConnectionStatus "CCP Handler CCP1 connection status" UBYTE CompuMethod_65 1 0 0 255 ECU_ADDRESS 0x4000032C /end MEASUREMENT
/begin MEASUREMENT ChargeAirTempEnrichment "Requsted base eq. ratio as a function of CAT and MAP" FLOAT32_IEEE CompuMethod_66 1 0 -1E+17 1E+17 ECU_ADDRESS 0x4000032D /end MEASUREMENT
/begin MEASUREMENT ClutchSw "Display output in engineering units" UBYTE CompuMethod_26 1 0 0 1 ECU_ADDRESS 0x40000331 /end MEASUREMENT
/begin MEASUREMENT ClutchSw_Raw "Display output in engineering units" FLOAT32_IEEE CompuMethod_22 1 0 -1E+17 1E+17 ECU_ADDRESS 0x40000332 /end MEASUREMENT
/begin MEASUREMENT CoilDwell "Required spark dwell to give the desired spark energy." FLOAT32_IEEE CompuMethod_69 1 0 -1E+17 1E+17 ECU_ADDRESS 0x40000336 /end MEASUREMENT
/begin MEASUREMENT CoilEnabled "Enable sate for coils." UBYTE CompuMethod_4 1 0 0 1 ECU_ADDRESS 0x4000033A MATRIX_DIM 8 1 1 /end MEASUREMENT
/begin MEASUREMENT CoilStartAngle "StartAngle for coils to establish dwell." FLOAT32_IEEE CompuMethod_70 1 0 -1E+17 1E+17 ECU_ADDRESS 0x40000342 /end MEASUREMENT
/begin MEASUREMENT CoilStopAngle "Stop angle for coils to establish dwell." FLOAT32_IEEE CompuMethod_70 1 0 -1E+17 1E+17 ECU_ADDRESS 0x40000346 /end MEASUREMENT
/begin MEASUREMENT CPUIdlePcent "Percentage of the CPU time spent servicing idle priority work." UWORD CompuMethod_71 1 0 0 99.9999 ECU_ADDRESS 0x400003CE /end MEASUREMENT
/begin MEASUREMENT CPUTime_AppISR "Percentage of the CPU time spent executing the periodic timer interrupt" UWORD CompuMethod_71 1 0 0 99.9999 ECU_ADDRESS 0x400003D0 /end MEASUREMENT
/begin MEASUREMENT CPUTime_Bgnd "Percentage of the CPU time spent servicing background priority tasks" UWORD CompuMethod_71 1 0 0 99.9999 ECU_ADDRESS 0x400003D2 /end MEASUREMENT
/begin MEASUREMENT CPUTime_CAN "Percentage of the CPU time spent executing CAN interrupts" UWORD CompuMethod_71 1 0 0 99.9999 ECU_ADDRESS 0x400003D4 /end MEASUREMENT
/begin MEASUREMENT CPUTime_FgndAngle "Percentage of the CPU time spent executing application callbacks due to framework events" UWORD CompuMethod_71 1 0 0 99.9999 ECU_ADDRESS 0x400003D6 /end MEASUREMENT
/begin MEASUREMENT CPUTime_FgndTime "Percentage of the CPU time spent servicing background priority tasks" UWORD CompuMethod_71 1 0 0 99.9999 ECU_ADDRESS 0x400003D8 /end MEASUREMENT
/begin MEASUREMENT CPUTime_MIOS "Percentage of the CPU time spent executing MIOS interrupts" UWORD CompuMethod_71 1 0 0 99.9999 ECU_ADDRESS 0x400003DA /end MEASUREMENT
/begin MEASUREMENT CPUTime_Serial "Percentage of the CPU time spent executing serial interrupts" UWORD CompuMethod_71 1 0 0 99.9999 ECU_ADDRESS 0x400003DC /end MEASUREMENT
/begin MEASUREMENT CPUTime_TimerISR "Percentage of the CPU time spent executing the periodic timer interrupt" UWORD CompuMethod_71 1 0 0 99.9999 ECU_ADDRESS 0x400003DE /end MEASUREMENT
/begin MEASUREMENT CPUTime_TPU "Percentage of the CPU time spent executing TPU interrupts" UWORD CompuMethod_71 1 0 0 99.9999 ECU_ADDRESS 0x400003E0 /end MEASUREMENT
/begin MEASUREMENT CrankAirflowSetPt "ETC setpoint during cranking." FLOAT32_IEEE CompuMethod_6 1 0 -1E+17 1E+17 ECU_ADDRESS 0x400003E2 /end MEASUREMENT
/begin MEASUREMENT CrankECT05Idx "ECT pre-lookup for crank maps." UWORD CompuMethod_15 1 0 0 127.998 ECU_ADDRESS 0x400003E6 /end MEASUREMENT
/begin MEASUREMENT CrankFPC "Liquid fuel supplied during crank." FLOAT32_IEEE CompuMethod_73 1 0 -1E+17 1E+17 ECU_ADDRESS 0x400003E8 /end MEASUREMENT
/begin MEASUREMENT CrankFPC_IATMult "Crank fuel IAT ultiplier" FLOAT32_IEEE CompuMethod_2 1 0 -1E+17 1E+17 ECU_ADDRESS 0x400003EC /end MEASUREMENT
/begin MEASUREMENT CrankFPC_OXYMult "Crank fuel oxygentation multiplier" FLOAT32_IEEE CompuMethod_2 1 0 -1E+17 1E+17 ECU_ADDRESS 0x400003F0 /end MEASUREMENT
/begin MEASUREMENT CrankIAC "Base IAC % While Cranking" FLOAT32_IEEE CompuMethod_6 1 0 -1E+17 1E+17 ECU_ADDRESS 0x400003F4 /end MEASUREMENT
/begin MEASUREMENT CrankIAC_IATMult "" FLOAT32_IEEE CompuMethod_2 1 0 -1E+17 1E+17 ECU_ADDRESS 0x400003F8 /end MEASUREMENT
/begin MEASUREMENT CrankIAC_OXYMult "" FLOAT32_IEEE CompuMethod_2 1 0 -1E+17 1E+17 ECU_ADDRESS 0x400003FC /end MEASUREMENT
/begin MEASUREMENT CrankIAT05Idx "IAT pre-lookup for crank maps." UWORD CompuMethod_15 1 0 0 127.998 ECU_ADDRESS 0x40000400 /end MEASUREMENT
/begin MEASUREMENT CrankMakeUpEOI "Start of injection during cranking." FLOAT32_IEEE CompuMethod_70 1 0 -1E+17 1E+17 ECU_ADDRESS 0x40000402 /end MEASUREMENT
/begin MEASUREMENT CrankOXY05Idx "OXY pre-lookup for crank maps." UWORD CompuMethod_15 1 0 0 127.998 ECU_ADDRESS 0x40000406 /end MEASUREMENT
/begin MEASUREMENT CrankOXY05In "OXY pre-lookup for crank maps." FLOAT32_IEEE CompuMethod_6 1 0 -1E+17 1E+17 ECU_ADDRESS 0x40000408 /end MEASUREMENT
/begin MEASUREMENT CrankRPM05Idx "RPM pre-lookup for crank maps" UWORD CompuMethod_15 1 0 0 127.998 ECU_ADDRESS 0x4000040C /end MEASUREMENT
/begin MEASUREMENT CrankRPM05In "RPM pre-lookup for crank maps" FLOAT32_IEEE CompuMethod_25 1 0 -1E+17 1E+17 ECU_ADDRESS 0x4000040E /end MEASUREMENT
/begin MEASUREMENT CrankSOI "Start of injection during cranking." FLOAT32_IEEE CompuMethod_70 1 0 -1E+17 1E+17 ECU_ADDRESS 0x40000412 /end MEASUREMENT
/begin MEASUREMENT CrankSpark "Spark adv during cranking." FLOAT32_IEEE CompuMethod_70 1 0 -1E+17 1E+17 ECU_ADDRESS 0x40000416 /end MEASUREMENT
/begin MEASUREMENT CrankSpkEnergy "Spark energy during cranking." FLOAT32_IEEE CompuMethod_74 1 0 -1E+17 1E+17 ECU_ADDRESS 0x4000041A /end MEASUREMENT
/begin MEASUREMENT CrankTDCs "" UBYTE CompuMethod_1 1 0 0 255 ECU_ADDRESS 0x4000041E /end MEASUREMENT
/begin MEASUREMENT CrankTrans "" UBYTE CompuMethod_11 1 0 0 1 ECU_ADDRESS 0x4000041F /end MEASUREMENT
/begin MEASUREMENT DeltaMAP "" FLOAT32_IEEE CompuMethod_2 1 0 -1E+17 1E+17 ECU_ADDRESS 0x40000420 /end MEASUREMENT
/begin MEASUREMENT DeltaMAP_Mult "Transient Fueling Multiplier for adjustment based on delta MAP" FLOAT32_IEEE CompuMethod_33 1 0 -1E+17 1E+17 ECU_ADDRESS 0x40000424 /end MEASUREMENT
/begin MEASUREMENT DeltaMAP17Idx "" UWORD CompuMethod_15 1 0 0 127.998 ECU_ADDRESS 0x40000428 /end MEASUREMENT
/begin MEASUREMENT DeltaMAP17In "" FLOAT32_IEEE CompuMethod_2 1 0 -1E+17 1E+17 ECU_ADDRESS 0x4000042A /end MEASUREMENT
/begin MEASUREMENT DeltaTPS "" FLOAT32_IEEE CompuMethod_2 1 0 -1E+17 1E+17 ECU_ADDRESS 0x4000042E /end MEASUREMENT
/begin MEASUREMENT DeltaTPS_Mult "Transient Fueling Multiplier for adjustment based on delta TPS" FLOAT32_IEEE CompuMethod_33 1 0 -1E+17 1E+17 ECU_ADDRESS 0x40000432 /end MEASUREMENT
/begin MEASUREMENT DeltaTPS17Idx "" UWORD CompuMethod_15 1 0 0 127.998 ECU_ADDRESS 0x40000436 /end MEASUREMENT
/begin MEASUREMENT DeltaTPS17In "" FLOAT32_IEEE CompuMethod_2 1 0 -1E+17 1E+17 ECU_ADDRESS 0x40000438 /end MEASUREMENT
/begin MEASUREMENT DesAFRatio "" FLOAT32_IEEE CompuMethod_77 1 0 -1E+17 1E+17 ECU_ADDRESS 0x4000043C /end MEASUREMENT
/begin MEASUREMENT DesAFRatioIdx "" UWORD CompuMethod_15 1 0 0 127.998 ECU_ADDRESS 0x40000440 /end MEASUREMENT
/begin MEASUREMENT DesAFRatioIn "" FLOAT32_IEEE CompuMethod_78 1 0 -1E+17 1E+17 ECU_ADDRESS 0x40000442 /end MEASUREMENT
/begin MEASUREMENT DesEqRatio09Idx "Desired Equivalence Ratio breakpoints" UWORD CompuMethod_15 1 0 0 127.998 ECU_ADDRESS 0x40000446 /end MEASUREMENT
/begin MEASUREMENT DesEqRatio09In "Desired Equivalence Ratio breakpoints" FLOAT32_IEEE CompuMethod_79 1 0 -1E+17 1E+17 ECU_ADDRESS 0x40000448 /end MEASUREMENT
/begin MEASUREMENT DesEquivInRange "" UBYTE CompuMethod_36 1 0 0 1 ECU_ADDRESS 0x4000044C /end MEASUREMENT
/begin MEASUREMENT DesEquivRatio "Desired liquid equivalence ratio." FLOAT32_IEEE CompuMethod_2 1 0 -1E+17 1E+17 ECU_ADDRESS 0x4000044D /end MEASUREMENT
/begin MEASUREMENT Desired_AF_Ratio "Desired Air to Fuel Ratio based on Ethanol Percentage" FLOAT32_IEEE CompuMethod_80 1 0 -1E+17 1E+17 ECU_ADDRESS 0x40000451 /end MEASUREMENT
/begin MEASUREMENT DFCOActive "DFCO state" UBYTE CompuMethod_11 1 0 0 1 ECU_ADDRESS 0x40000455 /end MEASUREMENT
/begin MEASUREMENT DFCODesEquivRatio "DFCO commanded equiv ratio" FLOAT32_IEEE CompuMethod_2 1 0 -1E+17 1E+17 ECU_ADDRESS 0x40000456 /end MEASUREMENT
/begin MEASUREMENT DFCODesSparkOutOfst "DFCO spark output" FLOAT32_IEEE CompuMethod_70 1 0 -1E+17 1E+17 ECU_ADDRESS 0x4000045A /end MEASUREMENT
/begin MEASUREMENT DFCOEnterCond "Conditions are correct for DFCO" UBYTE CompuMethod_11 1 0 0 1 ECU_ADDRESS 0x4000045E /end MEASUREMENT
/begin MEASUREMENT DFCOEntryRPM "DFCO entry RPM as a function of ECT" FLOAT32_IEEE CompuMethod_25 1 0 -1E+17 1E+17 ECU_ADDRESS 0x4000045F /end MEASUREMENT
/begin MEASUREMENT DFCOEntryRPMIdx "DFCO entry RPM as a function of ECT" UWORD CompuMethod_15 1 0 0 127.998 ECU_ADDRESS 0x40000463 /end MEASUREMENT
/begin MEASUREMENT DFCOEntryRPMIn "DFCO entry RPM as a function of ECT" FLOAT32_IEEE CompuMethod_27 1 0 -1E+17 1E+17 ECU_ADDRESS 0x40000465 /end MEASUREMENT
/begin MEASUREMENT DFCOExitRPM "DFCO exit rpm" FLOAT32_IEEE CompuMethod_25 1 0 -1E+17 1E+17 ECU_ADDRESS 0x40000469 /end MEASUREMENT
/begin MEASUREMENT DFCOExitRPMIdx "DFCO exit rpm" UWORD CompuMethod_15 1 0 0 127.998 ECU_ADDRESS 0x4000046D /end MEASUREMENT
/begin MEASUREMENT DFCOExitRPMIn "DFCO exit rpm" FLOAT32_IEEE CompuMethod_27 1 0 -1E+17 1E+17 ECU_ADDRESS 0x4000046F /end MEASUREMENT
/begin MEASUREMENT din_create_ESTOPPin "Debug Variable" UBYTE CompuMethod_31 1 0 0 0 ECU_ADDRESS 0x40000473 /end MEASUREMENT
/begin MEASUREMENT din_create_TwoStepPin "Debug Variable" UBYTE CompuMethod_31 1 0 0 0 ECU_ADDRESS 0x40000474 /end MEASUREMENT
/begin MEASUREMENT din_read_ESTOPPin "Debug Variable" UBYTE CompuMethod_31 1 0 0 0 ECU_ADDRESS 0x40000475 /end MEASUREMENT
/begin MEASUREMENT din_read_TwoStepPin "Debug Variable" UBYTE CompuMethod_31 1 0 0 0 ECU_ADDRESS 0x40000476 /end MEASUREMENT
/begin MEASUREMENT dout_create_DOut10165p0004 "Debug Variable" UBYTE CompuMethod_31 1 0 0 0 ECU_ADDRESS 0x40000477 /end MEASUREMENT
/begin MEASUREMENT dout_create_DOut9005p0001 "Debug Variable" UBYTE CompuMethod_31 1 0 0 0 ECU_ADDRESS 0x40000478 /end MEASUREMENT
/begin MEASUREMENT dout_create_DOut9617p0005 "Debug Variable" UBYTE CompuMethod_31 1 0 0 0 ECU_ADDRESS 0x40000479 /end MEASUREMENT
/begin MEASUREMENT dout_create_DOut9618p0005 "Debug Variable" UBYTE CompuMethod_31 1 0 0 0 ECU_ADDRESS 0x4000047A /end MEASUREMENT
/begin MEASUREMENT dout_create_DOut9638p0005 "Debug Variable" UBYTE CompuMethod_31 1 0 0 0 ECU_ADDRESS 0x4000047B /end MEASUREMENT
/begin MEASUREMENT ECT "Final value after Linear Sensor Characterization" FLOAT32_IEEE CompuMethod_61 1 0 -1E+17 1E+17 ECU_ADDRESS 0x4000047C /end MEASUREMENT
/begin MEASUREMENT ECT_FiltDirection "" UBYTE CompuMethod_34 1 0 0 1 ECU_ADDRESS 0x40000480 /end MEASUREMENT
/begin MEASUREMENT ECT_FiltFilterConst "" FLOAT32_IEEE CompuMethod_2 1 0 -1E+17 1E+17 ECU_ADDRESS 0x40000481 /end MEASUREMENT
/begin MEASUREMENT ECT_FiltFiltered "" FLOAT32_IEEE CompuMethod_2 1 0 -1E+17 1E+17 ECU_ADDRESS 0x40000485 /end MEASUREMENT
/begin MEASUREMENT ECT_KeyUp09Idx "Index of ECT captured at key-up." UWORD CompuMethod_15 1 0 0 127.998 ECU_ADDRESS 0x4000048D /end MEASUREMENT
/begin MEASUREMENT ECT_KeyUp09In "Index of ECT captured at key-up." FLOAT32_IEEE CompuMethod_27 1 0 -1E+17 1E+17 ECU_ADDRESS 0x4000048F /end MEASUREMENT
/begin MEASUREMENT ECT_SpkOfst "ECT spark offset" FLOAT32_IEEE CompuMethod_70 1 0 -1E+17 1E+17 ECU_ADDRESS 0x40000493 /end MEASUREMENT
/begin MEASUREMENT ECT_SpkOfstMult "Multiplier on ECT spark offset table." FLOAT32_IEEE CompuMethod_2 1 0 -1E+17 1E+17 ECU_ADDRESS 0x40000497 /end MEASUREMENT
/begin MEASUREMENT ECT05Idx "Idex of ECT" UWORD CompuMethod_15 1 0 0 127.998 ECU_ADDRESS 0x4000049B /end MEASUREMENT
/begin MEASUREMENT ECT05In "Idex of ECT" FLOAT32_IEEE CompuMethod_27 1 0 -1E+17 1E+17 ECU_ADDRESS 0x4000049D /end MEASUREMENT
/begin MEASUREMENT ECT09Idx "Index of ECT" UWORD CompuMethod_15 1 0 0 127.998 ECU_ADDRESS 0x400004A1 /end MEASUREMENT
/begin MEASUREMENT ECT09In "Index of ECT" FLOAT32_IEEE CompuMethod_27 1 0 -1E+17 1E+17 ECU_ADDRESS 0x400004A3 /end MEASUREMENT
/begin MEASUREMENT ECTADC "Signal measured directly from sensor" UWORD CompuMethod_16 1 0 0 65535 ECU_ADDRESS 0x400004A7 /end MEASUREMENT
/begin MEASUREMENT ECTIdx "Look up table to allownon-linear characterization of sensors" UWORD CompuMethod_15 1 0 0 127.998 ECU_ADDRESS 0x400004C9 /end MEASUREMENT
/begin MEASUREMENT ECTRaw "After conversion to engineering units, before range checking" FLOAT32_IEEE CompuMethod_61 1 0 -1E+17 1E+17 ECU_ADDRESS 0x400004CB /end MEASUREMENT
/begin MEASUREMENT ECTTransFuelMult "Transient fuel multiplier based on ECT.  Only engaged during transient fueling" FLOAT32_IEEE CompuMethod_2 1 0 -1E+17 1E+17 ECU_ADDRESS 0x400004CF /end MEASUREMENT
/begin MEASUREMENT ECUP_Enabled "" UBYTE CompuMethod_36 1 0 0 1 ECU_ADDRESS 0x400004D3 /end MEASUREMENT
/begin MEASUREMENT ECUVolt_FiltDirection "" UBYTE CompuMethod_34 1 0 0 1 ECU_ADDRESS 0x400004D4 /end MEASUREMENT
/begin MEASUREMENT ECUVolt_FiltFilterConst "" FLOAT32_IEEE CompuMethod_2 1 0 -1E+17 1E+17 ECU_ADDRESS 0x400004D5 /end MEASUREMENT
/begin MEASUREMENT ECUVolt_FiltFiltered "" FLOAT32_IEEE CompuMethod_2 1 0 -1E+17 1E+17 ECU_ADDRESS 0x400004D9 /end MEASUREMENT
/begin MEASUREMENT encoder_create "Debug Variable" UBYTE CompuMethod_31 1 0 0 0 ECU_ADDRESS 0x400004DD /end MEASUREMENT
/begin MEASUREMENT EncoderFault "" UBYTE CompuMethod_85 1 0 0 255 ECU_ADDRESS 0x400004DE /end MEASUREMENT
/begin MEASUREMENT EncoderFaultCount "" ULONG CompuMethod_60 1 0 0 4294970000 ECU_ADDRESS 0x400004DF /end MEASUREMENT
/begin MEASUREMENT EncoderState "" UBYTE CompuMethod_86 1 0 0 255 ECU_ADDRESS 0x400004E3 /end MEASUREMENT
/begin MEASUREMENT EncoderTDCOrder "Order of TDC angles (0 means unused)" SBYTE CompuMethod_87 1 0 -1 127 ECU_ADDRESS 0x400004E4 MATRIX_DIM 8 1 1 /end MEASUREMENT
/begin MEASUREMENT EngineAccel "Acceleration rate of engine" FLOAT32_IEEE CompuMethod_88 1 0 -1E+17 1E+17 ECU_ADDRESS 0x400004EC /end MEASUREMENT
/begin MEASUREMENT EngineStateRaw "" UBYTE CompuMethod_1 1 0 0 255 ECU_ADDRESS 0x400004F0 /end MEASUREMENT
/begin MEASUREMENT EnginSteadyState "" UBYTE CompuMethod_36 1 0 0 1 ECU_ADDRESS 0x400004F1 /end MEASUREMENT
/begin MEASUREMENT EqRatio_SpkOfsMult "Speed and Load Multiplier to the Equivalence Ratio Spark Offset table." FLOAT32_IEEE CompuMethod_33 1 0 -1E+17 1E+17 ECU_ADDRESS 0x400004F2 /end MEASUREMENT
/begin MEASUREMENT EqRatio_SpkOfst "Spark offset based on desired equivalence ratio (also muliplied by a speed load factor)" FLOAT32_IEEE CompuMethod_89 1 0 -1E+17 1E+17 ECU_ADDRESS 0x400004F6 /end MEASUREMENT
/begin MEASUREMENT EST_DiagDwell "Dwell time used to diagnose ESTs during run-state." UWORD CompuMethod_91 1 0 0 65535 ECU_ADDRESS 0x400004FA MATRIX_DIM 8 1 1 /end MEASUREMENT
/begin MEASUREMENT EST_Spark "Debug Variable" UBYTE CompuMethod_31 1 0 0 0 ECU_ADDRESS 0x4000050A /end MEASUREMENT
/begin MEASUREMENT EST_SparkCreate "Debug Variable" UBYTE CompuMethod_31 1 0 0 0 ECU_ADDRESS 0x4000050B /end MEASUREMENT
/begin MEASUREMENT EST_TDCEnabled "" SBYTE CompuMethod_7 1 0 -128 127 ECU_ADDRESS 0x4000050C /end MEASUREMENT
/begin MEASUREMENT ESTOP "Display output in engineering units" UBYTE CompuMethod_26 1 0 0 1 ECU_ADDRESS 0x4000050D /end MEASUREMENT
/begin MEASUREMENT ESTOP_Raw "Display output in engineering units" UBYTE CompuMethod_26 1 0 0 1 ECU_ADDRESS 0x4000050E /end MEASUREMENT
/begin MEASUREMENT ESTOpenADC "ADC counts of measured voltage feedback for diagnosing the ESTs during stall state." UWORD CompuMethod_52 1 0 0 65535 ECU_ADDRESS 0x4000050F MATRIX_DIM 8 1 1 /end MEASUREMENT
/begin MEASUREMENT ETB_Curr_Flt "" UBYTE CompuMethod_11 1 0 0 1 ECU_ADDRESS 0x4000051F /end MEASUREMENT
/begin MEASUREMENT ETC_Current "Current output of ETC duty cycle." SWORD CompuMethod_95 1 0 -32768 32767 ECU_ADDRESS 0x40000520 /end MEASUREMENT
/begin MEASUREMENT ETC_DutyCycle "Actual duty cycle of actuator" FLOAT32_IEEE CompuMethod_6 1 0 -1E+17 1E+17 ECU_ADDRESS 0x40000522 /end MEASUREMENT
/begin MEASUREMENT ETC_ECUPState "" UBYTE CompuMethod_11 1 0 0 1 ECU_ADDRESS 0x40000526 /end MEASUREMENT
/begin MEASUREMENT ETC_ErrorIdx "" UWORD CompuMethod_15 1 0 0 127.998 ECU_ADDRESS 0x40000527 /end MEASUREMENT
/begin MEASUREMENT ETC_ErrorIn "" FLOAT32_IEEE CompuMethod_2 1 0 -1E+17 1E+17 ECU_ADDRESS 0x40000529 /end MEASUREMENT
/begin MEASUREMENT ETC_IGainMult "Multiplier on the ETC I gain based on ETC error." FLOAT32_IEEE CompuMethod_2 1 0 -1E+17 1E+17 ECU_ADDRESS 0x4000052D /end MEASUREMENT
/begin MEASUREMENT ETC_PGainMult "Multiplier on the ETC P gain based on ETC error." FLOAT32_IEEE CompuMethod_2 1 0 -1E+17 1E+17 ECU_ADDRESS 0x40000531 /end MEASUREMENT
/begin MEASUREMENT ETC_Setpoint "Commanded electronic throttle position" FLOAT32_IEEE CompuMethod_6 1 0 -1E+17 1E+17 ECU_ADDRESS 0x40000535 /end MEASUREMENT
/begin MEASUREMENT ETC_SetpointIdx "" UWORD CompuMethod_15 1 0 0 127.998 ECU_ADDRESS 0x40000539 /end MEASUREMENT
/begin MEASUREMENT ETC_SetpointIn "" FLOAT32_IEEE CompuMethod_2 1 0 -1E+17 1E+17 ECU_ADDRESS 0x4000053B /end MEASUREMENT
/begin MEASUREMENT ETC_ShutdownSetpointMode "Shutdown mode for ETC setpoint. 0=Passthrough, 1=LoAdapt, 2=SpringTest." SBYTE CompuMethod_1 1 0 -128 127 ECU_ADDRESS 0x4000053F /end MEASUREMENT
/begin MEASUREMENT ETC_ShutDownTimer "" FLOAT32_IEEE CompuMethod_2 1 0 -1E+17 1E+17 ECU_ADDRESS 0x40000540 /end MEASUREMENT
/begin MEASUREMENT ETC_VoltageComp "Gain on ETC duty cycle based on DRVP" FLOAT32_IEEE CompuMethod_2 1 0 -1E+17 1E+17 ECU_ADDRESS 0x40000544 /end MEASUREMENT
/begin MEASUREMENT ETCDamperSwtichState "" UBYTE CompuMethod_11 1 0 0 1 ECU_ADDRESS 0x40000548 /end MEASUREMENT
/begin MEASUREMENT ETCDamperTPS "" FLOAT32_IEEE CompuMethod_2 1 0 -1E+17 1E+17 ECU_ADDRESS 0x40000549 /end MEASUREMENT
/begin MEASUREMENT ETCDamperTPSThresh "" FLOAT32_IEEE CompuMethod_2 1 0 -1E+17 1E+17 ECU_ADDRESS 0x4000054D /end MEASUREMENT
/begin MEASUREMENT ETCDampTerm "PID Damper Term" FLOAT32_IEEE CompuMethod_6 1 0 -1E+17 1E+17 ECU_ADDRESS 0x40000551 /end MEASUREMENT
/begin MEASUREMENT ETCDCOffset "Duty cycle offset based on desired ETC position." FLOAT32_IEEE CompuMethod_6 1 0 -1E+17 1E+17 ECU_ADDRESS 0x40000555 /end MEASUREMENT
/begin MEASUREMENT ETCDTerm "PID Derivative Term" FLOAT32_IEEE CompuMethod_6 1 0 -1E+17 1E+17 ECU_ADDRESS 0x40000559 /end MEASUREMENT
/begin MEASUREMENT ETCError "PID Error Term" FLOAT32_IEEE CompuMethod_6 1 0 -1E+17 1E+17 ECU_ADDRESS 0x4000055D /end MEASUREMENT
/begin MEASUREMENT ETCITerm "PID Integrator Term" FLOAT32_IEEE CompuMethod_6 1 0 -1E+17 1E+17 ECU_ADDRESS 0x40000561 /end MEASUREMENT
/begin MEASUREMENT ETCOut "PID Final Output" FLOAT32_IEEE CompuMethod_6 1 0 -1E+17 1E+17 ECU_ADDRESS 0x40000565 /end MEASUREMENT
/begin MEASUREMENT ETCPTerm "PID Proportional Term" FLOAT32_IEEE CompuMethod_6 1 0 -1E+17 1E+17 ECU_ADDRESS 0x40000569 /end MEASUREMENT
/begin MEASUREMENT ETCStallAppOvrReq "" FLOAT32_IEEE CompuMethod_6 1 0 -1E+17 1E+17 ECU_ADDRESS 0x4000058B /end MEASUREMENT
/begin MEASUREMENT ETCStallIceBreakReq "" FLOAT32_IEEE CompuMethod_6 1 0 -1E+17 1E+17 ECU_ADDRESS 0x4000058F /end MEASUREMENT
/begin MEASUREMENT ETCStallReq "" FLOAT32_IEEE CompuMethod_6 1 0 -1E+17 1E+17 ECU_ADDRESS 0x40000593 /end MEASUREMENT
/begin MEASUREMENT ETCStallStateShutdown "" UBYTE CompuMethod_36 1 0 0 1 ECU_ADDRESS 0x40000597 /end MEASUREMENT
/begin MEASUREMENT Eth11IdxIdx "" UWORD CompuMethod_15 1 0 0 127.998 ECU_ADDRESS 0x40000598 /end MEASUREMENT
/begin MEASUREMENT Eth11IdxIn "" FLOAT32_IEEE CompuMethod_2 1 0 -1E+17 1E+17 ECU_ADDRESS 0x4000059A /end MEASUREMENT
/begin MEASUREMENT Ethanol_Spk_Ofst "Total Spark Offset based on ECT, IAT2, engine speed and load" FLOAT32_IEEE CompuMethod_89 1 0 -1E+17 1E+17 ECU_ADDRESS 0x4000059E /end MEASUREMENT
/begin MEASUREMENT Ethanol_SpkOfstMult "Multiplier on ECT spark offset table." FLOAT32_IEEE CompuMethod_33 1 0 -1E+17 1E+17 ECU_ADDRESS 0x400005A2 /end MEASUREMENT
/begin MEASUREMENT EthSpkMod "Spark advance as a function of ethanol %" FLOAT32_IEEE CompuMethod_70 1 0 -1E+17 1E+17 ECU_ADDRESS 0x400005A6 /end MEASUREMENT
/begin MEASUREMENT EVAP "Final value after Linear Sensor Characterization" FLOAT32_IEEE CompuMethod_61 1 0 -1E+17 1E+17 ECU_ADDRESS 0x400005AA /end MEASUREMENT
/begin MEASUREMENT EVAPADC "Signal measured directly from sensor" UWORD CompuMethod_16 1 0 0 65535 ECU_ADDRESS 0x400005AE /end MEASUREMENT
/begin MEASUREMENT EVAPIdx "Look up table to allownon-linear characterization of sensors" UWORD CompuMethod_15 1 0 0 127.998 ECU_ADDRESS 0x400005B0 /end MEASUREMENT
/begin MEASUREMENT EVAPRaw "After conversion to engineering units, before range checking" FLOAT32_IEEE CompuMethod_61 1 0 -1E+17 1E+17 ECU_ADDRESS 0x400005B2 /end MEASUREMENT
/begin MEASUREMENT FAN1 "Display output in engineering units" UBYTE CompuMethod_4 1 0 0 1 ECU_ADDRESS 0x400005B6 /end MEASUREMENT
/begin MEASUREMENT FAN1_PWMDutyCycle "Actual duty cycle of actuator" FLOAT32_IEEE CompuMethod_6 1 0 -1E+17 1E+17 ECU_ADDRESS 0x400005B7 /end MEASUREMENT
/begin MEASUREMENT FAN2 "Display output in engineering units" UBYTE CompuMethod_4 1 0 0 1 ECU_ADDRESS 0x400005BF /end MEASUREMENT
/begin MEASUREMENT FAN2_PWMDutyCycle "Actual duty cycle of actuator" FLOAT32_IEEE CompuMethod_6 1 0 -1E+17 1E+17 ECU_ADDRESS 0x400005C0 /end MEASUREMENT
/begin MEASUREMENT FaultActionReason._.CutThrottle "Displays a rolling marquee of the reasons for fault action: FaultActionReason." UBYTE CompuMethod_106 1 0 0 255 ECU_ADDRESS 0x400005C8 /end MEASUREMENT
/begin MEASUREMENT FaultActionReason._.DFCODisable "Displays a rolling marquee of the reasons for fault action: FaultActionReason." UBYTE CompuMethod_106 1 0 0 255 ECU_ADDRESS 0x400005C9 /end MEASUREMENT
/begin MEASUREMENT FaultActionReason._.DelayedEngineShutdown "Displays a rolling marquee of the reasons for fault action: FaultActionReason." UBYTE CompuMethod_106 1 0 0 255 ECU_ADDRESS 0x400005CA /end MEASUREMENT
/begin MEASUREMENT FaultActionReason._.DisableAC "Displays a rolling marquee of the reasons for fault action: FaultActionReason." UBYTE CompuMethod_106 1 0 0 255 ECU_ADDRESS 0x400005CB /end MEASUREMENT
/begin MEASUREMENT FaultActionReason._.DisableO2Ctrl "Displays a rolling marquee of the reasons for fault action: FaultActionReason." UBYTE CompuMethod_106 1 0 0 255 ECU_ADDRESS 0x400005CC /end MEASUREMENT
/begin MEASUREMENT FaultActionReason._.DisableVEAdapt "Displays a rolling marquee of the reasons for fault action: FaultActionReason." UBYTE CompuMethod_106 1 0 0 255 ECU_ADDRESS 0x400005CD /end MEASUREMENT
/begin MEASUREMENT FaultActionReason._.DisableWastegate "Displays a rolling marquee of the reasons for fault action: FaultActionReason." UBYTE CompuMethod_106 1 0 0 255 ECU_ADDRESS 0x400005CE /end MEASUREMENT
/begin MEASUREMENT FaultActionReason._.EngineProtectLED "Displays a rolling marquee of the reasons for fault action: FaultActionReason." UBYTE CompuMethod_106 1 0 0 255 ECU_ADDRESS 0x400005CF /end MEASUREMENT
/begin MEASUREMENT FaultActionReason._.EngineShutdown "Displays a rolling marquee of the reasons for fault action: FaultActionReason." UBYTE CompuMethod_106 1 0 0 255 ECU_ADDRESS 0x400005D0 /end MEASUREMENT
/begin MEASUREMENT FaultActionReason._.HardRevLimit "Displays a rolling marquee of the reasons for fault action: FaultActionReason." UBYTE CompuMethod_106 1 0 0 255 ECU_ADDRESS 0x400005D1 /end MEASUREMENT
/begin MEASUREMENT FaultActionReason._.MIL_LED "Displays a rolling marquee of the reasons for fault action: FaultActionReason." UBYTE CompuMethod_106 1 0 0 255 ECU_ADDRESS 0x400005D2 /end MEASUREMENT
/begin MEASUREMENT FaultActionReason._.MediumRevLimit "Displays a rolling marquee of the reasons for fault action: FaultActionReason." UBYTE CompuMethod_106 1 0 0 255 ECU_ADDRESS 0x400005D3 /end MEASUREMENT
/begin MEASUREMENT FaultActionReason._.SoftRevLimit "Displays a rolling marquee of the reasons for fault action: FaultActionReason." UBYTE CompuMethod_106 1 0 0 255 ECU_ADDRESS 0x400005D4 /end MEASUREMENT
/begin MEASUREMENT FgndAngleStackMinBytesFree "Min bytes observed on the Foreground Angle Stack (may not exist depending onapplication)" ULONG CompuMethod_54 1 0 0 0 ECU_ADDRESS 0x400005D8 /end MEASUREMENT
/begin MEASUREMENT FgndAngTaskStatus "Foreground Time Scheduler Status" UBYTE CompuMethod_53 1 0 0 0 ECU_ADDRESS 0x400005DC /end MEASUREMENT
/begin MEASUREMENT FgndTimeStackMinBytesFree "Min bytes observed on the Foreground Time Stack" ULONG CompuMethod_54 1 0 0 0 ECU_ADDRESS 0x400005DD /end MEASUREMENT
/begin MEASUREMENT Flex_FiltDirection "" UBYTE CompuMethod_34 1 0 0 1 ECU_ADDRESS 0x400005E5 /end MEASUREMENT
/begin MEASUREMENT Flex_FiltFilterConst "" FLOAT32_IEEE CompuMethod_2 1 0 -1E+17 1E+17 ECU_ADDRESS 0x400005E6 /end MEASUREMENT
/begin MEASUREMENT Flex_FiltFiltered "" FLOAT32_IEEE CompuMethod_2 1 0 -1E+17 1E+17 ECU_ADDRESS 0x400005EA /end MEASUREMENT
/begin MEASUREMENT ForcedShutDownTimer "" FLOAT32_IEEE CompuMethod_2 1 0 -1E+17 1E+17 ECU_ADDRESS 0x400005EE /end MEASUREMENT
/begin MEASUREMENT FrameworkGlueErrors "This indicates the currently Active Errors within the Framework Glue module." UWORD CompuMethod_113 1 0 0 65535 ECU_ADDRESS 0x400005F2 /end MEASUREMENT
/begin MEASUREMENT freq_in_create_FuelSensorPin "Debug Variable" UBYTE CompuMethod_31 1 0 0 0 ECU_ADDRESS 0x400005F4 /end MEASUREMENT
/begin MEASUREMENT freq_in_create_MAF_Pin "Debug Variable" UBYTE CompuMethod_31 1 0 0 0 ECU_ADDRESS 0x400005F5 /end MEASUREMENT
/begin MEASUREMENT freq_in_create_VSPD_Pin "Debug Variable" UBYTE CompuMethod_31 1 0 0 0 ECU_ADDRESS 0x400005F6 /end MEASUREMENT
/begin MEASUREMENT freq_in_read_FuelSensorPin "Debug Variable" UBYTE CompuMethod_31 1 0 0 0 ECU_ADDRESS 0x400005F7 /end MEASUREMENT
/begin MEASUREMENT freq_in_read_MAF_Pin "Debug Variable" UBYTE CompuMethod_31 1 0 0 0 ECU_ADDRESS 0x400005F8 /end MEASUREMENT
/begin MEASUREMENT freq_in_read_VSPD_Pin "Debug Variable" UBYTE CompuMethod_31 1 0 0 0 ECU_ADDRESS 0x400005F9 /end MEASUREMENT
/begin MEASUREMENT FuelPumpTSE "" FLOAT32_IEEE CompuMethod_2 1 0 -1E+17 1E+17 ECU_ADDRESS 0x4000068B /end MEASUREMENT
/begin MEASUREMENT GearEstimated "" FLOAT32_IEEE CompuMethod_2 1 0 -1E+17 1E+17 ECU_ADDRESS 0x4000069B /end MEASUREMENT
/begin MEASUREMENT IAT_FiltDirection "" UBYTE CompuMethod_34 1 0 0 1 ECU_ADDRESS 0x400006E0 /end MEASUREMENT
/begin MEASUREMENT IAT_FiltFilterConst "" FLOAT32_IEEE CompuMethod_2 1 0 -1E+17 1E+17 ECU_ADDRESS 0x400006E1 /end MEASUREMENT
/begin MEASUREMENT IAT_FiltFiltered "" FLOAT32_IEEE CompuMethod_2 1 0 -1E+17 1E+17 ECU_ADDRESS 0x400006E5 /end MEASUREMENT
/begin MEASUREMENT IAT_SpkOfst "IAT spark offset" FLOAT32_IEEE CompuMethod_70 1 0 -1E+17 1E+17 ECU_ADDRESS 0x400006F3 /end MEASUREMENT
/begin MEASUREMENT IAT_SpkOfstMult "Multiplier on IAT spark offset table." FLOAT32_IEEE CompuMethod_2 1 0 -1E+17 1E+17 ECU_ADDRESS 0x400006F7 /end MEASUREMENT
/begin MEASUREMENT IdleStackMinBytesFree "Min bytes observed on the Idle Stack" ULONG CompuMethod_54 1 0 0 0 ECU_ADDRESS 0x40000733 /end MEASUREMENT
/begin MEASUREMENT IdleState "The idle governor may be one of: Flaring, OnIdle, OffIdle" UBYTE CompuMethod_129 1 0 0 255 ECU_ADDRESS 0x40000737 /end MEASUREMENT
/begin MEASUREMENT INJ_InjectorCreate "Debug Variable" UBYTE CompuMethod_31 1 0 0 0 ECU_ADDRESS 0x40000738 /end MEASUREMENT
/begin MEASUREMENT InjDC "" FLOAT32_IEEE CompuMethod_2 1 0 -1E+17 1E+17 ECU_ADDRESS 0x40000739 MATRIX_DIM 8 1 1 /end MEASUREMENT
/begin MEASUREMENT InjdPComp "Injector characterization compenastion based on dP across injector." FLOAT32_IEEE CompuMethod_133 1 0 -1E+17 1E+17 ECU_ADDRESS 0x4000075F /end MEASUREMENT
/begin MEASUREMENT InjectorsEnabled "Enable state for injectors." UBYTE CompuMethod_4 1 0 0 1 ECU_ADDRESS 0x40000763 MATRIX_DIM 8 1 1 /end MEASUREMENT
/begin MEASUREMENT InjEPW "" FLOAT32_IEEE CompuMethod_2 1 0 -1E+17 1E+17 ECU_ADDRESS 0x4000076B /end MEASUREMENT
/begin MEASUREMENT InjMPW "" FLOAT32_IEEE CompuMethod_2 1 0 -1E+17 1E+17 ECU_ADDRESS 0x4000076F MATRIX_DIM 8 1 1 /end MEASUREMENT
/begin MEASUREMENT InjTransitionCount "" UBYTE CompuMethod_1 1 0 0 255 ECU_ADDRESS 0x4000078F MATRIX_DIM 8 1 1 /end MEASUREMENT
/begin MEASUREMENT InjTurnOff "Injector turn off time" FLOAT32_IEEE CompuMethod_68 1 0 -1E+17 1E+17 ECU_ADDRESS 0x40000797 /end MEASUREMENT
/begin MEASUREMENT InjTurnOn "Injector turn on time." FLOAT32_IEEE CompuMethod_68 1 0 -1E+17 1E+17 ECU_ADDRESS 0x4000079B /end MEASUREMENT
/begin MEASUREMENT IntakeAirTempEnrichment "Requested on base eq. ratio as a function of IAT and MAP" FLOAT32_IEEE CompuMethod_66 1 0 -1E+17 1E+17 ECU_ADDRESS 0x4000079F /end MEASUREMENT
/begin MEASUREMENT InterruptStackMinBytesFree "Minimum observed stack free for use by the interrupts" UWORD CompuMethod_136 1 0 0 65535 ECU_ADDRESS 0x400007A3 /end MEASUREMENT
/begin MEASUREMENT LastOSError "Monitor of Internal OS Errors" UBYTE CompuMethod_137 1 0 0 0 ECU_ADDRESS 0x400007A5 /end MEASUREMENT
/begin MEASUREMENT MAF09Idx "" UWORD CompuMethod_15 1 0 0 127.998 ECU_ADDRESS 0x400007C3 /end MEASUREMENT
/begin MEASUREMENT MAF09In "" FLOAT32_IEEE CompuMethod_2 1 0 -1E+17 1E+17 ECU_ADDRESS 0x400007C5 /end MEASUREMENT
/begin MEASUREMENT MAFFinal "Air mass flow rate at the intake manifold - Used by the fueling algorithm" FLOAT32_IEEE CompuMethod_30 1 0 -1E+17 1E+17 ECU_ADDRESS 0x400007CD /end MEASUREMENT
/begin MEASUREMENT MakeUpEOI "End of injection timing for transient makeup fuel pulse" FLOAT32_IEEE CompuMethod_70 1 0 -1E+17 1E+17 ECU_ADDRESS 0x400007DD /end MEASUREMENT
/begin MEASUREMENT MaxAllowableMPW "" FLOAT32_IEEE CompuMethod_2 1 0 -1E+17 1E+17 ECU_ADDRESS 0x40000862 /end MEASUREMENT
/begin MEASUREMENT O2Calibration "" UBYTE CompuMethod_36 1 0 0 1 ECU_ADDRESS 0x40000A48 /end MEASUREMENT
/begin MEASUREMENT O2CtrlMode "" UBYTE CompuMethod_152 1 0 0 1 ECU_ADDRESS 0x40000A49 /end MEASUREMENT
/begin MEASUREMENT O2FuelMult "Closed-loop O2 control fuel multiplier." FLOAT32_IEEE CompuMethod_33 1 0 -1E+17 1E+17 ECU_ADDRESS 0x40000A4A /end MEASUREMENT
/begin MEASUREMENT O2ITermIdx "Index for O2 ITerm." UWORD CompuMethod_15 1 0 0 127.998 ECU_ADDRESS 0x40000A4E /end MEASUREMENT
/begin MEASUREMENT O2ITermIn "Index for O2 ITerm." FLOAT32_IEEE CompuMethod_33 1 0 -1E+17 1E+17 ECU_ADDRESS 0x40000A50 /end MEASUREMENT
/begin MEASUREMENT O2SensorFaults "" UBYTE CompuMethod_36 1 0 0 1 ECU_ADDRESS 0x40000A68 /end MEASUREMENT
/begin MEASUREMENT O2StartUpDelay "Delay O2 enable until TimeSinceRun is greater than this time." FLOAT32_IEEE CompuMethod_10 1 0 -1E+17 1E+17 ECU_ADDRESS 0x40000A69 /end MEASUREMENT
/begin MEASUREMENT O2TimeDelay "" UBYTE CompuMethod_36 1 0 0 1 ECU_ADDRESS 0x40000A71 /end MEASUREMENT
/begin MEASUREMENT OSErrorCnt "Number of errors observed by the OS" UBYTE CompuMethod_1 1 0 0 255 ECU_ADDRESS 0x40000A85 /end MEASUREMENT
/begin MEASUREMENT OSStatus "" UBYTE CompuMethod_155 1 0 0 0 ECU_ADDRESS 0x40000A86 /end MEASUREMENT
/begin MEASUREMENT PeakHeapBytesUsed "The peak number of bytes seen on the heap." ULONG CompuMethod_52 1 0 0 0 ECU_ADDRESS 0x40000AB9 /end MEASUREMENT
/begin MEASUREMENT PrimarySOI "Injection timing for primary fuel pulse - SOI or EOI depending on Inj Config" FLOAT32_IEEE CompuMethod_70 1 0 -1E+17 1E+17 ECU_ADDRESS 0x40000AD1 /end MEASUREMENT
/begin MEASUREMENT protocol_register_CAN_1 "Debug Variable" UBYTE CompuMethod_31 1 0 0 0 ECU_ADDRESS 0x40000AD5 /end MEASUREMENT
/begin MEASUREMENT protocol_register_CAN_2 "Debug Variable" UBYTE CompuMethod_31 1 0 0 0 ECU_ADDRESS 0x40000AD6 /end MEASUREMENT
/begin MEASUREMENT RPM "" FLOAT32_IEEE CompuMethod_2 1 0 -1E+17 1E+17 ECU_ADDRESS 0x40000AED /end MEASUREMENT
/begin MEASUREMENT RPMCtrlMode "" UBYTE CompuMethod_11 1 0 0 1 ECU_ADDRESS 0x40000B09 /end MEASUREMENT
/begin MEASUREMENT RPMInst "" FLOAT32_IEEE CompuMethod_2 1 0 -1E+17 1E+17 ECU_ADDRESS 0x40000B13 /end MEASUREMENT
/begin MEASUREMENT Spark_Adv_Prb "" FLOAT32_IEEE CompuMethod_2 1 0 -1E+17 1E+17 ECU_ADDRESS 0x40000B26 /end MEASUREMENT
/begin MEASUREMENT SparkAdv "Base spark advance map." FLOAT32_IEEE CompuMethod_70 1 0 -1E+17 1E+17 ECU_ADDRESS 0x40000B2A /end MEASUREMENT
/begin MEASUREMENT SparkAdv_FiltDirection "" UBYTE CompuMethod_34 1 0 0 1 ECU_ADDRESS 0x40000B2E /end MEASUREMENT
/begin MEASUREMENT SparkAdv_FiltFilterConst "" FLOAT32_IEEE CompuMethod_2 1 0 -1E+17 1E+17 ECU_ADDRESS 0x40000B2F /end MEASUREMENT
/begin MEASUREMENT SparkAdv_FiltFiltered "" FLOAT32_IEEE CompuMethod_2 1 0 -1E+17 1E+17 ECU_ADDRESS 0x40000B33 /end MEASUREMENT
/begin MEASUREMENT SparkDwell "Total electrical spark dwell time" FLOAT32_IEEE CompuMethod_69 1 0 -1E+17 1E+17 ECU_ADDRESS 0x40000B37 /end MEASUREMENT
/begin MEASUREMENT SparkEnabled "Enabled when spark energy is greater than zero" UBYTE CompuMethod_37 1 0 0 1 ECU_ADDRESS 0x40000B3B /end MEASUREMENT
/begin MEASUREMENT SparkEnergyMonitor "Commanded spark energy, before conversion to dwell time" FLOAT32_IEEE CompuMethod_51 1 0 -1E+17 1E+17 ECU_ADDRESS 0x40000B3C /end MEASUREMENT
/begin MEASUREMENT SpkEnergy09Idx "" UWORD CompuMethod_15 1 0 0 127.998 ECU_ADDRESS 0x40000B40 /end MEASUREMENT
/begin MEASUREMENT SpkEnergy09In "" FLOAT32_IEEE CompuMethod_2 1 0 -1E+17 1E+17 ECU_ADDRESS 0x40000B42 /end MEASUREMENT
/begin MEASUREMENT SpkOfstTempFnl "Total Spark Offset based on ECT, IAT, CAT, engine speed and load" FLOAT32_IEEE CompuMethod_70 1 0 -1E+17 1E+17 ECU_ADDRESS 0x40000B64 /end MEASUREMENT
/begin MEASUREMENT SWISRCurrQueueSize "Current size of the Software ISR Queue" UBYTE CompuMethod_172 1 0 0 255 ECU_ADDRESS 0x40000B7C /end MEASUREMENT
/begin MEASUREMENT TDCCount "Number of TDC events counted after stall.  This will reset once in Crank and Run." UBYTE CompuMethod_1 1 0 0 255 ECU_ADDRESS 0x40000B91 /end MEASUREMENT
/begin MEASUREMENT TDCCountThreshEnabled "" UBYTE CompuMethod_36 1 0 0 1 ECU_ADDRESS 0x40000B92 /end MEASUREMENT
/begin MEASUREMENT Tot_EqRatio_SpkOfst "Total Spark Offset based on Desired Equivalence Ratio, engine speed and load" FLOAT32_IEEE CompuMethod_89 1 0 -1E+17 1E+17 ECU_ADDRESS 0x40000BA5 /end MEASUREMENT
/begin MEASUREMENT TotalFPC "Total fuel per cylinder after application of transient algorithm" FLOAT32_IEEE CompuMethod_114 1 0 -1E+17 1E+17 ECU_ADDRESS 0x40000BA9 MATRIX_DIM 8 1 1 /end MEASUREMENT
/begin MEASUREMENT TPS_FiltDirection "" UBYTE CompuMethod_34 1 0 0 1 ECU_ADDRESS 0x40000BCD /end MEASUREMENT
/begin MEASUREMENT TPS_FiltFilterConst "" FLOAT32_IEEE CompuMethod_2 1 0 -1E+17 1E+17 ECU_ADDRESS 0x40000BCE /end MEASUREMENT
/begin MEASUREMENT TPS_FiltFiltered "" FLOAT32_IEEE CompuMethod_2 1 0 -1E+17 1E+17 ECU_ADDRESS 0x40000BD2 /end MEASUREMENT
/begin MEASUREMENT TransFuel_MAPFilt "" FLOAT32_IEEE CompuMethod_2 1 0 -1E+17 1E+17 ECU_ADDRESS 0x40000C0E /end MEASUREMENT
/begin MEASUREMENT TransFuel_TPSFilt "" FLOAT32_IEEE CompuMethod_2 1 0 -1E+17 1E+17 ECU_ADDRESS 0x40000C12 /end MEASUREMENT
/begin MEASUREMENT VEAdaptAmnt "Volumetric efficiency adapt amount at the given speed and load" FLOAT32_IEEE CompuMethod_6 1 0 -1E+17 1E+17 ECU_ADDRESS 0x40000C1F /end MEASUREMENT
/begin MEASUREMENT VEAdapting "Indicates whether the volumetric efficiency map is currently being adjusted" UBYTE CompuMethod_177 1 0 0 1 ECU_ADDRESS 0x40000C27 /end MEASUREMENT
/begin MEASUREMENT VEBaroCorr "Vol Eff compensation based on BARO." FLOAT32_IEEE CompuMethod_2 1 0 -1E+17 1E+17 ECU_ADDRESS 0x40000C28 /end MEASUREMENT
/begin MEASUREMENT VEFin "Final volumentric efficiency after adapt table" FLOAT32_IEEE CompuMethod_30 1 0 -1E+17 1E+17 ECU_ADDRESS 0x40000C2C /end MEASUREMENT
/begin MEASUREMENT VEIdealMAF "Air Mass Flow Rate - ideal" FLOAT32_IEEE CompuMethod_30 1 0 -1E+17 1E+17 ECU_ADDRESS 0x40000C30 /end MEASUREMENT
/begin MEASUREMENT VEMapIdx "Index of MAP for VE calculations" UWORD CompuMethod_15 1 0 0 127.998 ECU_ADDRESS 0x40000C34 /end MEASUREMENT
/begin MEASUREMENT VEMapIn "Index of MAP for VE calculations" FLOAT32_IEEE CompuMethod_8 1 0 -1E+17 1E+17 ECU_ADDRESS 0x40000C36 /end MEASUREMENT
/begin MEASUREMENT VEModelMAF "Air Mass Flow Rate - Port Total" FLOAT32_IEEE CompuMethod_30 1 0 -1E+17 1E+17 ECU_ADDRESS 0x40000C3A /end MEASUREMENT
/begin MEASUREMENT VETempCorr "" FLOAT32_IEEE CompuMethod_6 1 0 -1E+17 1E+17 ECU_ADDRESS 0x40000C3E /end MEASUREMENT
/begin MEASUREMENT VolEff "Volumetric efficiency table for speed density mode" FLOAT32_IEEE CompuMethod_6 1 0 -1E+17 1E+17 ECU_ADDRESS 0x40000C42 /end MEASUREMENT
/begin MEASUREMENT VolEffAdapt "Volumetric efficiency adapt table" FLOAT32_IEEE CompuMethod_6 1 0 -1E+17 1E+17 ECU_ADDRESS 0x40000C46 /end MEASUREMENT
/begin MEASUREMENT VSPD_FiltDirection "" UBYTE CompuMethod_34 1 0 0 1 ECU_ADDRESS 0x40000C53 /end MEASUREMENT
/begin MEASUREMENT VSPD_FiltFilterConst "" FLOAT32_IEEE CompuMethod_2 1 0 -1E+17 1E+17 ECU_ADDRESS 0x40000C54 /end MEASUREMENT
/begin MEASUREMENT VSPD_FiltFiltered "" FLOAT32_IEEE CompuMethod_2 1 0 -1E+17 1E+17 ECU_ADDRESS 0x40000C58 /end MEASUREMENT
/begin MEASUREMENT WarmUpEqRatio "Requested eq. ratio as a function of ECT and MAP." FLOAT32_IEEE CompuMethod_66 1 0 -1E+17 1E+17 ECU_ADDRESS 0x40000C7B /end MEASUREMENT
/begin MEASUREMENT WarmUpTimeRatio "Requested eq. ratio as a function of TimeSinceRun and ECT. Use for cold temps" FLOAT32_IEEE CompuMethod_66 1 0 -1E+17 1E+17 ECU_ADDRESS 0x40000C80 /end MEASUREMENT
/begin MEASUREMENT WGDeadTime "Wastegate turn on time" FLOAT32_IEEE CompuMethod_68 1 0 -1E+17 1E+17 ECU_ADDRESS 0x40000C88 /end MEASUREMENT
/begin CHARACTERISTIC Bank1_SensorStatus_Ovr_new "" VALUE 0x80000642 RecordLayout_4 0 CompuMethod_2 -1E+17 1E+17 /end CHARACTERISTIC
/begin CHARACTERISTIC Bank1_SensorStatus_Ovr_ovr "" VALUE 0x80000646 RecordLayout_1 0 CompuMethod_5 0 1 /end CHARACTERISTIC
/begin CHARACTERISTIC Bank1_SystemVolts_Ovr_new "" VALUE 0x80000647 RecordLayout_4 0 CompuMethod_2 -1E+17 1E+17 /end CHARACTERISTIC
/begin CHARACTERISTIC Bank1_SystemVolts_Ovr_ovr "" VALUE 0x8000064B RecordLayout_1 0 CompuMethod_5 0 1 /end CHARACTERISTIC
/begin CHARACTERISTIC Bank1_UsingFreeAreCalState_Ovr_new "" VALUE 0x8000064C RecordLayout_4 0 CompuMethod_2 -1E+17 1E+17 /end CHARACTERISTIC
/begin CHARACTERISTIC Bank1_UsingFreeAreCalState_Ovr_ovr "" VALUE 0x80000650 RecordLayout_1 0 CompuMethod_5 0 1 /end CHARACTERISTIC
/begin CHARACTERISTIC Bank2_DataValidState_Ovr_new "" VALUE 0x80000651 RecordLayout_4 0 CompuMethod_2 -1E+17 1E+17 /end CHARACTERISTIC
/begin CHARACTERISTIC Bank2_DataValidState_Ovr_ovr "" VALUE 0x80000655 RecordLayout_1 0 CompuMethod_5 0 1 /end CHARACTERISTIC
/begin CHARACTERISTIC Bank2_EquivRatio_new "Override result of linear sensor characterization, in engineering units" VALUE 0x80000657 RecordLayout_4 0 CompuMethod_44 -1E+17 1E+17 /end CHARACTERISTIC
/begin CHARACTERISTIC Bank2_EquivRatio_ovr "" VALUE 0x8000065B RecordLayout_1 0 CompuMethod_5 0 1 /end CHARACTERISTIC
/begin CHARACTERISTIC Bank2_EquivRatioDfltValue "This is the initial default value should the sensor be in fault on key-up.  Otherwise the sensors outputs the last value prior to faulting" VALUE 0x8000065C RecordLayout_4 0 CompuMethod_44 -1E+17 1E+17 /end CHARACTERISTIC
/begin CHARACTERISTIC Bank2_EquivRatioFilterConst "Filter time constant" VALUE 0x80000660 RecordLayout_4 0 CompuMethod_20 -1E+17 1E+17 /end CHARACTERISTIC
/begin CHARACTERISTIC Bank2_EquivRatioGain "Scaling from A/D counts to engineering units" VALUE 0x80000664 RecordLayout_4 0 CompuMethod_45 -1E+17 1E+17 /end CHARACTERISTIC
/begin CHARACTERISTIC Bank2_EquivRatioInputHiFltPos "Maximum allowable input, indicating short or open circuit" VALUE 0x80000668 RecordLayout_4 0 CompuMethod_44 -1E+17 1E+17 /end CHARACTERISTIC
/begin CHARACTERISTIC Bank2_EquivRatioInputLoFltPos "Minimum allowable input, indicating short or open circuit" VALUE 0x8000066C RecordLayout_4 0 CompuMethod_44 -1E+17 1E+17 /end CHARACTERISTIC
/begin CHARACTERISTIC Bank2_EquivRatioOfst "Offset after gain in engineering units" VALUE 0x80000670 RecordLayout_4 0 CompuMethod_44 -1E+17 1E+17 /end CHARACTERISTIC
/begin CHARACTERISTIC Bank2_HeaterVolts_Ovr_new "" VALUE 0x80000674 RecordLayout_4 0 CompuMethod_2 -1E+17 1E+17 /end CHARACTERISTIC
/begin CHARACTERISTIC Bank2_HeaterVolts_Ovr_ovr "" VALUE 0x80000678 RecordLayout_1 0 CompuMethod_5 0 1 /end CHARACTERISTIC
/begin CHARACTERISTIC Bank2_Lambda_Ovr_new "" VALUE 0x80000679 RecordLayout_4 0 CompuMethod_2 -1E+17 1E+17 /end CHARACTERISTIC
/begin CHARACTERISTIC Bank2_Lambda_Ovr_ovr "" VALUE 0x8000067D RecordLayout_1 0 CompuMethod_5 0 1 /end CHARACTERISTIC
/begin CHARACTERISTIC Bank2_OxygenConcentration_Ovr_new "" VALUE 0x8000067E RecordLayout_4 0 CompuMethod_2 -1E+17 1E+17 /end CHARACTERISTIC
/begin CHARACTERISTIC Bank2_OxygenConcentration_Ovr_ovr "" VALUE 0x80000682 RecordLayout_1 0 CompuMethod_5 0 1 /end CHARACTERISTIC
/begin CHARACTERISTIC Bank2_SensorDetectedStatus_Ovr_new "" VALUE 0x80000683 RecordLayout_4 0 CompuMethod_2 -1E+17 1E+17 /end CHARACTERISTIC
/begin CHARACTERISTIC Bank2_SensorDetectedStatus_Ovr_ovr "" VALUE 0x80000687 RecordLayout_1 0 CompuMethod_5 0 1 /end CHARACTERISTIC
/begin CHARACTERISTIC Bank2_SensorFaultState_Ovr_new "" VALUE 0x80000688 RecordLayout_4 0 CompuMethod_2 -1E+17 1E+17 /end CHARACTERISTIC
/begin CHARACTERISTIC Bank2_SensorFaultState_Ovr_ovr "" VALUE 0x8000068C RecordLayout_1 0 CompuMethod_5 0 1 /end CHARACTERISTIC
/begin CHARACTERISTIC Bank2_SensorStatus_Ovr_new "" VALUE 0x8000068D RecordLayout_4 0 CompuMethod_2 -1E+17 1E+17 /end CHARACTERISTIC
/begin CHARACTERISTIC Bank2_SensorStatus_Ovr_ovr "" VALUE 0x80000691 RecordLayout_1 0 CompuMethod_5 0 1 /end CHARACTERISTIC
/begin CHARACTERISTIC Bank2_SystemVolts_Ovr_new "" VALUE 0x80000692 RecordLayout_4 0 CompuMethod_2 -1E+17 1E+17 /end CHARACTERISTIC
/begin CHARACTERISTIC Bank2_SystemVolts_Ovr_ovr "" VALUE 0x80000696 RecordLayout_1 0 CompuMethod_5 0 1 /end CHARACTERISTIC
/begin CHARACTERISTIC Bank2_UsingFreeAreCalState_Ovr_new "" VALUE 0x80000697 RecordLayout_4 0 CompuMethod_2 -1E+17 1E+17 /end CHARACTERISTIC
/begin CHARACTERISTIC Bank2_UsingFreeAreCalState_Ovr_ovr "" VALUE 0x8000069B RecordLayout_1 0 CompuMethod_5 0 1 /end CHARACTERISTIC
/begin CHARACTERISTIC BARO_Count "Number of samples to average at key-up to produce signal value" VALUE 0x8000069C RecordLayout_7 0 CompuMethod_1 -128 127 /end CHARACTERISTIC
/begin CHARACTERISTIC BARO_offset "Provides an override to the input by adding this amount to either the locked or running value" VALUE 0x8000069D RecordLayout_4 0 CompuMethod_8 -1E+17 1E+17 /end CHARACTERISTIC
/begin CHARACTERISTIC BARO_ovr "Provides an override to the input by adding this amount to either the locked or running value" VALUE 0x800006A1 RecordLayout_1 0 CompuMethod_46 0 1 /end CHARACTERISTIC
/begin CHARACTERISTIC BaroLearn_MAP "" VALUE 0x800006C6 RecordLayout_4 0 CompuMethod_8 0 100 /end CHARACTERISTIC
/begin CHARACTERISTIC BaroLearn_Tm "" VALUE 0x800006CA RecordLayout_4 0 CompuMethod_20 0 100 /end CHARACTERISTIC
/begin CHARACTERISTIC BaroLearn_TPSPos "" VALUE 0x800006CE RecordLayout_4 0 CompuMethod_6 0 100 /end CHARACTERISTIC
/begin CHARACTERISTIC BaroRunStallDelay "Delay time after transitioning from Run to Stall before resampling baro." VALUE 0x800006D2 RecordLayout_4 0 CompuMethod_10 -1E+17 1E+17 /end CHARACTERISTIC
/begin CHARACTERISTIC BaseAirflowAdaptDelayTime "Idle Control must be enabled for this amount of time before fuel adaption is enabled" VALUE 0x800006D6 RecordLayout_4 0 CompuMethod_10 0 1E+17 /end CHARACTERISTIC
/begin CHARACTERISTIC BaseAirflowAdaptDelta "Air PID Iterm must be less than this delta to adapt the BaseAirflow table." VALUE 0x800006DA RecordLayout_4 0 CompuMethod_33 -1E+17 1E+17 /end CHARACTERISTIC
/begin CHARACTERISTIC BaseAirflowAdaptEnable "Determines whether the BaseAirflow table will be adapted using the air PID Iterm." VALUE 0x800006DE RecordLayout_1 0 CompuMethod_29 0 1 /end CHARACTERISTIC
/begin CHARACTERISTIC BaseAirflowAdaptErrorLwrLim "Lower Limit Value" VALUE 0x800006DF RecordLayout_4 0 CompuMethod_48 -1E+17 1E+17 /end CHARACTERISTIC
/begin CHARACTERISTIC BaseAirflowAdaptErrorUprLim "Upper Limit Value" VALUE 0x800006E3 RecordLayout_4 0 CompuMethod_48 -1E+17 1E+17 /end CHARACTERISTIC
/begin CHARACTERISTIC BaseAirflowAdaptGain "Gain for updating BaseAirflow table.  This fraction of the error is added to the map every 5ms." VALUE 0x800006E7 RecordLayout_4 0 CompuMethod_49 -1E+17 1E+17 /end CHARACTERISTIC
/begin CHARACTERISTIC BaseAirflowOfstMaxValue "Maximum value that can be adapted into the BaseAirflowOfst table." VALUE 0x800006EB RecordLayout_4 0 CompuMethod_6 -1E+17 1E+17 /end CHARACTERISTIC
/begin CHARACTERISTIC BaseAirflowOfstMinValue "Minimum value that can be adapted into the BaseAirflowOfst table." VALUE 0x800006EF RecordLayout_4 0 CompuMethod_6 -1E+17 1E+17 /end CHARACTERISTIC
/begin CHARACTERISTIC BaseRevLimit "Maximum RPM allowed, before any action is taken" VALUE 0x80000707 RecordLayout_4 0 CompuMethod_25 0 1E+17 /end CHARACTERISTIC
/begin CHARACTERISTIC BaseSparkEnergyMap "Spark energy - Run state" MAP 0x8000070B RecordLayout_4 0 CompuMethod_51 -1E+17 1E+17
 /begin AXIS_DESCR COM_AXIS RPM09In CompuMethod_25 9 0 14000 AXIS_PTS_REF RPM09IdxArr /end AXIS_DESCR
 /begin AXIS_DESCR COM_AXIS MAP09In CompuMethod_8 9 0 1000 AXIS_PTS_REF MAP09IdxArr /end AXIS_DESCR
/end CHARACTERISTIC
/begin CHARACTERISTIC BGND_BASE_Multiple "Base rate of the BGND_BASE_PERIODIC event, as a multiple of FGND_RTI_Period" VALUE 0x8000084F RecordLayout_8 0 CompuMethod_52 0 65535 /end CHARACTERISTIC
/begin CHARACTERISTIC BGND_BASE_PERIODIC_RunCnt "The number of times to execute BGND_BASE_PERIODIC before pausing.  -1 means run forever" VALUE 0x80000851 RecordLayout_9 0 CompuMethod_52 -1 2147480000 /end CHARACTERISTIC
/begin CHARACTERISTIC BGND_BASEx10_PERIODIC_RunCnt "The number of times to execute BGND_BASEx10_PERIODIC before pausing.  -1 means run forever" VALUE 0x80000855 RecordLayout_9 0 CompuMethod_52 -1 2147480000 /end CHARACTERISTIC
/begin CHARACTERISTIC BGND_BASEx2_PERIODIC_RunCnt "The number of times to execute BGND_BASEx2_PERIODIC before pausing.  -1 means run forever" VALUE 0x80000859 RecordLayout_9 0 CompuMethod_52 -1 2147480000 /end CHARACTERISTIC
/begin CHARACTERISTIC BoostActivationThreshold "Minimum boost pressure before controller is activated, usually set to wastegate spring pressure" VALUE 0x8000085F RecordLayout_4 0 CompuMethod_56 -1E+17 1E+17 /end CHARACTERISTIC
/begin CHARACTERISTIC BoostAdaptDelayTime "Idle Control must be enabled for this amount of time before fuel adaption is enabled" VALUE 0x80000863 RecordLayout_4 0 CompuMethod_10 0 1E+17 /end CHARACTERISTIC
/begin CHARACTERISTIC BoostAdaptErrorLwrLim "Lower Limit Value" VALUE 0x80000867 RecordLayout_4 0 CompuMethod_48 -1E+17 1E+17 /end CHARACTERISTIC
/begin CHARACTERISTIC BoostAdaptErrorUprLim "Upper Limit Value" VALUE 0x8000086B RecordLayout_4 0 CompuMethod_48 -1E+17 1E+17 /end CHARACTERISTIC
/begin CHARACTERISTIC BoostControlAdaptDelta "Air PID Iterm must be less than this delta to adapt the BaseAirflow table." VALUE 0x8000086F RecordLayout_4 0 CompuMethod_33 -1E+17 1E+17 /end CHARACTERISTIC
/begin CHARACTERISTIC BoostControlAdaptEnable "Determines whether the BaseAirflow table will be adapted using the air PID Iterm." VALUE 0x80000873 RecordLayout_1 0 CompuMethod_29 0 1 /end CHARACTERISTIC
/begin CHARACTERISTIC BoostControlAdaptGain "Gain for updating BaseAirflow table.  This fraction of the error is added to the map every 5ms." VALUE 0x80000874 RecordLayout_4 0 CompuMethod_49 -1E+17 1E+17 /end CHARACTERISTIC
/begin CHARACTERISTIC BoostControlBase_AdaptMap "Base boost duty cycle table for feed forward" MAP 0x80000878 RecordLayout_4 0 CompuMethod_57 0 100
 /begin AXIS_DESCR COM_AXIS RPM09In CompuMethod_25 9 0 14000 AXIS_PTS_REF RPM09IdxArr /end AXIS_DESCR
 /begin AXIS_DESCR COM_AXIS BoostTargetIn CompuMethod_2 9 0 1E+17 AXIS_PTS_REF BoostTargetIdxArr /end AXIS_DESCR
/end CHARACTERISTIC
/begin CHARACTERISTIC BoostControlBaseMap "Base boost duty cycle table for feed forward" MAP 0x800009BC RecordLayout_4 0 CompuMethod_57 0 100
 /begin AXIS_DESCR COM_AXIS RPM09In CompuMethod_25 9 0 14000 AXIS_PTS_REF RPM09IdxArr /end AXIS_DESCR
 /begin AXIS_DESCR COM_AXIS BoostTargetIn CompuMethod_2 9 0 1E+17 AXIS_PTS_REF BoostTargetIdxArr /end AXIS_DESCR
/end CHARACTERISTIC
/begin CHARACTERISTIC BoostControlOfstMaxValue "Maximum value that can be adapted into the BaseAirflowOfst table." VALUE 0x80000B00 RecordLayout_4 0 CompuMethod_6 -1E+17 1E+17 /end CHARACTERISTIC
/begin CHARACTERISTIC BoostControlOfstMinValue "Minimum value that can be adapted into the BaseAirflowOfst table." VALUE 0x80000B04 RecordLayout_4 0 CompuMethod_6 -1E+17 1E+17 /end CHARACTERISTIC
/begin CHARACTERISTIC BoostCtlDGain "Base D-gain for the min. governor controller." VALUE 0x80000B08 RecordLayout_4 0 CompuMethod_33 -1E+17 1E+17 /end CHARACTERISTIC
/begin CHARACTERISTIC BoostCtlDGainErrorMultTbl "" CURVE 0x80000B0C RecordLayout_4 0 CompuMethod_33 -1E+17 1E+17
 /begin AXIS_DESCR COM_AXIS BoostCtlSpeedErrorIn CompuMethod_2 9 -1E+17 1E+17 AXIS_PTS_REF BoostCtlSpeedErrorIdxArr /end AXIS_DESCR
/end CHARACTERISTIC
/begin CHARACTERISTIC BoostCtlErrorGain "Error gain for the min governor controller. This gain is applied to the RPM error term before it is used to calculate the P, I and D terms." VALUE 0x80000B30 RecordLayout_4 0 CompuMethod_33 -1E+17 1E+17 /end CHARACTERISTIC
/begin CHARACTERISTIC BoostCtlIGain "Base I-gain for the min. governor controller." VALUE 0x80000B34 RecordLayout_4 0 CompuMethod_33 -1E+17 1E+17 /end CHARACTERISTIC
/begin CHARACTERISTIC BoostCtlIGainErrorMultTbl "" CURVE 0x80000B38 RecordLayout_4 0 CompuMethod_33 -1E+17 1E+17
 /begin AXIS_DESCR COM_AXIS BoostCtlSpeedErrorIn CompuMethod_2 9 -1E+17 1E+17 AXIS_PTS_REF BoostCtlSpeedErrorIdxArr /end AXIS_DESCR
/end CHARACTERISTIC
/begin CHARACTERISTIC BoostCtlITermLowerLimit "Lower limit on Air Min Governor I-term value." VALUE 0x80000B5C RecordLayout_4 0 CompuMethod_57 -1E+17 1E+17 /end CHARACTERISTIC
/begin CHARACTERISTIC BoostCtlITermUpperLimit "Upper limit on Air Min Governor I-term value." VALUE 0x80000B60 RecordLayout_4 0 CompuMethod_57 -1E+17 1E+17 /end CHARACTERISTIC
/begin CHARACTERISTIC BoostCtlPGain "Base P-gain for the min. governor controller." VALUE 0x80000B64 RecordLayout_4 0 CompuMethod_33 -1E+17 1E+17 /end CHARACTERISTIC
/begin CHARACTERISTIC BoostCtlPGainErrorMultTbl "" CURVE 0x80000B68 RecordLayout_4 0 CompuMethod_33 -1E+17 1E+17
 /begin AXIS_DESCR COM_AXIS BoostCtlSpeedErrorIn CompuMethod_2 9 -1E+17 1E+17 AXIS_PTS_REF BoostCtlSpeedErrorIdxArr /end AXIS_DESCR
/end CHARACTERISTIC
/begin CHARACTERISTIC BoostCtlPIDOutLowerLimit "Lower limit on air min governor PID Output." VALUE 0x80000B8C RecordLayout_4 0 CompuMethod_57 -1E+17 1E+17 /end CHARACTERISTIC
/begin CHARACTERISTIC BoostCtlPIDOutUpperLimit "Upper limit on air min governor PID Output." VALUE 0x80000B90 RecordLayout_4 0 CompuMethod_57 -1E+17 1E+17 /end CHARACTERISTIC
/begin CHARACTERISTIC BoostECTLimitTbl "Boost limit as a function of ECT" CURVE 0x80000BB8 RecordLayout_4 0 CompuMethod_56 0 100
 /begin AXIS_DESCR COM_AXIS ECT05In CompuMethod_27 5 -40 200 AXIS_PTS_REF ECT05IdxArr /end AXIS_DESCR
/end CHARACTERISTIC
/begin CHARACTERISTIC BoostFallRate "Maximum rate boost falls at" VALUE 0x80000BCC RecordLayout_4 0 CompuMethod_58 -10000 0 /end CHARACTERISTIC
/begin CHARACTERISTIC BoostIATLimitTbl "Boost limit as a function of IAT" CURVE 0x80000BD0 RecordLayout_4 0 CompuMethod_56 0 100
 /begin AXIS_DESCR COM_AXIS IAT05In CompuMethod_27 5 -40 300 AXIS_PTS_REF IAT05IdxArr /end AXIS_DESCR
/end CHARACTERISTIC
/begin CHARACTERISTIC BoostRiseRate "Maximum rate boost builds at" VALUE 0x80000BE4 RecordLayout_4 0 CompuMethod_58 0 10000 /end CHARACTERISTIC
/begin CHARACTERISTIC BoostScrambleAdder "Amount of pressure to increase target by when scramble button is activated" VALUE 0x80000BE8 RecordLayout_4 0 CompuMethod_56 -100 100 /end CHARACTERISTIC
/begin CHARACTERISTIC BoostTarget_TwoStepTbl "Boost target with repsect to RPM when on two step" CURVE 0x80000BEC RecordLayout_4 0 CompuMethod_56 0 100
 /begin AXIS_DESCR COM_AXIS RPM09In CompuMethod_25 9 0 14000 AXIS_PTS_REF RPM09IdxArr /end AXIS_DESCR
/end CHARACTERISTIC
/begin CHARACTERISTIC BoostTargetMap "Target boost as a function of RPM and VSPD" MAP 0x80000C34 RecordLayout_4 0 CompuMethod_56 0 100
 /begin AXIS_DESCR COM_AXIS RPM09In CompuMethod_25 9 0 14000 AXIS_PTS_REF RPM09IdxArr /end AXIS_DESCR
 /begin AXIS_DESCR COM_AXIS VSPD09In CompuMethod_180 9 -100 200 AXIS_PTS_REF VSPD09IdxArr /end AXIS_DESCR
/end CHARACTERISTIC
/begin CHARACTERISTIC CAMDelay "Delay between the rising edge of the actual CAM signal and the rising edge of the ideal CAM.  If it leads the ideal CAM by one tooth (60-6 system) then the delay would be 6 degCA and 714 degCA if it lagged.  Applicable if crank encoder has >1 sync pts" VALUE 0x80000D78 RecordLayout_8 0 CompuMethod_59 0 720 /end CHARACTERISTIC
/begin CHARACTERISTIC CAT_new "Override result of linear sensor characterization, in engineering units" VALUE 0x80000D7A RecordLayout_4 0 CompuMethod_61 -1E+17 1E+17 /end CHARACTERISTIC
/begin CHARACTERISTIC CAT_ovr "" VALUE 0x80000D7E RecordLayout_1 0 CompuMethod_5 0 1 /end CHARACTERISTIC
/begin CHARACTERISTIC CAT_SpkOfstMultMap "Multiplier on IAT2 spark offset table." MAP 0x80000D7F RecordLayout_4 0 CompuMethod_33 -1E+17 1E+17
 /begin AXIS_DESCR COM_AXIS RPM09In CompuMethod_25 9 0 14000 AXIS_PTS_REF RPM09IdxArr /end AXIS_DESCR
 /begin AXIS_DESCR COM_AXIS MAP09In CompuMethod_8 9 0 1000 AXIS_PTS_REF MAP09IdxArr /end AXIS_DESCR
/end CHARACTERISTIC
/begin CHARACTERISTIC CAT_SpkOfstTbl "CAT spark offset" CURVE 0x80000EC3 RecordLayout_4 0 CompuMethod_2 -50 50
 /begin AXIS_DESCR COM_AXIS CAT05In CompuMethod_27 5 -40 300 AXIS_PTS_REF CAT05IdxArr /end AXIS_DESCR
/end CHARACTERISTIC
/begin CHARACTERISTIC CATDefault "This is the initial default value should the sensor be in fault on key-up.  Otherwise the sensors outputs the last value prior to faulting" VALUE 0x80000EEB RecordLayout_4 0 CompuMethod_61 -1E+17 1E+17 /end CHARACTERISTIC
/begin CHARACTERISTIC CATFiltConst "Filter time constant" VALUE 0x80000EEF RecordLayout_4 0 CompuMethod_20 -1E+17 1E+17 /end CHARACTERISTIC
/begin CHARACTERISTIC CATMax "Maximum allowable input, indicating short or open circuit" VALUE 0x80000F27 RecordLayout_4 0 CompuMethod_22 -1E+17 1E+17 /end CHARACTERISTIC
/begin CHARACTERISTIC CATMin "Minimum allowable input, indicating short or open circuit" VALUE 0x80000F2B RecordLayout_4 0 CompuMethod_22 -1E+17 1E+17 /end CHARACTERISTIC
/begin CHARACTERISTIC CATTbl "Look up table to allownon-linear characterization of sensors" CURVE 0x80000F32 RecordLayout_4 0 CompuMethod_61 -1E+17 1E+17
 /begin AXIS_DESCR COM_AXIS CATADC CompuMethod_22 13 -1E+17 1E+17 AXIS_PTS_REF CATIdxArr /end AXIS_DESCR
/end CHARACTERISTIC
/begin CHARACTERISTIC CCP1_StationAddr "Station ID for CCP handler: CCP1" VALUE 0x80000F66 RecordLayout_8 0 CompuMethod_52 0 65535 /end CHARACTERISTIC
/begin CHARACTERISTIC CCP1RxID "Receive CAN ID for CCP handler: CCP1" VALUE 0x80000F68 RecordLayout_3 0 CompuMethod_60 0 4294970000 /end CHARACTERISTIC
/begin CHARACTERISTIC CCP1RxIDMask "Receive CAN ID Mask for CCP handler: CCP1" VALUE 0x80000F6C RecordLayout_3 0 CompuMethod_60 0 4294970000 /end CHARACTERISTIC
/begin CHARACTERISTIC CCP1TxID "Transmit CAN ID for CCP handler: CCP1" VALUE 0x80000F70 RecordLayout_3 0 CompuMethod_60 0 4294970000 /end CHARACTERISTIC
/begin CHARACTERISTIC ChargeAirTempEnrichmentMap "Requsted base eq. ratio as a function of CAT and MAP" MAP 0x80000F74 RecordLayout_4 0 CompuMethod_66 0 1E+17
 /begin AXIS_DESCR COM_AXIS CAT05In CompuMethod_27 5 -40 300 AXIS_PTS_REF CAT05IdxArr /end AXIS_DESCR
 /begin AXIS_DESCR COM_AXIS MAP09In CompuMethod_8 9 0 1000 AXIS_PTS_REF MAP09IdxArr /end AXIS_DESCR
/end CHARACTERISTIC
/begin CHARACTERISTIC CityID_CAN_1 "City ID for CAN bus CAN_1" VALUE 0x80001028 RecordLayout_1 0 CompuMethod_1 0 255 /end CHARACTERISTIC
/begin CHARACTERISTIC CityID_CAN_2 "City ID for CAN bus CAN_2" VALUE 0x80001029 RecordLayout_1 0 CompuMethod_1 0 255 /end CHARACTERISTIC
/begin CHARACTERISTIC ClearFloodThreshold "In crank mode, throttle commands greater than this threshold will disable crank fueling." VALUE 0x8000102A RecordLayout_4 0 CompuMethod_67 -1E+17 1E+17 /end CHARACTERISTIC
/begin CHARACTERISTIC ClutchSw_new "Override actuator, in engineering units" VALUE 0x8000102E RecordLayout_1 0 CompuMethod_26 0 1 /end CHARACTERISTIC
/begin CHARACTERISTIC ClutchSw_ovr "" VALUE 0x8000102F RecordLayout_1 0 CompuMethod_5 0 1 /end CHARACTERISTIC
/begin CHARACTERISTIC ClutchSwPolarity "0 = High True    1 = Low True" VALUE 0x80001033 RecordLayout_1 0 CompuMethod_4 0 1 /end CHARACTERISTIC
/begin CHARACTERISTIC ClutchSwSwitchPt "Defines switch point in ADC units boolean conversion" VALUE 0x80001034 RecordLayout_4 0 CompuMethod_22 -1E+17 1E+17 /end CHARACTERISTIC
/begin CHARACTERISTIC CoilDrvrDlyTime "Coil driver delay time between receipt of EST signal and initiation of coil dwell." VALUE 0x80001038 RecordLayout_4 0 CompuMethod_68 -1E+17 1E+17 /end CHARACTERISTIC
/begin CHARACTERISTIC CoilDwellMap "Required spark dwell to give the desired spark energy." MAP 0x8000103C RecordLayout_4 0 CompuMethod_69 -1E+17 1E+17
 /begin AXIS_DESCR COM_AXIS SysVolt09In CompuMethod_165 9 0 32 AXIS_PTS_REF SysVolt09IdxArr /end AXIS_DESCR
 /begin AXIS_DESCR COM_AXIS SpkEnergy09In CompuMethod_2 9 -1E+17 1E+17 AXIS_PTS_REF SpkEnergy09IdxArr /end AXIS_DESCR
/end CHARACTERISTIC
/begin CHARACTERISTIC CombEventsPerRev "Number of conbustion events per engine revolution. For example, for a four-stroke, eight cylinder engine the value would be 4." VALUE 0x80001180 RecordLayout_1 0 CompuMethod_1 0.5 255 /end CHARACTERISTIC
/begin CHARACTERISTIC Constant_Fuel_Pump "" VALUE 0x80001181 RecordLayout_4 0 CompuMethod_2 -1E+17 1E+17 /end CHARACTERISTIC
/begin CHARACTERISTIC CrankAirflowSetPtTbl "ETC setpoint during cranking." CURVE 0x80001187 RecordLayout_4 0 CompuMethod_6 -1E+17 1E+17
 /begin AXIS_DESCR COM_AXIS ECT CompuMethod_27 5 -1E+17 1E+17 AXIS_PTS_REF CrankECT05IdxArr /end AXIS_DESCR
/end CHARACTERISTIC
/begin CHARACTERISTIC CrankFPC_IATMultTbl "Crank fuel IAT ultiplier" CURVE 0x800011AF RecordLayout_4 0 CompuMethod_2 0 100
 /begin AXIS_DESCR COM_AXIS IAT CompuMethod_27 5 -1E+17 1E+17 AXIS_PTS_REF CrankIAT05IdxArr /end AXIS_DESCR
/end CHARACTERISTIC
/begin CHARACTERISTIC CrankFPC_OXYMultTbl "Crank fuel oxygentation multiplier" CURVE 0x800011C3 RecordLayout_4 0 CompuMethod_2 0 100
 /begin AXIS_DESCR COM_AXIS CrankOXY05In CompuMethod_6 5 -1E+17 1E+17 AXIS_PTS_REF CrankOXY05IdxArr /end AXIS_DESCR
/end CHARACTERISTIC
/begin CHARACTERISTIC CrankFPCMap "Liquid fuel supplied during crank." MAP 0x800011D7 RecordLayout_4 0 CompuMethod_73 0 1E+17
 /begin AXIS_DESCR COM_AXIS CrankRPM05In CompuMethod_25 5 -1E+17 1E+17 AXIS_PTS_REF CrankRPM05IdxArr /end AXIS_DESCR
 /begin AXIS_DESCR COM_AXIS ECT CompuMethod_27 5 -1E+17 1E+17 AXIS_PTS_REF CrankECT05IdxArr /end AXIS_DESCR
/end CHARACTERISTIC
/begin CHARACTERISTIC CrankIAC_IATMultTbl "" CURVE 0x8000123B RecordLayout_4 0 CompuMethod_2 0 100
 /begin AXIS_DESCR COM_AXIS IAT CompuMethod_27 5 -1E+17 1E+17 AXIS_PTS_REF CrankIAT05IdxArr /end AXIS_DESCR
/end CHARACTERISTIC
/begin CHARACTERISTIC CrankIAC_OXYMultTbl "" CURVE 0x8000124F RecordLayout_4 0 CompuMethod_2 0 100
 /begin AXIS_DESCR COM_AXIS CrankOXY05In CompuMethod_6 5 -1E+17 1E+17 AXIS_PTS_REF CrankOXY05IdxArr /end AXIS_DESCR
/end CHARACTERISTIC
/begin CHARACTERISTIC CrankIACMap "Base IAC % While Cranking" MAP 0x80001263 RecordLayout_4 0 CompuMethod_6 0 100
 /begin AXIS_DESCR COM_AXIS CrankRPM05In CompuMethod_25 5 -1E+17 1E+17 AXIS_PTS_REF CrankRPM05IdxArr /end AXIS_DESCR
 /begin AXIS_DESCR COM_AXIS ECT CompuMethod_27 5 -1E+17 1E+17 AXIS_PTS_REF CrankECT05IdxArr /end AXIS_DESCR
/end CHARACTERISTIC
/begin CHARACTERISTIC CrankMakeUpEOITbl "Start of injection during cranking." CURVE 0x800012DB RecordLayout_4 0 CompuMethod_70 -920 920
 /begin AXIS_DESCR COM_AXIS CrankRPM05In CompuMethod_25 5 -1E+17 1E+17 AXIS_PTS_REF CrankRPM05IdxArr /end AXIS_DESCR
/end CHARACTERISTIC
/begin CHARACTERISTIC CrankSOITbl "Start of injection during cranking." CURVE 0x80001317 RecordLayout_4 0 CompuMethod_70 -920 920
 /begin AXIS_DESCR COM_AXIS CrankRPM05In CompuMethod_25 5 -1E+17 1E+17 AXIS_PTS_REF CrankRPM05IdxArr /end AXIS_DESCR
/end CHARACTERISTIC
/begin CHARACTERISTIC CrankSparkMap "Spark adv during cranking." MAP 0x8000132B RecordLayout_4 0 CompuMethod_70 -100 100
 /begin AXIS_DESCR COM_AXIS CrankRPM05In CompuMethod_25 5 -1E+17 1E+17 AXIS_PTS_REF CrankRPM05IdxArr /end AXIS_DESCR
 /begin AXIS_DESCR COM_AXIS ECT CompuMethod_27 5 -1E+17 1E+17 AXIS_PTS_REF CrankECT05IdxArr /end AXIS_DESCR
/end CHARACTERISTIC
/begin CHARACTERISTIC CrankSpkEnergyMap "Spark energy during cranking." MAP 0x8000138F RecordLayout_4 0 CompuMethod_74 0 1E+17
 /begin AXIS_DESCR COM_AXIS CrankRPM05In CompuMethod_25 5 -1E+17 1E+17 AXIS_PTS_REF CrankRPM05IdxArr /end AXIS_DESCR
 /begin AXIS_DESCR COM_AXIS ECT CompuMethod_27 5 -1E+17 1E+17 AXIS_PTS_REF CrankECT05IdxArr /end AXIS_DESCR
/end CHARACTERISTIC
/begin CHARACTERISTIC CrankToRunRPMThresh "RPM above which RUN mode can be entered from CRANK mode." VALUE 0x800013F3 RecordLayout_8 0 CompuMethod_75 0 65535 /end CHARACTERISTIC
/begin CHARACTERISTIC CylSweptVol "Cylinder swept volume for a single cylinder." VALUE 0x800013F5 RecordLayout_4 0 CompuMethod_76 0 1E+17 /end CHARACTERISTIC
/begin CHARACTERISTIC DeltaMAP_FiltConst "Filter time constant" VALUE 0x800013F9 RecordLayout_4 0 CompuMethod_20 -1E+17 1E+17 /end CHARACTERISTIC
/begin CHARACTERISTIC DeltaMAP_MultMap "Transient Fueling Multiplier for adjustment based on delta MAP" MAP 0x800013FD RecordLayout_4 0 CompuMethod_33 -1E+17 1E+17
 /begin AXIS_DESCR COM_AXIS DeltaMAP17In CompuMethod_2 17 -1E+17 1E+17 AXIS_PTS_REF DeltaMAP17IdxArr /end AXIS_DESCR
 /begin AXIS_DESCR COM_AXIS MAF09In CompuMethod_2 9 -1E+17 1E+17 AXIS_PTS_REF MAF09IdxArr /end AXIS_DESCR
/end CHARACTERISTIC
/begin CHARACTERISTIC DeltaTPS_FiltConst "Filter time constant" VALUE 0x800016A5 RecordLayout_4 0 CompuMethod_20 -1E+17 1E+17 /end CHARACTERISTIC
/begin CHARACTERISTIC DeltaTPS_MultMap "Transient Fueling Multiplier for adjustment based on delta TPS" MAP 0x800016A9 RecordLayout_4 0 CompuMethod_33 -1E+17 1E+17
 /begin AXIS_DESCR COM_AXIS DeltaTPS17In CompuMethod_2 17 -1E+17 1E+17 AXIS_PTS_REF DeltaTPS17IdxArr /end AXIS_DESCR
 /begin AXIS_DESCR COM_AXIS MAF09In CompuMethod_2 9 -1E+17 1E+17 AXIS_PTS_REF MAF09IdxArr /end AXIS_DESCR
/end CHARACTERISTIC
/begin CHARACTERISTIC DeltaTPSFuelingEnable "Enable Delta TPS transient fuel algorithm" VALUE 0x80001951 RecordLayout_1 0 CompuMethod_36 0 1 /end CHARACTERISTIC
/begin CHARACTERISTIC DesAFRatioTbl "" CURVE 0x8000197E RecordLayout_4 0 CompuMethod_77 0 20
 /begin AXIS_DESCR COM_AXIS DesAFRatioIn CompuMethod_78 11 0 100 AXIS_PTS_REF DesAFRatioIdxArr /end AXIS_DESCR
/end CHARACTERISTIC
/begin CHARACTERISTIC DesEquivRatioMap "Desired liquid equivalence ratio." MAP 0x800019CE RecordLayout_4 0 CompuMethod_2 0 1E+17
 /begin AXIS_DESCR COM_AXIS RPM17In CompuMethod_25 17 0 14000 AXIS_PTS_REF RPM17IdxArr /end AXIS_DESCR
 /begin AXIS_DESCR COM_AXIS MAP17In CompuMethod_8 17 0 1000 AXIS_PTS_REF MAP17IdxArr /end AXIS_DESCR
/end CHARACTERISTIC
/begin CHARACTERISTIC DFCODelayTime "DFCO delay enter time" VALUE 0x80001E52 RecordLayout_4 0 CompuMethod_20 0 1000000 /end CHARACTERISTIC
/begin CHARACTERISTIC DFCOEnable "" VALUE 0x80001E56 RecordLayout_1 0 CompuMethod_7 0 255 /end CHARACTERISTIC
/begin CHARACTERISTIC DFCOEnterIdleSpeed "DFCO entry above idle speed setpoint" VALUE 0x80001E57 RecordLayout_4 0 CompuMethod_25 0 7000 /end CHARACTERISTIC
/begin CHARACTERISTIC DFCOEnterRampTime "DFCO enter ramp time" VALUE 0x80001E5B RecordLayout_4 0 CompuMethod_20 -1E+17 1E+17 /end CHARACTERISTIC
/begin CHARACTERISTIC DFCOEntryAPP "DFCO APP entry threshold" VALUE 0x80001E5F RecordLayout_4 0 CompuMethod_6 0 100 /end CHARACTERISTIC
/begin CHARACTERISTIC DFCOEntryMAP "DFCO MAP entry threshold" VALUE 0x80001E63 RecordLayout_4 0 CompuMethod_8 0 1000 /end CHARACTERISTIC
/begin CHARACTERISTIC DFCOEntryRPMTbl "DFCO entry RPM as a function of ECT" CURVE 0x80001E8F RecordLayout_4 0 CompuMethod_25 0 14000
 /begin AXIS_DESCR COM_AXIS DFCOEntryRPMIn CompuMethod_27 10 -40 250 AXIS_PTS_REF DFCOEntryRPMIdxArr /end AXIS_DESCR
/end CHARACTERISTIC
/begin CHARACTERISTIC DFCOExitAPP "DFCO exit APP threshold" VALUE 0x80001EB7 RecordLayout_4 0 CompuMethod_6 0 100 /end CHARACTERISTIC
/begin CHARACTERISTIC DFCOExitIdleSpeed "DFCO exit offset from desired idle speed" VALUE 0x80001EBB RecordLayout_4 0 CompuMethod_25 0 7000 /end CHARACTERISTIC
/begin CHARACTERISTIC DFCOExitMAP "DFCO exit MAP threhsold" VALUE 0x80001EBF RecordLayout_4 0 CompuMethod_8 0 1000 /end CHARACTERISTIC
/begin CHARACTERISTIC DFCOExitRampTime "DFCO exit ramp time" VALUE 0x80001EC3 RecordLayout_4 0 CompuMethod_20 -1E+17 1E+17 /end CHARACTERISTIC
/begin CHARACTERISTIC DFCOExitRPMTbl "DFCO exit rpm" CURVE 0x80001EEF RecordLayout_4 0 CompuMethod_25 0 14000
 /begin AXIS_DESCR COM_AXIS DFCOExitRPMIn CompuMethod_27 10 -40 250 AXIS_PTS_REF DFCOExitRPMIdxArr /end AXIS_DESCR
/end CHARACTERISTIC
/begin CHARACTERISTIC DFCOExitSparkRet "DFCO exit spark retard" VALUE 0x80001F17 RecordLayout_4 0 CompuMethod_70 -100 100 /end CHARACTERISTIC
/begin CHARACTERISTIC ECT_FiltDecFiltC "Filter time constant for a decreasing signal." VALUE 0x80001F1B RecordLayout_4 0 CompuMethod_20 -1E+17 1E+17 /end CHARACTERISTIC
/begin CHARACTERISTIC ECT_FiltIncFiltC "Filter time constant for a increasing signal." VALUE 0x80001F1F RecordLayout_4 0 CompuMethod_20 -1E+17 1E+17 /end CHARACTERISTIC
/begin CHARACTERISTIC ECT_KeyUp_Count "Number of samples to average at key-up to produce signal value" VALUE 0x80001F23 RecordLayout_7 0 CompuMethod_1 -128 127 /end CHARACTERISTIC
/begin CHARACTERISTIC ECT_new "Override result of linear sensor characterization, in engineering units" VALUE 0x80001F48 RecordLayout_4 0 CompuMethod_61 -1E+17 1E+17 /end CHARACTERISTIC
/begin CHARACTERISTIC ECT_ovr "" VALUE 0x80001F4C RecordLayout_1 0 CompuMethod_5 0 1 /end CHARACTERISTIC
/begin CHARACTERISTIC ECT_SpkOfstMultMap "Multiplier on ECT spark offset table." MAP 0x80001F4D RecordLayout_4 0 CompuMethod_2 -100 100
 /begin AXIS_DESCR COM_AXIS RPM09In CompuMethod_25 9 0 14000 AXIS_PTS_REF RPM09IdxArr /end AXIS_DESCR
 /begin AXIS_DESCR COM_AXIS MAP09In CompuMethod_8 9 0 1000 AXIS_PTS_REF MAP09IdxArr /end AXIS_DESCR
/end CHARACTERISTIC
/begin CHARACTERISTIC ECT_SpkOfstTbl "ECT spark offset" CURVE 0x80002091 RecordLayout_4 0 CompuMethod_70 -50 50
 /begin AXIS_DESCR COM_AXIS ECT05In CompuMethod_27 5 -40 200 AXIS_PTS_REF ECT05IdxArr /end AXIS_DESCR
/end CHARACTERISTIC
/begin CHARACTERISTIC ECTDefault "This is the initial default value should the sensor be in fault on key-up.  Otherwise the sensors outputs the last value prior to faulting" VALUE 0x800020DD RecordLayout_4 0 CompuMethod_61 -1E+17 1E+17 /end CHARACTERISTIC
/begin CHARACTERISTIC ECTFiltConst "Filter time constant" VALUE 0x800022E1 RecordLayout_4 0 CompuMethod_20 -1E+17 1E+17 /end CHARACTERISTIC
/begin CHARACTERISTIC ECTMax "Maximum allowable input, indicating short or open circuit" VALUE 0x80002319 RecordLayout_4 0 CompuMethod_22 -1E+17 1E+17 /end CHARACTERISTIC
/begin CHARACTERISTIC ECTMin "Minimum allowable input, indicating short or open circuit" VALUE 0x8000231D RecordLayout_4 0 CompuMethod_22 -1E+17 1E+17 /end CHARACTERISTIC
/begin CHARACTERISTIC ECTTbl "Look up table to allownon-linear characterization of sensors" CURVE 0x80002324 RecordLayout_4 0 CompuMethod_61 -1E+17 1E+17
 /begin AXIS_DESCR COM_AXIS ECTADC CompuMethod_22 13 -1E+17 1E+17 AXIS_PTS_REF ECTIdxArr /end AXIS_DESCR
/end CHARACTERISTIC
/begin CHARACTERISTIC ECTTransFuelMultTbl "Transient fuel multiplier based on ECT.  Only engaged during transient fueling" CURVE 0x80002358 RecordLayout_4 0 CompuMethod_2 -1E+17 1E+17
 /begin AXIS_DESCR COM_AXIS ECT05In CompuMethod_27 5 -40 200 AXIS_PTS_REF ECT05IdxArr /end AXIS_DESCR
/end CHARACTERISTIC
/begin CHARACTERISTIC ECUP_Threshold "ADC voltage threshold above which ECU is considered powered" VALUE 0x8000236C RecordLayout_8 0 CompuMethod_82 0 1023 /end CHARACTERISTIC
/begin CHARACTERISTIC ECUVolt_FiltDecFiltC "Filter time constant for a decreasing signal." VALUE 0x8000236E RecordLayout_4 0 CompuMethod_20 -1E+17 1E+17 /end CHARACTERISTIC
/begin CHARACTERISTIC ECUVolt_FiltIncFiltC "Filter time constant for a increasing signal." VALUE 0x80002372 RecordLayout_4 0 CompuMethod_20 -1E+17 1E+17 /end CHARACTERISTIC
/begin CHARACTERISTIC Elec_PW_new "" VALUE 0x80002376 RecordLayout_4 0 CompuMethod_2 -1E+17 1E+17 /end CHARACTERISTIC
/begin CHARACTERISTIC Elec_PW_ovr "" VALUE 0x8000237A RecordLayout_1 0 CompuMethod_5 0 1 /end CHARACTERISTIC
/begin CHARACTERISTIC EnableRPMFalling "If disabled, Min Gov will enable immediately after cranking without waiting for falling RPM." VALUE 0x8000237B RecordLayout_1 0 CompuMethod_4 0 1 /end CHARACTERISTIC
/begin CHARACTERISTIC EncoderCamPullup "Selects the pullup conditioning applied to the Cam Input" VALUE 0x8000237C RecordLayout_1 0 CompuMethod_83 0 1 /end CHARACTERISTIC
/begin CHARACTERISTIC EncoderCamSyncEdge "Selects which edge of a digital signal represents the synchronous edge of the CAM tooth.  It has no meaning for a variable reluctance type sensor" VALUE 0x8000237D RecordLayout_1 0 CompuMethod_84 0 1 /end CHARACTERISTIC
/begin CHARACTERISTIC EncoderCrankPullup "Selects the pullup conditioning applied to the Crank Input" VALUE 0x8000237E RecordLayout_1 0 CompuMethod_83 0 1 /end CHARACTERISTIC
/begin CHARACTERISTIC EncoderCrankTeethAfterCam "The number of crank teeth between the synchronizing edge of the cam and the first tooth in the crank pattern.  May be -1 to disable explicit tooth counting." VALUE 0x8000237F RecordLayout_5 0 CompuMethod_52 -1 32766 /end CHARACTERISTIC
/begin CHARACTERISTIC EncoderNumCylinders "Number of cylinders" VALUE 0x80002381 RecordLayout_1 0 CompuMethod_1 1 8 /end CHARACTERISTIC
/begin CHARACTERISTIC EncoderSyncEdge "Selects which edge of a digital signal represents the synchronous edge of the tooth.  It has no meaning for a variable reluctance type sensor" VALUE 0x80002382 RecordLayout_1 0 CompuMethod_84 0 1 /end CHARACTERISTIC
/begin CHARACTERISTIC EncoderTDCAngles "TDC angle of each cylinder in degrees after TDC1" VAL_BLK 0x80002383 RecordLayout_5 0 CompuMethod_59 0 720 MATRIX_DIM 8 1 1 /end CHARACTERISTIC
/begin CHARACTERISTIC EngineAccelFiltConst "Filter time constant" VALUE 0x80002393 RecordLayout_4 0 CompuMethod_20 -1E+17 1E+17 /end CHARACTERISTIC
/begin CHARACTERISTIC EngineShutdownDelayTime "Delays the engine shutdown when DelayedEngineShutdown fault-action is active." VALUE 0x80002397 RecordLayout_4 0 CompuMethod_10 0 1E+17 /end CHARACTERISTIC
/begin CHARACTERISTIC EngineToEncoderOffset "" VALUE 0x8000239B RecordLayout_4 0 CompuMethod_2 -1E+17 1E+17 /end CHARACTERISTIC
/begin CHARACTERISTIC EqRatio_SpkOfsMultMap "Speed and Load Multiplier to the Equivalence Ratio Spark Offset table." MAP 0x8000239F RecordLayout_4 0 CompuMethod_33 -1E+17 1E+17
 /begin AXIS_DESCR COM_AXIS RPM09In CompuMethod_25 9 0 14000 AXIS_PTS_REF RPM09IdxArr /end AXIS_DESCR
 /begin AXIS_DESCR COM_AXIS MAP09In CompuMethod_8 9 0 1000 AXIS_PTS_REF MAP09IdxArr /end AXIS_DESCR
/end CHARACTERISTIC
/begin CHARACTERISTIC EqRatio_SpkOfstTbl "Spark offset based on desired equivalence ratio (also muliplied by a speed load factor)" CURVE 0x800024E3 RecordLayout_4 0 CompuMethod_89 -1E+17 1E+17
 /begin AXIS_DESCR COM_AXIS DesEqRatio09In CompuMethod_79 9 0 1E+17 AXIS_PTS_REF DesEqRatio09IdxArr /end AXIS_DESCR
/end CHARACTERISTIC
/begin CHARACTERISTIC EquivRatio_new "" VALUE 0x80002507 RecordLayout_4 0 CompuMethod_2 -1E+17 1E+17 /end CHARACTERISTIC
/begin CHARACTERISTIC EquivRatio_ovr "" VALUE 0x8000250B RecordLayout_1 0 CompuMethod_5 0 1 /end CHARACTERISTIC
/begin CHARACTERISTIC EquivRatioDelta "Equivalence ratio has to be with this band of 1 to achieve close loop." VALUE 0x8000250C RecordLayout_4 0 CompuMethod_90 -1E+17 1E+17 /end CHARACTERISTIC
/begin CHARACTERISTIC ESTOP_FuelInj_Ovr_new "" VALUE 0x80002515 RecordLayout_1 0 CompuMethod_11 0 1 /end CHARACTERISTIC
/begin CHARACTERISTIC ESTOP_FuelInj_Ovr_ovr "" VALUE 0x80002516 RecordLayout_1 0 CompuMethod_5 0 1 /end CHARACTERISTIC
/begin CHARACTERISTIC ESTOP_new "Override actuator, in engineering units" VALUE 0x80002517 RecordLayout_1 0 CompuMethod_26 0 1 /end CHARACTERISTIC
/begin CHARACTERISTIC ESTOP_ovr "" VALUE 0x80002518 RecordLayout_1 0 CompuMethod_5 0 1 /end CHARACTERISTIC
/begin CHARACTERISTIC ESTOPPolarity "0 = High True    1 = Low True" VALUE 0x8000251B RecordLayout_1 0 CompuMethod_4 0 1 /end CHARACTERISTIC
/begin CHARACTERISTIC ETC_CutPower_ETC "Cut power to ETC if ETC request is less than this" VALUE 0x8000251C RecordLayout_4 0 CompuMethod_96 0 100 /end CHARACTERISTIC
/begin CHARACTERISTIC ETC_CutPower_Permitted "Cut power to ETC after ESTOP or long stalled period" VALUE 0x80002520 RecordLayout_1 0 CompuMethod_97 0 1 /end CHARACTERISTIC
/begin CHARACTERISTIC ETC_CutPower_StallTime "Cut power to ETC after stalled this long" VALUE 0x80002521 RecordLayout_4 0 CompuMethod_98 0 100 /end CHARACTERISTIC
/begin CHARACTERISTIC ETC_Frequency "Frequency of PWM output" VALUE 0x8000254D RecordLayout_4 0 CompuMethod_99 7.63 1E+17 /end CHARACTERISTIC
/begin CHARACTERISTIC ETC_I_MIN "H-bridge open circuit fault:  ETC current must exceed this when ETC duty cycle is > ETC_OC_MIN, otherwise an open circuit fault may exist." VALUE 0x80002551 RecordLayout_4 0 CompuMethod_100 0 1E+17 /end CHARACTERISTIC
/begin CHARACTERISTIC ETC_IceBreakEnblTm "" VALUE 0x80002555 RecordLayout_4 0 CompuMethod_20 0 10 /end CHARACTERISTIC
/begin CHARACTERISTIC ETC_IceBreakHoldTm "" VALUE 0x80002559 RecordLayout_4 0 CompuMethod_20 0 10 /end CHARACTERISTIC
/begin CHARACTERISTIC ETC_IceBreakPos "" VALUE 0x8000255D RecordLayout_4 0 CompuMethod_6 0 100 /end CHARACTERISTIC
/begin CHARACTERISTIC ETC_IGainMultTbl "Multiplier on the ETC I gain based on ETC error." CURVE 0x80002561 RecordLayout_4 0 CompuMethod_2 -1E+17 1E+17
 /begin AXIS_DESCR COM_AXIS ETC_ErrorIn CompuMethod_2 10 -1E+17 1E+17 AXIS_PTS_REF ETC_ErrorIdxArr /end AXIS_DESCR
/end CHARACTERISTIC
/begin CHARACTERISTIC ETC_LoAdaptRateLimit "Dictates the rate at which the ETC setpoint is decreased during shutdown to perform a low TPS adapt." VALUE 0x80002589 RecordLayout_4 0 CompuMethod_101 -1E+17 1E+17 /end CHARACTERISTIC
/begin CHARACTERISTIC ETC_new "Override result of linear sensor characterization, in engineering units" VALUE 0x8000258D RecordLayout_4 0 CompuMethod_2 -1E+17 1E+17 /end CHARACTERISTIC
/begin CHARACTERISTIC ETC_OC_MIN "H-bridge open circuit fault:  ETC duty cycle must exceed this to enable open circuit fault detection." VALUE 0x80002591 RecordLayout_4 0 CompuMethod_6 0 1E+17 /end CHARACTERISTIC
/begin CHARACTERISTIC ETC_Offset "Offset from engineering units to PWM duty cycle" VALUE 0x80002595 RecordLayout_4 0 CompuMethod_6 -1E+17 1E+17 /end CHARACTERISTIC
/begin CHARACTERISTIC ETC_ovr "" VALUE 0x80002599 RecordLayout_1 0 CompuMethod_5 0 1 /end CHARACTERISTIC
/begin CHARACTERISTIC ETC_PGainMultTbl "Multiplier on the ETC P gain based on ETC error." CURVE 0x8000259A RecordLayout_4 0 CompuMethod_2 -1E+17 1E+17
 /begin AXIS_DESCR COM_AXIS ETC_ErrorIn CompuMethod_2 10 -1E+17 1E+17 AXIS_PTS_REF ETC_ErrorIdxArr /end AXIS_DESCR
/end CHARACTERISTIC
/begin CHARACTERISTIC ETC_ShutdownLoAdaptError "Drive ETC closed until this error has been achieved in order to catch lo side adapt point." VALUE 0x80002612 RecordLayout_4 0 CompuMethod_6 -1E+17 1E+17 /end CHARACTERISTIC
/begin CHARACTERISTIC ETC_SpringTestHiThresh "Before initiating spring test during shutdown, open the ETC to this setpoint. When achieved, the ETC controller will release the ETC to have the spring close the valve." VALUE 0x80002616 RecordLayout_4 0 CompuMethod_6 -1E+17 1E+17 /end CHARACTERISTIC
/begin CHARACTERISTIC ETC_SpringTestLoThresh "Spring test timer will measure time of travel between ETC_SpringTestHiThresh and ETC_SpringTestLoThresh." VALUE 0x8000261A RecordLayout_4 0 CompuMethod_6 -1E+17 1E+17 /end CHARACTERISTIC
/begin CHARACTERISTIC ETC_SpringTestTimerThresh "During spring test at shutdown, TPS must fall to 0% within this time to prevent fault." VALUE 0x8000261E RecordLayout_4 0 CompuMethod_10 -1E+17 1E+17 /end CHARACTERISTIC
/begin CHARACTERISTIC ETC_StallAppOvrThesh "" VALUE 0x80002622 RecordLayout_4 0 CompuMethod_6 0 100 /end CHARACTERISTIC
/begin CHARACTERISTIC ETC_StallAppOvrTm "" VALUE 0x80002626 RecordLayout_4 0 CompuMethod_20 0 10 /end CHARACTERISTIC
/begin CHARACTERISTIC ETC_StickingThresh "Defines error limit between TPS_Request and TPS where ETC sticking fault will be set." VALUE 0x8000262A RecordLayout_4 0 CompuMethod_6 -1E+17 1E+17 /end CHARACTERISTIC
/begin CHARACTERISTIC ETC_VoltageCompTbl "Gain on ETC duty cycle based on DRVP" CURVE 0x8000262E RecordLayout_4 0 CompuMethod_2 -1E+17 1E+17
 /begin AXIS_DESCR COM_AXIS SysVolt09In CompuMethod_165 9 0 32 AXIS_PTS_REF SysVolt09IdxArr /end AXIS_DESCR
/end CHARACTERISTIC
/begin CHARACTERISTIC ETCDamperSwitchHyst "Hysterisis around the ThrPosDamperSwitchThresh." VALUE 0x80002652 RecordLayout_4 0 CompuMethod_101 -1E+17 1E+17 /end CHARACTERISTIC
/begin CHARACTERISTIC ETCDamperSwitchThresh "When filtered derivative of TPS is greater than this threshold, Damper_Up gain will be used." VALUE 0x80002656 RecordLayout_4 0 CompuMethod_101 -1E+17 1E+17 /end CHARACTERISTIC
/begin CHARACTERISTIC ETCDamperTPSFilt "Filter time constant" VALUE 0x8000265A RecordLayout_4 0 CompuMethod_20 -1E+17 1E+17 /end CHARACTERISTIC
/begin CHARACTERISTIC ETCDampGainDown "PID Damper Gain - Down Direction" VALUE 0x8000265E RecordLayout_4 0 CompuMethod_33 -1E+17 1E+17 /end CHARACTERISTIC
/begin CHARACTERISTIC ETCDampGainUp "PID Damper Gain - Up Direction" VALUE 0x80002662 RecordLayout_4 0 CompuMethod_33 -1E+17 1E+17 /end CHARACTERISTIC
/begin CHARACTERISTIC ETCDCOffsetTbl "Duty cycle offset based on desired ETC position." CURVE 0x80002666 RecordLayout_4 0 CompuMethod_6 -1E+17 1E+17
 /begin AXIS_DESCR COM_AXIS ETC_SetpointIn CompuMethod_2 20 -1E+17 1E+17 AXIS_PTS_REF ETC_SetpointIdxArr /end AXIS_DESCR
/end CHARACTERISTIC
/begin CHARACTERISTIC ETCDGain "PID Derivative Gain" VALUE 0x800026B6 RecordLayout_4 0 CompuMethod_33 -1E+17 1E+17 /end CHARACTERISTIC
/begin CHARACTERISTIC ETCErrorGain "PID Error Gain" VALUE 0x800026BA RecordLayout_4 0 CompuMethod_33 -1E+17 1E+17 /end CHARACTERISTIC
/begin CHARACTERISTIC ETCIGain "PID Integral Gain" VALUE 0x800026BE RecordLayout_4 0 CompuMethod_33 -1E+17 1E+17 /end CHARACTERISTIC
/begin CHARACTERISTIC ETCIMax "PID Integrator Upper Limit" VALUE 0x800026C2 RecordLayout_4 0 CompuMethod_6 -1E+17 1E+17 /end CHARACTERISTIC
/begin CHARACTERISTIC ETCIMin "PID Integrator Lower Limit" VALUE 0x800026C6 RecordLayout_4 0 CompuMethod_6 -1E+17 1E+17 /end CHARACTERISTIC
/begin CHARACTERISTIC ETCLwrLim "Lower Limit Value" VALUE 0x800026CA RecordLayout_4 0 CompuMethod_6 -1E+17 1E+17 /end CHARACTERISTIC
/begin CHARACTERISTIC ETCPGain "PID Proportional Gain" VALUE 0x800026CE RecordLayout_4 0 CompuMethod_33 -1E+17 1E+17 /end CHARACTERISTIC
/begin CHARACTERISTIC ETCReq_new "Override the electronic throttle position" VALUE 0x800026DC RecordLayout_4 0 CompuMethod_6 0 100 /end CHARACTERISTIC
/begin CHARACTERISTIC ETCReq_ovr "" VALUE 0x800026E0 RecordLayout_1 0 CompuMethod_5 0 1 /end CHARACTERISTIC
/begin CHARACTERISTIC ETCShutdownTimerThresh "Time limit in Stall State after which ETC will shutdown." VALUE 0x80002BB5 RecordLayout_4 0 CompuMethod_10 -1E+17 1E+17 /end CHARACTERISTIC
/begin CHARACTERISTIC ETCTuneAmp "" VALUE 0x80002BB9 RecordLayout_4 0 CompuMethod_2 -1E+17 1E+17 /end CHARACTERISTIC
/begin CHARACTERISTIC ETCTuneEnable "" VALUE 0x80002BBD RecordLayout_1 0 CompuMethod_36 0 1 /end CHARACTERISTIC
/begin CHARACTERISTIC ETCTuneFreq "" VALUE 0x80002BBE RecordLayout_4 0 CompuMethod_99 0 100 /end CHARACTERISTIC
/begin CHARACTERISTIC ETCTuneOffset "" VALUE 0x80002BC2 RecordLayout_4 0 CompuMethod_2 -1E+17 1E+17 /end CHARACTERISTIC
/begin CHARACTERISTIC ETCUprLim "Upper Limit Value" VALUE 0x80002BC6 RecordLayout_4 0 CompuMethod_6 -1E+17 1E+17 /end CHARACTERISTIC
/begin CHARACTERISTIC Ethanol_SpkOfstMultMap "Multiplier on ECT spark offset table." MAP 0x80002BF6 RecordLayout_4 0 CompuMethod_33 -1E+17 1E+17
 /begin AXIS_DESCR COM_AXIS RPM09In CompuMethod_25 9 0 14000 AXIS_PTS_REF RPM09IdxArr /end AXIS_DESCR
 /begin AXIS_DESCR COM_AXIS MAP09In CompuMethod_8 9 0 1000 AXIS_PTS_REF MAP09IdxArr /end AXIS_DESCR
/end CHARACTERISTIC
/begin CHARACTERISTIC EthSpkModTbl "Spark advance as a function of ethanol %" CURVE 0x80002D3A RecordLayout_4 0 CompuMethod_70 -1E+17 1E+17
 /begin AXIS_DESCR COM_AXIS Eth11IdxIn CompuMethod_2 11 -1E+17 1E+17 AXIS_PTS_REF Eth11IdxIdxArr /end AXIS_DESCR
/end CHARACTERISTIC
/begin CHARACTERISTIC EVAP_new "Override result of linear sensor characterization, in engineering units" VALUE 0x80002D66 RecordLayout_4 0 CompuMethod_61 -1E+17 1E+17 /end CHARACTERISTIC
/begin CHARACTERISTIC EVAP_ovr "" VALUE 0x80002D6A RecordLayout_1 0 CompuMethod_5 0 1 /end CHARACTERISTIC
/begin CHARACTERISTIC EVAPDefault "This is the initial default value should the sensor be in fault on key-up.  Otherwise the sensors outputs the last value prior to faulting" VALUE 0x80002D6B RecordLayout_4 0 CompuMethod_61 -1E+17 1E+17 /end CHARACTERISTIC
/begin CHARACTERISTIC EVAPFiltConst "Filter time constant" VALUE 0x80002D6F RecordLayout_4 0 CompuMethod_20 -1E+17 1E+17 /end CHARACTERISTIC
/begin CHARACTERISTIC EVAPMax "Maximum allowable input, indicating short or open circuit" VALUE 0x80002DA7 RecordLayout_4 0 CompuMethod_22 -1E+17 1E+17 /end CHARACTERISTIC
/begin CHARACTERISTIC EVAPMin "Minimum allowable input, indicating short or open circuit" VALUE 0x80002DAB RecordLayout_4 0 CompuMethod_22 -1E+17 1E+17 /end CHARACTERISTIC
/begin CHARACTERISTIC EVAPTbl "Look up table to allownon-linear characterization of sensors" CURVE 0x80002DB2 RecordLayout_4 0 CompuMethod_61 -1E+17 1E+17
 /begin AXIS_DESCR COM_AXIS EVAPADC CompuMethod_22 13 -1E+17 1E+17 AXIS_PTS_REF EVAPIdxArr /end AXIS_DESCR
/end CHARACTERISTIC
/begin CHARACTERISTIC Fall_Rate "" VALUE 0x80002DE6 RecordLayout_4 0 CompuMethod_2 -1E+17 1E+17 /end CHARACTERISTIC
/begin CHARACTERISTIC FAN1_new "Override actuator, in engineering units" VALUE 0x80002DEB RecordLayout_1 0 CompuMethod_4 0 1 /end CHARACTERISTIC
/begin CHARACTERISTIC FAN1_ovr "" VALUE 0x80002DEC RecordLayout_1 0 CompuMethod_5 0 1 /end CHARACTERISTIC
/begin CHARACTERISTIC FAN1_Polarity "Inverts the output of the actuator relative to the desired command - 0 = High True    1 = Low True" VALUE 0x80002DED RecordLayout_1 0 CompuMethod_4 0 1 /end CHARACTERISTIC
/begin CHARACTERISTIC FAN1_PWM_new "Override result of linear sensor characterization, in engineering units" VALUE 0x80002DEE RecordLayout_4 0 CompuMethod_6 -1E+17 1E+17 /end CHARACTERISTIC
/begin CHARACTERISTIC FAN1_PWM_ovr "" VALUE 0x80002DF2 RecordLayout_1 0 CompuMethod_5 0 1 /end CHARACTERISTIC
/begin CHARACTERISTIC FAN1_PWMFrequency "Frequency of PWM output" VALUE 0x80002DF3 RecordLayout_4 0 CompuMethod_99 -1E+17 1E+17 /end CHARACTERISTIC
/begin CHARACTERISTIC FAN1_PWMGain "Scaling from engineering units to PWM duty cycle" VALUE 0x80002DF7 RecordLayout_4 0 CompuMethod_105 -1E+17 1E+17 /end CHARACTERISTIC
/begin CHARACTERISTIC FAN1_PWMMaxLimit "Maximum limit of PWM signal." VALUE 0x80002DFB RecordLayout_4 0 CompuMethod_6 -1E+17 1E+17 /end CHARACTERISTIC
/begin CHARACTERISTIC FAN1_PWMMinLimit "Minimum limit of PWM signal." VALUE 0x80002DFF RecordLayout_4 0 CompuMethod_6 -1E+17 1E+17 /end CHARACTERISTIC
/begin CHARACTERISTIC FAN1_PWMOffset "Offset from engineering units to PWM duty cycle" VALUE 0x80002E03 RecordLayout_4 0 CompuMethod_6 -1E+17 1E+17 /end CHARACTERISTIC
/begin CHARACTERISTIC FAN2_new "Override actuator, in engineering units" VALUE 0x80002E0F RecordLayout_1 0 CompuMethod_4 0 1 /end CHARACTERISTIC
/begin CHARACTERISTIC FAN2_ovr "" VALUE 0x80002E10 RecordLayout_1 0 CompuMethod_5 0 1 /end CHARACTERISTIC
/begin CHARACTERISTIC FAN2_Polarity "Inverts the output of the actuator relative to the desired command - 0 = High True    1 = Low True" VALUE 0x80002E11 RecordLayout_1 0 CompuMethod_4 0 1 /end CHARACTERISTIC
/begin CHARACTERISTIC FAN2_PWM_new "Override result of linear sensor characterization, in engineering units" VALUE 0x80002E12 RecordLayout_4 0 CompuMethod_6 -1E+17 1E+17 /end CHARACTERISTIC
/begin CHARACTERISTIC FAN2_PWM_ovr "" VALUE 0x80002E16 RecordLayout_1 0 CompuMethod_5 0 1 /end CHARACTERISTIC
/begin CHARACTERISTIC FAN2_PWMFrequency "Frequency of PWM output" VALUE 0x80002E17 RecordLayout_4 0 CompuMethod_99 -1E+17 1E+17 /end CHARACTERISTIC
/begin CHARACTERISTIC FAN2_PWMGain "Scaling from engineering units to PWM duty cycle" VALUE 0x80002E1B RecordLayout_4 0 CompuMethod_105 -1E+17 1E+17 /end CHARACTERISTIC
/begin CHARACTERISTIC FAN2_PWMMaxLimit "Maximum limit of PWM signal." VALUE 0x80002E1F RecordLayout_4 0 CompuMethod_6 -1E+17 1E+17 /end CHARACTERISTIC
/begin CHARACTERISTIC FAN2_PWMMinLimit "Minimum limit of PWM signal." VALUE 0x80002E23 RecordLayout_4 0 CompuMethod_6 -1E+17 1E+17 /end CHARACTERISTIC
/begin CHARACTERISTIC FAN2_PWMOffset "Offset from engineering units to PWM duty cycle" VALUE 0x80002E27 RecordLayout_4 0 CompuMethod_6 -1E+17 1E+17 /end CHARACTERISTIC
/begin CHARACTERISTIC FDR "" VALUE 0x80003AE6 RecordLayout_4 0 CompuMethod_2 -1E+17 1E+17 /end CHARACTERISTIC
/begin CHARACTERISTIC FGND_20XRTI_PERIODIC_RunCnt "The number of times to execute FGND_20XRTI_PERIODIC before pausing.  -1 means run forever" VALUE 0x80003AEA RecordLayout_9 0 CompuMethod_52 -1 2147480000 /end CHARACTERISTIC
/begin CHARACTERISTIC FGND_5XRTI_PERIODIC_RunCnt "The number of times to execute FGND_5XRTI_PERIODIC before pausing.  -1 means run forever" VALUE 0x80003AEE RecordLayout_9 0 CompuMethod_52 -1 2147480000 /end CHARACTERISTIC
/begin CHARACTERISTIC FGND_MID_TDC_EVENT_RunCnt "The number of times to execute FGND_MID_TDC_EVENT before pausing.  -1 means run forever" VALUE 0x80003AF2 RecordLayout_9 0 CompuMethod_52 -1 2147480000 /end CHARACTERISTIC
/begin CHARACTERISTIC FGND_RTI_Period "Base rate of the FGND_RTI_PERIODIC event" VALUE 0x80003AF6 RecordLayout_8 0 CompuMethod_91 0 65535 /end CHARACTERISTIC
/begin CHARACTERISTIC FGND_RTI_PERIODIC_RunCnt "The number of times to execute FGND_RTI_PERIODIC before pausing.  -1 means run forever" VALUE 0x80003AF8 RecordLayout_9 0 CompuMethod_52 -1 2147480000 /end CHARACTERISTIC
/begin CHARACTERISTIC FGND_TDC_EVENT_RunCnt "The number of times to execute FGND_TDC_EVENT before pausing.  -1 means run forever" VALUE 0x80003AFC RecordLayout_9 0 CompuMethod_52 -1 2147480000 /end CHARACTERISTIC
/begin CHARACTERISTIC FGND_TDC1_EVENT_RunCnt "The number of times to execute FGND_TDC1_EVENT before pausing.  -1 means run forever" VALUE 0x80003B00 RecordLayout_9 0 CompuMethod_52 -1 2147480000 /end CHARACTERISTIC
/begin CHARACTERISTIC Filter_Type_Selection "Filter Section For Fuel Oxygenation Sensor" VALUE 0x80003B06 RecordLayout_1 0 CompuMethod_112 0 255 /end CHARACTERISTIC
/begin CHARACTERISTIC FinalGain "Gain 4 For Moving Average Filter" VALUE 0x80003B07 RecordLayout_4 0 CompuMethod_2 -1E+17 1E+17 /end CHARACTERISTIC
/begin CHARACTERISTIC Flex_FiltDecFiltC "Filter time constant for a decreasing signal." VALUE 0x80003B0B RecordLayout_4 0 CompuMethod_20 -1E+17 1E+17 /end CHARACTERISTIC
/begin CHARACTERISTIC Flex_FiltIncFiltC "Filter time constant for a increasing signal." VALUE 0x80003B0F RecordLayout_4 0 CompuMethod_20 -1E+17 1E+17 /end CHARACTERISTIC
/begin CHARACTERISTIC ForcedShutDownTimerThresh "If ECUP is off for this time and application has not turned off, then force a shutdown routine." VALUE 0x80003B13 RecordLayout_4 0 CompuMethod_20 0 1023 /end CHARACTERISTIC
/begin CHARACTERISTIC Fuel_Cyl1_offset "Provide lock and relative offset to input signal." VALUE 0x80003B17 RecordLayout_4 0 CompuMethod_114 -1E+17 1E+17 /end CHARACTERISTIC
/begin CHARACTERISTIC Fuel_Cyl1_ovr "Provide lock and relative offset to input signal." VALUE 0x80003B1B RecordLayout_1 0 CompuMethod_115 0 1 /end CHARACTERISTIC
/begin CHARACTERISTIC Fuel_Cyl2_offset "Provide lock and relative offset to input signal." VALUE 0x80003B1C RecordLayout_4 0 CompuMethod_114 -1E+17 1E+17 /end CHARACTERISTIC
/begin CHARACTERISTIC Fuel_Cyl2_ovr "Provide lock and relative offset to input signal." VALUE 0x80003B20 RecordLayout_1 0 CompuMethod_115 0 1 /end CHARACTERISTIC
/begin CHARACTERISTIC Fuel_Cyl3_offset "Provide lock and relative offset to input signal." VALUE 0x80003B21 RecordLayout_4 0 CompuMethod_114 -1E+17 1E+17 /end CHARACTERISTIC
/begin CHARACTERISTIC Fuel_Cyl3_ovr "Provide lock and relative offset to input signal." VALUE 0x80003B25 RecordLayout_1 0 CompuMethod_115 0 1 /end CHARACTERISTIC
/begin CHARACTERISTIC Fuel_Cyl4_offset "Provide lock and relative offset to input signal." VALUE 0x80003B26 RecordLayout_4 0 CompuMethod_114 -1E+17 1E+17 /end CHARACTERISTIC
/begin CHARACTERISTIC Fuel_Cyl4_ovr "Provide lock and relative offset to input signal." VALUE 0x80003B2A RecordLayout_1 0 CompuMethod_115 0 1 /end CHARACTERISTIC
/begin CHARACTERISTIC Fuel_Cyl5_offset "Provide lock and relative offset to input signal." VALUE 0x80003B2B RecordLayout_4 0 CompuMethod_114 -1E+17 1E+17 /end CHARACTERISTIC
/begin CHARACTERISTIC Fuel_Cyl5_ovr "Provide lock and relative offset to input signal." VALUE 0x80003B2F RecordLayout_1 0 CompuMethod_115 0 1 /end CHARACTERISTIC
/begin CHARACTERISTIC Fuel_Cyl6_offset "Provide lock and relative offset to input signal." VALUE 0x80003B30 RecordLayout_4 0 CompuMethod_114 -1E+17 1E+17 /end CHARACTERISTIC
/begin CHARACTERISTIC Fuel_Cyl6_ovr "Provide lock and relative offset to input signal." VALUE 0x80003B34 RecordLayout_1 0 CompuMethod_115 0 1 /end CHARACTERISTIC
/begin CHARACTERISTIC Fuel_Cyl7_offset "Provide lock and relative offset to input signal." VALUE 0x80003B35 RecordLayout_4 0 CompuMethod_114 -1E+17 1E+17 /end CHARACTERISTIC
/begin CHARACTERISTIC Fuel_Cyl7_ovr "Provide lock and relative offset to input signal." VALUE 0x80003B39 RecordLayout_1 0 CompuMethod_115 0 1 /end CHARACTERISTIC
/begin CHARACTERISTIC FuelPumpStartTime "The length of time for the Fuel Pump relay to be enabled at startup" VALUE 0x80003FCA RecordLayout_4 0 CompuMethod_20 0 100 /end CHARACTERISTIC
/begin CHARACTERISTIC Gain1 "Gain 1 For Moving Average Filter" VALUE 0x80003FF4 RecordLayout_4 0 CompuMethod_2 -1E+17 1E+17 /end CHARACTERISTIC
/begin CHARACTERISTIC Gain2 "Gain 2 For Moving Average Filter" VALUE 0x80003FF8 RecordLayout_4 0 CompuMethod_2 -1E+17 1E+17 /end CHARACTERISTIC
/begin CHARACTERISTIC Gain3 "Gain 3 For Moving Average Filter" VALUE 0x80003FFC RecordLayout_4 0 CompuMethod_2 -1E+17 1E+17 /end CHARACTERISTIC
/begin CHARACTERISTIC Gear1Ratio "" VALUE 0x80004000 RecordLayout_4 0 CompuMethod_2 -1E+17 1E+17 /end CHARACTERISTIC
/begin CHARACTERISTIC Gear2Ratio "" VALUE 0x80004004 RecordLayout_4 0 CompuMethod_2 -1E+17 1E+17 /end CHARACTERISTIC
/begin CHARACTERISTIC Gear3Ratio "" VALUE 0x80004008 RecordLayout_4 0 CompuMethod_2 -1E+17 1E+17 /end CHARACTERISTIC
/begin CHARACTERISTIC Gear4Ratio "" VALUE 0x8000400C RecordLayout_4 0 CompuMethod_2 -1E+17 1E+17 /end CHARACTERISTIC
/begin CHARACTERISTIC Gear5Ratio "" VALUE 0x80004010 RecordLayout_4 0 CompuMethod_2 -1E+17 1E+17 /end CHARACTERISTIC
/begin CHARACTERISTIC Gear6Ratio "" VALUE 0x80004014 RecordLayout_4 0 CompuMethod_2 -1E+17 1E+17 /end CHARACTERISTIC
/begin CHARACTERISTIC GearMatchHyst "" VALUE 0x80004018 RecordLayout_4 0 CompuMethod_2 -1E+17 1E+17 /end CHARACTERISTIC
/begin CHARACTERISTIC HardRevOffset "RPM rev limit for hard action to be taken" VALUE 0x800040AE RecordLayout_4 0 CompuMethod_25 0 1E+17 /end CHARACTERISTIC
/begin CHARACTERISTIC IAT_FiltDecFiltC "Filter time constant for a decreasing signal." VALUE 0x800040EB RecordLayout_4 0 CompuMethod_20 -1E+17 1E+17 /end CHARACTERISTIC
/begin CHARACTERISTIC IAT_FiltIncFiltC "Filter time constant for a increasing signal." VALUE 0x800040EF RecordLayout_4 0 CompuMethod_20 -1E+17 1E+17 /end CHARACTERISTIC
/begin CHARACTERISTIC IAT_SpkOfstMultMap "Multiplier on IAT spark offset table." MAP 0x8000411D RecordLayout_4 0 CompuMethod_2 -100 100
 /begin AXIS_DESCR COM_AXIS RPM09In CompuMethod_25 9 0 14000 AXIS_PTS_REF RPM09IdxArr /end AXIS_DESCR
 /begin AXIS_DESCR COM_AXIS MAP09In CompuMethod_8 9 0 1000 AXIS_PTS_REF MAP09IdxArr /end AXIS_DESCR
/end CHARACTERISTIC
/begin CHARACTERISTIC IAT_SpkOfstTbl "IAT spark offset" CURVE 0x80004261 RecordLayout_4 0 CompuMethod_70 -50 50
 /begin AXIS_DESCR COM_AXIS IAT05In CompuMethod_27 5 -40 300 AXIS_PTS_REF IAT05IdxArr /end AXIS_DESCR
/end CHARACTERISTIC
/begin CHARACTERISTIC IDLE_EVENT_RunCnt "The number of times to execute IDLE_EVENT before pausing.  -1 means run forever" VALUE 0x80004548 RecordLayout_9 0 CompuMethod_52 -1 2147480000 /end CHARACTERISTIC
/begin CHARACTERISTIC InGearMinGovEntryRPMDelta "RPM above setpoint where Min Gov will enable when RPM is falling into idle." VALUE 0x80004556 RecordLayout_4 0 CompuMethod_25 -1E+17 1E+17 /end CHARACTERISTIC
/begin CHARACTERISTIC InjdPCompTbl "Injector characterization compenastion based on dP across injector." CURVE 0x80004586 RecordLayout_4 0 CompuMethod_133 -1E+17 1E+17
 /begin AXIS_DESCR COM_AXIS InjDeltaPress09In CompuMethod_2 9 -1E+17 1E+17 AXIS_PTS_REF InjDeltaPress09IdxArr /end AXIS_DESCR
/end CHARACTERISTIC
/begin CHARACTERISTIC InjectiorMinDuration "Fuel injector min pulsewidth" VALUE 0x800045AA RecordLayout_4 0 CompuMethod_69 -1E+17 1E+17 /end CHARACTERISTIC
/begin CHARACTERISTIC Injector1Enable "" VALUE 0x800045AE RecordLayout_1 0 CompuMethod_36 0 1 /end CHARACTERISTIC
/begin CHARACTERISTIC Injector2Enable "" VALUE 0x800045AF RecordLayout_1 0 CompuMethod_36 0 1 /end CHARACTERISTIC
/begin CHARACTERISTIC Injector3Enable "" VALUE 0x800045B0 RecordLayout_1 0 CompuMethod_36 0 1 /end CHARACTERISTIC
/begin CHARACTERISTIC Injector4Enable "" VALUE 0x800045B1 RecordLayout_1 0 CompuMethod_36 0 1 /end CHARACTERISTIC
/begin CHARACTERISTIC Injector5Enable "" VALUE 0x800045B2 RecordLayout_1 0 CompuMethod_36 0 1 /end CHARACTERISTIC
/begin CHARACTERISTIC Injector6Enable "" VALUE 0x800045B3 RecordLayout_1 0 CompuMethod_36 0 1 /end CHARACTERISTIC
/begin CHARACTERISTIC Injector7Enable "" VALUE 0x800045B4 RecordLayout_1 0 CompuMethod_36 0 1 /end CHARACTERISTIC
/begin CHARACTERISTIC Injector8Enable "" VALUE 0x800045B5 RecordLayout_1 0 CompuMethod_36 0 1 /end CHARACTERISTIC
/begin CHARACTERISTIC InjectorMaxDuration "Maximum duration for an injector pulse.  Must be a multiple of 5ms" VALUE 0x800045B6 RecordLayout_4 0 CompuMethod_69 -1E+17 1E+17 /end CHARACTERISTIC
/begin CHARACTERISTIC InjGain "Gain value used in the linear transformation of FPC to mechanical pulsewidth." VALUE 0x800045C3 RecordLayout_4 0 CompuMethod_134 0 1E+17 /end CHARACTERISTIC
/begin CHARACTERISTIC InjOffset "Offset value used in the linear transformation of FPC to mechanical pulsewidth." VALUE 0x800045C7 RecordLayout_4 0 CompuMethod_135 -1E+17 1E+17 /end CHARACTERISTIC
/begin CHARACTERISTIC InjTurnOffTbl "Injector turn off time" CURVE 0x800045CB RecordLayout_4 0 CompuMethod_68 -1E+17 1E+17
 /begin AXIS_DESCR COM_AXIS InjDeltaPress09In CompuMethod_2 9 -1E+17 1E+17 AXIS_PTS_REF InjDeltaPress09IdxArr /end AXIS_DESCR
/end CHARACTERISTIC
/begin CHARACTERISTIC InjTurnOnTbl "Injector turn on time." CURVE 0x800045EF RecordLayout_4 0 CompuMethod_68 -1E+17 1E+17
 /begin AXIS_DESCR COM_AXIS SysVolt09In CompuMethod_165 9 0 32 AXIS_PTS_REF SysVolt09IdxArr /end AXIS_DESCR
/end CHARACTERISTIC
/begin CHARACTERISTIC IntakeAirTempEnrichmentMap "Requested on base eq. ratio as a function of IAT and MAP" MAP 0x80004613 RecordLayout_4 0 CompuMethod_66 0 10
 /begin AXIS_DESCR COM_AXIS IAT05In CompuMethod_27 5 -40 300 AXIS_PTS_REF IAT05IdxArr /end AXIS_DESCR
 /begin AXIS_DESCR COM_AXIS MAP09In CompuMethod_8 9 0 1000 AXIS_PTS_REF MAP09IdxArr /end AXIS_DESCR
/end CHARACTERISTIC
/begin CHARACTERISTIC MAF_Source "Selects the source for the fueling algorithm" VALUE 0x8000496F RecordLayout_1 0 CompuMethod_138 0 255 /end CHARACTERISTIC
/begin CHARACTERISTIC MakeUpEOIMap "End of injection timing for transient makeup fuel pulse" MAP 0x80004A25 RecordLayout_4 0 CompuMethod_70 -1000 1000
 /begin AXIS_DESCR COM_AXIS RPM09In CompuMethod_25 9 0 14000 AXIS_PTS_REF RPM09IdxArr /end AXIS_DESCR
 /begin AXIS_DESCR COM_AXIS MAP09In CompuMethod_8 9 0 1000 AXIS_PTS_REF MAP09IdxArr /end AXIS_DESCR
/end CHARACTERISTIC
/begin CHARACTERISTIC MediumRevOffset "RPM rev limit for medium action to be taken" VALUE 0x80004E0C RecordLayout_4 0 CompuMethod_25 0 1E+17 /end CHARACTERISTIC
/begin CHARACTERISTIC MinGovAirPcntHyst "Hysteresis around MinGovEntryAirPcnt where Min Gov will disable." VALUE 0x80004E14 RecordLayout_4 0 CompuMethod_6 -1E+17 1E+17 /end CHARACTERISTIC
/begin CHARACTERISTIC MinGovEntryAirPcnt "Percent air (TPS or APP) position where below which Min Gov will enable." VALUE 0x80004E2C RecordLayout_4 0 CompuMethod_6 -1E+17 1E+17 /end CHARACTERISTIC
/begin CHARACTERISTIC MinGovEntryAirTimeThresh "If entry AirPcnt condition is satisfied, but RPM is high, Min Gov will enable if this time is exceeded." VALUE 0x80004E30 RecordLayout_4 0 CompuMethod_10 -1E+17 1E+17 /end CHARACTERISTIC
/begin CHARACTERISTIC MinMakeUpPW "Minimum change in injector pulse width that will trigger a make-up pulse." VALUE 0x80004E34 RecordLayout_4 0 CompuMethod_69 -1E+17 1E+17 /end CHARACTERISTIC
/begin CHARACTERISTIC MotoTuneSerialBaudRate "The default baud rate that the serial MotoTune protocol will use for connections." VALUE 0x80004E8C RecordLayout_3 0 CompuMethod_52 9600 57600 /end CHARACTERISTIC
/begin CHARACTERISTIC O2ControlEnable "Enables O2 control" VALUE 0x80004E9C RecordLayout_1 0 CompuMethod_150 0 1 /end CHARACTERISTIC
/begin CHARACTERISTIC O2DisablmentMult "" VALUE 0x80004EB9 RecordLayout_7 0 CompuMethod_7 -128 127 /end CHARACTERISTIC
/begin CHARACTERISTIC O2StartUpDelayTbl "Delay O2 enable until TimeSinceRun is greater than this time." CURVE 0x80004F26 RecordLayout_4 0 CompuMethod_10 -1E+17 1E+17
 /begin AXIS_DESCR COM_AXIS ECT_KeyUp09In CompuMethod_27 9 -1E+17 1E+17 AXIS_PTS_REF ECT_KeyUp09IdxArr /end AXIS_DESCR
/end CHARACTERISTIC
/begin CHARACTERISTIC ONE_SECOND_EVENT_RunCnt "The number of times to execute ONE_SECOND_EVENT before pausing.  -1 means run forever" VALUE 0x80004F72 RecordLayout_9 0 CompuMethod_52 -1 2147480000 /end CHARACTERISTIC
/begin CHARACTERISTIC OpenThrottleFPCScalar "Crank FPC is scaled up with throttle opening for mechanical throttle systems, this parameter sets the gain for this relationship.  CrankFPC=CrankFPC*(1+TPS/100*FPCScalar)." VALUE 0x80004F76 RecordLayout_4 0 CompuMethod_67 -1E+17 1E+17 /end CHARACTERISTIC
/begin CHARACTERISTIC PrimarySOIMap "Injection timing for primary fuel pulse - SOI or EOI depending on Inj Config" MAP 0x80004FE7 RecordLayout_4 0 CompuMethod_70 -1000 1000
 /begin AXIS_DESCR COM_AXIS RPM09In CompuMethod_25 9 0 14000 AXIS_PTS_REF RPM09IdxArr /end AXIS_DESCR
 /begin AXIS_DESCR COM_AXIS MAP09In CompuMethod_8 9 0 1000 AXIS_PTS_REF MAP09IdxArr /end AXIS_DESCR
/end CHARACTERISTIC
/begin CHARACTERISTIC ProcessorReboot "Reboots the processor when set." VALUE 0x8000512B RecordLayout_1 0 CompuMethod_157 0 1 /end CHARACTERISTIC
/begin CHARACTERISTIC PseudoRPM "" VALUE 0x8000512C RecordLayout_8 0 CompuMethod_52 0 65535 /end CHARACTERISTIC
/begin CHARACTERISTIC RevLimitHyst "Hysteresis applied to MaxRPM once rev limit threshold is satisfied" VALUE 0x8000512F RecordLayout_4 0 CompuMethod_25 0 12000 /end CHARACTERISTIC
/begin CHARACTERISTIC Rise_Rate "" VALUE 0x800053BC RecordLayout_4 0 CompuMethod_2 -1E+17 1E+17 /end CHARACTERISTIC
/begin CHARACTERISTIC RPMFiltConst "Filter time constant" VALUE 0x8000548F RecordLayout_4 0 CompuMethod_20 -1E+17 1E+17 /end CHARACTERISTIC
/begin CHARACTERISTIC RunLatchTDCs "Number of TDCs required to be above CrankToRunRPMThresh before the RUN mode is invoked." VALUE 0x80005493 RecordLayout_1 0 CompuMethod_163 0 255 /end CHARACTERISTIC
/begin CHARACTERISTIC Shutdown_Delay "ECU calibrateable shutdown delay" VALUE 0x800054C2 RecordLayout_4 0 CompuMethod_28 0 1E+17 /end CHARACTERISTIC
/begin CHARACTERISTIC SparkAdv_FiltDecFiltC "Filter time constant for a decreasing signal." VALUE 0x8000551B RecordLayout_4 0 CompuMethod_20 -1E+17 1E+17 /end CHARACTERISTIC
/begin CHARACTERISTIC SparkAdv_FiltIncFiltC "Filter time constant for a increasing signal." VALUE 0x8000551F RecordLayout_4 0 CompuMethod_20 -1E+17 1E+17 /end CHARACTERISTIC
/begin CHARACTERISTIC SparkAdvMap "Base spark advance map." MAP 0x80005523 RecordLayout_4 0 CompuMethod_70 -1E+17 1E+17
 /begin AXIS_DESCR COM_AXIS RPM17In CompuMethod_25 17 0 14000 AXIS_PTS_REF RPM17IdxArr /end AXIS_DESCR
 /begin AXIS_DESCR COM_AXIS MAP17In CompuMethod_8 17 0 1000 AXIS_PTS_REF MAP17IdxArr /end AXIS_DESCR
/end CHARACTERISTIC
/begin CHARACTERISTIC SparkEnableCyl1 "Disable spark to particular cylinder." VALUE 0x800059AC RecordLayout_1 0 CompuMethod_168 0 1 /end CHARACTERISTIC
/begin CHARACTERISTIC SparkEnableCyl2 "Disable spark to particular cylinder." VALUE 0x800059AD RecordLayout_1 0 CompuMethod_168 0 1 /end CHARACTERISTIC
/begin CHARACTERISTIC SparkEnableCyl3 "Disable spark to particular cylinder." VALUE 0x800059AE RecordLayout_1 0 CompuMethod_168 0 1 /end CHARACTERISTIC
/begin CHARACTERISTIC SparkEnableCyl4 "Disable spark to particular cylinder." VALUE 0x800059AF RecordLayout_1 0 CompuMethod_168 0 1 /end CHARACTERISTIC
/begin CHARACTERISTIC SparkEnableCyl5 "Disable spark to particular cylinder." VALUE 0x800059B0 RecordLayout_1 0 CompuMethod_168 0 1 /end CHARACTERISTIC
/begin CHARACTERISTIC SparkEnableCyl6 "Disable spark to particular cylinder." VALUE 0x800059B1 RecordLayout_1 0 CompuMethod_168 0 1 /end CHARACTERISTIC
/begin CHARACTERISTIC SparkEnableCyl7 "Disable spark to particular cylinder." VALUE 0x800059B2 RecordLayout_1 0 CompuMethod_168 0 1 /end CHARACTERISTIC
/begin CHARACTERISTIC SparkEnableCyl8 "Disable spark to particular cylinder." VALUE 0x800059B3 RecordLayout_1 0 CompuMethod_168 0 1 /end CHARACTERISTIC
/begin CHARACTERISTIC SparkEnableTDCCounts "Do not enable spark until this many TDCs have occurred in order to guarantee cam synchronization. This number should typically be 2." VALUE 0x800059B4 RecordLayout_1 0 CompuMethod_1 0 255 /end CHARACTERISTIC
/begin CHARACTERISTIC SparkMaxDuration "Maximum duration for a spark pulse.  Must be a multiple of 5ms" VALUE 0x800059B5 RecordLayout_4 0 CompuMethod_69 -1E+17 1E+17 /end CHARACTERISTIC
/begin CHARACTERISTIC StallRPMMinThreshold "Min. RPM Threshold below which engine state transition to STALL." VALUE 0x80005A7F RecordLayout_8 0 CompuMethod_75 0 65535 /end CHARACTERISTIC
/begin CHARACTERISTIC StallRPMThresholdHyst "Hysteresis used in conjunction with Min. RPM Threshold to determine when engine state transition to STALL. " VALUE 0x80005A81 RecordLayout_8 0 CompuMethod_75 0 65535 /end CHARACTERISTIC
/begin CHARACTERISTIC StallSaverDeltaRPM "RPM delta below setpoint where Min Gov will enable to prevent engine stalls." VALUE 0x80005A83 RecordLayout_4 0 CompuMethod_25 -1E+17 1E+17 /end CHARACTERISTIC
/begin CHARACTERISTIC STARTUP_EVENT_RunCnt "The number of times to execute STARTUP_EVENT before pausing.  -1 means run forever" VALUE 0x80005A87 RecordLayout_9 0 CompuMethod_52 -1 2147480000 /end CHARACTERISTIC
/begin CHARACTERISTIC TeethBeforeSyncAllowed "The number of teeth that must be observed before the encoder will allow synchronization to occur." VALUE 0x80005AD0 RecordLayout_1 0 CompuMethod_1 0 255 /end CHARACTERISTIC
/begin CHARACTERISTIC TimeBeforeSyncAllowed "The amount of time that must be observed after initial encoder activity before the encoder will allow synchronization to occur." VALUE 0x80005ADE RecordLayout_8 0 CompuMethod_175 0 65535 /end CHARACTERISTIC
/begin CHARACTERISTIC TireRadius "" VALUE 0x80005B04 RecordLayout_4 0 CompuMethod_2 -1E+17 1E+17 /end CHARACTERISTIC
/begin CHARACTERISTIC TPS_FiltDecFiltC "Filter time constant for a decreasing signal." VALUE 0x80005B08 RecordLayout_4 0 CompuMethod_20 -1E+17 1E+17 /end CHARACTERISTIC
/begin CHARACTERISTIC TPS_FiltIncFiltC "Filter time constant for a increasing signal." VALUE 0x80005B0C RecordLayout_4 0 CompuMethod_20 -1E+17 1E+17 /end CHARACTERISTIC
/begin CHARACTERISTIC VEAdaptEnable "Determines whether the Volumetric Efficiency map will be adapted using the MAF sensor" VALUE 0x80005BDF RecordLayout_1 0 CompuMethod_29 0 1 /end CHARACTERISTIC
/begin CHARACTERISTIC VEAdaptTemp "Engine Coolant Temp Must be higher than this to Adapt VE" VALUE 0x80005C10 RecordLayout_4 0 CompuMethod_27 -40 200 /end CHARACTERISTIC
/begin CHARACTERISTIC VEAdaptTime "Engine Run Time must be greater than this to Adapt VE" VALUE 0x80005C14 RecordLayout_4 0 CompuMethod_20 0 200 /end CHARACTERISTIC
/begin CHARACTERISTIC VEBaroCorrTbl "Vol Eff compensation based on BARO." CURVE 0x80005C18 RecordLayout_4 0 CompuMethod_2 -1E+17 1E+17
 /begin AXIS_DESCR COM_AXIS BARO CompuMethod_2 9 -1E+17 1E+17 AXIS_PTS_REF BARO09IdxArr /end AXIS_DESCR
/end CHARACTERISTIC
/begin CHARACTERISTIC VETempCorrMap "" MAP 0x80005C80 RecordLayout_4 0 CompuMethod_6 -1E+17 1E+17
 /begin AXIS_DESCR COM_AXIS ECT09In CompuMethod_27 9 -40 200 AXIS_PTS_REF ECT09IdxArr /end AXIS_DESCR
 /begin AXIS_DESCR COM_AXIS IAT17In CompuMethod_27 17 -40 300 AXIS_PTS_REF IAT17IdxArr /end AXIS_DESCR
/end CHARACTERISTIC
/begin CHARACTERISTIC VolEffAdaptMap "Volumetric efficiency adapt table" MAP 0x80005EE4 RecordLayout_4 0 CompuMethod_6 -1000 1000
 /begin AXIS_DESCR COM_AXIS RPM17In CompuMethod_25 17 0 14000 AXIS_PTS_REF RPM17IdxArr /end AXIS_DESCR
 /begin AXIS_DESCR COM_AXIS VEMapIn CompuMethod_8 17 -1E+17 1E+17 AXIS_PTS_REF VEMapIdxArr /end AXIS_DESCR
/end CHARACTERISTIC
/begin CHARACTERISTIC VolEffMap "Volumetric efficiency table for speed density mode" MAP 0x80006368 RecordLayout_4 0 CompuMethod_6 0 1000
 /begin AXIS_DESCR COM_AXIS RPM17In CompuMethod_25 17 0 14000 AXIS_PTS_REF RPM17IdxArr /end AXIS_DESCR
 /begin AXIS_DESCR COM_AXIS VEMapIn CompuMethod_8 17 -1E+17 1E+17 AXIS_PTS_REF VEMapIdxArr /end AXIS_DESCR
/end CHARACTERISTIC
/begin CHARACTERISTIC VSPD_FiltDecFiltC "Filter time constant for a decreasing signal." VALUE 0x800067F2 RecordLayout_4 0 CompuMethod_20 -1E+17 1E+17 /end CHARACTERISTIC
/begin CHARACTERISTIC VSPD_FiltIncFiltC "Filter time constant for a increasing signal." VALUE 0x800067F6 RecordLayout_4 0 CompuMethod_20 -1E+17 1E+17 /end CHARACTERISTIC
/begin CHARACTERISTIC WarmUpEqRatioMap "Requested eq. ratio as a function of ECT and MAP." MAP 0x8000690A RecordLayout_4 0 CompuMethod_66 0 10
 /begin AXIS_DESCR COM_AXIS ECT09In CompuMethod_27 9 -40 200 AXIS_PTS_REF ECT09IdxArr /end AXIS_DESCR
 /begin AXIS_DESCR COM_AXIS MAP05In CompuMethod_8 5 0 1000 AXIS_PTS_REF MAP05IdxArr /end AXIS_DESCR
/end CHARACTERISTIC
/begin CHARACTERISTIC WarmUpTimeRatioMap "Requested eq. ratio as a function of TimeSinceRun and ECT. Use for cold temps" MAP 0x800069BE RecordLayout_4 0 CompuMethod_66 0 10
 /begin AXIS_DESCR COM_AXIS ECT05In CompuMethod_27 5 -40 200 AXIS_PTS_REF ECT05IdxArr /end AXIS_DESCR
 /begin AXIS_DESCR COM_AXIS TimeSinceRun09In CompuMethod_2 9 -1E+17 1E+17 AXIS_PTS_REF TimeSinceRun09IdxArr /end AXIS_DESCR
/end CHARACTERISTIC
/begin CHARACTERISTIC WGDeadTimeTbl "Wastegate turn on time" CURVE 0x80006A95 RecordLayout_4 0 CompuMethod_68 0 1000
 /begin AXIS_DESCR COM_AXIS SysVolt09In CompuMethod_165 9 0 32 AXIS_PTS_REF SysVolt09IdxArr /end AXIS_DESCR
/end CHARACTERISTIC
/begin AXIS_PTS BARO09IdxArr "" 0x800006A2 BARO RecordLayout_6 0 CompuMethod_2 9 -1E+17 1E+17 DEPOSIT ABSOLUTE /end AXIS_PTS
/begin AXIS_PTS BoostCtlSpeedErrorIdxArr "" 0x80000B94 BoostCtlSpeedErrorIn RecordLayout_6 0 CompuMethod_2 9 -1E+17 1E+17 DEPOSIT ABSOLUTE /end AXIS_PTS
/begin AXIS_PTS BoostTargetIdxArr "" 0x80000C10 BoostTargetIn RecordLayout_6 0 CompuMethod_2 9 0 1E+17 DEPOSIT ABSOLUTE /end AXIS_PTS
/begin AXIS_PTS CAT05IdxArr "Index of charge air temperature" 0x80000ED7 CAT05In RecordLayout_6 0 CompuMethod_27 5 -40 300 DEPOSIT ABSOLUTE /end AXIS_PTS
/begin AXIS_PTS CATIdxArr "Look up table to allownon-linear characterization of sensors" 0x80000EF3 CATADC RecordLayout_6 0 CompuMethod_22 13 -1E+17 1E+17 DEPOSIT ABSOLUTE /end AXIS_PTS
/begin AXIS_PTS CrankECT05IdxArr "ECT pre-lookup for crank maps." 0x8000119B ECT RecordLayout_6 0 CompuMethod_27 5 -1E+17 1E+17 DEPOSIT ABSOLUTE /end AXIS_PTS
/begin AXIS_PTS CrankIAT05IdxArr "IAT pre-lookup for crank maps." 0x800012C7 IAT RecordLayout_6 0 CompuMethod_27 5 -1E+17 1E+17 DEPOSIT ABSOLUTE /end AXIS_PTS
/begin AXIS_PTS CrankOXY05IdxArr "OXY pre-lookup for crank maps." 0x800012EF CrankOXY05In RecordLayout_6 0 CompuMethod_6 5 -1E+17 1E+17 DEPOSIT ABSOLUTE /end AXIS_PTS
/begin AXIS_PTS CrankRPM05IdxArr "RPM pre-lookup for crank maps" 0x80001303 CrankRPM05In RecordLayout_6 0 CompuMethod_25 5 -1E+17 1E+17 DEPOSIT ABSOLUTE /end AXIS_PTS
/begin AXIS_PTS DeltaMAP17IdxArr "" 0x80001661 DeltaMAP17In RecordLayout_6 0 CompuMethod_2 17 -1E+17 1E+17 DEPOSIT ABSOLUTE /end AXIS_PTS
/begin AXIS_PTS DeltaTPS17IdxArr "" 0x8000190D DeltaTPS17In RecordLayout_6 0 CompuMethod_2 17 -1E+17 1E+17 DEPOSIT ABSOLUTE /end AXIS_PTS
/begin AXIS_PTS DesAFRatioIdxArr "" 0x80001952 DesAFRatioIn RecordLayout_6 0 CompuMethod_78 11 0 100 DEPOSIT ABSOLUTE /end AXIS_PTS
/begin AXIS_PTS DesEqRatio09IdxArr "Desired Equivalence Ratio breakpoints" 0x800019AA DesEqRatio09In RecordLayout_6 0 CompuMethod_79 9 0 1E+17 DEPOSIT ABSOLUTE /end AXIS_PTS
/begin AXIS_PTS DFCOEntryRPMIdxArr "DFCO entry RPM as a function of ECT" 0x80001E67 DFCOEntryRPMIn RecordLayout_6 0 CompuMethod_27 10 -40 250 DEPOSIT ABSOLUTE /end AXIS_PTS
/begin AXIS_PTS DFCOExitRPMIdxArr "DFCO exit rpm" 0x80001EC7 DFCOExitRPMIn RecordLayout_6 0 CompuMethod_27 10 -40 250 DEPOSIT ABSOLUTE /end AXIS_PTS
/begin AXIS_PTS ECT_KeyUp09IdxArr "Index of ECT captured at key-up." 0x80001F24 ECT_KeyUp09In RecordLayout_6 0 CompuMethod_27 9 -1E+17 1E+17 DEPOSIT ABSOLUTE /end AXIS_PTS
/begin AXIS_PTS ECT05IdxArr "Idex of ECT" 0x800020A5 ECT05In RecordLayout_6 0 CompuMethod_27 5 -40 200 DEPOSIT ABSOLUTE /end AXIS_PTS
/begin AXIS_PTS ECT09IdxArr "Index of ECT" 0x800020B9 ECT09In RecordLayout_6 0 CompuMethod_27 9 -40 200 DEPOSIT ABSOLUTE /end AXIS_PTS
/begin AXIS_PTS ECTIdxArr "Look up table to allownon-linear characterization of sensors" 0x800022E5 ECTADC RecordLayout_6 0 CompuMethod_22 13 -1E+17 1E+17 DEPOSIT ABSOLUTE /end AXIS_PTS
/begin AXIS_PTS ETC_ErrorIdxArr "" 0x80002525 ETC_ErrorIn RecordLayout_6 0 CompuMethod_2 10 -1E+17 1E+17 DEPOSIT ABSOLUTE /end AXIS_PTS
/begin AXIS_PTS ETC_SetpointIdxArr "" 0x800025C2 ETC_SetpointIn RecordLayout_6 0 CompuMethod_2 20 -1E+17 1E+17 DEPOSIT ABSOLUTE /end AXIS_PTS
/begin AXIS_PTS Eth11IdxIdxArr "" 0x80002BCA Eth11IdxIn RecordLayout_6 0 CompuMethod_2 11 -1E+17 1E+17 DEPOSIT ABSOLUTE /end AXIS_PTS
/begin AXIS_PTS EVAPIdxArr "Look up table to allownon-linear characterization of sensors" 0x80002D73 EVAPADC RecordLayout_6 0 CompuMethod_22 13 -1E+17 1E+17 DEPOSIT ABSOLUTE /end AXIS_PTS
/begin AXIS_PTS IAT05IdxArr "Index of IAT" 0x80004275 IAT05In RecordLayout_6 0 CompuMethod_27 5 -40 300 DEPOSIT ABSOLUTE /end AXIS_PTS
/begin AXIS_PTS IAT17IdxArr "Index of IAT" 0x80004289 IAT17In RecordLayout_6 0 CompuMethod_27 17 -40 300 DEPOSIT ABSOLUTE /end AXIS_PTS
/begin AXIS_PTS InjDeltaPress09IdxArr "" 0x80004562 InjDeltaPress09In RecordLayout_6 0 CompuMethod_2 9 -1E+17 1E+17 DEPOSIT ABSOLUTE /end AXIS_PTS
/begin AXIS_PTS MAF09IdxArr "" 0x80004970 MAF09In RecordLayout_6 0 CompuMethod_2 9 -1E+17 1E+17 DEPOSIT ABSOLUTE /end AXIS_PTS
/begin AXIS_PTS MAP05IdxArr "Index of MAP" 0x80004B8E MAP05In RecordLayout_6 0 CompuMethod_8 5 0 1000 DEPOSIT ABSOLUTE /end AXIS_PTS
/begin AXIS_PTS MAP09IdxArr "Index of MAP" 0x80004BA2 MAP09In RecordLayout_6 0 CompuMethod_8 9 0 1000 DEPOSIT ABSOLUTE /end AXIS_PTS
/begin AXIS_PTS MAP17IdxArr "Index of MAP" 0x80004BC6 MAP17In RecordLayout_6 0 CompuMethod_8 17 0 1000 DEPOSIT ABSOLUTE /end AXIS_PTS
/begin AXIS_PTS RPM09IdxArr "Index of RPM" 0x800053D4 RPM09In RecordLayout_6 0 CompuMethod_25 9 0 14000 DEPOSIT ABSOLUTE /end AXIS_PTS
/begin AXIS_PTS RPM17IdxArr "Index of RPM" 0x800053F8 RPM17In RecordLayout_6 0 CompuMethod_25 17 0 14000 DEPOSIT ABSOLUTE /end AXIS_PTS
/begin AXIS_PTS SpkEnergy09IdxArr "" 0x800059C3 SpkEnergy09In RecordLayout_6 0 CompuMethod_2 9 -1E+17 1E+17 DEPOSIT ABSOLUTE /end AXIS_PTS
/begin AXIS_PTS SysVolt09IdxArr "Index of system voltage" 0x80005A91 SysVolt09In RecordLayout_6 0 CompuMethod_165 9 0 32 DEPOSIT ABSOLUTE /end AXIS_PTS
/begin AXIS_PTS TimeSinceRun09IdxArr "" 0x80005AE0 TimeSinceRun09In RecordLayout_6 0 CompuMethod_2 9 -1E+17 1E+17 DEPOSIT ABSOLUTE /end AXIS_PTS
/begin AXIS_PTS VEMapIdxArr "Index of MAP for VE calculations" 0x80005C3C VEMapIn RecordLayout_6 0 CompuMethod_8 17 -1E+17 1E+17 DEPOSIT ABSOLUTE /end AXIS_PTS
/begin AXIS_PTS VSPD09IdxArr "Index of VSPD" 0x80006816 VSPD09In RecordLayout_6 0 CompuMethod_180 9 -100 200 DEPOSIT ABSOLUTE /end AXIS_PTS
/*~~~~~~~~~ 6.3.106 RECORD_LAYOUTs ~~~~~~~~~*/
/begin RECORD_LAYOUT RecordLayout_1 FNC_VALUES 1 UBYTE ROW_DIR DIRECT /end RECORD_LAYOUT
/begin RECORD_LAYOUT RecordLayout_3 FNC_VALUES 1 ULONG ROW_DIR DIRECT /end RECORD_LAYOUT
/begin RECORD_LAYOUT RecordLayout_4 FNC_VALUES 1 FLOAT32_IEEE ROW_DIR DIRECT /end RECORD_LAYOUT
/begin RECORD_LAYOUT RecordLayout_5 FNC_VALUES 1 SWORD ROW_DIR DIRECT /end RECORD_LAYOUT
/begin RECORD_LAYOUT RecordLayout_6 AXIS_PTS_X 1 FLOAT32_IEEE /* IndexIncr */ INDEX_INCR /* Addressing */ DIRECT /end RECORD_LAYOUT
/begin RECORD_LAYOUT RecordLayout_7 FNC_VALUES 1 SBYTE ROW_DIR DIRECT /end RECORD_LAYOUT
/begin RECORD_LAYOUT RecordLayout_8 FNC_VALUES 1 UWORD ROW_DIR DIRECT /end RECORD_LAYOUT
/begin RECORD_LAYOUT RecordLayout_9 FNC_VALUES 1 SLONG ROW_DIR DIRECT /end RECORD_LAYOUT
/*~~~~~~~~~ 6.3.31 COMPU_METHODs ~~~~~~~~~*/
/begin COMPU_METHOD CompuMethod_1 "" RAT_FUNC "%3.0" "" COEFFS 0 1 0 0 0 1 /end COMPU_METHOD
/begin COMPU_METHOD CompuMethod_2 "" RAT_FUNC "%6.2" "" COEFFS 0 1 0 0 0 1 /end COMPU_METHOD
/begin COMPU_METHOD CompuMethod_4 "" RAT_FUNC "%1.0" "bool" COEFFS 0 1 0 0 0 1 /end COMPU_METHOD
/begin COMPU_METHOD CompuMethod_5 "" TAB_VERB "%1.0" "" COMPU_TAB_REF CompuVtab_1 /end COMPU_METHOD
/begin COMPU_METHOD CompuMethod_6 "" RAT_FUNC "%6.2" "%" COEFFS 0 1 0 0 0 1 /end COMPU_METHOD
/begin COMPU_METHOD CompuMethod_7 "" TAB_VERB "%3.0" "" COMPU_TAB_REF CompuVtab_2 /end COMPU_METHOD
/begin COMPU_METHOD CompuMethod_8 "" RAT_FUNC "%6.2" "kPa" COEFFS 0 1 0 0 0 1 /end COMPU_METHOD
/begin COMPU_METHOD CompuMethod_10 "" RAT_FUNC "%6.2" "s" COEFFS 0 1 0 0 0 1 /end COMPU_METHOD
/begin COMPU_METHOD CompuMethod_11 "" RAT_FUNC "%1.0" "" COEFFS 0 1 0 0 0 1 /end COMPU_METHOD
/begin COMPU_METHOD CompuMethod_15 "" RAT_FUNC "%6.2" "idx.frac" COEFFS 0 1 0 0 0 0.00195313 /end COMPU_METHOD
/begin COMPU_METHOD CompuMethod_16 "" RAT_FUNC "%5.0" "ADC" COEFFS 0 1 0 0 0 1 /end COMPU_METHOD
/begin COMPU_METHOD CompuMethod_20 "" RAT_FUNC "%6.2" "sec" COEFFS 0 1 0 0 0 1 /end COMPU_METHOD
/begin COMPU_METHOD CompuMethod_22 "" RAT_FUNC "%6.2" "ADC" COEFFS 0 1 0 0 0 1 /end COMPU_METHOD
/begin COMPU_METHOD CompuMethod_25 "" RAT_FUNC "%6.2" "RPM" COEFFS 0 1 0 0 0 1 /end COMPU_METHOD
/begin COMPU_METHOD CompuMethod_26 "" RAT_FUNC "%1.0" "Boolean" COEFFS 0 1 0 0 0 1 /end COMPU_METHOD
/begin COMPU_METHOD CompuMethod_27 "" RAT_FUNC "%6.2" "degC" COEFFS 0 1 0 0 0 1 /end COMPU_METHOD
/begin COMPU_METHOD CompuMethod_28 "" RAT_FUNC "%6.2" "Seconds" COEFFS 0 1 0 0 0 1 /end COMPU_METHOD
/begin COMPU_METHOD CompuMethod_29 "" TAB_VERB "%1.0" "bool" COMPU_TAB_REF CompuVtab_2 /end COMPU_METHOD
/begin COMPU_METHOD CompuMethod_30 "" RAT_FUNC "%6.2" "g/s" COEFFS 0 1 0 0 0 1 /end COMPU_METHOD
/begin COMPU_METHOD CompuMethod_31 "" TAB_VERB "%6.2" "" COMPU_TAB_REF CompuVtab_6 /end COMPU_METHOD
/begin COMPU_METHOD CompuMethod_33 "" RAT_FUNC "%6.2" "mult" COEFFS 0 1 0 0 0 1 /end COMPU_METHOD
/begin COMPU_METHOD CompuMethod_34 "" TAB_VERB "%1.0" "" COMPU_TAB_REF CompuVtab_8 /end COMPU_METHOD
/begin COMPU_METHOD CompuMethod_36 "" TAB_VERB "%1.0" "" COMPU_TAB_REF CompuVtab_2 /end COMPU_METHOD
/begin COMPU_METHOD CompuMethod_37 "" RAT_FUNC "%1.0" "boolean" COEFFS 0 1 0 0 0 1 /end COMPU_METHOD
/begin COMPU_METHOD CompuMethod_44 "" RAT_FUNC "%6.2" "EquivRatio" COEFFS 0 1 0 0 0 1 /end COMPU_METHOD
/begin COMPU_METHOD CompuMethod_45 "" RAT_FUNC "%9.4" "EquivRatio/ADC" COEFFS 0 1 0 0 0 1 /end COMPU_METHOD
/begin COMPU_METHOD CompuMethod_46 "" TAB_VERB "%1.0" "kPa" COMPU_TAB_REF CompuVtab_13 /end COMPU_METHOD
/begin COMPU_METHOD CompuMethod_47 "" TAB_VERB "%1.0" "" COMPU_TAB_REF CompuVtab_14 /end COMPU_METHOD
/begin COMPU_METHOD CompuMethod_48 "" RAT_FUNC "%5.4" "" COEFFS 0 1 0 0 0 1 /end COMPU_METHOD
/begin COMPU_METHOD CompuMethod_49 "" RAT_FUNC "%5.4" "mult" COEFFS 0 1 0 0 0 1 /end COMPU_METHOD
/begin COMPU_METHOD CompuMethod_51 "" RAT_FUNC "%6.2" "mJ" COEFFS 0 1 0 0 0 1 /end COMPU_METHOD
/begin COMPU_METHOD CompuMethod_52 "" RAT_FUNC "%5.0" "" COEFFS 0 1 0 0 0 1 /end COMPU_METHOD
/begin COMPU_METHOD CompuMethod_53 "" TAB_VERB "%3.0" "" COMPU_TAB_REF CompuVtab_15 /end COMPU_METHOD
/begin COMPU_METHOD CompuMethod_54 "" RAT_FUNC "%4.0" "" COEFFS 0 1 0 0 0 1 /end COMPU_METHOD
/begin COMPU_METHOD CompuMethod_55 "" TAB_VERB "%3.0" "" COMPU_TAB_REF CompuVtab_16 /end COMPU_METHOD
/begin COMPU_METHOD CompuMethod_56 "" RAT_FUNC "%6.2" "PSI" COEFFS 0 1 0 0 0 1 /end COMPU_METHOD
/begin COMPU_METHOD CompuMethod_57 "" RAT_FUNC "%6.2" "dutyCycle" COEFFS 0 1 0 0 0 1 /end COMPU_METHOD
/begin COMPU_METHOD CompuMethod_58 "" RAT_FUNC "%6.2" "PSI/sec" COEFFS 0 1 0 0 0 1 /end COMPU_METHOD
/begin COMPU_METHOD CompuMethod_59 "" RAT_FUNC "%5.0" "degCA" COEFFS 0 1 0 0 0 0.0625 /end COMPU_METHOD
/begin COMPU_METHOD CompuMethod_60 "" RAT_FUNC "%8.0" "" COEFFS 0 1 0 0 0 1 /end COMPU_METHOD
/begin COMPU_METHOD CompuMethod_61 "" RAT_FUNC "%6.2" "C" COEFFS 0 1 0 0 0 1 /end COMPU_METHOD
/begin COMPU_METHOD CompuMethod_62 "" TAB_VERB "%1.0" "" COMPU_TAB_REF CompuVtab_17 /end COMPU_METHOD
/begin COMPU_METHOD CompuMethod_63 "" TAB_VERB "%1.0" "" COMPU_TAB_REF CompuVtab_18 /end COMPU_METHOD
/begin COMPU_METHOD CompuMethod_64 "" TAB_VERB "%1.0" "" COMPU_TAB_REF CompuVtab_19 /end COMPU_METHOD
/begin COMPU_METHOD CompuMethod_65 "" TAB_VERB "%1.0" "" COMPU_TAB_REF CompuVtab_20 /end COMPU_METHOD
/begin COMPU_METHOD CompuMethod_66 "" RAT_FUNC "%6.2" "phi" COEFFS 0 1 0 0 0 1 /end COMPU_METHOD
/begin COMPU_METHOD CompuMethod_67 "" RAT_FUNC "%6.2" "Mult" COEFFS 0 1 0 0 0 1 /end COMPU_METHOD
/begin COMPU_METHOD CompuMethod_68 "" RAT_FUNC "%5.3" "ms" COEFFS 0 1 0 0 0 1 /end COMPU_METHOD
/begin COMPU_METHOD CompuMethod_69 "" RAT_FUNC "%6.2" "ms" COEFFS 0 1 0 0 0 1 /end COMPU_METHOD
/begin COMPU_METHOD CompuMethod_70 "" RAT_FUNC "%6.2" "degBTDC" COEFFS 0 1 0 0 0 1 /end COMPU_METHOD
/begin COMPU_METHOD CompuMethod_71 "" RAT_FUNC "%6.2" "%" COEFFS 0 1 0 0 0 0.0015259 /end COMPU_METHOD
/begin COMPU_METHOD CompuMethod_73 "" RAT_FUNC "%6.2" "mg/cyl" COEFFS 0 1 0 0 0 1 /end COMPU_METHOD
/begin COMPU_METHOD CompuMethod_74 "" RAT_FUNC "%6.2" "MJ" COEFFS 0 1 0 0 0 1 /end COMPU_METHOD
/begin COMPU_METHOD CompuMethod_75 "" RAT_FUNC "%5.0" "RPM" COEFFS 0 1 0 0 0 1 /end COMPU_METHOD
/begin COMPU_METHOD CompuMethod_76 "" RAT_FUNC "%6.2" "cm3" COEFFS 0 1 0 0 0 1 /end COMPU_METHOD
/begin COMPU_METHOD CompuMethod_77 "" RAT_FUNC "%6.2" "AFRatio" COEFFS 0 1 0 0 0 1 /end COMPU_METHOD
/begin COMPU_METHOD CompuMethod_78 "" RAT_FUNC "%6.2" "Ethanol%" COEFFS 0 1 0 0 0 1 /end COMPU_METHOD
/begin COMPU_METHOD CompuMethod_79 "" RAT_FUNC "%6.2" "F/A" COEFFS 0 1 0 0 0 1 /end COMPU_METHOD
/begin COMPU_METHOD CompuMethod_80 "" RAT_FUNC "%7.2" "ratio" COEFFS 0 1 0 0 0 1 /end COMPU_METHOD
/begin COMPU_METHOD CompuMethod_82 "" RAT_FUNC "%5.0" "ADC_counts" COEFFS 0 1 0 0 0 1 /end COMPU_METHOD
/begin COMPU_METHOD CompuMethod_83 "" TAB_VERB "%3.0" "" COMPU_TAB_REF CompuVtab_21 /end COMPU_METHOD
/begin COMPU_METHOD CompuMethod_84 "" TAB_VERB "%3.0" "" COMPU_TAB_REF CompuVtab_22 /end COMPU_METHOD
/begin COMPU_METHOD CompuMethod_85 "" TAB_VERB "%3.0" "" COMPU_TAB_REF CompuVtab_23 /end COMPU_METHOD
/begin COMPU_METHOD CompuMethod_86 "" TAB_VERB "%3.0" "" COMPU_TAB_REF CompuVtab_24 /end COMPU_METHOD
/begin COMPU_METHOD CompuMethod_87 "" RAT_FUNC "%3.0" "cyl#" COEFFS 0 1 -1 0 0 1 /end COMPU_METHOD
/begin COMPU_METHOD CompuMethod_88 "" RAT_FUNC "%6.2" "RPM/s" COEFFS 0 1 0 0 0 1 /end COMPU_METHOD
/begin COMPU_METHOD CompuMethod_89 "" RAT_FUNC "%6.2" "degCA" COEFFS 0 1 0 0 0 1 /end COMPU_METHOD
/begin COMPU_METHOD CompuMethod_90 "" RAT_FUNC "%8.3" "EquivRatio" COEFFS 0 1 0 0 0 1 /end COMPU_METHOD
/begin COMPU_METHOD CompuMethod_91 "" RAT_FUNC "%5.0" "us" COEFFS 0 1 0 0 0 1 /end COMPU_METHOD
/begin COMPU_METHOD CompuMethod_95 "" RAT_FUNC "%5.0" "mA" COEFFS 0 1 0 0 0 1 /end COMPU_METHOD
/begin COMPU_METHOD CompuMethod_96 "" RAT_FUNC "%5.3" "%" COEFFS 0 1 0 0 0 1 /end COMPU_METHOD
/begin COMPU_METHOD CompuMethod_97 "" RAT_FUNC "%5.3" "flag" COEFFS 0 1 0 0 0 1 /end COMPU_METHOD
/begin COMPU_METHOD CompuMethod_98 "" RAT_FUNC "%5.3" "s" COEFFS 0 1 0 0 0 1 /end COMPU_METHOD
/begin COMPU_METHOD CompuMethod_99 "" RAT_FUNC "%6.2" "Hz" COEFFS 0 1 0 0 0 1 /end COMPU_METHOD
/begin COMPU_METHOD CompuMethod_100 "" RAT_FUNC "%6.2" "mA" COEFFS 0 1 0 0 0 1 /end COMPU_METHOD
/begin COMPU_METHOD CompuMethod_101 "" RAT_FUNC "%6.2" "%/s" COEFFS 0 1 0 0 0 1 /end COMPU_METHOD
/begin COMPU_METHOD CompuMethod_105 "" RAT_FUNC "%6.2" "%/%" COEFFS 0 1 0 0 0 1 /end COMPU_METHOD
/begin COMPU_METHOD CompuMethod_106 "" TAB_VERB "%3.0" "" COMPU_TAB_REF CompuVtab_30 /end COMPU_METHOD
/begin COMPU_METHOD CompuMethod_112 "" TAB_VERB "%3.0" "" COMPU_TAB_REF CompuVtab_36 /end COMPU_METHOD
/begin COMPU_METHOD CompuMethod_113 "" TAB_VERB "%3.0" "" COMPU_TAB_REF CompuVtab_6 /end COMPU_METHOD
/begin COMPU_METHOD CompuMethod_114 "" RAT_FUNC "%6.2" "mg" COEFFS 0 1 0 0 0 1 /end COMPU_METHOD
/begin COMPU_METHOD CompuMethod_115 "" TAB_VERB "%1.0" "mg" COMPU_TAB_REF CompuVtab_13 /end COMPU_METHOD
/begin COMPU_METHOD CompuMethod_129 "" TAB_VERB "%3.0" "" COMPU_TAB_REF CompuVtab_42 /end COMPU_METHOD
/begin COMPU_METHOD CompuMethod_133 "" RAT_FUNC "%5.3" "" COEFFS 0 1 0 0 0 1 /end COMPU_METHOD
/begin COMPU_METHOD CompuMethod_134 "" RAT_FUNC "%6.4" "ms/mg" COEFFS 0 1 0 0 0 1 /end COMPU_METHOD
/begin COMPU_METHOD CompuMethod_135 "" RAT_FUNC "%7.4" "ms" COEFFS 0 1 0 0 0 1 /end COMPU_METHOD
/begin COMPU_METHOD CompuMethod_136 "" RAT_FUNC "%5.0" "bytes" COEFFS 0 1 0 0 0 1 /end COMPU_METHOD
/begin COMPU_METHOD CompuMethod_137 "" TAB_VERB "%6.2" "" COMPU_TAB_REF CompuVtab_46 /end COMPU_METHOD
/begin COMPU_METHOD CompuMethod_138 "" TAB_VERB "%3.0" "" COMPU_TAB_REF CompuVtab_47 /end COMPU_METHOD
/begin COMPU_METHOD CompuMethod_150 "" TAB_VERB "%8.3" "bool" COMPU_TAB_REF CompuVtab_2 /end COMPU_METHOD
/begin COMPU_METHOD CompuMethod_152 "" TAB_VERB "%1.0" "" COMPU_TAB_REF CompuVtab_56 /end COMPU_METHOD
/begin COMPU_METHOD CompuMethod_155 "" TAB_VERB "%6.2" "" COMPU_TAB_REF CompuVtab_57 /end COMPU_METHOD
/begin COMPU_METHOD CompuMethod_157 "" TAB_VERB "%1.0" "" COMPU_TAB_REF CompuVtab_58 /end COMPU_METHOD
/begin COMPU_METHOD CompuMethod_163 "" RAT_FUNC "%3.0" "TDCs" COEFFS 0 1 0 0 0 1 /end COMPU_METHOD
/begin COMPU_METHOD CompuMethod_165 "" RAT_FUNC "%6.2" "Volts" COEFFS 0 1 0 0 0 1 /end COMPU_METHOD
/begin COMPU_METHOD CompuMethod_168 "" TAB_VERB "%1.0" "boolean" COMPU_TAB_REF CompuVtab_2 /end COMPU_METHOD
/begin COMPU_METHOD CompuMethod_172 "" RAT_FUNC "%2.0" "ISRs" COEFFS 0 1 0 0 0 1 /end COMPU_METHOD
/begin COMPU_METHOD CompuMethod_175 "" RAT_FUNC "%5.0" "ms" COEFFS 0 1 0 0 0 1 /end COMPU_METHOD
/begin COMPU_METHOD CompuMethod_177 "" TAB_VERB "%1.0" "" COMPU_TAB_REF CompuVtab_67 /end COMPU_METHOD
/begin COMPU_METHOD CompuMethod_180 "" RAT_FUNC "%6.2" "MPH" COEFFS 0 1 0 0 0 1 /end COMPU_METHOD
/*~~~~~~~~~ 6.3.34 COMPU_VTABs ~~~~~~~~~*/
/begin COMPU_VTAB CompuVtab_1 "" TAB_VERB 2 0 "Pass-Through" 1 "Override" /end COMPU_VTAB
/begin COMPU_VTAB CompuVtab_2 "" TAB_VERB 2 0 "Disabled" 1 "Enabled" /end COMPU_VTAB
/begin COMPU_VTAB CompuVtab_6 "" TAB_VERB 90 0 "Normal Operation" 1 "Bad Resource ID" 2 "Hardware Not Supported" 3 "Behaviour Not Supported" 4 "Bad Attribute Data" 5 "Fail On Create" 6 "Fail On Set Attributes" 7 "Resource Not Created" 8 "Missing Attribute" 9 "Behaviour Method Not Supported" 10 "A Service Failed" 11 "Failed to destroy a resource" 12 "Resource Was Created" 13 "Resource Conflict" 14 "Invalid Encoder Type" 15 "2-Strike Not Supported" 16 "720degCA Pattern Not Supported" 17 "CAM Pattern Not Supported" 18 "Unknown CAM Pattern Supplied" 19 "Engine Speed Present" 20 "Hardware Interface Not Supported" 21 "Service Already Started" 22 "Register Write Failed to verify" 23 "Register access was denied" 24 "Out of free store memory" 25 "Software Q Overrun" 26 "Hardware Q Overrun" 27 "Feature unsupported in archive" 28 "Insufficient FW resource" 29 "OS Resource conflict" 30 "Driver Mode conflict" 31 "RTC time is illegal" 32 "FFS unmounted" 33 "Access from an ISR" 34 "FFS internal" 35 "Operation timed out" 36 "Task Kernel API Usage" 37 "Operation aborted" 38 "File not Found" 39 "Invalid characters in filename" 40 "Duplicate filename" 41 "Filename is too long" 42 "Dir not empty on remove" 43 "Dir not found" 44 "Dir name invalid" 45 "Dir exists" 46 "Dir too deep" 47 "Illegal Handle" 48 "End of File" 49 "Media Full" 50 "Media Write" 51 "Media Read" 52 "Media Write Protected" 53 "File Read Only" 54 "FS Media Changed" 55 "Internal USB" 56 "Voltage too high for USB IC" 57 "Encoder not created" 64 "TPU Chan Conflict" 65 "TPU Func Unavailable" 66 "TPU Config" 67 "TPU Primative Usage" 68 "TPU Primitive Count" 69 "TPU Restricted TPU channel" 70 "TPU Not Created" 71 "TPU Self Modify constant write err" 72 "TPU Error 0x48" 73 "TPU Error 0x49" 74 "TPU Error 0x4A" 75 "TPU Error 0x4B" 76 "TPU Error 0x4C" 77 "TPU Error 0x4D" 78 "TPU Error 0x4E" 79 "TPU Error 0x4F" 80 "TPU Error 0x50" 81 "TPU Error 0x51" 82 "TPU Error 0x52" 83 "TPU Error 0x53" 84 "TPU Error 0x54" 85 "TPU Error 0x55" 86 "TPU Error 0x56" 87 "TPU Error 0x57" 88 "TPU Error 0x58" 89 "TPU Error 0x59" 90 "TPU Error 0x5A" 91 "TPU Error 0x5B" 92 "TPU Error 0x5C" 93 "TPU Error 0x5D" 94 "TPU Error 0x5E" 95 "TPU Error 0x5F" /end COMPU_VTAB
/begin COMPU_VTAB CompuVtab_8 "" TAB_VERB 2 0 "Decreasing" 1 "Increasing" /end COMPU_VTAB
/begin COMPU_VTAB CompuVtab_13 "" TAB_VERB 2 0 "Unlocked" 1 "Locked" /end COMPU_VTAB
/begin COMPU_VTAB CompuVtab_14 "" TAB_VERB 2 0 "Not Enabled" 1 "Enabled" /end COMPU_VTAB
/begin COMPU_VTAB CompuVtab_15 "" TAB_VERB 11 0 "None Late" 1 "720 Late" 2 "360 Late" 4 "180 Late" 6 "360, 180 Late" 8 "120 Late" 16 "90 Late" 32 "60 Late" 64 "30 Late" 128 "HIRES Late" 192 "HIRES, 30 Late" /end COMPU_VTAB
/begin COMPU_VTAB CompuVtab_16 "" TAB_VERB 8 0 "None Late" 1 "x1 Late" 2 "x2 Late" 3 "x1, x2 Late" 4 "x10 Late" 5 "x1, x10 Late" 6 "x2, x10 Late" 7 "x1, 2, 10 Late" /end COMPU_VTAB
/begin COMPU_VTAB CompuVtab_17 "" TAB_VERB 2 0 "Calibration Locked" 1 "Calibration Unlocked" /end COMPU_VTAB
/begin COMPU_VTAB CompuVtab_18 "" TAB_VERB 2 0 "Data Acquisition Locked" 1 "Data Acquisition Unlocked" /end COMPU_VTAB
/begin COMPU_VTAB CompuVtab_19 "" TAB_VERB 2 0 "Programming Locked" 1 "Programming Unlocked" /end COMPU_VTAB
/begin COMPU_VTAB CompuVtab_20 "" TAB_VERB 2 0 "Not Connected" 1 "Connected" /end COMPU_VTAB
/begin COMPU_VTAB CompuVtab_21 "" TAB_VERB 2 0 "Weak Pullup" 1 "Strong Pullup" /end COMPU_VTAB
/begin COMPU_VTAB CompuVtab_22 "" TAB_VERB 2 0 "Rising Edge" 1 "Falling Edge" /end COMPU_VTAB
/begin COMPU_VTAB CompuVtab_23 "" TAB_VERB 6 0 "No Fault" 1 "Crank Sync Fault" 2 "Reverse Rotation Fault" 3 "No Crank Edges Fault" 4 "No CAM edges fault" 5 "Cam Sync Fault" /end COMPU_VTAB
/begin COMPU_VTAB CompuVtab_24 "" TAB_VERB 5 0 "zero" 1 "ZERO_SPEED" 2 "POSN_UNKNOWN" 3 "ENC_SYNC_CAM_UNKNOWN" 4 "ENC_SYNC_CAM_SYNC" /end COMPU_VTAB
/begin COMPU_VTAB CompuVtab_30 "" TAB_VERB 126 0 "ACChargeHigh_Fault" 1 "ACChargeLow_Fault" 2 "ACPresRangeHigh" 3 "ACPresRangeLow" 4 "APP1RangeHigh" 5 "APP1RangeLow" 6 "APP1_AdaptAdaptHiMax" 7 "APP1_AdaptAdaptHiMin" 8 "APP1_AdaptAdaptLoMax" 9 "APP1_AdaptAdaptLoMin" 10 "APP1_AdaptRangeHigh" 11 "APP1_AdaptRangeLow" 12 "APP2RangeHigh" 13 "APP2RangeLow" 14 "APP2_AdaptAdaptHiMax" 15 "APP2_AdaptAdaptHiMin" 16 "APP2_AdaptAdaptLoMax" 17 "APP2_AdaptAdaptLoMin" 18 "APP2_AdaptRangeHigh" 19 "APP2_AdaptRangeLow" 20 "APP_Sensors_Conflict" 21 "Bank1_EquivRatioRangeHigh" 22 "Bank1_EquivRatioRangeLow" 23 "Bank2_EquivRatioRangeHigh" 24 "Bank2_EquivRatioRangeLow" 25 "CATRangeHigh" 26 "CATRangeLow" 27 "CamEdgesFault" 28 "CamSyncFault" 29 "CrankEdgesFault" 30 "CrankSyncFault" 31 "ECTOverTempFault" 32 "ECTRangeHigh" 33 "ECTRangeLow" 34 "ECTSevereOverTempFault" 35 "EST1_Open" 36 "EST1_Short" 37 "EST2_Open" 38 "EST2_Short" 39 "EST3_Open" 40 "EST3_Short" 41 "EST4_Open" 42 "EST4_Short" 43 "EST5_Open" 44 "EST5_Short" 45 "EST6_Open" 46 "EST6_Short" 47 "EST7_Open" 48 "EST7_Short" 49 "EST8_Open" 50 "EST8_Short" 51 "ETCSpringTest" 52 "ETC_Open_Fault" 53 "ETC_Sticking" 54 "EVAPRangeHigh" 55 "EVAPRangeLow" 56 "FuelAdaptRangeHi" 57 "FuelAdaptRangeLow" 58 "FuelPresHigh_Fault" 59 "FuelPresLow_Fault" 60 "FuelPresRangeHigh" 61 "FuelPresRangeLow" 62 "FuelSensRangeHigh" 63 "FuelSensRangeLow" 64 "Fuel_LvlRangeHigh" 65 "Fuel_LvlRangeLow" 66 "GPS_DateTime_Timeout" 67 "GPS_LatLong_Timeout" 68 "GPS_NotReady" 69 "GPS_SpeedDir_Timeout" 70 "HardOverBoost_Fault" 71 "HardOverspeed" 72 "IATRangeHigh" 73 "IATRangeLow" 74 "Inj1Open" 75 "Inj2Open" 76 "Inj3Open" 77 "Inj4Open" 78 "Inj5Open" 79 "Inj6Open" 80 "Inj7Open" 81 "Inj8Open" 82 "Lambda_1_NotReady" 83 "Lambda_1_Timeout" 84 "Lambda_2_NotReady" 85 "Lambda_2_Timeout" 86 "LeanProtect_Fault" 87 "MAFRangeHigh" 88 "MAFRangeLow" 89 "MAPRangeHigh" 90 "MAPRangeLow" 91 "MAPTimeRangeHigh" 92 "MAPTimeRangeLow" 93 "MAP_IR_HI" 94 "MAP_IR_LO" 95 "MAP_STICKING" 96 "MediumOverspeed" 97 "NoOil_Fault" 98 "O2FailedLean" 99 "O2FailedRich" 100 "O2NotActive" 101 "OilPresRangeHigh" 102 "OilPresRangeLow" 103 "SensVoltRangeHigh" 104 "SensVoltRangeLow" 105 "SoftOverBoost_Fault" 106 "SoftOverspeed" 107 "SysVoltRangeHigh" 108 "SysVoltRangeLow" 109 "TPS1AdaptHiMax" 110 "TPS1AdaptHiMin" 111 "TPS1AdaptLoMax" 112 "TPS1AdaptLoMin" 113 "TPS1RangeHigh" 114 "TPS1RangeLow" 115 "TPS2AdaptHiMax" 116 "TPS2AdaptHiMin" 117 "TPS2AdaptLoMax" 118 "TPS2AdaptLoMin" 119 "TPS2RangeHigh" 120 "TPS2RangeLow" 121 "TPS_Sensors_Conflict" 122 "VSPDRangeHigh" 123 "VSPDRangeLow" 124 "Wastegate_Fault" 125 "(None)" /end COMPU_VTAB
/begin COMPU_VTAB CompuVtab_36 "" TAB_VERB 3 0 "Rate Limiter" 1 "Low Pass" 2 "Moving Average" /end COMPU_VTAB
/begin COMPU_VTAB CompuVtab_42 "" TAB_VERB 4 0 "Unknown" 1 "Flaring" 2 "OnIdle" 3 "OffIdle" /end COMPU_VTAB
/begin COMPU_VTAB CompuVtab_46 "" TAB_VERB 74 0 "NO_OS_ERROR" 1 "PROSAK_TPU_ALLOCATE" 2 "PROSAK_DEADLOCK_PROT" 3 "QSPI_SEND_SIZE_ZERO" 4 "QSPI_SEND_SIZE_TOO_BIG" 5 "QSPI_RD_SIZE_TOO_BIG" 6 "QSPI_RD_SIZE_ZERO" 7 "QSPI_WR_SIZE_TOO_BIG" 8 "QSPI_WR_SIZE_ZERO" 9 "QSPI_CMD_SIZE_TOO_BIG" 10 "QSPI_CMD_SIZE_ZERO" 11 "IGN_DIAG_MDA_ALLOCATE" 12 "EEDataDirSizeMisMatch" 13 "EE_WRITE_QUEUE_OVFLOW" 14 "ESC_HBRIDGE_MDA_ALLOCATE" 15 "ETC_DIAG_MDA_ALLOCATE" 16 "DFLT_ENCODER_CREATE_ERR" 17 "ADC_TPU_ALLOCATE" 18 "SWISR_QUEUE_OVERFLOW" 19 "WATCHDOG_RESET" 20 "CHECKSTOP_RESET" 21 "SPIEE_WR_STAT_REG_ERR" 22 "SPIEE_QUEUE_OVFL_STATUS" 23 "SPIEE_WRITE_FAIL_ERR" 24 "Requested TPU Func not in mask" 25 "Unable to allocate QSPI knock" 26 "Stack has overflowed!" 27 "TPU Limits not setup" 28 "INVALID TPU MASK" 29 "TPU Mask Corrupt" 30 "Sequence Create with No Encoder" 31 "Illegal Sequence ISR" 32 "TPU Mask Version is insufficient" 33 "MUX PSP requested for 2-Stroke" 34 "Ext Flash Acc Denied" 35 "Ext Flash Erase Fail" 36 "Ext Flash Write Fail" 37 "Ext Flash Allign Error" 38 "EXT_FLASH_WR_ZERO_SIZE" 39 "Illegal Ext Flash Addr" 40 "Error: Write to non-existent Flash" 41 "Too many Logs want to be active" 42 "Bank Seq Destroy Problem" 43 "Transient Seq Destroy Problem" 44 "Transient Seq Update Problem" 45 "SPIEE System had a memory problem" 46 "Spent too long waiting for a sync return" 47 "TPUC Mask does not pair with TPUA/B mask" 48 "The Module Configuration was not available" 49 "Diagnostic Mux did not create" 50 "FGND Angle event queue overflow" 51 "FGND Time event queue overflow" 52 "EEPROM write to CAMDelay failed" 53 "SleepTask call from in ISR" 54 "Bad Kernel API call detected" 55 "Kernel Internal" 56 "SPIEE Device create" 57 "NAND Flash timeout on Write" 58 "NAND Flash timeout on Erase" 59 "NAND Flash WP" 60 "NAND Flash RDY/BUSYb" 61 "NAND Flash Access" 62 "NAND Flash Device" 63 "USB Core Stack Initialisation" 64 "USB Stack Assert" 65 "EXT_EE_ACCESS" 66 "VARCAM_PATTERN_SETUP" 67 "FP Divide by Zero" 68 "Unable to allocate requested memory on heap" 69 "Unable create Fgnd Angle task" 70 "FP Denormalized number" 71 "RPMVector Buffers Full" 72 "RPMVector Overrun" 73 "Failed to Write TPU Self Modify Parameter" /end COMPU_VTAB
/begin COMPU_VTAB CompuVtab_47 "" TAB_VERB 2 0 "Model from MAP" 1 "Use MAF sensor directly" /end COMPU_VTAB
/begin COMPU_VTAB CompuVtab_56 "" TAB_VERB 2 0 "Open-Loop" 1 "Closed-Loop" /end COMPU_VTAB
/begin COMPU_VTAB CompuVtab_57 "" TAB_VERB 2 0 "Abnormal Operation!" 1 "Operating Normally" /end COMPU_VTAB
/begin COMPU_VTAB CompuVtab_58 "" TAB_VERB 2 0 "Run" 1 "Reboot" /end COMPU_VTAB
/begin COMPU_VTAB CompuVtab_67 "" TAB_VERB 2 0 "Not adapting" 1 "Adapting" /end COMPU_VTAB
/begin FUNCTION Bank1_SensorStatus_Ovr_Override "" /begin DEF_CHARACTERISTIC Bank1_SensorStatus_Ovr_new Bank1_SensorStatus_Ovr_ovr /end DEF_CHARACTERISTIC /end FUNCTION
/begin FUNCTION Bank1_SystemVolts_Ovr_Override "" /begin DEF_CHARACTERISTIC Bank1_SystemVolts_Ovr_new Bank1_SystemVolts_Ovr_ovr /end DEF_CHARACTERISTIC /end FUNCTION
/begin FUNCTION Bank1_UsingFreeAreCalState_Ovr_Override ""
 /begin DEF_CHARACTERISTIC Bank1_UsingFreeAreCalState_Ovr_new Bank1_UsingFreeAreCalState_Ovr_ovr /end DEF_CHARACTERISTIC
/end FUNCTION
/begin FUNCTION Bank2_DataValidState_Ovr_Override "" /begin DEF_CHARACTERISTIC Bank2_DataValidState_Ovr_new Bank2_DataValidState_Ovr_ovr /end DEF_CHARACTERISTIC /end FUNCTION
/begin FUNCTION Bank2_EquivRatio "" /begin OUT_MEASUREMENT Bank2_EquivRatio Bank2_EquivRatioADC Bank2_EquivRatioRaw /end OUT_MEASUREMENT /begin SUB_FUNCTION Bank2_EquivRatio_Override Bank2_EquivRatio_Config /end SUB_FUNCTION /end FUNCTION
/begin FUNCTION Bank2_EquivRatio_Override "" /begin DEF_CHARACTERISTIC Bank2_EquivRatio_new Bank2_EquivRatio_ovr /end DEF_CHARACTERISTIC /end FUNCTION
/begin FUNCTION Bank2_EquivRatio_Config ""
 /begin DEF_CHARACTERISTIC Bank2_EquivRatioDfltValue Bank2_EquivRatioFilterConst Bank2_EquivRatioGain Bank2_EquivRatioInputHiFltPos Bank2_EquivRatioInputLoFltPos Bank2_EquivRatioOfst /end DEF_CHARACTERISTIC
/end FUNCTION
/begin FUNCTION Bank2_HeaterVolts_Ovr_Override "" /begin DEF_CHARACTERISTIC Bank2_HeaterVolts_Ovr_new Bank2_HeaterVolts_Ovr_ovr /end DEF_CHARACTERISTIC /end FUNCTION
/begin FUNCTION Bank2_Lambda_Ovr_Override "" /begin DEF_CHARACTERISTIC Bank2_Lambda_Ovr_new Bank2_Lambda_Ovr_ovr /end DEF_CHARACTERISTIC /end FUNCTION
/begin FUNCTION Bank2_OxygenConcentration_Ovr_Override ""
 /begin DEF_CHARACTERISTIC Bank2_OxygenConcentration_Ovr_new Bank2_OxygenConcentration_Ovr_ovr /end DEF_CHARACTERISTIC
/end FUNCTION
/begin FUNCTION Bank2_SensorDetectedStatus_Ovr_Override ""
 /begin DEF_CHARACTERISTIC Bank2_SensorDetectedStatus_Ovr_new Bank2_SensorDetectedStatus_Ovr_ovr /end DEF_CHARACTERISTIC
/end FUNCTION
/begin FUNCTION Bank2_SensorFaultState_Ovr_Override ""
 /begin DEF_CHARACTERISTIC Bank2_SensorFaultState_Ovr_new Bank2_SensorFaultState_Ovr_ovr /end DEF_CHARACTERISTIC
/end FUNCTION
/begin FUNCTION Bank2_SensorStatus_Ovr_Override "" /begin DEF_CHARACTERISTIC Bank2_SensorStatus_Ovr_new Bank2_SensorStatus_Ovr_ovr /end DEF_CHARACTERISTIC /end FUNCTION
/begin FUNCTION Bank2_SystemVolts_Ovr_Override "" /begin DEF_CHARACTERISTIC Bank2_SystemVolts_Ovr_new Bank2_SystemVolts_Ovr_ovr /end DEF_CHARACTERISTIC /end FUNCTION
/begin FUNCTION Bank2_UsingFreeAreCalState_Ovr_Override ""
 /begin DEF_CHARACTERISTIC Bank2_UsingFreeAreCalState_Ovr_new Bank2_UsingFreeAreCalState_Ovr_ovr /end DEF_CHARACTERISTIC
/end FUNCTION
/begin FUNCTION AirCalcs "" /begin DEF_CHARACTERISTIC BaroRunStallDelay /end DEF_CHARACTERISTIC /begin OUT_MEASUREMENT BARO BaroDelayTime /end OUT_MEASUREMENT
 /begin SUB_FUNCTION Capture_Signal_At_Startup BARO_Override Speed_Density___MAP_Referenced___Adaptive Running_Baro_Learn /end SUB_FUNCTION
/end FUNCTION
/begin FUNCTION Capture_Signal_At_Startup "" /begin DEF_CHARACTERISTIC BARO_Count /end DEF_CHARACTERISTIC /end FUNCTION
/begin FUNCTION BARO_Override "" /begin DEF_CHARACTERISTIC BARO_offset BARO_ovr /end DEF_CHARACTERISTIC /end FUNCTION
/begin FUNCTION Speed_Density___MAP_Referenced___Adaptive ""
 /begin DEF_CHARACTERISTIC CombEventsPerRev CylSweptVol MAF_Source VEAdaptEnable VEAdaptTemp VEAdaptTime VEBaroCorrTbl VETempCorrMap VolEffAdaptMap VolEffMap /end DEF_CHARACTERISTIC
 /begin OUT_MEASUREMENT BARO09Idx MAFFinal VEAdaptAmnt VEAdapting VEBaroCorr VEFin VEIdealMAF VEMapIdx VEMapIn VEModelMAF VETempCorr VolEff VolEffAdapt /end OUT_MEASUREMENT
 /begin SUB_FUNCTION Adapt_VolEff_Map /end SUB_FUNCTION
/end FUNCTION
/begin FUNCTION Running_Baro_Learn "" /begin DEF_CHARACTERISTIC BaroLearn_MAP BaroLearn_Tm BaroLearn_TPSPos /end DEF_CHARACTERISTIC /end FUNCTION
/begin FUNCTION Idle_Control_Enable_Delay "" /begin DEF_CHARACTERISTIC BaseAirflowAdaptDelayTime /end DEF_CHARACTERISTIC /end FUNCTION
/begin FUNCTION Base_Airflow_Table_Adapt ""
 /begin DEF_CHARACTERISTIC BaseAirflowAdaptDelta BaseAirflowAdaptEnable BaseAirflowAdaptGain /end DEF_CHARACTERISTIC
 /begin OUT_MEASUREMENT BaseAirflowAdaptEnabled /end OUT_MEASUREMENT
 /begin SUB_FUNCTION Idle_Control_Enable_Delay Saturation__Tunable_ Adapt_Base_Airflow_Table /end SUB_FUNCTION
/end FUNCTION
/begin FUNCTION Saturation__Tunable_ "" /begin DEF_CHARACTERISTIC BaseAirflowAdaptErrorLwrLim BaseAirflowAdaptErrorUprLim /end DEF_CHARACTERISTIC /end FUNCTION
/begin FUNCTION Adapt_Base_Airflow_Table "" /begin DEF_CHARACTERISTIC BaseAirflowOfstMaxValue BaseAirflowOfstMinValue /end DEF_CHARACTERISTIC /end FUNCTION
/begin FUNCTION Base_Equiv_Ratio ""
 /begin DEF_CHARACTERISTIC ChargeAirTempEnrichmentMap DesEquivRatioMap IntakeAirTempEnrichmentMap WarmUpEqRatioMap WarmUpTimeRatioMap /end DEF_CHARACTERISTIC
 /begin OUT_MEASUREMENT BaseEquivRatio ChargeAirTempEnrichment DesEquivRatio IntakeAirTempEnrichment WarmUpEqRatio WarmUpTimeRatio /end OUT_MEASUREMENT
 /begin SUB_FUNCTION EquivRatio_Override Warm_Up_Fuel_Holdoff /end SUB_FUNCTION
/end FUNCTION
/begin FUNCTION BaseRevLimit "" /begin DEF_CHARACTERISTIC BaseRevLimit HardRevOffset MediumRevOffset RevLimitHyst /end DEF_CHARACTERISTIC /end FUNCTION
/begin FUNCTION Overspeed_Protection "" /begin SUB_FUNCTION BaseRevLimit TwoStepRevLimit /end SUB_FUNCTION /end FUNCTION
/begin FUNCTION Spark_Manager "" /begin DEF_CHARACTERISTIC BaseSparkEnergyMap SparkAdvMap /end DEF_CHARACTERISTIC /begin OUT_MEASUREMENT BaseSparkEnergy Spark_Adv_Prb SparkAdv /end OUT_MEASUREMENT
 /begin SUB_FUNCTION Temp_Comp_Offset Desired_Eq_Ratio_Offset Ethanol_Spark_Offset SparkAdvanceLimiter Spark_Advance_Rate_Limiter /end SUB_FUNCTION
/end FUNCTION
/begin FUNCTION Trigger_Config "" /begin DEF_CHARACTERISTIC BGND_BASE_Multiple FGND_RTI_Period /end DEF_CHARACTERISTIC /end FUNCTION
/begin FUNCTION Event_Pause_Counters ""
 /begin DEF_CHARACTERISTIC BGND_BASE_PERIODIC_RunCnt BGND_BASEx10_PERIODIC_RunCnt BGND_BASEx2_PERIODIC_RunCnt FGND_20XRTI_PERIODIC_RunCnt FGND_5XRTI_PERIODIC_RunCnt FGND_MID_TDC_EVENT_RunCnt FGND_RTI_PERIODIC_RunCnt FGND_TDC_EVENT_RunCnt FGND_TDC1_EVENT_RunCnt IDLE_EVENT_RunCnt ONE_SECOND_EVENT_RunCnt STARTUP_EVENT_RunCnt /end DEF_CHARACTERISTIC
/end FUNCTION
/begin FUNCTION OS ""
 /begin OUT_MEASUREMENT BgndAngTaskStatus BgndStackMinBytesFree BgndTimeTaskStatus FgndAngleStackMinBytesFree FgndAngTaskStatus FgndTimeStackMinBytesFree IdleStackMinBytesFree InterruptStackMinBytesFree LastOSError OSErrorCnt OSStatus PeakHeapBytesUsed SWISRCurrQueueSize /end OUT_MEASUREMENT
/end FUNCTION
/begin FUNCTION Boost_Control ""
 /begin DEF_CHARACTERISTIC BoostActivationThreshold BoostControlBase_AdaptMap BoostControlBaseMap BoostECTLimitTbl BoostFallRate BoostIATLimitTbl BoostRiseRate BoostScrambleAdder BoostTarget_TwoStepTbl BoostTargetMap WGDeadTimeTbl /end DEF_CHARACTERISTIC
 /begin OUT_MEASUREMENT BoostControlBase BoostControlBase_Adapt BoostControlDutyCycleFF BoostControlDutyCycleOut BoostControlPID BoostControlPID_ITerm BoostControlTarget BoostECTLimit BoostIATLimit BoostTarget BoostTarget_TwoStep BoostTargetIdx BoostTargetIn WGDeadTime /end OUT_MEASUREMENT
 /begin SUB_FUNCTION BoostControl_Adapt Universal_PID__Tunable___Scheduled__1 Air_PID_Config_1 /end SUB_FUNCTION
/end FUNCTION
/begin FUNCTION BoostControl_Enable_Delay "" /begin DEF_CHARACTERISTIC BoostAdaptDelayTime /end DEF_CHARACTERISTIC /end FUNCTION
/begin FUNCTION BoostControl_Adapt ""
 /begin DEF_CHARACTERISTIC BoostControlAdaptDelta BoostControlAdaptEnable BoostControlAdaptGain /end DEF_CHARACTERISTIC
 /begin OUT_MEASUREMENT BoostControlAdaptEnabled /end OUT_MEASUREMENT
 /begin SUB_FUNCTION BoostControl_Enable_Delay Saturation__Tunable__1 Adapt_Boost_Table /end SUB_FUNCTION
/end FUNCTION
/begin FUNCTION Saturation__Tunable__1 "" /begin DEF_CHARACTERISTIC BoostAdaptErrorLwrLim BoostAdaptErrorUprLim /end DEF_CHARACTERISTIC /end FUNCTION
/begin FUNCTION Adapt_Boost_Table "" /begin DEF_CHARACTERISTIC BoostControlOfstMaxValue BoostControlOfstMinValue /end DEF_CHARACTERISTIC /end FUNCTION
/begin FUNCTION PID_Gain_Select1_1 ""
 /begin DEF_CHARACTERISTIC BoostCtlDGain BoostCtlDGainErrorMultTbl BoostCtlIGain BoostCtlIGainErrorMultTbl BoostCtlPGain BoostCtlPGainErrorMultTbl /end DEF_CHARACTERISTIC
 /begin OUT_MEASUREMENT BoostCtlDGainErrorMult BoostCtlIGainErrorMult BoostCtlPGainErrorMult /end OUT_MEASUREMENT
/end FUNCTION
/begin FUNCTION Universal_PID__Tunable___Scheduled__1 ""
 /begin OUT_MEASUREMENT BoostCtlDTerm BoostCtlError BoostCtlITerm BoostCtlPTerm BoostCtlSpeedErrorIdx BoostCtlSpeedErrorIn /end OUT_MEASUREMENT
 /begin SUB_FUNCTION PID_Gain_Select1_1 /end SUB_FUNCTION
/end FUNCTION
/begin FUNCTION Air_PID_Config_1 ""
 /begin DEF_CHARACTERISTIC BoostCtlErrorGain BoostCtlITermLowerLimit BoostCtlITermUpperLimit BoostCtlPIDOutLowerLimit BoostCtlPIDOutUpperLimit /end DEF_CHARACTERISTIC
/end FUNCTION
/begin FUNCTION Encoder_Config ""
 /begin DEF_CHARACTERISTIC CAMDelay EncoderCamPullup EncoderCamSyncEdge EncoderCrankPullup EncoderCrankTeethAfterCam EncoderNumCylinders EncoderSyncEdge EncoderTDCAngles TeethBeforeSyncAllowed TimeBeforeSyncAllowed /end DEF_CHARACTERISTIC
/end FUNCTION
/begin FUNCTION EngineSpeed "" /begin DEF_CHARACTERISTIC EngineToEncoderOffset PseudoRPM RPMFiltConst /end DEF_CHARACTERISTIC /begin OUT_MEASUREMENT EncoderState EncoderTDCOrder RPM RPMInst /end OUT_MEASUREMENT /begin SUB_FUNCTION Encoder_Config Encoder_Diagnostics /end SUB_FUNCTION /end FUNCTION
/begin FUNCTION CAN_1 ""
 /begin OUT_MEASUREMENT CAN_1_ext_handled_count CAN_1_ext_last_unhandled_id CAN_1_ext_receive_count can_create_CAN_1 can_create_CAN_2 can_tx_err_CAN_1_0 can_tx_err_CAN_1_0_50 can_tx_err_CAN_2_0 can_tx_err_CAN_2_0_51 protocol_register_CAN_1 protocol_register_CAN_2 /end OUT_MEASUREMENT
/end FUNCTION
/begin FUNCTION CAT "" /begin DEF_CHARACTERISTIC CATTbl /end DEF_CHARACTERISTIC /begin OUT_MEASUREMENT CAT CATADC CATIdx CATRaw /end OUT_MEASUREMENT /begin SUB_FUNCTION CAT_Override CAT_Config /end SUB_FUNCTION /end FUNCTION
/begin FUNCTION Temp_Sensors "" /begin SUB_FUNCTION CAT ECT EVAP IAT /end SUB_FUNCTION /end FUNCTION
/begin FUNCTION NonLinearSensors "" /begin SUB_FUNCTION Temp_Sensors Fuel_Level /end SUB_FUNCTION /end FUNCTION
/begin FUNCTION CAT_Override "" /begin DEF_CHARACTERISTIC CAT_new CAT_ovr /end DEF_CHARACTERISTIC /end FUNCTION
/begin FUNCTION Temp_Comp_Offset ""
 /begin DEF_CHARACTERISTIC CAT_SpkOfstMultMap CAT_SpkOfstTbl ECT_SpkOfstMultMap ECT_SpkOfstTbl IAT_SpkOfstMultMap IAT_SpkOfstTbl /end DEF_CHARACTERISTIC
 /begin OUT_MEASUREMENT CAT_SpkOfst CAT_SpkOfstMult ECT_SpkOfst ECT_SpkOfstMult IAT_SpkOfst IAT_SpkOfstMult SpkOfstTempFnl /end OUT_MEASUREMENT
/end FUNCTION
/begin FUNCTION CAT_Index "" /begin OUT_MEASUREMENT CAT05Idx CAT05In /end OUT_MEASUREMENT /end FUNCTION
/begin FUNCTION CAT_Config "" /begin DEF_CHARACTERISTIC CATDefault CATFiltConst CATMax CATMin /end DEF_CHARACTERISTIC /end FUNCTION
/begin FUNCTION CCP1 "" /begin DEF_CHARACTERISTIC CCP1_StationAddr CCP1RxID CCP1RxIDMask CCP1TxID /end DEF_CHARACTERISTIC
 /begin OUT_MEASUREMENT CCP_CCP1_Access CCP_CCP1_Access.CCP_CCP1_CAL CCP_CCP1_Access.CCP_CCP1_DAQ CCP_CCP1_Access.CCP_CCP1_PGM CCP_CCP1_ConnectionStatus /end OUT_MEASUREMENT
/end FUNCTION
/begin FUNCTION CCP "" /begin SUB_FUNCTION CCP1 /end SUB_FUNCTION /end FUNCTION
/begin FUNCTION Communication_Config "" /begin DEF_CHARACTERISTIC CityID_CAN_1 CityID_CAN_2 MotoTuneSerialBaudRate /end DEF_CHARACTERISTIC /end FUNCTION
/begin FUNCTION CrankFueling ""
 /begin DEF_CHARACTERISTIC ClearFloodThreshold CrankFPC_IATMultTbl CrankFPC_OXYMultTbl CrankFPCMap OpenThrottleFPCScalar /end DEF_CHARACTERISTIC
 /begin OUT_MEASUREMENT CrankFPC CrankFPC_IATMult CrankFPC_OXYMult /end OUT_MEASUREMENT
/end FUNCTION
/begin FUNCTION Crank ""
 /begin DEF_CHARACTERISTIC CrankAirflowSetPtTbl CrankMakeUpEOITbl CrankSOITbl CrankSparkMap CrankSpkEnergyMap /end DEF_CHARACTERISTIC
 /begin OUT_MEASUREMENT CrankAirflowSetPt CrankECT05Idx CrankIAT05Idx CrankMakeUpEOI CrankOXY05Idx CrankOXY05In CrankRPM05Idx CrankRPM05In CrankSOI CrankSpark CrankSpkEnergy /end OUT_MEASUREMENT
 /begin SUB_FUNCTION CrankFueling CrankIAC /end SUB_FUNCTION
/end FUNCTION
/begin FUNCTION ClutchSw "" /begin OUT_MEASUREMENT ClutchSw ClutchSw_Raw /end OUT_MEASUREMENT /begin SUB_FUNCTION ClutchSw_Override ClutchSw_Config /end SUB_FUNCTION /end FUNCTION
/begin FUNCTION ClutchSw_Override "" /begin DEF_CHARACTERISTIC ClutchSw_new ClutchSw_ovr /end DEF_CHARACTERISTIC /end FUNCTION
/begin FUNCTION ClutchSw_Config "" /begin DEF_CHARACTERISTIC ClutchSwPolarity ClutchSwSwitchPt /end DEF_CHARACTERISTIC /end FUNCTION
/begin FUNCTION Spark_Coil_Characterization "" /begin DEF_CHARACTERISTIC CoilDrvrDlyTime CoilDwellMap /end DEF_CHARACTERISTIC
 /begin OUT_MEASUREMENT CoilDwell SparkDwell SparkEnabled SparkEnergyMonitor SpkEnergy09Idx SpkEnergy09In /end OUT_MEASUREMENT
 /begin SUB_FUNCTION SparkDwell_Override /end SUB_FUNCTION
/end FUNCTION
/begin FUNCTION ActuatorCharacterization ""
 /begin SUB_FUNCTION Spark_Coil_Characterization Electronic_Throttle_Controller Injector_Characterization SequenceCutPattern /end SUB_FUNCTION
/end FUNCTION
/begin FUNCTION Coil_Control "" /begin DEF_CHARACTERISTIC SparkMaxDuration /end DEF_CHARACTERISTIC /begin OUT_MEASUREMENT CoilEnabled CoilStartAngle CoilStopAngle /end OUT_MEASUREMENT
 /begin SUB_FUNCTION EST_Fault_Management Coil_Enable_Manager SparkStartAngle_Override SparkStopAngle_Override /end SUB_FUNCTION
/end FUNCTION
/begin FUNCTION Fuel_Pump_at_Startup "" /begin DEF_CHARACTERISTIC Constant_Fuel_Pump FuelPumpStartTime /end DEF_CHARACTERISTIC /begin OUT_MEASUREMENT FuelPumpTSE /end OUT_MEASUREMENT /end FUNCTION
/begin FUNCTION Performance ""
 /begin OUT_MEASUREMENT CPUIdlePcent CPUTime_AppISR CPUTime_Bgnd CPUTime_CAN CPUTime_FgndAngle CPUTime_FgndTime CPUTime_MIOS CPUTime_Serial CPUTime_TimerISR CPUTime_TPU /end OUT_MEASUREMENT
/end FUNCTION
/begin FUNCTION CrankIAC "" /begin DEF_CHARACTERISTIC CrankIAC_IATMultTbl CrankIAC_OXYMultTbl CrankIACMap /end DEF_CHARACTERISTIC /begin OUT_MEASUREMENT CrankIAC CrankIAC_IATMult CrankIAC_OXYMult /end OUT_MEASUREMENT /end FUNCTION
/begin FUNCTION TDC_Counter "" /begin OUT_MEASUREMENT CrankTDCs /end OUT_MEASUREMENT /end FUNCTION
/begin FUNCTION EngineState ""
 /begin DEF_CHARACTERISTIC CrankToRunRPMThresh RunLatchTDCs StallRPMMinThreshold StallRPMThresholdHyst /end DEF_CHARACTERISTIC
 /begin OUT_MEASUREMENT CrankTrans EngineStateRaw /end OUT_MEASUREMENT
 /begin SUB_FUNCTION TDC_Counter /end SUB_FUNCTION
/end FUNCTION
/begin FUNCTION Delta_TPS_Transient_Fueling ""
 /begin DEF_CHARACTERISTIC DeltaMAP_FiltConst DeltaMAP_MultMap DeltaTPS_FiltConst DeltaTPS_MultMap /end DEF_CHARACTERISTIC
 /begin OUT_MEASUREMENT DeltaMAP DeltaMAP_Mult DeltaMAP17Idx DeltaMAP17In DeltaTPS DeltaTPS_Mult DeltaTPS17Idx DeltaTPS17In MAF09Idx MAF09In TransFuel_MAPFilt TransFuel_TPSFilt /end OUT_MEASUREMENT
 /begin SUB_FUNCTION ECT_Transient_Fueling OXY_Transient_Fueling /end SUB_FUNCTION
/end FUNCTION
/begin FUNCTION Injector_Manager "" /begin DEF_CHARACTERISTIC DeltaTPSFuelingEnable MakeUpEOIMap PrimarySOIMap /end DEF_CHARACTERISTIC /begin OUT_MEASUREMENT MakeUpEOI PrimarySOI /end OUT_MEASUREMENT /begin SUB_FUNCTION Delta_TPS_Transient_Fueling /end SUB_FUNCTION /end FUNCTION
/begin FUNCTION Calculate_A_F_Ratio "" /begin DEF_CHARACTERISTIC DesAFRatioTbl /end DEF_CHARACTERISTIC /begin OUT_MEASUREMENT DesAFRatio DesAFRatioIdx DesAFRatioIn /end OUT_MEASUREMENT /end FUNCTION
/begin FUNCTION Calculate_Fuel_Flow "" /begin OUT_MEASUREMENT Desired_AF_Ratio /end OUT_MEASUREMENT /begin SUB_FUNCTION Calculate_A_F_Ratio /end SUB_FUNCTION /end FUNCTION
/begin FUNCTION Desired_Eq_Ratio_Offset "" /begin DEF_CHARACTERISTIC EqRatio_SpkOfsMultMap EqRatio_SpkOfstTbl /end DEF_CHARACTERISTIC
 /begin OUT_MEASUREMENT DesEqRatio09Idx DesEqRatio09In EqRatio_SpkOfsMult EqRatio_SpkOfst Tot_EqRatio_SpkOfst /end OUT_MEASUREMENT
/end FUNCTION
/begin FUNCTION O2_Control_State_Determination "" /begin DEF_CHARACTERISTIC EquivRatioDelta O2ControlEnable O2StartUpDelayTbl /end DEF_CHARACTERISTIC
 /begin OUT_MEASUREMENT DesEquivInRange EnginSteadyState O2Calibration O2CtrlMode O2SensorFaults O2StartUpDelay O2TimeDelay /end OUT_MEASUREMENT
/end FUNCTION
/begin FUNCTION O2_Control "" /begin DEF_CHARACTERISTIC O2DisablmentMult /end DEF_CHARACTERISTIC /begin OUT_MEASUREMENT O2FuelMult O2ITermIdx O2ITermIn /end OUT_MEASUREMENT
 /begin SUB_FUNCTION O2_Control_State_Determination O2_PID_Calibrations O2_PID_Controller /end SUB_FUNCTION
/end FUNCTION
/begin FUNCTION DesEquivRatioMod ""
 /begin DEF_CHARACTERISTIC DFCODelayTime DFCOEnable DFCOEnterIdleSpeed DFCOEnterRampTime DFCOEntryAPP DFCOEntryMAP DFCOEntryRPMTbl DFCOExitAPP DFCOExitIdleSpeed DFCOExitMAP DFCOExitRampTime DFCOExitRPMTbl DFCOExitSparkRet /end DEF_CHARACTERISTIC
 /begin OUT_MEASUREMENT DFCOActive DFCODesEquivRatio DFCODesSparkOutOfst DFCOEnterCond DFCOEntryRPM DFCOEntryRPMIdx DFCOEntryRPMIn DFCOExitRPM DFCOExitRPMIdx DFCOExitRPMIn /end OUT_MEASUREMENT
/end FUNCTION
/begin FUNCTION DFCO "" /begin SUB_FUNCTION DesEquivRatioMod /end SUB_FUNCTION /end FUNCTION
/begin FUNCTION DigitalInput ""
 /begin OUT_MEASUREMENT din_create_ESTOPPin din_create_TwoStepPin din_read_ESTOPPin din_read_TwoStepPin /end OUT_MEASUREMENT
/end FUNCTION
/begin FUNCTION DiscreteOut ""
 /begin OUT_MEASUREMENT dout_create_DOut10165p0004 dout_create_DOut9005p0001 dout_create_DOut9617p0005 dout_create_DOut9618p0005 dout_create_DOut9638p0005 /end OUT_MEASUREMENT
/end FUNCTION
/begin FUNCTION ECT "" /begin DEF_CHARACTERISTIC ECTTbl /end DEF_CHARACTERISTIC /begin OUT_MEASUREMENT ECT ECTADC ECTIdx ECTRaw /end OUT_MEASUREMENT /begin SUB_FUNCTION ECT_Override ECT_Config /end SUB_FUNCTION /end FUNCTION
/begin FUNCTION Dash_Message_1 ""
 /begin DEF_CHARACTERISTIC ECT_FiltDecFiltC ECT_FiltIncFiltC IAT_FiltDecFiltC IAT_FiltIncFiltC TPS_FiltDecFiltC TPS_FiltIncFiltC /end DEF_CHARACTERISTIC
 /begin OUT_MEASUREMENT ECT_FiltDirection ECT_FiltFilterConst ECT_FiltFiltered IAT_FiltDirection IAT_FiltFilterConst IAT_FiltFiltered TPS_FiltDirection TPS_FiltFilterConst TPS_FiltFiltered /end OUT_MEASUREMENT
 /begin SUB_FUNCTION RPM_Filt /end SUB_FUNCTION
/end FUNCTION
/begin FUNCTION Capture_ECT_At_Startup "" /begin DEF_CHARACTERISTIC ECT_KeyUp_Count /end DEF_CHARACTERISTIC /end FUNCTION
/begin FUNCTION ECT_KeyUp "" /begin OUT_MEASUREMENT ECT_KeyUp09Idx ECT_KeyUp09In /end OUT_MEASUREMENT /end FUNCTION
/begin FUNCTION ECT_Override "" /begin DEF_CHARACTERISTIC ECT_new ECT_ovr /end DEF_CHARACTERISTIC /end FUNCTION
/begin FUNCTION ECT_Index "" /begin OUT_MEASUREMENT ECT05Idx ECT05In ECT09Idx ECT09In /end OUT_MEASUREMENT /end FUNCTION
/begin FUNCTION ECT_Config "" /begin DEF_CHARACTERISTIC ECTDefault ECTFiltConst ECTMax ECTMin /end DEF_CHARACTERISTIC /end FUNCTION
/begin FUNCTION ECT_Transient_Fueling "" /begin DEF_CHARACTERISTIC ECTTransFuelMultTbl /end DEF_CHARACTERISTIC /begin OUT_MEASUREMENT ECTTransFuelMult /end OUT_MEASUREMENT /end FUNCTION
/begin FUNCTION Main_Power_Relay "" /begin DEF_CHARACTERISTIC ProcessorReboot /end DEF_CHARACTERISTIC /begin OUT_MEASUREMENT ECUP_Enabled ForcedShutDownTimer /end OUT_MEASUREMENT /begin SUB_FUNCTION Main_Power_Relay_Config MPRD_Override /end SUB_FUNCTION /end FUNCTION
/begin FUNCTION Main_Power_Relay_Config "" /begin DEF_CHARACTERISTIC ECUP_Threshold ForcedShutDownTimerThresh Shutdown_Delay /end DEF_CHARACTERISTIC /end FUNCTION
/begin FUNCTION Dash_Message_2 ""
 /begin DEF_CHARACTERISTIC ECUVolt_FiltDecFiltC ECUVolt_FiltIncFiltC SparkAdv_FiltDecFiltC SparkAdv_FiltIncFiltC VSPD_FiltDecFiltC VSPD_FiltIncFiltC /end DEF_CHARACTERISTIC
 /begin OUT_MEASUREMENT ECUVolt_FiltDirection ECUVolt_FiltFilterConst ECUVolt_FiltFiltered SparkAdv_FiltDirection SparkAdv_FiltFilterConst SparkAdv_FiltFiltered VSPD_FiltDirection VSPD_FiltFilterConst VSPD_FiltFiltered /end OUT_MEASUREMENT
 /begin SUB_FUNCTION PHI_Filt PHI_Filt1 /end SUB_FUNCTION
/end FUNCTION
/begin FUNCTION Elec_PW_Override "" /begin DEF_CHARACTERISTIC Elec_PW_new Elec_PW_ovr /end DEF_CHARACTERISTIC /end FUNCTION
/begin FUNCTION Injector_Control "" /begin DEF_CHARACTERISTIC InjectiorMinDuration InjectorMaxDuration MinMakeUpPW /end DEF_CHARACTERISTIC /begin OUT_MEASUREMENT InjectorsEnabled InjTransitionCount /end OUT_MEASUREMENT
 /begin SUB_FUNCTION Elec_PW_Override Injector_Enable_Manager ESTOP_FuelInj_Ovr_Override InjEnable_Override MakeUp_EOI_Override Mech_PW_Override SOI_Override /end SUB_FUNCTION
/end FUNCTION
/begin FUNCTION Idle_State_Determination ""
 /begin DEF_CHARACTERISTIC EnableRPMFalling InGearMinGovEntryRPMDelta MinGovAirPcntHyst MinGovEntryAirPcnt MinGovEntryAirTimeThresh StallSaverDeltaRPM /end DEF_CHARACTERISTIC
 /begin OUT_MEASUREMENT IdleState RPMCtrlMode /end OUT_MEASUREMENT
 /begin SUB_FUNCTION Determine_if_RPM_is_Falling /end SUB_FUNCTION
/end FUNCTION
/begin FUNCTION Encoder "" /begin OUT_MEASUREMENT encoder_create /end OUT_MEASUREMENT /end FUNCTION
/begin FUNCTION Encoder_Diagnostics "" /begin OUT_MEASUREMENT EncoderFault EncoderFaultCount /end OUT_MEASUREMENT /end FUNCTION
/begin FUNCTION Engine_Accel "" /begin DEF_CHARACTERISTIC EngineAccelFiltConst /end DEF_CHARACTERISTIC /begin OUT_MEASUREMENT EngineAccel /end OUT_MEASUREMENT /end FUNCTION
/begin FUNCTION Injector_Enable_Manager ""
 /begin DEF_CHARACTERISTIC EngineShutdownDelayTime Injector1Enable Injector2Enable Injector3Enable Injector4Enable Injector5Enable Injector6Enable Injector7Enable Injector8Enable /end DEF_CHARACTERISTIC
/end FUNCTION
/begin FUNCTION EquivRatio_Override "" /begin DEF_CHARACTERISTIC EquivRatio_new EquivRatio_ovr /end DEF_CHARACTERISTIC /end FUNCTION
/begin FUNCTION EST_Fault_Management "" /begin OUT_MEASUREMENT EST_DiagDwell ESTOpenADC /end OUT_MEASUREMENT /end FUNCTION
/begin FUNCTION SequenceOut "" /begin OUT_MEASUREMENT EST_Spark EST_SparkCreate INJ_InjectorCreate /end OUT_MEASUREMENT /end FUNCTION
/begin FUNCTION EST_Enable_TDC_Counter "" /begin DEF_CHARACTERISTIC SparkEnableTDCCounts /end DEF_CHARACTERISTIC /begin OUT_MEASUREMENT EST_TDCEnabled TDCCount TDCCountThreshEnabled /end OUT_MEASUREMENT /end FUNCTION
/begin FUNCTION Coil_Enable_Manager ""
 /begin DEF_CHARACTERISTIC SparkEnableCyl1 SparkEnableCyl2 SparkEnableCyl3 SparkEnableCyl4 SparkEnableCyl5 SparkEnableCyl6 SparkEnableCyl7 SparkEnableCyl8 /end DEF_CHARACTERISTIC
 /begin SUB_FUNCTION EST_Enable_TDC_Counter /end SUB_FUNCTION
/end FUNCTION
/begin FUNCTION ESTOP "" /begin OUT_MEASUREMENT ESTOP ESTOP_Raw /end OUT_MEASUREMENT /begin SUB_FUNCTION ESTOP_Override ESTOP_Config /end SUB_FUNCTION /end FUNCTION
/begin FUNCTION ESTOP_FuelInj_Ovr_Override "" /begin DEF_CHARACTERISTIC ESTOP_FuelInj_Ovr_new ESTOP_FuelInj_Ovr_ovr /end DEF_CHARACTERISTIC /end FUNCTION
/begin FUNCTION ESTOP_Override "" /begin DEF_CHARACTERISTIC ESTOP_new ESTOP_ovr /end DEF_CHARACTERISTIC /end FUNCTION
/begin FUNCTION ESTOP_Config "" /begin DEF_CHARACTERISTIC ESTOPPolarity /end DEF_CHARACTERISTIC /end FUNCTION
/begin FUNCTION HBridge ""
 /begin DEF_CHARACTERISTIC ETC_CutPower_Permitted ETC_Frequency ETC_I_MIN ETC_OC_MIN ETC_Offset ETC_VoltageCompTbl /end DEF_CHARACTERISTIC
 /begin OUT_MEASUREMENT ETB_Curr_Flt ETC_Current ETC_DutyCycle ETC_VoltageComp /end OUT_MEASUREMENT
 /begin SUB_FUNCTION ETC_Override /end SUB_FUNCTION
/end FUNCTION
/begin FUNCTION ETC_CutPower "" /begin DEF_CHARACTERISTIC ETC_CutPower_ETC ETC_CutPower_StallTime /end DEF_CHARACTERISTIC /end FUNCTION
/begin FUNCTION State__Manager "" /begin OUT_MEASUREMENT ETC_ECUPState ETC_ShutDownTimer /end OUT_MEASUREMENT /end FUNCTION
/begin FUNCTION Electronic_Throttle_Controller ""
 /begin DEF_CHARACTERISTIC ETC_ShutdownLoAdaptError ETC_SpringTestHiThresh ETC_SpringTestLoThresh ETC_SpringTestTimerThresh /end DEF_CHARACTERISTIC
 /begin SUB_FUNCTION State__Manager PID_With_Damper_Terms__Tunable_ Setpoint_Manager ETC_Adapt_Request ETC_Sticking_Fault ETC_PID_Config ETCStallShutDown /end SUB_FUNCTION
/end FUNCTION
/begin FUNCTION PID_With_Damper_Terms__Tunable_ ""
 /begin DEF_CHARACTERISTIC ETCDampGainDown ETCDampGainUp ETCDCOffsetTbl ETCDGain ETCErrorGain ETCIMax ETCIMin /end DEF_CHARACTERISTIC
 /begin OUT_MEASUREMENT ETC_ErrorIdx ETC_ErrorIn ETC_Setpoint ETC_SetpointIdx ETC_SetpointIn ETCDampTerm ETCDCOffset ETCDTerm ETCError ETCITerm ETCOut ETCPTerm /end OUT_MEASUREMENT
 /begin SUB_FUNCTION IGain PGain DamperSwitch /end SUB_FUNCTION
/end FUNCTION
/begin FUNCTION Stall_Throttle ""
 /begin DEF_CHARACTERISTIC ETC_IceBreakEnblTm ETC_IceBreakHoldTm ETC_IceBreakPos ETC_StallAppOvrThesh ETC_StallAppOvrTm /end DEF_CHARACTERISTIC
 /begin OUT_MEASUREMENT ETCStallAppOvrReq ETCStallIceBreakReq ETCStallReq /end OUT_MEASUREMENT
/end FUNCTION
/begin FUNCTION IGain "" /begin DEF_CHARACTERISTIC ETC_IGainMultTbl ETCIGain /end DEF_CHARACTERISTIC /begin OUT_MEASUREMENT ETC_IGainMult /end OUT_MEASUREMENT /end FUNCTION
/begin FUNCTION Setpoint_Manager "" /begin DEF_CHARACTERISTIC ETC_LoAdaptRateLimit /end DEF_CHARACTERISTIC /begin SUB_FUNCTION Tuning /end SUB_FUNCTION /end FUNCTION
/begin FUNCTION ETC_Override "" /begin DEF_CHARACTERISTIC ETC_new ETC_ovr /end DEF_CHARACTERISTIC /end FUNCTION
/begin FUNCTION PGain "" /begin DEF_CHARACTERISTIC ETC_PGainMultTbl ETCPGain /end DEF_CHARACTERISTIC /begin OUT_MEASUREMENT ETC_PGainMult /end OUT_MEASUREMENT /end FUNCTION
/begin FUNCTION ETC_Adapt_Request "" /begin OUT_MEASUREMENT ETC_ShutdownSetpointMode /end OUT_MEASUREMENT /end FUNCTION
/begin FUNCTION ETC_Sticking_Fault "" /begin DEF_CHARACTERISTIC ETC_StickingThresh /end DEF_CHARACTERISTIC /end FUNCTION
/begin FUNCTION DamperSwitch "" /begin DEF_CHARACTERISTIC ETCDamperSwitchHyst ETCDamperSwitchThresh /end DEF_CHARACTERISTIC /begin OUT_MEASUREMENT ETCDamperSwtichState ETCDamperTPS ETCDamperTPSThresh /end OUT_MEASUREMENT /end FUNCTION
/begin FUNCTION ETC_PID_Config "" /begin DEF_CHARACTERISTIC ETCDamperTPSFilt ETCLwrLim ETCUprLim /end DEF_CHARACTERISTIC /end FUNCTION
/begin FUNCTION ETCReq_Override "" /begin DEF_CHARACTERISTIC ETCReq_new ETCReq_ovr /end DEF_CHARACTERISTIC /end FUNCTION
/begin FUNCTION Tuning "" /begin DEF_CHARACTERISTIC ETCTuneAmp ETCTuneEnable ETCTuneFreq ETCTuneOffset /end DEF_CHARACTERISTIC /begin SUB_FUNCTION ETCReq_Override /end SUB_FUNCTION /end FUNCTION
/begin FUNCTION ETCStallShutDown "" /begin DEF_CHARACTERISTIC ETCShutdownTimerThresh /end DEF_CHARACTERISTIC /begin OUT_MEASUREMENT ETCStallStateShutdown /end OUT_MEASUREMENT /end FUNCTION
/begin FUNCTION Ethanol_Spark_Offset "" /begin DEF_CHARACTERISTIC Ethanol_SpkOfstMultMap EthSpkModTbl /end DEF_CHARACTERISTIC
 /begin OUT_MEASUREMENT Eth11IdxIdx Eth11IdxIn Ethanol_Spk_Ofst Ethanol_SpkOfstMult EthSpkMod /end OUT_MEASUREMENT
/end FUNCTION
/begin FUNCTION EVAP "" /begin DEF_CHARACTERISTIC EVAPTbl /end DEF_CHARACTERISTIC /begin OUT_MEASUREMENT EVAP EVAPADC EVAPIdx EVAPRaw /end OUT_MEASUREMENT /begin SUB_FUNCTION EVAP_Override EVAP_Config /end SUB_FUNCTION /end FUNCTION
/begin FUNCTION EVAP_Override "" /begin DEF_CHARACTERISTIC EVAP_new EVAP_ovr /end DEF_CHARACTERISTIC /end FUNCTION
/begin FUNCTION EVAP_Config "" /begin DEF_CHARACTERISTIC EVAPDefault EVAPFiltConst EVAPMax EVAPMin /end DEF_CHARACTERISTIC /end FUNCTION
/begin FUNCTION Rate_Limiter "" /begin DEF_CHARACTERISTIC Fall_Rate Rise_Rate /end DEF_CHARACTERISTIC /end FUNCTION
/begin FUNCTION Filter_Options "" /begin DEF_CHARACTERISTIC Filter_Type_Selection /end DEF_CHARACTERISTIC /begin SUB_FUNCTION Rate_Limiter Moving_Average_Filter /end SUB_FUNCTION /end FUNCTION
/begin FUNCTION FuelOxygenationSensor "" /begin SUB_FUNCTION Filter_Options /end SUB_FUNCTION /end FUNCTION
/begin FUNCTION FAN1 "" /begin OUT_MEASUREMENT FAN1 /end OUT_MEASUREMENT /begin SUB_FUNCTION FAN1_Override FAN1_Config /end SUB_FUNCTION /end FUNCTION
/begin FUNCTION FAN_Control_2 "" /begin SUB_FUNCTION FAN1 FAN1_PWM FAN2 FAN2_PWM /end SUB_FUNCTION /end FUNCTION
/begin FUNCTION FAN1_Override "" /begin DEF_CHARACTERISTIC FAN1_new FAN1_ovr /end DEF_CHARACTERISTIC /end FUNCTION
/begin FUNCTION FAN1_Config "" /begin DEF_CHARACTERISTIC FAN1_Polarity /end DEF_CHARACTERISTIC /end FUNCTION
/begin FUNCTION FAN1_PWM_Override "" /begin DEF_CHARACTERISTIC FAN1_PWM_new FAN1_PWM_ovr /end DEF_CHARACTERISTIC /end FUNCTION
/begin FUNCTION FAN1_PWM "" /begin OUT_MEASUREMENT FAN1_PWMDutyCycle /end OUT_MEASUREMENT /begin SUB_FUNCTION FAN1_PWM_Override FAN1_PWM_Config /end SUB_FUNCTION /end FUNCTION
/begin FUNCTION FAN1_PWM_Config ""
 /begin DEF_CHARACTERISTIC FAN1_PWMFrequency FAN1_PWMGain FAN1_PWMMaxLimit FAN1_PWMMinLimit FAN1_PWMOffset /end DEF_CHARACTERISTIC
/end FUNCTION
/begin FUNCTION FAN2 "" /begin OUT_MEASUREMENT FAN2 /end OUT_MEASUREMENT /begin SUB_FUNCTION FAN2_Override FAN2_Config /end SUB_FUNCTION /end FUNCTION
/begin FUNCTION FAN2_Override "" /begin DEF_CHARACTERISTIC FAN2_new FAN2_ovr /end DEF_CHARACTERISTIC /end FUNCTION
/begin FUNCTION FAN2_Config "" /begin DEF_CHARACTERISTIC FAN2_Polarity /end DEF_CHARACTERISTIC /end FUNCTION
/begin FUNCTION FAN2_PWM_Override "" /begin DEF_CHARACTERISTIC FAN2_PWM_new FAN2_PWM_ovr /end DEF_CHARACTERISTIC /end FUNCTION
/begin FUNCTION FAN2_PWM "" /begin OUT_MEASUREMENT FAN2_PWMDutyCycle /end OUT_MEASUREMENT /begin SUB_FUNCTION FAN2_PWM_Override FAN2_PWM_Config /end SUB_FUNCTION /end FUNCTION
/begin FUNCTION FAN2_PWM_Config ""
 /begin DEF_CHARACTERISTIC FAN2_PWMFrequency FAN2_PWMGain FAN2_PWMMaxLimit FAN2_PWMMinLimit FAN2_PWMOffset /end DEF_CHARACTERISTIC
/end FUNCTION
/begin FUNCTION Action_Reasons ""
 /begin OUT_MEASUREMENT FaultActionReason._.CutThrottle FaultActionReason._.DFCODisable FaultActionReason._.DelayedEngineShutdown FaultActionReason._.DisableAC FaultActionReason._.DisableO2Ctrl FaultActionReason._.DisableVEAdapt FaultActionReason._.DisableWastegate FaultActionReason._.EngineProtectLED FaultActionReason._.EngineShutdown FaultActionReason._.HardRevLimit FaultActionReason._.MIL_LED FaultActionReason._.MediumRevLimit FaultActionReason._.SoftRevLimit /end OUT_MEASUREMENT
/end FUNCTION
/begin FUNCTION Gear_Estimator ""
 /begin DEF_CHARACTERISTIC FDR Gear1Ratio Gear2Ratio Gear3Ratio Gear4Ratio Gear5Ratio Gear6Ratio GearMatchHyst TireRadius /end DEF_CHARACTERISTIC
 /begin OUT_MEASUREMENT GearEstimated /end OUT_MEASUREMENT
/end FUNCTION
/begin FUNCTION Moving_Average_Filter "" /begin DEF_CHARACTERISTIC FinalGain Gain1 Gain2 Gain3 /end DEF_CHARACTERISTIC /end FUNCTION
/begin FUNCTION Dash_Message_6 "" /begin DEF_CHARACTERISTIC Flex_FiltDecFiltC Flex_FiltIncFiltC /end DEF_CHARACTERISTIC /begin OUT_MEASUREMENT Flex_FiltDirection Flex_FiltFilterConst Flex_FiltFiltered /end OUT_MEASUREMENT /end FUNCTION
/begin FUNCTION Framework "" /begin OUT_MEASUREMENT FrameworkGlueErrors /end OUT_MEASUREMENT /end FUNCTION
/begin FUNCTION FrequencyIn ""
 /begin OUT_MEASUREMENT freq_in_create_FuelSensorPin freq_in_create_MAF_Pin freq_in_create_VSPD_Pin freq_in_read_FuelSensorPin freq_in_read_MAF_Pin freq_in_read_VSPD_Pin /end OUT_MEASUREMENT
/end FUNCTION
/begin FUNCTION Fuel_Cyl1_Override "" /begin DEF_CHARACTERISTIC Fuel_Cyl1_offset Fuel_Cyl1_ovr /end DEF_CHARACTERISTIC /end FUNCTION
/begin FUNCTION Fuel_Inj_Offsets "" /begin OUT_MEASUREMENT TotalFPC /end OUT_MEASUREMENT
 /begin SUB_FUNCTION Fuel_Cyl1_Override Fuel_Cyl2_Override Fuel_Cyl3_Override Fuel_Cyl4_Override Fuel_Cyl5_Override Fuel_Cyl6_Override Fuel_Cyl7_Override Fuel_Cyl8_Override Fuel_Global_Override /end SUB_FUNCTION
/end FUNCTION
/begin FUNCTION Injector_Characterization "" /begin DEF_CHARACTERISTIC InjdPCompTbl InjGain InjOffset InjTurnOffTbl InjTurnOnTbl /end DEF_CHARACTERISTIC
 /begin OUT_MEASUREMENT InjDC InjdPComp InjEPW InjMPW InjTurnOff InjTurnOn MaxAllowableMPW /end OUT_MEASUREMENT
 /begin SUB_FUNCTION Fuel_Inj_Offsets DeltaPressureIndex /end SUB_FUNCTION
/end FUNCTION
/begin FUNCTION Fuel_Cyl2_Override "" /begin DEF_CHARACTERISTIC Fuel_Cyl2_offset Fuel_Cyl2_ovr /end DEF_CHARACTERISTIC /end FUNCTION
/begin FUNCTION Fuel_Cyl3_Override "" /begin DEF_CHARACTERISTIC Fuel_Cyl3_offset Fuel_Cyl3_ovr /end DEF_CHARACTERISTIC /end FUNCTION
/begin FUNCTION Fuel_Cyl4_Override "" /begin DEF_CHARACTERISTIC Fuel_Cyl4_offset Fuel_Cyl4_ovr /end DEF_CHARACTERISTIC /end FUNCTION
/begin FUNCTION Fuel_Cyl5_Override "" /begin DEF_CHARACTERISTIC Fuel_Cyl5_offset Fuel_Cyl5_ovr /end DEF_CHARACTERISTIC /end FUNCTION
/begin FUNCTION Fuel_Cyl6_Override "" /begin DEF_CHARACTERISTIC Fuel_Cyl6_offset Fuel_Cyl6_ovr /end DEF_CHARACTERISTIC /end FUNCTION
/begin FUNCTION Fuel_Cyl7_Override "" /begin DEF_CHARACTERISTIC Fuel_Cyl7_offset Fuel_Cyl7_ovr /end DEF_CHARACTERISTIC /end FUNCTION
/end MODULE
/end PROJECT
