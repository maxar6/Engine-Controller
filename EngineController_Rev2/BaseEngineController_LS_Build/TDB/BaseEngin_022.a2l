ASAP2_VERSION 1 51
/begin PROJECT Project ""
/begin MODULE BaseEngin_022 ""
/begin MOD_COMMON /* MOD_COMMON Comment */ "" BYTE_ORDER MSB_FIRST ALIGNMENT_BYTE 1 ALIGNMENT_FLOAT32_IEEE 1 ALIGNMENT_FLOAT64_IEEE 1 ALIGNMENT_LONG 1 ALIGNMENT_WORD 1 /end MOD_COMMON
/begin MEASUREMENT ACAirFlowOfst "AC air position in based on ECT." FLOAT32_IEEE CompuMethod_6 1 0 -1E+17 1E+17 ECU_ADDRESS 0x40000117 /end MEASUREMENT
/begin MEASUREMENT ACHighPresOff "AC pressure that the AC turns off at high" FLOAT32_IEEE CompuMethod_8 1 0 -1E+17 1E+17 ECU_ADDRESS 0x4000011B /end MEASUREMENT
/begin MEASUREMENT ACHighPresOn "AC pressure that the AC turns on at high" FLOAT32_IEEE CompuMethod_8 1 0 -1E+17 1E+17 ECU_ADDRESS 0x4000011F /end MEASUREMENT
/begin MEASUREMENT ACLowChrg "" UBYTE CompuMethod_11 1 0 0 1 ECU_ADDRESS 0x40000123 /end MEASUREMENT
/begin MEASUREMENT ACLowPresOff "AC pressure that the AC turns off at low" FLOAT32_IEEE CompuMethod_8 1 0 -1E+17 1E+17 ECU_ADDRESS 0x40000124 /end MEASUREMENT
/begin MEASUREMENT ACLowPresOn "AC pressure that the AC turns on at low" FLOAT32_IEEE CompuMethod_8 1 0 -1E+17 1E+17 ECU_ADDRESS 0x40000128 /end MEASUREMENT
/begin MEASUREMENT ACOutput "" UBYTE CompuMethod_11 1 0 0 1 ECU_ADDRESS 0x4000012C /end MEASUREMENT
/begin MEASUREMENT ACOverPressure "" UBYTE CompuMethod_11 1 0 0 1 ECU_ADDRESS 0x4000012D /end MEASUREMENT
/begin MEASUREMENT ACPres "Final value after Linear Sensor Characterization" FLOAT32_IEEE CompuMethod_13 1 0 -1E+17 1E+17 ECU_ADDRESS 0x4000012E /end MEASUREMENT
/begin MEASUREMENT ACPres05Idx "Index of AC system high side pressure" UWORD CompuMethod_15 1 0 0 127.998 ECU_ADDRESS 0x40000132 /end MEASUREMENT
/begin MEASUREMENT ACPres05In "Index of AC system high side pressure" FLOAT32_IEEE CompuMethod_8 1 0 -1E+17 1E+17 ECU_ADDRESS 0x40000134 /end MEASUREMENT
/begin MEASUREMENT ACPresADC "Singal measured directly from sensor" UWORD CompuMethod_16 1 0 0 65535 ECU_ADDRESS 0x40000138 /end MEASUREMENT
/begin MEASUREMENT ACPresFanSpeed "ACPres Fan speed request" FLOAT32_IEEE CompuMethod_6 1 0 -1E+17 1E+17 ECU_ADDRESS 0x4000013A /end MEASUREMENT
/begin MEASUREMENT ACPresFanSpeed_Stall "ACPres Fan speed request" FLOAT32_IEEE CompuMethod_6 1 0 -1E+17 1E+17 ECU_ADDRESS 0x4000013E /end MEASUREMENT
/begin MEASUREMENT ACPresFanSpeed_StallColIdx "ACPres Fan speed request" UWORD CompuMethod_15 1 0 0 127.998 ECU_ADDRESS 0x40000142 /end MEASUREMENT
/begin MEASUREMENT ACPresFanSpeed_StallColIn "ACPres Fan speed request" FLOAT32_IEEE CompuMethod_17 1 0 -1E+17 1E+17 ECU_ADDRESS 0x40000144 /end MEASUREMENT
/begin MEASUREMENT ACPresFanSpeed_StallRowIdx "ACPres Fan speed request" UWORD CompuMethod_15 1 0 0 127.998 ECU_ADDRESS 0x40000148 /end MEASUREMENT
/begin MEASUREMENT ACPresFanSpeed_StallRowIn "ACPres Fan speed request" FLOAT32_IEEE CompuMethod_18 1 0 -1E+17 1E+17 ECU_ADDRESS 0x4000014A /end MEASUREMENT
/begin MEASUREMENT ACPresFanSpeedColIdx "ACPres Fan speed request" UWORD CompuMethod_15 1 0 0 127.998 ECU_ADDRESS 0x4000014E /end MEASUREMENT
/begin MEASUREMENT ACPresFanSpeedColIn "ACPres Fan speed request" FLOAT32_IEEE CompuMethod_17 1 0 -1E+17 1E+17 ECU_ADDRESS 0x40000150 /end MEASUREMENT
/begin MEASUREMENT ACPresFanSpeedRowIdx "ACPres Fan speed request" UWORD CompuMethod_15 1 0 0 127.998 ECU_ADDRESS 0x40000154 /end MEASUREMENT
/begin MEASUREMENT ACPresFanSpeedRowIn "ACPres Fan speed request" FLOAT32_IEEE CompuMethod_19 1 0 -1E+17 1E+17 ECU_ADDRESS 0x40000156 /end MEASUREMENT
/begin MEASUREMENT ACPresRaw "After conversion to engineering units, before range checking" FLOAT32_IEEE CompuMethod_13 1 0 -1E+17 1E+17 ECU_ADDRESS 0x4000015A /end MEASUREMENT
/begin MEASUREMENT ACRpmHighEnbl "" UBYTE CompuMethod_11 1 0 0 1 ECU_ADDRESS 0x4000015E /end MEASUREMENT
/begin MEASUREMENT ACRpmLowEnbl "" UBYTE CompuMethod_11 1 0 0 1 ECU_ADDRESS 0x4000015F /end MEASUREMENT
/begin MEASUREMENT ACSw "Display output in engineering units" UBYTE CompuMethod_26 1 0 0 1 ECU_ADDRESS 0x40000160 /end MEASUREMENT
/begin MEASUREMENT ACSw_Raw "Display output in engineering units" FLOAT32_IEEE CompuMethod_22 1 0 -1E+17 1E+17 ECU_ADDRESS 0x40000161 /end MEASUREMENT
/begin MEASUREMENT ACTempEnbl "" UBYTE CompuMethod_11 1 0 0 1 ECU_ADDRESS 0x40000165 /end MEASUREMENT
/begin MEASUREMENT ACTempOff "AC evap temp that the compressor turns on at" FLOAT32_IEEE CompuMethod_27 1 0 -1E+17 1E+17 ECU_ADDRESS 0x40000166 /end MEASUREMENT
/begin MEASUREMENT ACTempOn "AC evap temp that the compressor turns on at" FLOAT32_IEEE CompuMethod_27 1 0 -1E+17 1E+17 ECU_ADDRESS 0x4000016A /end MEASUREMENT
/begin MEASUREMENT ACTpsEnble "" UBYTE CompuMethod_11 1 0 0 1 ECU_ADDRESS 0x4000016E /end MEASUREMENT
/begin MEASUREMENT AdjustedPerCylFuelRate "Desired fuel per cylinder after application of individual cylinder offsets and multipliers." FLOAT32_IEEE CompuMethod_30 1 0 -1E+17 1E+17 ECU_ADDRESS 0x4000016F /end MEASUREMENT
/begin MEASUREMENT ain_create_ACPresPin "Debug Variable" UBYTE CompuMethod_31 1 0 0 0 ECU_ADDRESS 0x40000173 /end MEASUREMENT
/begin MEASUREMENT ain_create_ACSwPin "Debug Variable" UBYTE CompuMethod_31 1 0 0 0 ECU_ADDRESS 0x40000174 /end MEASUREMENT
/begin MEASUREMENT ain_create_APP1AnalogInput "Debug Variable" UBYTE CompuMethod_31 1 0 0 0 ECU_ADDRESS 0x40000175 /end MEASUREMENT
/begin MEASUREMENT ain_create_APP2AnalogInput "Debug Variable" UBYTE CompuMethod_31 1 0 0 0 ECU_ADDRESS 0x40000176 /end MEASUREMENT
/begin MEASUREMENT ain_create_CATSensorPin "Debug Variable" UBYTE CompuMethod_31 1 0 0 0 ECU_ADDRESS 0x40000177 /end MEASUREMENT
/begin MEASUREMENT ain_create_ClutchSw_Pin "Debug Variable" UBYTE CompuMethod_31 1 0 0 0 ECU_ADDRESS 0x40000178 /end MEASUREMENT
/begin MEASUREMENT ain_create_ECTSensorPin "Debug Variable" UBYTE CompuMethod_31 1 0 0 0 ECU_ADDRESS 0x40000179 /end MEASUREMENT
/begin MEASUREMENT ain_create_ECUP "Debug Variable" UBYTE CompuMethod_31 1 0 0 0 ECU_ADDRESS 0x4000017A /end MEASUREMENT
/begin MEASUREMENT ain_create_EVAPSensorPin "Debug Variable" UBYTE CompuMethod_31 1 0 0 0 ECU_ADDRESS 0x4000017B /end MEASUREMENT
/begin MEASUREMENT ain_create_FuelLvlSensorPin "Debug Variable" UBYTE CompuMethod_31 1 0 0 0 ECU_ADDRESS 0x4000017C /end MEASUREMENT
/begin MEASUREMENT ain_create_FuelPresPin "Debug Variable" UBYTE CompuMethod_31 1 0 0 0 ECU_ADDRESS 0x4000017D /end MEASUREMENT
/begin MEASUREMENT ain_create_IATSensorPin "Debug Variable" UBYTE CompuMethod_31 1 0 0 0 ECU_ADDRESS 0x4000017E /end MEASUREMENT
/begin MEASUREMENT ain_create_MAPSensorPin "Debug Variable" UBYTE CompuMethod_31 1 0 0 0 ECU_ADDRESS 0x4000017F /end MEASUREMENT
/begin MEASUREMENT ain_create_OilPresPin "Debug Variable" UBYTE CompuMethod_31 1 0 0 0 ECU_ADDRESS 0x40000180 /end MEASUREMENT
/begin MEASUREMENT ain_create_ScramblePin "Debug Variable" UBYTE CompuMethod_31 1 0 0 0 ECU_ADDRESS 0x40000181 /end MEASUREMENT
/begin MEASUREMENT ain_create_SensVoltSensorPin "Debug Variable" UBYTE CompuMethod_31 1 0 0 0 ECU_ADDRESS 0x40000182 /end MEASUREMENT
/begin MEASUREMENT ain_create_SysVoltage "Debug Variable" UBYTE CompuMethod_31 1 0 0 0 ECU_ADDRESS 0x40000183 /end MEASUREMENT
/begin MEASUREMENT ain_create_TPS1AnalogInput "Debug Variable" UBYTE CompuMethod_31 1 0 0 0 ECU_ADDRESS 0x40000184 /end MEASUREMENT
/begin MEASUREMENT ain_create_TPS2AnalogInput "Debug Variable" UBYTE CompuMethod_31 1 0 0 0 ECU_ADDRESS 0x40000185 /end MEASUREMENT
/begin MEASUREMENT ain_read_ACPresPin "Debug Variable" UBYTE CompuMethod_31 1 0 0 0 ECU_ADDRESS 0x40000186 /end MEASUREMENT
/begin MEASUREMENT ain_read_ACSwPin "Debug Variable" UBYTE CompuMethod_31 1 0 0 0 ECU_ADDRESS 0x40000187 /end MEASUREMENT
/begin MEASUREMENT ain_read_APP1AnalogInput "Debug Variable" UBYTE CompuMethod_31 1 0 0 0 ECU_ADDRESS 0x40000188 /end MEASUREMENT
/begin MEASUREMENT ain_read_APP2AnalogInput "Debug Variable" UBYTE CompuMethod_31 1 0 0 0 ECU_ADDRESS 0x40000189 /end MEASUREMENT
/begin MEASUREMENT ain_read_CATSensorPin "Debug Variable" UBYTE CompuMethod_31 1 0 0 0 ECU_ADDRESS 0x4000018A /end MEASUREMENT
/begin MEASUREMENT ain_read_ClutchSw_Pin "Debug Variable" UBYTE CompuMethod_31 1 0 0 0 ECU_ADDRESS 0x4000018B /end MEASUREMENT
/begin MEASUREMENT ain_read_ECTSensorPin "Debug Variable" UBYTE CompuMethod_31 1 0 0 0 ECU_ADDRESS 0x4000018C /end MEASUREMENT
/begin MEASUREMENT ain_read_ECUP "Debug Variable" UBYTE CompuMethod_31 1 0 0 0 ECU_ADDRESS 0x4000018D /end MEASUREMENT
/begin MEASUREMENT ain_read_EVAPSensorPin "Debug Variable" UBYTE CompuMethod_31 1 0 0 0 ECU_ADDRESS 0x4000018E /end MEASUREMENT
/begin MEASUREMENT ain_read_FuelLvlSensorPin "Debug Variable" UBYTE CompuMethod_31 1 0 0 0 ECU_ADDRESS 0x4000018F /end MEASUREMENT
/begin MEASUREMENT ain_read_FuelPresPin "Debug Variable" UBYTE CompuMethod_31 1 0 0 0 ECU_ADDRESS 0x40000190 /end MEASUREMENT
/begin MEASUREMENT ain_read_IATSensorPin "Debug Variable" UBYTE CompuMethod_31 1 0 0 0 ECU_ADDRESS 0x40000191 /end MEASUREMENT
/begin MEASUREMENT ain_read_MAPSensorPin "Debug Variable" UBYTE CompuMethod_31 1 0 0 0 ECU_ADDRESS 0x40000192 /end MEASUREMENT
/begin MEASUREMENT ain_read_OilPresPin "Debug Variable" UBYTE CompuMethod_31 1 0 0 0 ECU_ADDRESS 0x40000193 /end MEASUREMENT
/begin MEASUREMENT ain_read_ScramblePin "Debug Variable" UBYTE CompuMethod_31 1 0 0 0 ECU_ADDRESS 0x40000194 /end MEASUREMENT
/begin MEASUREMENT ain_read_SensVoltSensorPin "Debug Variable" UBYTE CompuMethod_31 1 0 0 0 ECU_ADDRESS 0x40000195 /end MEASUREMENT
/begin MEASUREMENT ain_read_SysVoltage "Debug Variable" UBYTE CompuMethod_31 1 0 0 0 ECU_ADDRESS 0x40000196 /end MEASUREMENT
/begin MEASUREMENT ain_read_TPS1AnalogInput "Debug Variable" UBYTE CompuMethod_31 1 0 0 0 ECU_ADDRESS 0x40000197 /end MEASUREMENT
/begin MEASUREMENT ain_read_TPS2AnalogInput "Debug Variable" UBYTE CompuMethod_31 1 0 0 0 ECU_ADDRESS 0x40000198 /end MEASUREMENT
/begin MEASUREMENT AirMinGovDGainErrorMult "" FLOAT32_IEEE CompuMethod_33 1 0 -1E+17 1E+17 ECU_ADDRESS 0x40000199 /end MEASUREMENT
/begin MEASUREMENT AirMinGovDTerm "Air min governor D term" FLOAT32_IEEE CompuMethod_2 1 0 -1E+17 1E+17 ECU_ADDRESS 0x4000019D /end MEASUREMENT
/begin MEASUREMENT AirMinGovError "Air min governor P term" FLOAT32_IEEE CompuMethod_2 1 0 -1E+17 1E+17 ECU_ADDRESS 0x400001A1 /end MEASUREMENT
/begin MEASUREMENT AirMinGovIGainErrorMult "" FLOAT32_IEEE CompuMethod_33 1 0 -1E+17 1E+17 ECU_ADDRESS 0x400001A5 /end MEASUREMENT
/begin MEASUREMENT AirMinGovITerm "Air min governor I term" FLOAT32_IEEE CompuMethod_2 1 0 -1E+17 1E+17 ECU_ADDRESS 0x400001A9 /end MEASUREMENT
/begin MEASUREMENT AirMinGovOutput "Total output from min. gov. air PID controller." FLOAT32_IEEE CompuMethod_6 1 0 -1E+17 1E+17 ECU_ADDRESS 0x400001AD /end MEASUREMENT
/begin MEASUREMENT AirMinGovPGainErrorMult "" FLOAT32_IEEE CompuMethod_33 1 0 -1E+17 1E+17 ECU_ADDRESS 0x400001B1 /end MEASUREMENT
/begin MEASUREMENT AirMinGovPTerm "Air min governor P term" FLOAT32_IEEE CompuMethod_2 1 0 -1E+17 1E+17 ECU_ADDRESS 0x400001B5 /end MEASUREMENT
/begin MEASUREMENT AirMinGovSpeedErrorIdx "" UWORD CompuMethod_15 1 0 0 127.998 ECU_ADDRESS 0x400001B9 /end MEASUREMENT
/begin MEASUREMENT AirMinGovSpeedErrorIn "" FLOAT32_IEEE CompuMethod_2 1 0 -1E+17 1E+17 ECU_ADDRESS 0x400001BB /end MEASUREMENT
/begin MEASUREMENT APP_FiltDirection "" UBYTE CompuMethod_34 1 0 0 1 ECU_ADDRESS 0x400001BF /end MEASUREMENT
/begin MEASUREMENT APP_FiltFilterConst "" FLOAT32_IEEE CompuMethod_2 1 0 -1E+17 1E+17 ECU_ADDRESS 0x400001C0 /end MEASUREMENT
/begin MEASUREMENT APP_FiltFiltered "" FLOAT32_IEEE CompuMethod_2 1 0 -1E+17 1E+17 ECU_ADDRESS 0x400001C4 /end MEASUREMENT
/begin MEASUREMENT App05Idx "" UWORD CompuMethod_15 1 0 0 127.998 ECU_ADDRESS 0x400001C8 /end MEASUREMENT
/begin MEASUREMENT App05In "" FLOAT32_IEEE CompuMethod_2 1 0 -1E+17 1E+17 ECU_ADDRESS 0x400001CA /end MEASUREMENT
/begin MEASUREMENT APP1 "Final value after Linear Sensor Characterization" FLOAT32_IEEE CompuMethod_6 1 0 -1E+17 1E+17 ECU_ADDRESS 0x400001CE /end MEASUREMENT
/begin MEASUREMENT APP1_AdaptAdapt_Hi "" FLOAT32_IEEE CompuMethod_2 1 0 -1E+17 1E+17 ECU_ADDRESS 0x400001D2 /end MEASUREMENT
/begin MEASUREMENT APP1_AdaptAdapt_Low "" FLOAT32_IEEE CompuMethod_2 1 0 -1E+17 1E+17 ECU_ADDRESS 0x400001D6 /end MEASUREMENT
/begin MEASUREMENT APP1_AdaptADC "" FLOAT32_IEEE CompuMethod_2 1 0 -1E+17 1E+17 ECU_ADDRESS 0x400001DA /end MEASUREMENT
/begin MEASUREMENT APP1_AdaptPercent "" FLOAT32_IEEE CompuMethod_2 1 0 -1E+17 1E+17 ECU_ADDRESS 0x400001DE /end MEASUREMENT
/begin MEASUREMENT APP1_AdaptPercentRaw "" FLOAT32_IEEE CompuMethod_2 1 0 -1E+17 1E+17 ECU_ADDRESS 0x400001E2 /end MEASUREMENT
/begin MEASUREMENT APP17Idx "Index of APP for driver demand" UWORD CompuMethod_15 1 0 0 127.998 ECU_ADDRESS 0x400001E6 /end MEASUREMENT
/begin MEASUREMENT APP17In "Index of APP for driver demand" FLOAT32_IEEE CompuMethod_6 1 0 -1E+17 1E+17 ECU_ADDRESS 0x400001E8 /end MEASUREMENT
/begin MEASUREMENT APP1ADC "Signal measured directly from sensor" UWORD CompuMethod_16 1 0 0 65535 ECU_ADDRESS 0x400001EC /end MEASUREMENT
/begin MEASUREMENT APP1Idx "Look up table to allownon-linear characterization of sensors" UWORD CompuMethod_15 1 0 0 127.998 ECU_ADDRESS 0x400001EE /end MEASUREMENT
/begin MEASUREMENT APP1Raw "After conversion to engineering units, before range checking" FLOAT32_IEEE CompuMethod_6 1 0 -1E+17 1E+17 ECU_ADDRESS 0x400001F0 /end MEASUREMENT
/begin MEASUREMENT APP2 "Final value after Linear Sensor Characterization" FLOAT32_IEEE CompuMethod_6 1 0 -1E+17 1E+17 ECU_ADDRESS 0x400001F4 /end MEASUREMENT
/begin MEASUREMENT APP2_AdaptAdapt_Hi "" FLOAT32_IEEE CompuMethod_2 1 0 -1E+17 1E+17 ECU_ADDRESS 0x400001F8 /end MEASUREMENT
/begin MEASUREMENT APP2_AdaptAdapt_Low "" FLOAT32_IEEE CompuMethod_2 1 0 -1E+17 1E+17 ECU_ADDRESS 0x400001FC /end MEASUREMENT
/begin MEASUREMENT APP2_AdaptADC "" FLOAT32_IEEE CompuMethod_2 1 0 -1E+17 1E+17 ECU_ADDRESS 0x40000200 /end MEASUREMENT
/begin MEASUREMENT APP2_AdaptPercent "" FLOAT32_IEEE CompuMethod_2 1 0 -1E+17 1E+17 ECU_ADDRESS 0x40000204 /end MEASUREMENT
/begin MEASUREMENT APP2_AdaptPercentRaw "" FLOAT32_IEEE CompuMethod_2 1 0 -1E+17 1E+17 ECU_ADDRESS 0x40000208 /end MEASUREMENT
/begin MEASUREMENT APP2ADC "Signal measured directly from sensor" UWORD CompuMethod_16 1 0 0 65535 ECU_ADDRESS 0x4000020C /end MEASUREMENT
/begin MEASUREMENT APP2Idx "Look up table to allownon-linear characterization of sensors" UWORD CompuMethod_15 1 0 0 127.998 ECU_ADDRESS 0x4000020E /end MEASUREMENT
/begin MEASUREMENT APP2Raw "After conversion to engineering units, before range checking" FLOAT32_IEEE CompuMethod_6 1 0 -1E+17 1E+17 ECU_ADDRESS 0x40000210 /end MEASUREMENT
/begin MEASUREMENT ApplicationInitStatus "Shows how far the module initialization has progressed" UBYTE CompuMethod_39 1 0 3 5 ECU_ADDRESS 0x40000214 /end MEASUREMENT
/begin MEASUREMENT ApplicationStopReason "Indicates the reason for an application stop" ULONG CompuMethod_42 1 0 0 5 ECU_ADDRESS 0x40000215 /end MEASUREMENT
/begin MEASUREMENT ApplicationStopReasonBlock "Indicates the block that caused the application stop" ULONG CompuMethod_43 1 0 0 5 ECU_ADDRESS 0x40000219 /end MEASUREMENT
/begin MEASUREMENT APPPcnt "APP used in controller (after power curve and CutThrottle limiting" FLOAT32_IEEE CompuMethod_6 1 0 -1E+17 1E+17 ECU_ADDRESS 0x4000021D /end MEASUREMENT
/begin MEASUREMENT Bank1_DataValidState_Prb "" FLOAT32_IEEE CompuMethod_2 1 0 -1E+17 1E+17 ECU_ADDRESS 0x40000221 /end MEASUREMENT
/begin MEASUREMENT Bank1_EquivRatio "Final value after Linear Sensor Characterization" FLOAT32_IEEE CompuMethod_44 1 0 -1E+17 1E+17 ECU_ADDRESS 0x40000225 /end MEASUREMENT
/begin MEASUREMENT Bank1_EquivRatioADC "Singal measured directly from sensor" FLOAT32_IEEE CompuMethod_44 1 0 -1E+17 1E+17 ECU_ADDRESS 0x40000229 /end MEASUREMENT
/begin MEASUREMENT Bank1_EquivRatioRaw "After conversion to engineering units, before range checking" FLOAT32_IEEE CompuMethod_44 1 0 -1E+17 1E+17 ECU_ADDRESS 0x4000022D /end MEASUREMENT
/begin MEASUREMENT Bank1_HeaterVolts_Prb "" FLOAT32_IEEE CompuMethod_2 1 0 -1E+17 1E+17 ECU_ADDRESS 0x40000231 /end MEASUREMENT
/begin MEASUREMENT Bank1_Lambda_Prb "" FLOAT32_IEEE CompuMethod_2 1 0 -1E+17 1E+17 ECU_ADDRESS 0x40000235 /end MEASUREMENT
/begin MEASUREMENT Bank1_OxygenConcentration_Prb "" FLOAT32_IEEE CompuMethod_2 1 0 -1E+17 1E+17 ECU_ADDRESS 0x40000239 /end MEASUREMENT
/begin MEASUREMENT Bank1_SensorDetectedStatus_Prb "" FLOAT32_IEEE CompuMethod_2 1 0 -1E+17 1E+17 ECU_ADDRESS 0x4000023D /end MEASUREMENT
/begin MEASUREMENT Bank1_SensorFaultState_Prb "" FLOAT32_IEEE CompuMethod_2 1 0 -1E+17 1E+17 ECU_ADDRESS 0x40000241 /end MEASUREMENT
/begin MEASUREMENT Bank1_SensorStatus_Prb "" FLOAT32_IEEE CompuMethod_2 1 0 -1E+17 1E+17 ECU_ADDRESS 0x40000245 /end MEASUREMENT
/begin MEASUREMENT Bank1_SystemVolts_Prb "" FLOAT32_IEEE CompuMethod_2 1 0 -1E+17 1E+17 ECU_ADDRESS 0x40000249 /end MEASUREMENT
/begin MEASUREMENT Bank1_UsingFreeAreCalState_Prb "" FLOAT32_IEEE CompuMethod_2 1 0 -1E+17 1E+17 ECU_ADDRESS 0x4000024D /end MEASUREMENT
/begin MEASUREMENT Bank1EquivRatio "" FLOAT32_IEEE CompuMethod_2 1 0 -1E+17 1E+17 ECU_ADDRESS 0x40000251 /end MEASUREMENT
/begin MEASUREMENT Bank2_DataValidState_Prb "" FLOAT32_IEEE CompuMethod_2 1 0 -1E+17 1E+17 ECU_ADDRESS 0x40000255 /end MEASUREMENT
/begin MEASUREMENT Bank2_HeaterVolts_Prb "" FLOAT32_IEEE CompuMethod_2 1 0 -1E+17 1E+17 ECU_ADDRESS 0x40000265 /end MEASUREMENT
/begin MEASUREMENT Bank2_Lambda_Prb "" FLOAT32_IEEE CompuMethod_2 1 0 -1E+17 1E+17 ECU_ADDRESS 0x40000269 /end MEASUREMENT
/begin MEASUREMENT Bank2_OxygenConcentration_Prb "" FLOAT32_IEEE CompuMethod_2 1 0 -1E+17 1E+17 ECU_ADDRESS 0x4000026D /end MEASUREMENT
/begin MEASUREMENT Bank2_SensorDetectedStatus_Prb "" FLOAT32_IEEE CompuMethod_2 1 0 -1E+17 1E+17 ECU_ADDRESS 0x40000271 /end MEASUREMENT
/begin MEASUREMENT Bank2_SensorFaultState_Prb "" FLOAT32_IEEE CompuMethod_2 1 0 -1E+17 1E+17 ECU_ADDRESS 0x40000275 /end MEASUREMENT
/begin MEASUREMENT Bank2_SensorStatus_Prb "" FLOAT32_IEEE CompuMethod_2 1 0 -1E+17 1E+17 ECU_ADDRESS 0x40000279 /end MEASUREMENT
/begin MEASUREMENT Bank2_SystemVolts_Prb "" FLOAT32_IEEE CompuMethod_2 1 0 -1E+17 1E+17 ECU_ADDRESS 0x4000027D /end MEASUREMENT
/begin MEASUREMENT Bank2_UsingFreeAreCalState_Prb "" FLOAT32_IEEE CompuMethod_2 1 0 -1E+17 1E+17 ECU_ADDRESS 0x40000281 /end MEASUREMENT
/begin MEASUREMENT Bank2EquivRatio "" FLOAT32_IEEE CompuMethod_2 1 0 -1E+17 1E+17 ECU_ADDRESS 0x40000285 /end MEASUREMENT
/begin MEASUREMENT BaseAirflowOfst "Base air position in based on ECT." FLOAT32_IEEE CompuMethod_6 1 0 -1E+17 1E+17 ECU_ADDRESS 0x40000294 /end MEASUREMENT
/begin MEASUREMENT BaseAirOffset "Base air request position, includes ramp into idle manager." FLOAT32_IEEE CompuMethod_50 1 0 -1E+17 1E+17 ECU_ADDRESS 0x40000298 /end MEASUREMENT
/begin MEASUREMENT ECT_KeyUp "" FLOAT32_IEEE CompuMethod_61 1 0 -1E+17 1E+17 ECU_ADDRESS 0x40000489 /end MEASUREMENT
/begin MEASUREMENT ECTFanSpeed "ECT Fan speed request" FLOAT32_IEEE CompuMethod_6 1 0 -1E+17 1E+17 ECU_ADDRESS 0x400004A9 /end MEASUREMENT
/begin MEASUREMENT ECTFanSpeed_Stall "ECT Fan speed request" FLOAT32_IEEE CompuMethod_6 1 0 -1E+17 1E+17 ECU_ADDRESS 0x400004AD /end MEASUREMENT
/begin MEASUREMENT ECTFanSpeed_StallColIdx "ECT Fan speed request" UWORD CompuMethod_15 1 0 0 127.998 ECU_ADDRESS 0x400004B1 /end MEASUREMENT
/begin MEASUREMENT ECTFanSpeed_StallColIn "ECT Fan speed request" FLOAT32_IEEE CompuMethod_17 1 0 -1E+17 1E+17 ECU_ADDRESS 0x400004B3 /end MEASUREMENT
/begin MEASUREMENT ECTFanSpeed_StallRowIdx "ECT Fan speed request" UWORD CompuMethod_15 1 0 0 127.998 ECU_ADDRESS 0x400004B7 /end MEASUREMENT
/begin MEASUREMENT ECTFanSpeed_StallRowIn "ECT Fan speed request" FLOAT32_IEEE CompuMethod_81 1 0 -1E+17 1E+17 ECU_ADDRESS 0x400004B9 /end MEASUREMENT
/begin MEASUREMENT ECTFanSpeedColIdx "ECT Fan speed request" UWORD CompuMethod_15 1 0 0 127.998 ECU_ADDRESS 0x400004BD /end MEASUREMENT
/begin MEASUREMENT ECTFanSpeedColIn "ECT Fan speed request" FLOAT32_IEEE CompuMethod_17 1 0 -1E+17 1E+17 ECU_ADDRESS 0x400004BF /end MEASUREMENT
/begin MEASUREMENT ECTFanSpeedRowIdx "ECT Fan speed request" UWORD CompuMethod_15 1 0 0 127.998 ECU_ADDRESS 0x400004C3 /end MEASUREMENT
/begin MEASUREMENT ECTFanSpeedRowIn "ECT Fan speed request" FLOAT32_IEEE CompuMethod_81 1 0 -1E+17 1E+17 ECU_ADDRESS 0x400004C5 /end MEASUREMENT
/begin MEASUREMENT ETCReq_FiltDirection "" UBYTE CompuMethod_34 1 0 0 1 ECU_ADDRESS 0x4000056D /end MEASUREMENT
/begin MEASUREMENT ETCReq_FiltFilterConst "" FLOAT32_IEEE CompuMethod_2 1 0 -1E+17 1E+17 ECU_ADDRESS 0x4000056E /end MEASUREMENT
/begin MEASUREMENT ETCReq_FiltFiltered "" FLOAT32_IEEE CompuMethod_2 1 0 -1E+17 1E+17 ECU_ADDRESS 0x40000572 /end MEASUREMENT
/begin MEASUREMENT ETCReqFallRate "Limits fall rate of ETCRequestFiltered." FLOAT32_IEEE CompuMethod_103 1 0 -1E+17 1E+17 ECU_ADDRESS 0x40000576 /end MEASUREMENT
/begin MEASUREMENT ETCReqFilterConst "" FLOAT32_IEEE CompuMethod_2 1 0 -1E+17 1E+17 ECU_ADDRESS 0x4000057A /end MEASUREMENT
/begin MEASUREMENT ETCReqRiseRate "Limits rise rate of ETCRequestFiltered." FLOAT32_IEEE CompuMethod_103 1 0 -1E+17 1E+17 ECU_ADDRESS 0x4000057E /end MEASUREMENT
/begin MEASUREMENT ETCRequest "Driver demand table" FLOAT32_IEEE CompuMethod_6 1 0 -1E+17 1E+17 ECU_ADDRESS 0x40000582 /end MEASUREMENT
/begin MEASUREMENT ETCRequestDirection "" UBYTE CompuMethod_34 1 0 0 1 ECU_ADDRESS 0x40000586 /end MEASUREMENT
/begin MEASUREMENT ETCRequestFinal "Final ETC request sent to ETC controller from Run state." FLOAT32_IEEE CompuMethod_50 1 0 -1E+17 1E+17 ECU_ADDRESS 0x40000587 /end MEASUREMENT
/begin MEASUREMENT Fan1Cmd "FAN 1 final request" FLOAT32_IEEE CompuMethod_6 1 0 -1E+17 1E+17 ECU_ADDRESS 0x400005BB /end MEASUREMENT
/begin MEASUREMENT Fan2Cmd "Fan 2 final command" FLOAT32_IEEE CompuMethod_6 1 0 -1E+17 1E+17 ECU_ADDRESS 0x400005C4 /end MEASUREMENT
/begin MEASUREMENT FilteredETCRequest "Final ETC request" FLOAT32_IEEE CompuMethod_6 1 0 -1E+17 1E+17 ECU_ADDRESS 0x400005E1 /end MEASUREMENT
/begin MEASUREMENT FuelAdapt_Error "Error in fuel flow at the current operating point, as compared to O2 sensor" FLOAT32_IEEE CompuMethod_2 1 0 -1E+17 1E+17 ECU_ADDRESS 0x40000646 /end MEASUREMENT
/begin MEASUREMENT FuelAdaptEnabled "Indicates whether FuelFlowComp map adapting is enabled" UBYTE CompuMethod_47 1 0 0 1 ECU_ADDRESS 0x4000064A /end MEASUREMENT
/begin MEASUREMENT FuelAdaptGain "Gain for updating FuelFlowComp map.  This fraction of the error is added to the map every 5ms." FLOAT32_IEEE CompuMethod_48 1 0 -1E+17 1E+17 ECU_ADDRESS 0x4000064B /end MEASUREMENT
/begin MEASUREMENT FuelFlowComp "Fuel Flow Compensation Multiplier - gain to adjust modelling errors in mechanical fuel system." FLOAT32_IEEE CompuMethod_33 1 0 -1E+17 1E+17 ECU_ADDRESS 0x40000657 /end MEASUREMENT
/begin MEASUREMENT FuelFlowCompAdapt "Adapt map based on O2 ITerm that is multiplied into FuelFlowComp." FLOAT32_IEEE CompuMethod_33 1 0 -1E+17 1E+17 ECU_ADDRESS 0x4000065B /end MEASUREMENT
/begin MEASUREMENT GlobalBaseFuelRate "Liquid fuel rate based on airflow and target equivalence ratio" FLOAT32_IEEE CompuMethod_30 1 0 -1E+17 1E+17 ECU_ADDRESS 0x4000069F /end MEASUREMENT
/begin MEASUREMENT IATFanSpeed "ECT Fan speed request" FLOAT32_IEEE CompuMethod_6 1 0 -1E+17 1E+17 ECU_ADDRESS 0x40000709 /end MEASUREMENT
/begin MEASUREMENT IATFanSpeed_Stall "IAT Fan speed request" FLOAT32_IEEE CompuMethod_6 1 0 -1E+17 1E+17 ECU_ADDRESS 0x4000070D /end MEASUREMENT
/begin MEASUREMENT IATFanSpeed_StallColIdx "IAT Fan speed request" UWORD CompuMethod_15 1 0 0 127.998 ECU_ADDRESS 0x40000711 /end MEASUREMENT
/begin MEASUREMENT IATFanSpeed_StallColIn "IAT Fan speed request" FLOAT32_IEEE CompuMethod_17 1 0 -1E+17 1E+17 ECU_ADDRESS 0x40000713 /end MEASUREMENT
/begin MEASUREMENT IATFanSpeed_StallRowIdx "IAT Fan speed request" UWORD CompuMethod_15 1 0 0 127.998 ECU_ADDRESS 0x40000717 /end MEASUREMENT
/begin MEASUREMENT IATFanSpeed_StallRowIn "IAT Fan speed request" FLOAT32_IEEE CompuMethod_127 1 0 -1E+17 1E+17 ECU_ADDRESS 0x40000719 /end MEASUREMENT
/begin MEASUREMENT IATFanSpeedColIdx "ECT Fan speed request" UWORD CompuMethod_15 1 0 0 127.998 ECU_ADDRESS 0x4000071D /end MEASUREMENT
/begin MEASUREMENT IATFanSpeedColIn "ECT Fan speed request" FLOAT32_IEEE CompuMethod_17 1 0 -1E+17 1E+17 ECU_ADDRESS 0x4000071F /end MEASUREMENT
/begin MEASUREMENT IATFanSpeedRowIdx "ECT Fan speed request" UWORD CompuMethod_15 1 0 0 127.998 ECU_ADDRESS 0x40000723 /end MEASUREMENT
/begin MEASUREMENT IATFanSpeedRowIn "ECT Fan speed request" FLOAT32_IEEE CompuMethod_127 1 0 -1E+17 1E+17 ECU_ADDRESS 0x40000725 /end MEASUREMENT
/begin MEASUREMENT IdleHandOffMult "" FLOAT32_IEEE CompuMethod_2 1 0 -1E+17 1E+17 ECU_ADDRESS 0x4000072F /end MEASUREMENT
/begin MEASUREMENT MaxETCSetPtLimit "Maximum allowable ETC position." FLOAT32_IEEE CompuMethod_6 1 0 -1E+17 1E+17 ECU_ADDRESS 0x40000866 /end MEASUREMENT
/begin MEASUREMENT MinGovReset "" UBYTE CompuMethod_11 1 0 0 1 ECU_ADDRESS 0x400008A8 /end MEASUREMENT
/begin MEASUREMENT O2_EquivRatio_Avg "" FLOAT32_IEEE CompuMethod_2 1 0 -1E+17 1E+17 ECU_ADDRESS 0x40000A44 /end MEASUREMENT
/begin MEASUREMENT PerCylBaseFuelRate "Liquid fuel mass flow rate based on airflow and target equivalence ratio per cylinder." FLOAT32_IEEE CompuMethod_30 1 0 -1E+17 1E+17 ECU_ADDRESS 0x40000ABD /end MEASUREMENT
/begin MEASUREMENT RPMAccel17Idx "" UWORD CompuMethod_15 1 0 0 127.998 ECU_ADDRESS 0x40000AFB /end MEASUREMENT
/begin MEASUREMENT RPMAccel17In "" FLOAT32_IEEE CompuMethod_2 1 0 -1E+17 1E+17 ECU_ADDRESS 0x40000AFD /end MEASUREMENT
/begin MEASUREMENT SpkMinGovOutput "" FLOAT32_IEEE CompuMethod_2 1 0 -1E+17 1E+17 ECU_ADDRESS 0x40000B4A /end MEASUREMENT
/begin MEASUREMENT TimeSinceRun09Idx "" UWORD CompuMethod_15 1 0 0 127.998 ECU_ADDRESS 0x40000B93 /end MEASUREMENT
/begin MEASUREMENT TimeSinceRun09In "" FLOAT32_IEEE CompuMethod_2 1 0 -1E+17 1E+17 ECU_ADDRESS 0x40000B95 /end MEASUREMENT
/begin MEASUREMENT TPS1_FiltDirection "" UBYTE CompuMethod_34 1 0 0 1 ECU_ADDRESS 0x40000BD4 /end MEASUREMENT
/begin MEASUREMENT TPS1_FiltFilterConst "" FLOAT32_IEEE CompuMethod_2 1 0 -1E+17 1E+17 ECU_ADDRESS 0x40000BD5 /end MEASUREMENT
/begin MEASUREMENT TPS1_FiltFiltered "" FLOAT32_IEEE CompuMethod_2 1 0 -1E+17 1E+17 ECU_ADDRESS 0x40000BD9 /end MEASUREMENT
/begin MEASUREMENT TPS2_FiltDirection "" UBYTE CompuMethod_34 1 0 0 1 ECU_ADDRESS 0x40000BF1 /end MEASUREMENT
/begin MEASUREMENT TPS2_FiltFilterConst "" FLOAT32_IEEE CompuMethod_2 1 0 -1E+17 1E+17 ECU_ADDRESS 0x40000BF2 /end MEASUREMENT
/begin MEASUREMENT TPS2_FiltFiltered "" FLOAT32_IEEE CompuMethod_2 1 0 -1E+17 1E+17 ECU_ADDRESS 0x40000BF6 /end MEASUREMENT
/begin CHARACTERISTIC AC_new "Override actuator, in engineering units" VALUE 0x80000051 RecordLayout_1 0 CompuMethod_4 0 1 /end CHARACTERISTIC
/begin CHARACTERISTIC AC_ovr "" VALUE 0x80000052 RecordLayout_1 0 CompuMethod_5 0 1 /end CHARACTERISTIC
/begin CHARACTERISTIC AC_Polarity "Inverts the output of the actuator relative to the desired command - 0 = High True    1 = Low True" VALUE 0x80000053 RecordLayout_1 0 CompuMethod_4 0 1 /end CHARACTERISTIC
/begin CHARACTERISTIC AC_TPSOff "Throttle position at which AC gets disengaged" VALUE 0x80000054 RecordLayout_4 0 CompuMethod_6 -1E+17 1E+17 /end CHARACTERISTIC
/begin CHARACTERISTIC AC_TPSOn "Throttle position at which AC gets engaged" VALUE 0x80000058 RecordLayout_4 0 CompuMethod_6 -1E+17 1E+17 /end CHARACTERISTIC
/begin CHARACTERISTIC ACAirFlowOfst_Enab "Enables AC airflow adder" VALUE 0x8000005C RecordLayout_1 0 CompuMethod_7 0 255 /end CHARACTERISTIC
/begin CHARACTERISTIC ACAirFlowOfstTbl "AC air position in based on ECT." CURVE 0x8000005D RecordLayout_4 0 CompuMethod_6 -1E+17 1E+17
 /begin AXIS_DESCR COM_AXIS ACPres05In CompuMethod_8 5 -150 10000 AXIS_PTS_REF ACPres05IdxArr /end AXIS_DESCR
/end CHARACTERISTIC
/begin CHARACTERISTIC ACHighPresOffTbl "AC pressure that the AC turns off at high" CURVE 0x80000071 RecordLayout_4 0 CompuMethod_8 -1E+17 1E+17
 /begin AXIS_DESCR COM_AXIS IAT_KeyUp09In CompuMethod_27 9 -1E+17 1E+17 AXIS_PTS_REF IAT_KeyUp09IdxArr /end AXIS_DESCR
/end CHARACTERISTIC
/begin CHARACTERISTIC ACHighPresOnTbl "AC pressure that the AC turns on at high" CURVE 0x80000095 RecordLayout_4 0 CompuMethod_8 -1E+17 1E+17
 /begin AXIS_DESCR COM_AXIS IAT_KeyUp09In CompuMethod_27 9 -1E+17 1E+17 AXIS_PTS_REF IAT_KeyUp09IdxArr /end AXIS_DESCR
/end CHARACTERISTIC
/begin CHARACTERISTIC ACHighPressureDisable "Pressure when ac gets disabled" VALUE 0x800000B9 RecordLayout_4 0 CompuMethod_9 -1E+17 1E+17 /end CHARACTERISTIC
/begin CHARACTERISTIC ACHighPressureTime "After high pressure level reached for this time ACChargeHigh_Fault becomes active" VALUE 0x800000BD RecordLayout_4 0 CompuMethod_10 0 1E+17 /end CHARACTERISTIC
/begin CHARACTERISTIC ACLowPresOffTbl "AC pressure that the AC turns off at low" CURVE 0x800000C1 RecordLayout_4 0 CompuMethod_8 -1E+17 1E+17
 /begin AXIS_DESCR COM_AXIS IAT_KeyUp09In CompuMethod_27 9 -1E+17 1E+17 AXIS_PTS_REF IAT_KeyUp09IdxArr /end AXIS_DESCR
/end CHARACTERISTIC
/begin CHARACTERISTIC ACLowPresOnTbl "AC pressure that the AC turns on at low" CURVE 0x800000E5 RecordLayout_4 0 CompuMethod_8 -1E+17 1E+17
 /begin AXIS_DESCR COM_AXIS IAT_KeyUp09In CompuMethod_27 9 -1E+17 1E+17 AXIS_PTS_REF IAT_KeyUp09IdxArr /end AXIS_DESCR
/end CHARACTERISTIC
/begin CHARACTERISTIC ACLowPressureDisable "Pressure when ac gets disabled" VALUE 0x80000109 RecordLayout_4 0 CompuMethod_9 -1E+17 1E+17 /end CHARACTERISTIC
/begin CHARACTERISTIC ACLowPressureTime "After low pressure level reached for this time ACChargeLow_Fault becomes active" VALUE 0x8000010D RecordLayout_4 0 CompuMethod_10 0 1E+17 /end CHARACTERISTIC
/begin CHARACTERISTIC ACPin "Digital output pin selection for DOut9005p0001" VALUE 0x80000111 RecordLayout_5 0 CompuMethod_12 -32768 32767 /end CHARACTERISTIC
/begin CHARACTERISTIC ACPres_new "Override result of linear sensor characterization, in engineering units" VALUE 0x80000113 RecordLayout_4 0 CompuMethod_14 -1E+17 1E+17 /end CHARACTERISTIC
/begin CHARACTERISTIC ACPres_ovr "" VALUE 0x80000117 RecordLayout_1 0 CompuMethod_5 0 1 /end CHARACTERISTIC
/begin CHARACTERISTIC ACPresDfltValue "This is the initial default value should the sensor be in fault on key-up.  Otherwise the sensors outputs the last value prior to faulting" VALUE 0x8000012C RecordLayout_4 0 CompuMethod_14 -1E+17 1E+17 /end CHARACTERISTIC
/begin CHARACTERISTIC ACPresFanOff "AC pressure when the fan turns off" VALUE 0x80000130 RecordLayout_4 0 CompuMethod_9 -1E+17 1E+17 /end CHARACTERISTIC
/begin CHARACTERISTIC ACPresFanOn "AC pressure when the fan turns on" VALUE 0x80000134 RecordLayout_4 0 CompuMethod_9 -1E+17 1E+17 /end CHARACTERISTIC
/begin CHARACTERISTIC ACPresFanSpeed_StallMap "ACPres Fan speed request" MAP 0x80000154 RecordLayout_4 0 CompuMethod_6 0 100
 /begin AXIS_DESCR COM_AXIS ACPresFanSpeed_StallColIn CompuMethod_17 7 0 300 AXIS_PTS_REF ACPresFanSpeed_StallColIdxArr /end AXIS_DESCR
 /begin AXIS_DESCR COM_AXIS ACPresFanSpeed_StallRowIn CompuMethod_18 7 0 1000 AXIS_PTS_REF ACPresFanSpeed_StallRowIdxArr /end AXIS_DESCR
/end CHARACTERISTIC
/begin CHARACTERISTIC ACPresFanSpeedMap "ACPres Fan speed request" MAP 0x80000250 RecordLayout_4 0 CompuMethod_6 0 100
 /begin AXIS_DESCR COM_AXIS ACPresFanSpeedColIn CompuMethod_17 7 0 300 AXIS_PTS_REF ACPresFanSpeedColIdxArr /end AXIS_DESCR
 /begin AXIS_DESCR COM_AXIS ACPresFanSpeedRowIn CompuMethod_19 7 0 1000 AXIS_PTS_REF ACPresFanSpeedRowIdxArr /end AXIS_DESCR
/end CHARACTERISTIC
/begin CHARACTERISTIC ACPresFilterConst "Filter time constant" VALUE 0x80000330 RecordLayout_4 0 CompuMethod_20 -1E+17 1E+17 /end CHARACTERISTIC
/begin CHARACTERISTIC ACPresGain "Scaling from A/D counts to engineering units" VALUE 0x80000334 RecordLayout_4 0 CompuMethod_21 -1E+17 1E+17 /end CHARACTERISTIC
/begin CHARACTERISTIC ACPresInputHiFltPos "Maximum allowable input, indicating short or open circuit" VALUE 0x80000338 RecordLayout_4 0 CompuMethod_22 -1E+17 1E+17 /end CHARACTERISTIC
/begin CHARACTERISTIC ACPresInputLoFltPos "Minimum allowable input, indicating short or open circuit" VALUE 0x8000033C RecordLayout_4 0 CompuMethod_22 -1E+17 1E+17 /end CHARACTERISTIC
/begin CHARACTERISTIC ACPresOfst "Offset after gain in engineering units" VALUE 0x80000340 RecordLayout_4 0 CompuMethod_14 -1E+17 1E+17 /end CHARACTERISTIC
/begin CHARACTERISTIC ACPresPin "Analog input pin selection for ACPresPin" VALUE 0x80000344 RecordLayout_5 0 CompuMethod_23 -32768 32767 /end CHARACTERISTIC
/begin CHARACTERISTIC ACPresPin_ref "Reference Voltage Selection" VALUE 0x80000346 RecordLayout_1 0 CompuMethod_24 0 255 /end CHARACTERISTIC
/begin CHARACTERISTIC ACSpdFastOff "Engine speed at which the compressor turns off at high side" VALUE 0x80000347 RecordLayout_4 0 CompuMethod_25 -1E+17 1E+17 /end CHARACTERISTIC
/begin CHARACTERISTIC ACSpdFastOn "Engine speed at which the compressor turns on at high side" VALUE 0x8000034B RecordLayout_4 0 CompuMethod_25 -1E+17 1E+17 /end CHARACTERISTIC
/begin CHARACTERISTIC ACSpdSlowOff "Engine speed at which the compressor turns off at low side" VALUE 0x8000034F RecordLayout_4 0 CompuMethod_25 -1E+17 1E+17 /end CHARACTERISTIC
/begin CHARACTERISTIC ACSpdSlowOn "Engine speed at which the compressor turns on at low side" VALUE 0x80000353 RecordLayout_4 0 CompuMethod_25 -1E+17 1E+17 /end CHARACTERISTIC
/begin CHARACTERISTIC ACSw_new "Override actuator, in engineering units" VALUE 0x80000357 RecordLayout_1 0 CompuMethod_26 0 1 /end CHARACTERISTIC
/begin CHARACTERISTIC ACSw_ovr "" VALUE 0x80000358 RecordLayout_1 0 CompuMethod_5 0 1 /end CHARACTERISTIC
/begin CHARACTERISTIC ACSwFanSpeed "Fan speed % req for AC Sw 0 to disable" VALUE 0x80000359 RecordLayout_4 0 CompuMethod_6 0 100 /end CHARACTERISTIC
/begin CHARACTERISTIC ACSwFanSpeed_Stall "Fan speed % req for AC Sw 0 to disable" VALUE 0x8000035D RecordLayout_4 0 CompuMethod_6 0 100 /end CHARACTERISTIC
/begin CHARACTERISTIC ACSwPin "Analog input pin selection for ACSwPin" VALUE 0x80000361 RecordLayout_5 0 CompuMethod_23 -32768 32767 /end CHARACTERISTIC
/begin CHARACTERISTIC ACSwPin_ref "Reference Voltage Selection" VALUE 0x80000363 RecordLayout_1 0 CompuMethod_24 0 255 /end CHARACTERISTIC
/begin CHARACTERISTIC ACSwPolarity "0 = High True    1 = Low True" VALUE 0x80000364 RecordLayout_1 0 CompuMethod_4 0 1 /end CHARACTERISTIC
/begin CHARACTERISTIC ACSwSwitchPt "Defines switch point in ADC units boolean conversion" VALUE 0x80000365 RecordLayout_4 0 CompuMethod_22 -1E+17 1E+17 /end CHARACTERISTIC
/begin CHARACTERISTIC ACTempOffTbl "AC evap temp that the compressor turns on at" CURVE 0x80000369 RecordLayout_4 0 CompuMethod_27 -1E+17 1E+17
 /begin AXIS_DESCR COM_AXIS IAT_KeyUp09In CompuMethod_27 9 -1E+17 1E+17 AXIS_PTS_REF IAT_KeyUp09IdxArr /end AXIS_DESCR
/end CHARACTERISTIC
/begin CHARACTERISTIC ACTempOnTbl "AC evap temp that the compressor turns on at" CURVE 0x8000038D RecordLayout_4 0 CompuMethod_27 -1E+17 1E+17
 /begin AXIS_DESCR COM_AXIS IAT_KeyUp09In CompuMethod_27 9 -1E+17 1E+17 AXIS_PTS_REF IAT_KeyUp09IdxArr /end AXIS_DESCR
/end CHARACTERISTIC
/begin CHARACTERISTIC ACTimeFromStartDelay "Time from start AC enable delay" VALUE 0x800003B1 RecordLayout_4 0 CompuMethod_28 0 1E+17 /end CHARACTERISTIC
/begin CHARACTERISTIC AdaptEnable "Determines whether the FuelFlowComp map will be adapted using the MAF sensor" VALUE 0x800003B5 RecordLayout_1 0 CompuMethod_29 0 1 /end CHARACTERISTIC
/begin CHARACTERISTIC AirControlSource "Selects source of idle air control" VALUE 0x800003B6 RecordLayout_1 0 CompuMethod_32 0 1 /end CHARACTERISTIC
/begin CHARACTERISTIC AirMinGovDGain "Base D-gain for the min. governor controller." VALUE 0x800003B7 RecordLayout_4 0 CompuMethod_33 -1E+17 1E+17 /end CHARACTERISTIC
/begin CHARACTERISTIC AirMinGovDGainErrorMultTbl "" CURVE 0x800003BB RecordLayout_4 0 CompuMethod_33 -1E+17 1E+17
 /begin AXIS_DESCR COM_AXIS AirMinGovSpeedErrorIn CompuMethod_2 9 -1E+17 1E+17 AXIS_PTS_REF AirMinGovSpeedErrorIdxArr /end AXIS_DESCR
/end CHARACTERISTIC
/begin CHARACTERISTIC AirMinGovErrorGain "Error gain for the min governor controller. This gain is applied to the RPM error term before it is used to calculate the P, I and D terms." VALUE 0x800003DF RecordLayout_4 0 CompuMethod_33 -1E+17 1E+17 /end CHARACTERISTIC
/begin CHARACTERISTIC AirMinGovIGain "Base I-gain for the min. governor controller." VALUE 0x800003E3 RecordLayout_4 0 CompuMethod_33 -1E+17 1E+17 /end CHARACTERISTIC
/begin CHARACTERISTIC AirMinGovIGainErrorMultTbl "" CURVE 0x800003E7 RecordLayout_4 0 CompuMethod_33 -1E+17 1E+17
 /begin AXIS_DESCR COM_AXIS AirMinGovSpeedErrorIn CompuMethod_2 9 -1E+17 1E+17 AXIS_PTS_REF AirMinGovSpeedErrorIdxArr /end AXIS_DESCR
/end CHARACTERISTIC
/begin CHARACTERISTIC AirMinGovITermLowerLimit "Lower limit on Air Min Governor I-term value." VALUE 0x8000040B RecordLayout_4 0 CompuMethod_6 -1E+17 1E+17 /end CHARACTERISTIC
/begin CHARACTERISTIC AirMinGovITermUpperLimit "Upper limit on Air Min Governor I-term value." VALUE 0x8000040F RecordLayout_4 0 CompuMethod_6 -1E+17 1E+17 /end CHARACTERISTIC
/begin CHARACTERISTIC AirMinGovPGain "Base P-gain for the min. governor controller." VALUE 0x80000413 RecordLayout_4 0 CompuMethod_33 -1E+17 1E+17 /end CHARACTERISTIC
/begin CHARACTERISTIC AirMinGovPGainErrorMultTbl "" CURVE 0x80000417 RecordLayout_4 0 CompuMethod_33 -1E+17 1E+17
 /begin AXIS_DESCR COM_AXIS AirMinGovSpeedErrorIn CompuMethod_2 9 -1E+17 1E+17 AXIS_PTS_REF AirMinGovSpeedErrorIdxArr /end AXIS_DESCR
/end CHARACTERISTIC
/begin CHARACTERISTIC AirMinGovPIDOutLowerLimit "Lower limit on air min governor PID Output." VALUE 0x8000043B RecordLayout_4 0 CompuMethod_6 -1E+17 1E+17 /end CHARACTERISTIC
/begin CHARACTERISTIC AirMinGovPIDOutUpperLimit "Upper limit on air min governor PID Output." VALUE 0x8000043F RecordLayout_4 0 CompuMethod_6 -1E+17 1E+17 /end CHARACTERISTIC
/begin CHARACTERISTIC APP_AdaptMode "" VALUE 0x80000467 RecordLayout_1 0 CompuMethod_7 0 255 /end CHARACTERISTIC
/begin CHARACTERISTIC APP_FiltDecFiltC "Filter time constant for a decreasing signal." VALUE 0x80000468 RecordLayout_4 0 CompuMethod_20 -1E+17 1E+17 /end CHARACTERISTIC
/begin CHARACTERISTIC APP_FiltIncFiltC "Filter time constant for a increasing signal." VALUE 0x8000046C RecordLayout_4 0 CompuMethod_20 -1E+17 1E+17 /end CHARACTERISTIC
/begin CHARACTERISTIC APP1_Adapt_new "Override result of linear sensor characterization, in engineering units" VALUE 0x80000484 RecordLayout_4 0 CompuMethod_6 -1E+17 1E+17 /end CHARACTERISTIC
/begin CHARACTERISTIC APP1_Adapt_ovr "" VALUE 0x80000488 RecordLayout_1 0 CompuMethod_5 0 1 /end CHARACTERISTIC
/begin CHARACTERISTIC APP1_AdaptAdapt_Delta "Specifies the minimum deviation amount to react to." VALUE 0x80000489 RecordLayout_4 0 CompuMethod_22 -1E+17 1E+17 /end CHARACTERISTIC
/begin CHARACTERISTIC APP1_AdaptAdapt_Hi_Max "Specifies for the maximum value of the upper adapt range." VALUE 0x8000048D RecordLayout_4 0 CompuMethod_35 -1E+17 1E+17 /end CHARACTERISTIC
/begin CHARACTERISTIC APP1_AdaptAdapt_Hi_Min "Specifies for the minimum value of the upper adapt range." VALUE 0x80000491 RecordLayout_4 0 CompuMethod_35 -1E+17 1E+17 /end CHARACTERISTIC
/begin CHARACTERISTIC APP1_AdaptAdapt_Low_Max "Specifies for the maximum value of the lower adapt range." VALUE 0x80000495 RecordLayout_4 0 CompuMethod_35 -1E+17 1E+17 /end CHARACTERISTIC
/begin CHARACTERISTIC APP1_AdaptAdapt_Low_Min "Specifies for the minimum value of the lower adapt range." VALUE 0x80000499 RecordLayout_4 0 CompuMethod_35 -1E+17 1E+17 /end CHARACTERISTIC
/begin CHARACTERISTIC APP1_AdaptAdaptHiEnable "Enables or disables this adapt." VALUE 0x8000049D RecordLayout_1 0 CompuMethod_36 0 1 /end CHARACTERISTIC
/begin CHARACTERISTIC APP1_AdaptAdaptLoEnable "Enables or disables this adapt." VALUE 0x8000049E RecordLayout_1 0 CompuMethod_36 0 1 /end CHARACTERISTIC
/begin CHARACTERISTIC APP1_AdaptDfltValue "This is the initial default value should the sensor be in fault on key-up.  Otherwise the sensors outputs the last value prior to faulting" VALUE 0x8000049F RecordLayout_4 0 CompuMethod_6 -1E+17 1E+17 /end CHARACTERISTIC
/begin CHARACTERISTIC APP1_AdaptFilterConst "Filter time constant" VALUE 0x800004A3 RecordLayout_4 0 CompuMethod_20 -1E+17 1E+17 /end CHARACTERISTIC
/begin CHARACTERISTIC APP1_AdaptInputHiFltPos "Hi limit of input signal which sets fault" VALUE 0x800004A7 RecordLayout_4 0 CompuMethod_22 -1E+17 1E+17 /end CHARACTERISTIC
/begin CHARACTERISTIC APP1_AdaptInputLoFltPos "Low limit of input signal which sets fault" VALUE 0x800004AB RecordLayout_4 0 CompuMethod_22 -1E+17 1E+17 /end CHARACTERISTIC
/begin CHARACTERISTIC APP1_AdaptMaxLimit "Sets the upper limit on the potentiometer range." VALUE 0x800004AF RecordLayout_4 0 CompuMethod_6 -1E+17 1E+17 /end CHARACTERISTIC
/begin CHARACTERISTIC APP1_AdaptRev_Polarity "1 = Reverse Polarity (Smaller voltage values indicate larger % travel)" VALUE 0x800004B3 RecordLayout_1 0 CompuMethod_37 0 1 /end CHARACTERISTIC
/begin CHARACTERISTIC APP1_APP2_Max_Deviation "Specifies the maximum allowable deviation between the two sensors" VALUE 0x800004B4 RecordLayout_4 0 CompuMethod_38 -1E+17 1E+17 /end CHARACTERISTIC
/begin CHARACTERISTIC APP1_new "Override result of linear sensor characterization, in engineering units" VALUE 0x800004B8 RecordLayout_4 0 CompuMethod_6 -1E+17 1E+17 /end CHARACTERISTIC
/begin CHARACTERISTIC APP1_ovr "" VALUE 0x800004BC RecordLayout_1 0 CompuMethod_5 0 1 /end CHARACTERISTIC
/begin CHARACTERISTIC APP1AnalogInput "Analog input pin selection for APP1AnalogInput" VALUE 0x80000501 RecordLayout_5 0 CompuMethod_23 -32768 32767 /end CHARACTERISTIC
/begin CHARACTERISTIC APP1AnalogInput_ref "Reference Voltage Selection" VALUE 0x80000503 RecordLayout_1 0 CompuMethod_24 0 255 /end CHARACTERISTIC
/begin CHARACTERISTIC APP1Default "This is the initial default value should the sensor be in fault on key-up.  Otherwise the sensors outputs the last value prior to faulting" VALUE 0x80000504 RecordLayout_4 0 CompuMethod_6 -1E+17 1E+17 /end CHARACTERISTIC
/begin CHARACTERISTIC APP1FiltConst "Filter time constant" VALUE 0x80000508 RecordLayout_4 0 CompuMethod_20 -1E+17 1E+17 /end CHARACTERISTIC
/begin CHARACTERISTIC APP1HiAdaptADCThresh "Sets the ADC limit above which a high-side adapt will be captured on key-up." VALUE 0x8000050C RecordLayout_4 0 CompuMethod_22 -1E+17 1E+17 /end CHARACTERISTIC
/begin CHARACTERISTIC APP1LowAdaptADCThresh "Sets the ADC limit below which a low-side adapt will be captured on key-up." VALUE 0x80000534 RecordLayout_4 0 CompuMethod_22 -1E+17 1E+17 /end CHARACTERISTIC
/begin CHARACTERISTIC APP1Max "Maximum allowable input, indicating short or open circuit" VALUE 0x80000538 RecordLayout_4 0 CompuMethod_22 -1E+17 1E+17 /end CHARACTERISTIC
/begin CHARACTERISTIC APP1MaxLimit "Sets the upper limit on the potentiometer range." VALUE 0x8000053C RecordLayout_4 0 CompuMethod_6 -1E+17 1E+17 /end CHARACTERISTIC
/begin CHARACTERISTIC APP1Min "Minimum allowable input, indicating short or open circuit" VALUE 0x80000540 RecordLayout_4 0 CompuMethod_22 -1E+17 1E+17 /end CHARACTERISTIC
/begin CHARACTERISTIC APP1Tbl "Look up table to allownon-linear characterization of sensors" CURVE 0x80000544 RecordLayout_4 0 CompuMethod_6 -1E+17 1E+17
 /begin AXIS_DESCR COM_AXIS APP1ADC CompuMethod_22 9 -1E+17 1E+17 AXIS_PTS_REF APP1IdxArr /end AXIS_DESCR
/end CHARACTERISTIC
/begin CHARACTERISTIC APP2_Adapt_new "Override result of linear sensor characterization, in engineering units" VALUE 0x80000568 RecordLayout_4 0 CompuMethod_6 -1E+17 1E+17 /end CHARACTERISTIC
/begin CHARACTERISTIC APP2_Adapt_ovr "" VALUE 0x8000056C RecordLayout_1 0 CompuMethod_5 0 1 /end CHARACTERISTIC
/begin CHARACTERISTIC APP2_AdaptAdapt_Delta "Specifies the minimum deviation amount to react to." VALUE 0x8000056D RecordLayout_4 0 CompuMethod_22 -1E+17 1E+17 /end CHARACTERISTIC
/begin CHARACTERISTIC APP2_AdaptAdapt_Hi_Max "Specifies for the maximum value of the upper adapt range." VALUE 0x80000571 RecordLayout_4 0 CompuMethod_35 -1E+17 1E+17 /end CHARACTERISTIC
/begin CHARACTERISTIC APP2_AdaptAdapt_Hi_Min "Specifies for the minimum value of the upper adapt range." VALUE 0x80000575 RecordLayout_4 0 CompuMethod_35 -1E+17 1E+17 /end CHARACTERISTIC
/begin CHARACTERISTIC APP2_AdaptAdapt_Low_Max "Specifies for the maximum value of the lower adapt range." VALUE 0x80000579 RecordLayout_4 0 CompuMethod_35 -1E+17 1E+17 /end CHARACTERISTIC
/begin CHARACTERISTIC APP2_AdaptAdapt_Low_Min "Specifies for the minimum value of the lower adapt range." VALUE 0x8000057D RecordLayout_4 0 CompuMethod_35 -1E+17 1E+17 /end CHARACTERISTIC
/begin CHARACTERISTIC APP2_AdaptAdaptHiEnable "Enables or disables this adapt." VALUE 0x80000581 RecordLayout_1 0 CompuMethod_36 0 1 /end CHARACTERISTIC
/begin CHARACTERISTIC APP2_AdaptAdaptLoEnable "Enables or disables this adapt." VALUE 0x80000582 RecordLayout_1 0 CompuMethod_36 0 1 /end CHARACTERISTIC
/begin CHARACTERISTIC APP2_AdaptDfltValue "This is the initial default value should the sensor be in fault on key-up.  Otherwise the sensors outputs the last value prior to faulting" VALUE 0x80000583 RecordLayout_4 0 CompuMethod_6 -1E+17 1E+17 /end CHARACTERISTIC
/begin CHARACTERISTIC APP2_AdaptFilterConst "Filter time constant" VALUE 0x80000587 RecordLayout_4 0 CompuMethod_20 -1E+17 1E+17 /end CHARACTERISTIC
/begin CHARACTERISTIC APP2_AdaptInputHiFltPos "Hi limit of input signal which sets fault" VALUE 0x8000058B RecordLayout_4 0 CompuMethod_22 -1E+17 1E+17 /end CHARACTERISTIC
/begin CHARACTERISTIC APP2_AdaptInputLoFltPos "Low limit of input signal which sets fault" VALUE 0x8000058F RecordLayout_4 0 CompuMethod_22 -1E+17 1E+17 /end CHARACTERISTIC
/begin CHARACTERISTIC APP2_AdaptMaxLimit "Sets the upper limit on the potentiometer range." VALUE 0x80000593 RecordLayout_4 0 CompuMethod_6 -1E+17 1E+17 /end CHARACTERISTIC
/begin CHARACTERISTIC APP2_AdaptRev_Polarity "1 = Reverse Polarity (Smaller voltage values indicate larger % travel)" VALUE 0x80000597 RecordLayout_1 0 CompuMethod_37 0 1 /end CHARACTERISTIC
/begin CHARACTERISTIC APP2_new "Override result of linear sensor characterization, in engineering units" VALUE 0x80000598 RecordLayout_4 0 CompuMethod_6 -1E+17 1E+17 /end CHARACTERISTIC
/begin CHARACTERISTIC APP2_ovr "" VALUE 0x8000059C RecordLayout_1 0 CompuMethod_5 0 1 /end CHARACTERISTIC
/begin CHARACTERISTIC APP2AnalogInput "Analog input pin selection for APP2AnalogInput" VALUE 0x8000059D RecordLayout_5 0 CompuMethod_23 -32768 32767 /end CHARACTERISTIC
/begin CHARACTERISTIC APP2AnalogInput_ref "Reference Voltage Selection" VALUE 0x8000059F RecordLayout_1 0 CompuMethod_24 0 255 /end CHARACTERISTIC
/begin CHARACTERISTIC APP2Default "This is the initial default value should the sensor be in fault on key-up.  Otherwise the sensors outputs the last value prior to faulting" VALUE 0x800005A0 RecordLayout_4 0 CompuMethod_6 -1E+17 1E+17 /end CHARACTERISTIC
/begin CHARACTERISTIC APP2FiltConst "Filter time constant" VALUE 0x800005A4 RecordLayout_4 0 CompuMethod_20 -1E+17 1E+17 /end CHARACTERISTIC
/begin CHARACTERISTIC APP2HiAdaptADCThresh "Sets the ADC limit above which a high-side adapt will be captured on key-up." VALUE 0x800005A8 RecordLayout_4 0 CompuMethod_22 -1E+17 1E+17 /end CHARACTERISTIC
/begin CHARACTERISTIC APP2LowAdaptADCThresh "Sets the ADC limit below which a low-side adapt will be captured on key-up." VALUE 0x800005D0 RecordLayout_4 0 CompuMethod_22 -1E+17 1E+17 /end CHARACTERISTIC
/begin CHARACTERISTIC APP2Max "Maximum allowable input, indicating short or open circuit" VALUE 0x800005D4 RecordLayout_4 0 CompuMethod_22 -1E+17 1E+17 /end CHARACTERISTIC
/begin CHARACTERISTIC APP2MaxLimit "Sets the upper limit on the potentiometer range." VALUE 0x800005D8 RecordLayout_4 0 CompuMethod_6 -1E+17 1E+17 /end CHARACTERISTIC
/begin CHARACTERISTIC APP2Min "Minimum allowable input, indicating short or open circuit" VALUE 0x800005DC RecordLayout_4 0 CompuMethod_22 -1E+17 1E+17 /end CHARACTERISTIC
/begin CHARACTERISTIC APP2Tbl "Look up table to allownon-linear characterization of sensors" CURVE 0x800005E0 RecordLayout_4 0 CompuMethod_6 -1E+17 1E+17
 /begin AXIS_DESCR COM_AXIS APP2ADC CompuMethod_22 9 -1E+17 1E+17 AXIS_PTS_REF APP2IdxArr /end AXIS_DESCR
/end CHARACTERISTIC
/begin CHARACTERISTIC ApplicationMonitorEnable "Enables runtime checking of stack, heap, CPU, and OS errors.  Stops the application on error." VALUE 0x80000604 RecordLayout_1 0 CompuMethod_7 0 1 /end CHARACTERISTIC
/begin CHARACTERISTIC ApplicationPausePoint "Selects the startup pause point, for debugging.  Can be moved forward to step through the initialization" VALUE 0x80000605 RecordLayout_1 0 CompuMethod_40 0 3 /end CHARACTERISTIC
/begin CHARACTERISTIC ApplicationStatus "View and set the application runtime status" VALUE 0x80000606 RecordLayout_1 0 CompuMethod_41 1 3 /end CHARACTERISTIC
/begin CHARACTERISTIC Bank1_DataValidState_Ovr_new "" VALUE 0x80000607 RecordLayout_4 0 CompuMethod_2 -1E+17 1E+17 /end CHARACTERISTIC
/begin CHARACTERISTIC Bank1_DataValidState_Ovr_ovr "" VALUE 0x8000060B RecordLayout_1 0 CompuMethod_5 0 1 /end CHARACTERISTIC
/begin CHARACTERISTIC Bank1_EquivRatio_new "Override result of linear sensor characterization, in engineering units" VALUE 0x8000060C RecordLayout_4 0 CompuMethod_44 -1E+17 1E+17 /end CHARACTERISTIC
/begin CHARACTERISTIC Bank1_EquivRatio_ovr "" VALUE 0x80000610 RecordLayout_1 0 CompuMethod_5 0 1 /end CHARACTERISTIC
/begin CHARACTERISTIC Bank1_EquivRatioDfltValue "This is the initial default value should the sensor be in fault on key-up.  Otherwise the sensors outputs the last value prior to faulting" VALUE 0x80000611 RecordLayout_4 0 CompuMethod_44 -1E+17 1E+17 /end CHARACTERISTIC
/begin CHARACTERISTIC Bank1_EquivRatioFilterConst "Filter time constant" VALUE 0x80000615 RecordLayout_4 0 CompuMethod_20 -1E+17 1E+17 /end CHARACTERISTIC
/begin CHARACTERISTIC Bank1_EquivRatioGain "Scaling from A/D counts to engineering units" VALUE 0x80000619 RecordLayout_4 0 CompuMethod_45 -1E+17 1E+17 /end CHARACTERISTIC
/begin CHARACTERISTIC Bank1_EquivRatioInputHiFltPos "Maximum allowable input, indicating short or open circuit" VALUE 0x8000061D RecordLayout_4 0 CompuMethod_44 -1E+17 1E+17 /end CHARACTERISTIC
/begin CHARACTERISTIC Bank1_EquivRatioInputLoFltPos "Minimum allowable input, indicating short or open circuit" VALUE 0x80000621 RecordLayout_4 0 CompuMethod_44 -1E+17 1E+17 /end CHARACTERISTIC
/begin CHARACTERISTIC Bank1_EquivRatioOfst "Offset after gain in engineering units" VALUE 0x80000625 RecordLayout_4 0 CompuMethod_44 -1E+17 1E+17 /end CHARACTERISTIC
/begin CHARACTERISTIC Bank1_HeaterVolts_Ovr_new "" VALUE 0x80000629 RecordLayout_4 0 CompuMethod_2 -1E+17 1E+17 /end CHARACTERISTIC
/begin CHARACTERISTIC Bank1_HeaterVolts_Ovr_ovr "" VALUE 0x8000062D RecordLayout_1 0 CompuMethod_5 0 1 /end CHARACTERISTIC
/begin CHARACTERISTIC Bank1_Lambda_Ovr_new "" VALUE 0x8000062E RecordLayout_4 0 CompuMethod_2 -1E+17 1E+17 /end CHARACTERISTIC
/begin CHARACTERISTIC Bank1_Lambda_Ovr_ovr "" VALUE 0x80000632 RecordLayout_1 0 CompuMethod_5 0 1 /end CHARACTERISTIC
/begin CHARACTERISTIC Bank2_Enable "" VALUE 0x80000656 RecordLayout_1 0 CompuMethod_7 0 255 /end CHARACTERISTIC
/begin CHARACTERISTIC BaseAirflowOfstTbl "Base air position in based on ECT." CURVE 0x800006F3 RecordLayout_4 0 CompuMethod_6 -1E+17 1E+17
 /begin AXIS_DESCR COM_AXIS ECT05In CompuMethod_27 5 -40 200 AXIS_PTS_REF ECT05IdxArr /end AXIS_DESCR
/end CHARACTERISTIC
/begin CHARACTERISTIC BgndStackMargin "When the available stack space drops below this threshold, the application performs a safety stop" VALUE 0x8000085D RecordLayout_8 0 CompuMethod_52 0 2048 /end CHARACTERISTIC
/begin CHARACTERISTIC CATSensorPin "Analog input pin selection for CATSensorPin" VALUE 0x80000F2F RecordLayout_5 0 CompuMethod_23 -32768 32767 /end CHARACTERISTIC
/begin CHARACTERISTIC CATSensorPin_ref "Reference Voltage Selection" VALUE 0x80000F31 RecordLayout_1 0 CompuMethod_24 0 255 /end CHARACTERISTIC
/begin CHARACTERISTIC ClutchSw_Pin "Analog input pin selection for ClutchSw_Pin" VALUE 0x80001030 RecordLayout_5 0 CompuMethod_23 -32768 32767 /end CHARACTERISTIC
/begin CHARACTERISTIC ClutchSw_Pin_ref "Reference Voltage Selection" VALUE 0x80001032 RecordLayout_1 0 CompuMethod_24 0 255 /end CHARACTERISTIC
/begin CHARACTERISTIC CPUMargin "When the available CPU idle time drops below this threshold, the application performs a safety stop" VALUE 0x80001185 RecordLayout_8 0 CompuMethod_72 0 100 /end CHARACTERISTIC
/begin CHARACTERISTIC ECTFanOff "ECT temp when the fan turns off" VALUE 0x800020E1 RecordLayout_4 0 CompuMethod_27 -1E+17 1E+17 /end CHARACTERISTIC
/begin CHARACTERISTIC ECTFanOn "ECT temp when the fan turns on" VALUE 0x800020E5 RecordLayout_4 0 CompuMethod_27 -1E+17 1E+17 /end CHARACTERISTIC
/begin CHARACTERISTIC ECTFanSpeed_StallMap "ECT Fan speed request" MAP 0x80002105 RecordLayout_4 0 CompuMethod_6 0 100
 /begin AXIS_DESCR COM_AXIS ECTFanSpeed_StallColIn CompuMethod_17 7 0 300 AXIS_PTS_REF ECTFanSpeed_StallColIdxArr /end AXIS_DESCR
 /begin AXIS_DESCR COM_AXIS ECTFanSpeed_StallRowIn CompuMethod_81 7 -40 250 AXIS_PTS_REF ECTFanSpeed_StallRowIdxArr /end AXIS_DESCR
/end CHARACTERISTIC
/begin CHARACTERISTIC ECTFanSpeedMap "ECT Fan speed request" MAP 0x80002201 RecordLayout_4 0 CompuMethod_6 0 100
 /begin AXIS_DESCR COM_AXIS ECTFanSpeedColIn CompuMethod_17 7 0 300 AXIS_PTS_REF ECTFanSpeedColIdxArr /end AXIS_DESCR
 /begin AXIS_DESCR COM_AXIS ECTFanSpeedRowIn CompuMethod_81 7 -40 250 AXIS_PTS_REF ECTFanSpeedRowIdxArr /end AXIS_DESCR
/end CHARACTERISTIC
/begin CHARACTERISTIC ECTSensorPin "Analog input pin selection for ECTSensorPin" VALUE 0x80002321 RecordLayout_5 0 CompuMethod_23 -32768 32767 /end CHARACTERISTIC
/begin CHARACTERISTIC ECTSensorPin_ref "Reference Voltage Selection" VALUE 0x80002323 RecordLayout_1 0 CompuMethod_24 0 255 /end CHARACTERISTIC
/begin CHARACTERISTIC EST_InitialPin "First pin selection for Spark Sequence.  Goes up from here depending on the Sequence Type and number of cylinders" VALUE 0x80002510 RecordLayout_5 0 CompuMethod_92 -32768 32767 /end CHARACTERISTIC
/begin CHARACTERISTIC EST_OpenThreshold "ADC counts for the diagnostic inputs, above which the driver is considered an open-circuit" VALUE 0x80002512 RecordLayout_8 0 CompuMethod_52 0 1023 /end CHARACTERISTIC
/begin CHARACTERISTIC EST_SequenceType "Select the type of spark sequence.  The number of pins used will depend on this selection" VALUE 0x80002514 RecordLayout_1 0 CompuMethod_93 0 255 /end CHARACTERISTIC
/begin CHARACTERISTIC ESTOPPin "Digital input pin selection for ESTOPPin" VALUE 0x80002519 RecordLayout_5 0 CompuMethod_94 -32768 32767 /end CHARACTERISTIC
/begin CHARACTERISTIC ETCPin "PWM output pin selection for ETCPin" VALUE 0x800026D2 RecordLayout_5 0 CompuMethod_102 -32768 32767 /end CHARACTERISTIC
/begin CHARACTERISTIC ETCReq_FiltDecFiltC "Filter time constant for a decreasing signal." VALUE 0x800026D4 RecordLayout_4 0 CompuMethod_20 -1E+17 1E+17 /end CHARACTERISTIC
/begin CHARACTERISTIC ETCReq_FiltIncFiltC "Filter time constant for a increasing signal." VALUE 0x800026D8 RecordLayout_4 0 CompuMethod_20 -1E+17 1E+17 /end CHARACTERISTIC
/begin CHARACTERISTIC ETCReqDecFiltC "Filter time constant for a decreasing ETC Request signal." VALUE 0x800026E1 RecordLayout_4 0 CompuMethod_20 -1E+17 1E+17 /end CHARACTERISTIC
/begin CHARACTERISTIC ETCReqFallRateTbl "Limits fall rate of ETCRequestFiltered." CURVE 0x800026E5 RecordLayout_4 0 CompuMethod_103 -10000 0
 /begin AXIS_DESCR COM_AXIS TPS09In CompuMethod_6 9 0 100 AXIS_PTS_REF TPS09IdxArr /end AXIS_DESCR
/end CHARACTERISTIC
/begin CHARACTERISTIC ETCReqIncFiltC "Filter time constant for a decreasing ETC Request signal." VALUE 0x80002709 RecordLayout_4 0 CompuMethod_20 -1E+17 1E+17 /end CHARACTERISTIC
/begin CHARACTERISTIC ETCReqRiseRateTbl "Limits rise rate of ETCRequestFiltered." CURVE 0x8000270D RecordLayout_4 0 CompuMethod_103 0 10000
 /begin AXIS_DESCR COM_AXIS TPS09In CompuMethod_6 9 0 100 AXIS_PTS_REF TPS09IdxArr /end AXIS_DESCR
/end CHARACTERISTIC
/begin CHARACTERISTIC ETCRequestMap "Driver demand table" MAP 0x80002731 RecordLayout_4 0 CompuMethod_6 0 100
 /begin AXIS_DESCR COM_AXIS APP17In CompuMethod_6 17 0 100 AXIS_PTS_REF APP17IdxArr /end AXIS_DESCR
 /begin AXIS_DESCR COM_AXIS VSPD17In CompuMethod_180 17 -100 200 AXIS_PTS_REF VSPD17IdxArr /end AXIS_DESCR
/end CHARACTERISTIC
/begin CHARACTERISTIC EVAPSensorPin "Analog input pin selection for EVAPSensorPin" VALUE 0x80002DAF RecordLayout_5 0 CompuMethod_23 -32768 32767 /end CHARACTERISTIC
/begin CHARACTERISTIC EVAPSensorPin_ref "Reference Voltage Selection" VALUE 0x80002DB1 RecordLayout_1 0 CompuMethod_24 0 255 /end CHARACTERISTIC
/begin CHARACTERISTIC FAN_Mode "" VALUE 0x80002DEA RecordLayout_1 0 CompuMethod_104 0 255 /end CHARACTERISTIC
/begin CHARACTERISTIC Fan1ACPres "Fan Enabler" VALUE 0x80002E07 RecordLayout_1 0 CompuMethod_7 0 255 /end CHARACTERISTIC
/begin CHARACTERISTIC Fan1ACSw "Fan Enabler" VALUE 0x80002E08 RecordLayout_1 0 CompuMethod_7 0 255 /end CHARACTERISTIC
/begin CHARACTERISTIC Fan1ECT "Fan Enabler" VALUE 0x80002E09 RecordLayout_1 0 CompuMethod_7 0 255 /end CHARACTERISTIC
/begin CHARACTERISTIC Fan1IAT "Fan Enabler" VALUE 0x80002E0A RecordLayout_1 0 CompuMethod_7 0 255 /end CHARACTERISTIC
/begin CHARACTERISTIC FAN1Pin "Digital output pin selection for DOut9617p0005" VALUE 0x80002E0B RecordLayout_5 0 CompuMethod_12 -32768 32767 /end CHARACTERISTIC
/begin CHARACTERISTIC FAN1Pin_PWM "PWM output pin selection for FAN1Pin_PWM" VALUE 0x80002E0D RecordLayout_5 0 CompuMethod_102 -32768 32767 /end CHARACTERISTIC
/begin CHARACTERISTIC Fan2ACPres "Fan Enabler" VALUE 0x80002E2B RecordLayout_1 0 CompuMethod_7 0 255 /end CHARACTERISTIC
/begin CHARACTERISTIC Fan2ACSw "Fan Enabler" VALUE 0x80002E2C RecordLayout_1 0 CompuMethod_7 0 255 /end CHARACTERISTIC
/begin CHARACTERISTIC Fan2ECT "Fan Enabler" VALUE 0x80002E2D RecordLayout_1 0 CompuMethod_7 0 255 /end CHARACTERISTIC
/begin CHARACTERISTIC Fan2IAT "Fan Enabler" VALUE 0x80002E2E RecordLayout_1 0 CompuMethod_7 0 255 /end CHARACTERISTIC
/begin CHARACTERISTIC FAN2Pin "Digital output pin selection for DOut9618p0005" VALUE 0x80002E2F RecordLayout_5 0 CompuMethod_12 -32768 32767 /end CHARACTERISTIC
/begin CHARACTERISTIC FAN2Pin_PWM "PWM output pin selection for FAN2Pin_PWM" VALUE 0x80002E31 RecordLayout_5 0 CompuMethod_102 -32768 32767 /end CHARACTERISTIC
/begin CHARACTERISTIC FaultManager.OilPresRangeLow.Action_4_Condition "Fault manager configuration.  Select up to 4 actions for each fault." VALUE 0x800038A8 RecordLayout_8 0 CompuMethod_111 0 65535 /end CHARACTERISTIC
/begin CHARACTERISTIC FaultManager.SensVoltRangeHigh.Mode "Fault manager configuration.  Select up to 4 actions for each fault." VALUE 0x800038AA RecordLayout_8 0 CompuMethod_108 0 65535 /end CHARACTERISTIC
/begin CHARACTERISTIC FaultManager.SensVoltRangeHigh.ID "Fault manager configuration.  Select up to 4 actions for each fault." VALUE 0x800038AC RecordLayout_8 0 CompuMethod_1 0 65535 /end CHARACTERISTIC
/begin CHARACTERISTIC FaultManager.SensVoltRangeHigh.Test "Fault manager configuration.  Select up to 4 actions for each fault." VALUE 0x800038AE RecordLayout_8 0 CompuMethod_109 0 65535 /end CHARACTERISTIC
/begin CHARACTERISTIC FaultManager.SensVoltRangeHigh.Faulty_Samples__X_ "Fault manager configuration.  Select up to 4 actions for each fault." VALUE 0x800038B0 RecordLayout_8 0 CompuMethod_1 0 65535 /end CHARACTERISTIC
/begin CHARACTERISTIC FaultManager.SensVoltRangeHigh.Total_Samples__Y_ "Fault manager configuration.  Select up to 4 actions for each fault." VALUE 0x800038B2 RecordLayout_8 0 CompuMethod_1 0 65535 /end CHARACTERISTIC
/begin CHARACTERISTIC FaultManager.SensVoltRangeHigh.Action_1 "Fault manager configuration.  Select up to 4 actions for each fault." VALUE 0x800038B4 RecordLayout_8 0 CompuMethod_110 0 65535 /end CHARACTERISTIC
/begin CHARACTERISTIC FaultManager.SensVoltRangeHigh.Action_1_Condition "Fault manager configuration.  Select up to 4 actions for each fault." VALUE 0x800038B6 RecordLayout_8 0 CompuMethod_111 0 65535 /end CHARACTERISTIC
/begin CHARACTERISTIC FaultManager.SensVoltRangeHigh.Action_2 "Fault manager configuration.  Select up to 4 actions for each fault." VALUE 0x800038B8 RecordLayout_8 0 CompuMethod_110 0 65535 /end CHARACTERISTIC
/begin CHARACTERISTIC FaultManager.SensVoltRangeHigh.Action_2_Condition "Fault manager configuration.  Select up to 4 actions for each fault." VALUE 0x800038BA RecordLayout_8 0 CompuMethod_111 0 65535 /end CHARACTERISTIC
/begin CHARACTERISTIC FaultManager.SensVoltRangeHigh.Action_3 "Fault manager configuration.  Select up to 4 actions for each fault." VALUE 0x800038BC RecordLayout_8 0 CompuMethod_110 0 65535 /end CHARACTERISTIC
/begin CHARACTERISTIC FaultManager.SensVoltRangeHigh.Action_3_Condition "Fault manager configuration.  Select up to 4 actions for each fault." VALUE 0x800038BE RecordLayout_8 0 CompuMethod_111 0 65535 /end CHARACTERISTIC
/begin CHARACTERISTIC FaultManager.SensVoltRangeHigh.Action_4 "Fault manager configuration.  Select up to 4 actions for each fault." VALUE 0x800038C0 RecordLayout_8 0 CompuMethod_110 0 65535 /end CHARACTERISTIC
/begin CHARACTERISTIC FaultManager.SensVoltRangeHigh.Action_4_Condition "Fault manager configuration.  Select up to 4 actions for each fault." VALUE 0x800038C2 RecordLayout_8 0 CompuMethod_111 0 65535 /end CHARACTERISTIC
/begin CHARACTERISTIC FaultManager.SensVoltRangeLow.Mode "Fault manager configuration.  Select up to 4 actions for each fault." VALUE 0x800038C4 RecordLayout_8 0 CompuMethod_108 0 65535 /end CHARACTERISTIC
/begin CHARACTERISTIC FaultManager.SensVoltRangeLow.ID "Fault manager configuration.  Select up to 4 actions for each fault." VALUE 0x800038C6 RecordLayout_8 0 CompuMethod_1 0 65535 /end CHARACTERISTIC
/begin CHARACTERISTIC FaultManager.SensVoltRangeLow.Test "Fault manager configuration.  Select up to 4 actions for each fault." VALUE 0x800038C8 RecordLayout_8 0 CompuMethod_109 0 65535 /end CHARACTERISTIC
/begin CHARACTERISTIC FaultManager.SensVoltRangeLow.Faulty_Samples__X_ "Fault manager configuration.  Select up to 4 actions for each fault." VALUE 0x800038CA RecordLayout_8 0 CompuMethod_1 0 65535 /end CHARACTERISTIC
/begin CHARACTERISTIC FaultManager.SensVoltRangeLow.Total_Samples__Y_ "Fault manager configuration.  Select up to 4 actions for each fault." VALUE 0x800038CC RecordLayout_8 0 CompuMethod_1 0 65535 /end CHARACTERISTIC
/begin CHARACTERISTIC FaultManager.SensVoltRangeLow.Action_1 "Fault manager configuration.  Select up to 4 actions for each fault." VALUE 0x800038CE RecordLayout_8 0 CompuMethod_110 0 65535 /end CHARACTERISTIC
/begin CHARACTERISTIC FaultManager.SensVoltRangeLow.Action_1_Condition "Fault manager configuration.  Select up to 4 actions for each fault." VALUE 0x800038D0 RecordLayout_8 0 CompuMethod_111 0 65535 /end CHARACTERISTIC
/begin CHARACTERISTIC FaultManager.SensVoltRangeLow.Action_2 "Fault manager configuration.  Select up to 4 actions for each fault." VALUE 0x800038D2 RecordLayout_8 0 CompuMethod_110 0 65535 /end CHARACTERISTIC
/begin CHARACTERISTIC FaultManager.SensVoltRangeLow.Action_2_Condition "Fault manager configuration.  Select up to 4 actions for each fault." VALUE 0x800038D4 RecordLayout_8 0 CompuMethod_111 0 65535 /end CHARACTERISTIC
/begin CHARACTERISTIC FaultManager.SensVoltRangeLow.Action_3 "Fault manager configuration.  Select up to 4 actions for each fault." VALUE 0x800038D6 RecordLayout_8 0 CompuMethod_110 0 65535 /end CHARACTERISTIC
/begin CHARACTERISTIC FaultManager.SensVoltRangeLow.Action_3_Condition "Fault manager configuration.  Select up to 4 actions for each fault." VALUE 0x800038D8 RecordLayout_8 0 CompuMethod_111 0 65535 /end CHARACTERISTIC
/begin CHARACTERISTIC FaultManager.SensVoltRangeLow.Action_4 "Fault manager configuration.  Select up to 4 actions for each fault." VALUE 0x800038DA RecordLayout_8 0 CompuMethod_110 0 65535 /end CHARACTERISTIC
/begin CHARACTERISTIC FaultManager.SensVoltRangeLow.Action_4_Condition "Fault manager configuration.  Select up to 4 actions for each fault." VALUE 0x800038DC RecordLayout_8 0 CompuMethod_111 0 65535 /end CHARACTERISTIC
/begin CHARACTERISTIC FaultManager.SoftOverBoost_Fault.Mode "Fault manager configuration.  Select up to 4 actions for each fault." VALUE 0x800038DE RecordLayout_8 0 CompuMethod_108 0 65535 /end CHARACTERISTIC
/begin CHARACTERISTIC FaultManager.SoftOverBoost_Fault.ID "Fault manager configuration.  Select up to 4 actions for each fault." VALUE 0x800038E0 RecordLayout_8 0 CompuMethod_1 0 65535 /end CHARACTERISTIC
/begin CHARACTERISTIC FaultManager.SoftOverBoost_Fault.Test "Fault manager configuration.  Select up to 4 actions for each fault." VALUE 0x800038E2 RecordLayout_8 0 CompuMethod_109 0 65535 /end CHARACTERISTIC
/begin CHARACTERISTIC FaultManager.SoftOverBoost_Fault.Faulty_Samples__X_ "Fault manager configuration.  Select up to 4 actions for each fault." VALUE 0x800038E4 RecordLayout_8 0 CompuMethod_1 0 65535 /end CHARACTERISTIC
/begin CHARACTERISTIC FaultManager.SoftOverBoost_Fault.Total_Samples__Y_ "Fault manager configuration.  Select up to 4 actions for each fault." VALUE 0x800038E6 RecordLayout_8 0 CompuMethod_1 0 65535 /end CHARACTERISTIC
/begin CHARACTERISTIC FaultManager.SoftOverBoost_Fault.Action_1 "Fault manager configuration.  Select up to 4 actions for each fault." VALUE 0x800038E8 RecordLayout_8 0 CompuMethod_110 0 65535 /end CHARACTERISTIC
/begin CHARACTERISTIC FaultManager.SoftOverBoost_Fault.Action_1_Condition "Fault manager configuration.  Select up to 4 actions for each fault." VALUE 0x800038EA RecordLayout_8 0 CompuMethod_111 0 65535 /end CHARACTERISTIC
/begin CHARACTERISTIC FaultManager.SoftOverBoost_Fault.Action_2 "Fault manager configuration.  Select up to 4 actions for each fault." VALUE 0x800038EC RecordLayout_8 0 CompuMethod_110 0 65535 /end CHARACTERISTIC
/begin CHARACTERISTIC FaultManager.SoftOverBoost_Fault.Action_2_Condition "Fault manager configuration.  Select up to 4 actions for each fault." VALUE 0x800038EE RecordLayout_8 0 CompuMethod_111 0 65535 /end CHARACTERISTIC
/begin CHARACTERISTIC FaultManager.SoftOverBoost_Fault.Action_3 "Fault manager configuration.  Select up to 4 actions for each fault." VALUE 0x800038F0 RecordLayout_8 0 CompuMethod_110 0 65535 /end CHARACTERISTIC
/begin CHARACTERISTIC FaultManager.SoftOverBoost_Fault.Action_3_Condition "Fault manager configuration.  Select up to 4 actions for each fault." VALUE 0x800038F2 RecordLayout_8 0 CompuMethod_111 0 65535 /end CHARACTERISTIC
/begin CHARACTERISTIC FaultManager.SoftOverBoost_Fault.Action_4 "Fault manager configuration.  Select up to 4 actions for each fault." VALUE 0x800038F4 RecordLayout_8 0 CompuMethod_110 0 65535 /end CHARACTERISTIC
/begin CHARACTERISTIC FaultManager.SoftOverBoost_Fault.Action_4_Condition "Fault manager configuration.  Select up to 4 actions for each fault." VALUE 0x800038F6 RecordLayout_8 0 CompuMethod_111 0 65535 /end CHARACTERISTIC
/begin CHARACTERISTIC FaultManager.SoftOverspeed.Mode "Fault manager configuration.  Select up to 4 actions for each fault." VALUE 0x800038F8 RecordLayout_8 0 CompuMethod_108 0 65535 /end CHARACTERISTIC
/begin CHARACTERISTIC FaultManager.SoftOverspeed.ID "Fault manager configuration.  Select up to 4 actions for each fault." VALUE 0x800038FA RecordLayout_8 0 CompuMethod_1 0 65535 /end CHARACTERISTIC
/begin CHARACTERISTIC FaultManager.SoftOverspeed.Test "Fault manager configuration.  Select up to 4 actions for each fault." VALUE 0x800038FC RecordLayout_8 0 CompuMethod_109 0 65535 /end CHARACTERISTIC
/begin CHARACTERISTIC FaultManager.SoftOverspeed.Faulty_Samples__X_ "Fault manager configuration.  Select up to 4 actions for each fault." VALUE 0x800038FE RecordLayout_8 0 CompuMethod_1 0 65535 /end CHARACTERISTIC
/begin CHARACTERISTIC FaultManager.SoftOverspeed.Total_Samples__Y_ "Fault manager configuration.  Select up to 4 actions for each fault." VALUE 0x80003900 RecordLayout_8 0 CompuMethod_1 0 65535 /end CHARACTERISTIC
/begin CHARACTERISTIC FaultManager.SoftOverspeed.Action_1 "Fault manager configuration.  Select up to 4 actions for each fault." VALUE 0x80003902 RecordLayout_8 0 CompuMethod_110 0 65535 /end CHARACTERISTIC
/begin CHARACTERISTIC FaultManager.SoftOverspeed.Action_1_Condition "Fault manager configuration.  Select up to 4 actions for each fault." VALUE 0x80003904 RecordLayout_8 0 CompuMethod_111 0 65535 /end CHARACTERISTIC
/begin CHARACTERISTIC FaultManager.SoftOverspeed.Action_2 "Fault manager configuration.  Select up to 4 actions for each fault." VALUE 0x80003906 RecordLayout_8 0 CompuMethod_110 0 65535 /end CHARACTERISTIC
/begin CHARACTERISTIC FaultManager.SoftOverspeed.Action_2_Condition "Fault manager configuration.  Select up to 4 actions for each fault." VALUE 0x80003908 RecordLayout_8 0 CompuMethod_111 0 65535 /end CHARACTERISTIC
/begin CHARACTERISTIC FaultManager.SoftOverspeed.Action_3 "Fault manager configuration.  Select up to 4 actions for each fault." VALUE 0x8000390A RecordLayout_8 0 CompuMethod_110 0 65535 /end CHARACTERISTIC
/begin CHARACTERISTIC FaultManager.SoftOverspeed.Action_3_Condition "Fault manager configuration.  Select up to 4 actions for each fault." VALUE 0x8000390C RecordLayout_8 0 CompuMethod_111 0 65535 /end CHARACTERISTIC
/begin CHARACTERISTIC FaultManager.SoftOverspeed.Action_4 "Fault manager configuration.  Select up to 4 actions for each fault." VALUE 0x8000390E RecordLayout_8 0 CompuMethod_110 0 65535 /end CHARACTERISTIC
/begin CHARACTERISTIC FaultManager.SoftOverspeed.Action_4_Condition "Fault manager configuration.  Select up to 4 actions for each fault." VALUE 0x80003910 RecordLayout_8 0 CompuMethod_111 0 65535 /end CHARACTERISTIC
/begin CHARACTERISTIC FaultManager.SysVoltRangeHigh.Mode "Fault manager configuration.  Select up to 4 actions for each fault." VALUE 0x80003912 RecordLayout_8 0 CompuMethod_108 0 65535 /end CHARACTERISTIC
/begin CHARACTERISTIC FaultManager.SysVoltRangeHigh.ID "Fault manager configuration.  Select up to 4 actions for each fault." VALUE 0x80003914 RecordLayout_8 0 CompuMethod_1 0 65535 /end CHARACTERISTIC
/begin CHARACTERISTIC FaultManager.SysVoltRangeHigh.Test "Fault manager configuration.  Select up to 4 actions for each fault." VALUE 0x80003916 RecordLayout_8 0 CompuMethod_109 0 65535 /end CHARACTERISTIC
/begin CHARACTERISTIC FaultManager.SysVoltRangeHigh.Faulty_Samples__X_ "Fault manager configuration.  Select up to 4 actions for each fault." VALUE 0x80003918 RecordLayout_8 0 CompuMethod_1 0 65535 /end CHARACTERISTIC
/begin CHARACTERISTIC FaultManager.SysVoltRangeHigh.Total_Samples__Y_ "Fault manager configuration.  Select up to 4 actions for each fault." VALUE 0x8000391A RecordLayout_8 0 CompuMethod_1 0 65535 /end CHARACTERISTIC
/begin CHARACTERISTIC FaultManager.SysVoltRangeHigh.Action_1 "Fault manager configuration.  Select up to 4 actions for each fault." VALUE 0x8000391C RecordLayout_8 0 CompuMethod_110 0 65535 /end CHARACTERISTIC
/begin CHARACTERISTIC FaultManager.SysVoltRangeHigh.Action_1_Condition "Fault manager configuration.  Select up to 4 actions for each fault." VALUE 0x8000391E RecordLayout_8 0 CompuMethod_111 0 65535 /end CHARACTERISTIC
/begin CHARACTERISTIC FaultManager.SysVoltRangeHigh.Action_2 "Fault manager configuration.  Select up to 4 actions for each fault." VALUE 0x80003920 RecordLayout_8 0 CompuMethod_110 0 65535 /end CHARACTERISTIC
/begin CHARACTERISTIC FaultManager.SysVoltRangeHigh.Action_2_Condition "Fault manager configuration.  Select up to 4 actions for each fault." VALUE 0x80003922 RecordLayout_8 0 CompuMethod_111 0 65535 /end CHARACTERISTIC
/begin CHARACTERISTIC FaultManager.SysVoltRangeHigh.Action_3 "Fault manager configuration.  Select up to 4 actions for each fault." VALUE 0x80003924 RecordLayout_8 0 CompuMethod_110 0 65535 /end CHARACTERISTIC
/begin CHARACTERISTIC FaultManager.SysVoltRangeHigh.Action_3_Condition "Fault manager configuration.  Select up to 4 actions for each fault." VALUE 0x80003926 RecordLayout_8 0 CompuMethod_111 0 65535 /end CHARACTERISTIC
/begin CHARACTERISTIC FaultManager.SysVoltRangeHigh.Action_4 "Fault manager configuration.  Select up to 4 actions for each fault." VALUE 0x80003928 RecordLayout_8 0 CompuMethod_110 0 65535 /end CHARACTERISTIC
/begin CHARACTERISTIC FaultManager.SysVoltRangeHigh.Action_4_Condition "Fault manager configuration.  Select up to 4 actions for each fault." VALUE 0x8000392A RecordLayout_8 0 CompuMethod_111 0 65535 /end CHARACTERISTIC
/begin CHARACTERISTIC FaultManager.SysVoltRangeLow.Mode "Fault manager configuration.  Select up to 4 actions for each fault." VALUE 0x8000392C RecordLayout_8 0 CompuMethod_108 0 65535 /end CHARACTERISTIC
/begin CHARACTERISTIC FaultManager.SysVoltRangeLow.ID "Fault manager configuration.  Select up to 4 actions for each fault." VALUE 0x8000392E RecordLayout_8 0 CompuMethod_1 0 65535 /end CHARACTERISTIC
/begin CHARACTERISTIC FaultManager.SysVoltRangeLow.Test "Fault manager configuration.  Select up to 4 actions for each fault." VALUE 0x80003930 RecordLayout_8 0 CompuMethod_109 0 65535 /end CHARACTERISTIC
/begin CHARACTERISTIC FaultManager.SysVoltRangeLow.Faulty_Samples__X_ "Fault manager configuration.  Select up to 4 actions for each fault." VALUE 0x80003932 RecordLayout_8 0 CompuMethod_1 0 65535 /end CHARACTERISTIC
/begin CHARACTERISTIC FaultManager.SysVoltRangeLow.Total_Samples__Y_ "Fault manager configuration.  Select up to 4 actions for each fault." VALUE 0x80003934 RecordLayout_8 0 CompuMethod_1 0 65535 /end CHARACTERISTIC
/begin CHARACTERISTIC FaultManager.SysVoltRangeLow.Action_1 "Fault manager configuration.  Select up to 4 actions for each fault." VALUE 0x80003936 RecordLayout_8 0 CompuMethod_110 0 65535 /end CHARACTERISTIC
/begin CHARACTERISTIC FaultManager.SysVoltRangeLow.Action_1_Condition "Fault manager configuration.  Select up to 4 actions for each fault." VALUE 0x80003938 RecordLayout_8 0 CompuMethod_111 0 65535 /end CHARACTERISTIC
/begin CHARACTERISTIC FaultManager.SysVoltRangeLow.Action_2 "Fault manager configuration.  Select up to 4 actions for each fault." VALUE 0x8000393A RecordLayout_8 0 CompuMethod_110 0 65535 /end CHARACTERISTIC
/begin CHARACTERISTIC FaultManager.SysVoltRangeLow.Action_2_Condition "Fault manager configuration.  Select up to 4 actions for each fault." VALUE 0x8000393C RecordLayout_8 0 CompuMethod_111 0 65535 /end CHARACTERISTIC
/begin CHARACTERISTIC FaultManager.SysVoltRangeLow.Action_3 "Fault manager configuration.  Select up to 4 actions for each fault." VALUE 0x8000393E RecordLayout_8 0 CompuMethod_110 0 65535 /end CHARACTERISTIC
/begin CHARACTERISTIC FaultManager.SysVoltRangeLow.Action_3_Condition "Fault manager configuration.  Select up to 4 actions for each fault." VALUE 0x80003940 RecordLayout_8 0 CompuMethod_111 0 65535 /end CHARACTERISTIC
/begin CHARACTERISTIC FaultManager.SysVoltRangeLow.Action_4 "Fault manager configuration.  Select up to 4 actions for each fault." VALUE 0x80003942 RecordLayout_8 0 CompuMethod_110 0 65535 /end CHARACTERISTIC
/begin CHARACTERISTIC FaultManager.SysVoltRangeLow.Action_4_Condition "Fault manager configuration.  Select up to 4 actions for each fault." VALUE 0x80003944 RecordLayout_8 0 CompuMethod_111 0 65535 /end CHARACTERISTIC
/begin CHARACTERISTIC FaultManager.TPS1AdaptHiMax.Mode "Fault manager configuration.  Select up to 4 actions for each fault." VALUE 0x80003946 RecordLayout_8 0 CompuMethod_108 0 65535 /end CHARACTERISTIC
/begin CHARACTERISTIC FaultManager.TPS1AdaptHiMax.ID "Fault manager configuration.  Select up to 4 actions for each fault." VALUE 0x80003948 RecordLayout_8 0 CompuMethod_1 0 65535 /end CHARACTERISTIC
/begin CHARACTERISTIC FaultManager.TPS1AdaptHiMax.Test "Fault manager configuration.  Select up to 4 actions for each fault." VALUE 0x8000394A RecordLayout_8 0 CompuMethod_109 0 65535 /end CHARACTERISTIC
/begin CHARACTERISTIC FaultManager.TPS1AdaptHiMax.Faulty_Samples__X_ "Fault manager configuration.  Select up to 4 actions for each fault." VALUE 0x8000394C RecordLayout_8 0 CompuMethod_1 0 65535 /end CHARACTERISTIC
/begin CHARACTERISTIC FaultManager.TPS1AdaptHiMax.Total_Samples__Y_ "Fault manager configuration.  Select up to 4 actions for each fault." VALUE 0x8000394E RecordLayout_8 0 CompuMethod_1 0 65535 /end CHARACTERISTIC
/begin CHARACTERISTIC FaultManager.TPS1AdaptHiMax.Action_1 "Fault manager configuration.  Select up to 4 actions for each fault." VALUE 0x80003950 RecordLayout_8 0 CompuMethod_110 0 65535 /end CHARACTERISTIC
/begin CHARACTERISTIC FaultManager.TPS1AdaptHiMax.Action_1_Condition "Fault manager configuration.  Select up to 4 actions for each fault." VALUE 0x80003952 RecordLayout_8 0 CompuMethod_111 0 65535 /end CHARACTERISTIC
/begin CHARACTERISTIC FaultManager.TPS1AdaptHiMax.Action_2 "Fault manager configuration.  Select up to 4 actions for each fault." VALUE 0x80003954 RecordLayout_8 0 CompuMethod_110 0 65535 /end CHARACTERISTIC
/begin CHARACTERISTIC FaultManager.TPS1AdaptHiMax.Action_2_Condition "Fault manager configuration.  Select up to 4 actions for each fault." VALUE 0x80003956 RecordLayout_8 0 CompuMethod_111 0 65535 /end CHARACTERISTIC
/begin CHARACTERISTIC FaultManager.TPS1AdaptHiMax.Action_3 "Fault manager configuration.  Select up to 4 actions for each fault." VALUE 0x80003958 RecordLayout_8 0 CompuMethod_110 0 65535 /end CHARACTERISTIC
/begin CHARACTERISTIC FaultManager.TPS1AdaptHiMax.Action_3_Condition "Fault manager configuration.  Select up to 4 actions for each fault." VALUE 0x8000395A RecordLayout_8 0 CompuMethod_111 0 65535 /end CHARACTERISTIC
/begin CHARACTERISTIC FaultManager.TPS1AdaptHiMax.Action_4 "Fault manager configuration.  Select up to 4 actions for each fault." VALUE 0x8000395C RecordLayout_8 0 CompuMethod_110 0 65535 /end CHARACTERISTIC
/begin CHARACTERISTIC FaultManager.TPS1AdaptHiMax.Action_4_Condition "Fault manager configuration.  Select up to 4 actions for each fault." VALUE 0x8000395E RecordLayout_8 0 CompuMethod_111 0 65535 /end CHARACTERISTIC
/begin CHARACTERISTIC FaultManager.TPS1AdaptHiMin.Mode "Fault manager configuration.  Select up to 4 actions for each fault." VALUE 0x80003960 RecordLayout_8 0 CompuMethod_108 0 65535 /end CHARACTERISTIC
/begin CHARACTERISTIC FaultManager.TPS1AdaptHiMin.ID "Fault manager configuration.  Select up to 4 actions for each fault." VALUE 0x80003962 RecordLayout_8 0 CompuMethod_1 0 65535 /end CHARACTERISTIC
/begin CHARACTERISTIC FaultManager.TPS1AdaptHiMin.Test "Fault manager configuration.  Select up to 4 actions for each fault." VALUE 0x80003964 RecordLayout_8 0 CompuMethod_109 0 65535 /end CHARACTERISTIC
/begin CHARACTERISTIC FaultManager.TPS1AdaptHiMin.Faulty_Samples__X_ "Fault manager configuration.  Select up to 4 actions for each fault." VALUE 0x80003966 RecordLayout_8 0 CompuMethod_1 0 65535 /end CHARACTERISTIC
/begin CHARACTERISTIC FaultManager.TPS1AdaptHiMin.Total_Samples__Y_ "Fault manager configuration.  Select up to 4 actions for each fault." VALUE 0x80003968 RecordLayout_8 0 CompuMethod_1 0 65535 /end CHARACTERISTIC
/begin CHARACTERISTIC FaultManager.TPS1AdaptHiMin.Action_1 "Fault manager configuration.  Select up to 4 actions for each fault." VALUE 0x8000396A RecordLayout_8 0 CompuMethod_110 0 65535 /end CHARACTERISTIC
/begin CHARACTERISTIC FaultManager.TPS1AdaptHiMin.Action_1_Condition "Fault manager configuration.  Select up to 4 actions for each fault." VALUE 0x8000396C RecordLayout_8 0 CompuMethod_111 0 65535 /end CHARACTERISTIC
/begin CHARACTERISTIC FaultManager.TPS1AdaptHiMin.Action_2 "Fault manager configuration.  Select up to 4 actions for each fault." VALUE 0x8000396E RecordLayout_8 0 CompuMethod_110 0 65535 /end CHARACTERISTIC
/begin CHARACTERISTIC FaultManager.TPS1AdaptHiMin.Action_2_Condition "Fault manager configuration.  Select up to 4 actions for each fault." VALUE 0x80003970 RecordLayout_8 0 CompuMethod_111 0 65535 /end CHARACTERISTIC
/begin CHARACTERISTIC FaultManager.TPS1AdaptHiMin.Action_3 "Fault manager configuration.  Select up to 4 actions for each fault." VALUE 0x80003972 RecordLayout_8 0 CompuMethod_110 0 65535 /end CHARACTERISTIC
/begin CHARACTERISTIC FaultManager.TPS1AdaptHiMin.Action_3_Condition "Fault manager configuration.  Select up to 4 actions for each fault." VALUE 0x80003974 RecordLayout_8 0 CompuMethod_111 0 65535 /end CHARACTERISTIC
/begin CHARACTERISTIC FaultManager.TPS1AdaptHiMin.Action_4 "Fault manager configuration.  Select up to 4 actions for each fault." VALUE 0x80003976 RecordLayout_8 0 CompuMethod_110 0 65535 /end CHARACTERISTIC
/begin CHARACTERISTIC FaultManager.TPS1AdaptHiMin.Action_4_Condition "Fault manager configuration.  Select up to 4 actions for each fault." VALUE 0x80003978 RecordLayout_8 0 CompuMethod_111 0 65535 /end CHARACTERISTIC
/begin CHARACTERISTIC FaultManager.TPS1AdaptLoMax.Mode "Fault manager configuration.  Select up to 4 actions for each fault." VALUE 0x8000397A RecordLayout_8 0 CompuMethod_108 0 65535 /end CHARACTERISTIC
/begin CHARACTERISTIC FaultManager.TPS1AdaptLoMax.ID "Fault manager configuration.  Select up to 4 actions for each fault." VALUE 0x8000397C RecordLayout_8 0 CompuMethod_1 0 65535 /end CHARACTERISTIC
/begin CHARACTERISTIC FaultManager.TPS1AdaptLoMax.Test "Fault manager configuration.  Select up to 4 actions for each fault." VALUE 0x8000397E RecordLayout_8 0 CompuMethod_109 0 65535 /end CHARACTERISTIC
/begin CHARACTERISTIC FaultManager.TPS1AdaptLoMax.Faulty_Samples__X_ "Fault manager configuration.  Select up to 4 actions for each fault." VALUE 0x80003980 RecordLayout_8 0 CompuMethod_1 0 65535 /end CHARACTERISTIC
/begin CHARACTERISTIC FaultManager.TPS1AdaptLoMax.Total_Samples__Y_ "Fault manager configuration.  Select up to 4 actions for each fault." VALUE 0x80003982 RecordLayout_8 0 CompuMethod_1 0 65535 /end CHARACTERISTIC
/begin CHARACTERISTIC FaultManager.TPS1AdaptLoMax.Action_1 "Fault manager configuration.  Select up to 4 actions for each fault." VALUE 0x80003984 RecordLayout_8 0 CompuMethod_110 0 65535 /end CHARACTERISTIC
/begin CHARACTERISTIC FaultManager.TPS1AdaptLoMax.Action_1_Condition "Fault manager configuration.  Select up to 4 actions for each fault." VALUE 0x80003986 RecordLayout_8 0 CompuMethod_111 0 65535 /end CHARACTERISTIC
/begin CHARACTERISTIC FaultManager.TPS1AdaptLoMax.Action_2 "Fault manager configuration.  Select up to 4 actions for each fault." VALUE 0x80003988 RecordLayout_8 0 CompuMethod_110 0 65535 /end CHARACTERISTIC
/begin CHARACTERISTIC FaultManager.TPS1AdaptLoMax.Action_2_Condition "Fault manager configuration.  Select up to 4 actions for each fault." VALUE 0x8000398A RecordLayout_8 0 CompuMethod_111 0 65535 /end CHARACTERISTIC
/begin CHARACTERISTIC FaultManager.TPS1AdaptLoMax.Action_3 "Fault manager configuration.  Select up to 4 actions for each fault." VALUE 0x8000398C RecordLayout_8 0 CompuMethod_110 0 65535 /end CHARACTERISTIC
/begin CHARACTERISTIC FaultManager.TPS1AdaptLoMax.Action_3_Condition "Fault manager configuration.  Select up to 4 actions for each fault." VALUE 0x8000398E RecordLayout_8 0 CompuMethod_111 0 65535 /end CHARACTERISTIC
/begin CHARACTERISTIC FaultManager.TPS1AdaptLoMax.Action_4 "Fault manager configuration.  Select up to 4 actions for each fault." VALUE 0x80003990 RecordLayout_8 0 CompuMethod_110 0 65535 /end CHARACTERISTIC
/begin CHARACTERISTIC FaultManager.TPS1AdaptLoMax.Action_4_Condition "Fault manager configuration.  Select up to 4 actions for each fault." VALUE 0x80003992 RecordLayout_8 0 CompuMethod_111 0 65535 /end CHARACTERISTIC
/begin CHARACTERISTIC FaultManager.TPS1AdaptLoMin.Mode "Fault manager configuration.  Select up to 4 actions for each fault." VALUE 0x80003994 RecordLayout_8 0 CompuMethod_108 0 65535 /end CHARACTERISTIC
/begin CHARACTERISTIC FaultManager.TPS1AdaptLoMin.ID "Fault manager configuration.  Select up to 4 actions for each fault." VALUE 0x80003996 RecordLayout_8 0 CompuMethod_1 0 65535 /end CHARACTERISTIC
/begin CHARACTERISTIC FaultManager.TPS1AdaptLoMin.Test "Fault manager configuration.  Select up to 4 actions for each fault." VALUE 0x80003998 RecordLayout_8 0 CompuMethod_109 0 65535 /end CHARACTERISTIC
/begin CHARACTERISTIC FaultManager.TPS1AdaptLoMin.Faulty_Samples__X_ "Fault manager configuration.  Select up to 4 actions for each fault." VALUE 0x8000399A RecordLayout_8 0 CompuMethod_1 0 65535 /end CHARACTERISTIC
/begin CHARACTERISTIC FaultManager.TPS1AdaptLoMin.Total_Samples__Y_ "Fault manager configuration.  Select up to 4 actions for each fault." VALUE 0x8000399C RecordLayout_8 0 CompuMethod_1 0 65535 /end CHARACTERISTIC
/begin CHARACTERISTIC FaultManager.TPS1AdaptLoMin.Action_1 "Fault manager configuration.  Select up to 4 actions for each fault." VALUE 0x8000399E RecordLayout_8 0 CompuMethod_110 0 65535 /end CHARACTERISTIC
/begin CHARACTERISTIC FaultManager.TPS1AdaptLoMin.Action_1_Condition "Fault manager configuration.  Select up to 4 actions for each fault." VALUE 0x800039A0 RecordLayout_8 0 CompuMethod_111 0 65535 /end CHARACTERISTIC
/begin CHARACTERISTIC FaultManager.TPS1AdaptLoMin.Action_2 "Fault manager configuration.  Select up to 4 actions for each fault." VALUE 0x800039A2 RecordLayout_8 0 CompuMethod_110 0 65535 /end CHARACTERISTIC
/begin CHARACTERISTIC FaultManager.TPS1AdaptLoMin.Action_2_Condition "Fault manager configuration.  Select up to 4 actions for each fault." VALUE 0x800039A4 RecordLayout_8 0 CompuMethod_111 0 65535 /end CHARACTERISTIC
/begin CHARACTERISTIC FaultManager.TPS1AdaptLoMin.Action_3 "Fault manager configuration.  Select up to 4 actions for each fault." VALUE 0x800039A6 RecordLayout_8 0 CompuMethod_110 0 65535 /end CHARACTERISTIC
/begin CHARACTERISTIC FaultManager.TPS1AdaptLoMin.Action_3_Condition "Fault manager configuration.  Select up to 4 actions for each fault." VALUE 0x800039A8 RecordLayout_8 0 CompuMethod_111 0 65535 /end CHARACTERISTIC
/begin CHARACTERISTIC FaultManager.TPS1AdaptLoMin.Action_4 "Fault manager configuration.  Select up to 4 actions for each fault." VALUE 0x800039AA RecordLayout_8 0 CompuMethod_110 0 65535 /end CHARACTERISTIC
/begin CHARACTERISTIC FaultManager.TPS1AdaptLoMin.Action_4_Condition "Fault manager configuration.  Select up to 4 actions for each fault." VALUE 0x800039AC RecordLayout_8 0 CompuMethod_111 0 65535 /end CHARACTERISTIC
/begin CHARACTERISTIC FaultManager.TPS1RangeHigh.Mode "Fault manager configuration.  Select up to 4 actions for each fault." VALUE 0x800039AE RecordLayout_8 0 CompuMethod_108 0 65535 /end CHARACTERISTIC
/begin CHARACTERISTIC FaultManager.TPS1RangeHigh.ID "Fault manager configuration.  Select up to 4 actions for each fault." VALUE 0x800039B0 RecordLayout_8 0 CompuMethod_1 0 65535 /end CHARACTERISTIC
/begin CHARACTERISTIC FaultManager.TPS1RangeHigh.Test "Fault manager configuration.  Select up to 4 actions for each fault." VALUE 0x800039B2 RecordLayout_8 0 CompuMethod_109 0 65535 /end CHARACTERISTIC
/begin CHARACTERISTIC FaultManager.TPS1RangeHigh.Faulty_Samples__X_ "Fault manager configuration.  Select up to 4 actions for each fault." VALUE 0x800039B4 RecordLayout_8 0 CompuMethod_1 0 65535 /end CHARACTERISTIC
/begin CHARACTERISTIC FaultManager.TPS1RangeHigh.Total_Samples__Y_ "Fault manager configuration.  Select up to 4 actions for each fault." VALUE 0x800039B6 RecordLayout_8 0 CompuMethod_1 0 65535 /end CHARACTERISTIC
/begin CHARACTERISTIC FaultManager.TPS1RangeHigh.Action_1 "Fault manager configuration.  Select up to 4 actions for each fault." VALUE 0x800039B8 RecordLayout_8 0 CompuMethod_110 0 65535 /end CHARACTERISTIC
/begin CHARACTERISTIC FaultManager.TPS1RangeHigh.Action_1_Condition "Fault manager configuration.  Select up to 4 actions for each fault." VALUE 0x800039BA RecordLayout_8 0 CompuMethod_111 0 65535 /end CHARACTERISTIC
/begin CHARACTERISTIC FaultManager.TPS1RangeHigh.Action_2 "Fault manager configuration.  Select up to 4 actions for each fault." VALUE 0x800039BC RecordLayout_8 0 CompuMethod_110 0 65535 /end CHARACTERISTIC
/begin CHARACTERISTIC FaultManager.TPS1RangeHigh.Action_2_Condition "Fault manager configuration.  Select up to 4 actions for each fault." VALUE 0x800039BE RecordLayout_8 0 CompuMethod_111 0 65535 /end CHARACTERISTIC
/begin CHARACTERISTIC FaultManager.TPS1RangeHigh.Action_3 "Fault manager configuration.  Select up to 4 actions for each fault." VALUE 0x800039C0 RecordLayout_8 0 CompuMethod_110 0 65535 /end CHARACTERISTIC
/begin CHARACTERISTIC FaultManager.TPS1RangeHigh.Action_3_Condition "Fault manager configuration.  Select up to 4 actions for each fault." VALUE 0x800039C2 RecordLayout_8 0 CompuMethod_111 0 65535 /end CHARACTERISTIC
/begin CHARACTERISTIC FaultManager.TPS1RangeHigh.Action_4 "Fault manager configuration.  Select up to 4 actions for each fault." VALUE 0x800039C4 RecordLayout_8 0 CompuMethod_110 0 65535 /end CHARACTERISTIC
/begin CHARACTERISTIC FaultManager.TPS1RangeHigh.Action_4_Condition "Fault manager configuration.  Select up to 4 actions for each fault." VALUE 0x800039C6 RecordLayout_8 0 CompuMethod_111 0 65535 /end CHARACTERISTIC
/begin CHARACTERISTIC FaultManager.TPS1RangeLow.Mode "Fault manager configuration.  Select up to 4 actions for each fault." VALUE 0x800039C8 RecordLayout_8 0 CompuMethod_108 0 65535 /end CHARACTERISTIC
/begin CHARACTERISTIC FaultManager.TPS1RangeLow.ID "Fault manager configuration.  Select up to 4 actions for each fault." VALUE 0x800039CA RecordLayout_8 0 CompuMethod_1 0 65535 /end CHARACTERISTIC
/begin CHARACTERISTIC FaultManager.TPS1RangeLow.Test "Fault manager configuration.  Select up to 4 actions for each fault." VALUE 0x800039CC RecordLayout_8 0 CompuMethod_109 0 65535 /end CHARACTERISTIC
/begin CHARACTERISTIC FaultManager.TPS1RangeLow.Faulty_Samples__X_ "Fault manager configuration.  Select up to 4 actions for each fault." VALUE 0x800039CE RecordLayout_8 0 CompuMethod_1 0 65535 /end CHARACTERISTIC
/begin CHARACTERISTIC FaultManager.TPS1RangeLow.Total_Samples__Y_ "Fault manager configuration.  Select up to 4 actions for each fault." VALUE 0x800039D0 RecordLayout_8 0 CompuMethod_1 0 65535 /end CHARACTERISTIC
/begin CHARACTERISTIC FaultManager.TPS1RangeLow.Action_1 "Fault manager configuration.  Select up to 4 actions for each fault." VALUE 0x800039D2 RecordLayout_8 0 CompuMethod_110 0 65535 /end CHARACTERISTIC
/begin CHARACTERISTIC FaultManager.TPS1RangeLow.Action_1_Condition "Fault manager configuration.  Select up to 4 actions for each fault." VALUE 0x800039D4 RecordLayout_8 0 CompuMethod_111 0 65535 /end CHARACTERISTIC
/begin CHARACTERISTIC FaultManager.TPS1RangeLow.Action_2 "Fault manager configuration.  Select up to 4 actions for each fault." VALUE 0x800039D6 RecordLayout_8 0 CompuMethod_110 0 65535 /end CHARACTERISTIC
/begin CHARACTERISTIC FaultManager.TPS1RangeLow.Action_2_Condition "Fault manager configuration.  Select up to 4 actions for each fault." VALUE 0x800039D8 RecordLayout_8 0 CompuMethod_111 0 65535 /end CHARACTERISTIC
/begin CHARACTERISTIC FaultManager.TPS1RangeLow.Action_3 "Fault manager configuration.  Select up to 4 actions for each fault." VALUE 0x800039DA RecordLayout_8 0 CompuMethod_110 0 65535 /end CHARACTERISTIC
/begin CHARACTERISTIC FaultManager.TPS1RangeLow.Action_3_Condition "Fault manager configuration.  Select up to 4 actions for each fault." VALUE 0x800039DC RecordLayout_8 0 CompuMethod_111 0 65535 /end CHARACTERISTIC
/begin CHARACTERISTIC FaultManager.TPS1RangeLow.Action_4 "Fault manager configuration.  Select up to 4 actions for each fault." VALUE 0x800039DE RecordLayout_8 0 CompuMethod_110 0 65535 /end CHARACTERISTIC
/begin CHARACTERISTIC FaultManager.TPS1RangeLow.Action_4_Condition "Fault manager configuration.  Select up to 4 actions for each fault." VALUE 0x800039E0 RecordLayout_8 0 CompuMethod_111 0 65535 /end CHARACTERISTIC
/begin CHARACTERISTIC FaultManager.TPS2AdaptHiMax.Mode "Fault manager configuration.  Select up to 4 actions for each fault." VALUE 0x800039E2 RecordLayout_8 0 CompuMethod_108 0 65535 /end CHARACTERISTIC
/begin CHARACTERISTIC FaultManager.TPS2AdaptHiMax.ID "Fault manager configuration.  Select up to 4 actions for each fault." VALUE 0x800039E4 RecordLayout_8 0 CompuMethod_1 0 65535 /end CHARACTERISTIC
/begin CHARACTERISTIC FaultManager.TPS2AdaptHiMax.Test "Fault manager configuration.  Select up to 4 actions for each fault." VALUE 0x800039E6 RecordLayout_8 0 CompuMethod_109 0 65535 /end CHARACTERISTIC
/begin CHARACTERISTIC FaultManager.TPS2AdaptHiMax.Faulty_Samples__X_ "Fault manager configuration.  Select up to 4 actions for each fault." VALUE 0x800039E8 RecordLayout_8 0 CompuMethod_1 0 65535 /end CHARACTERISTIC
/begin CHARACTERISTIC FaultManager.TPS2AdaptHiMax.Total_Samples__Y_ "Fault manager configuration.  Select up to 4 actions for each fault." VALUE 0x800039EA RecordLayout_8 0 CompuMethod_1 0 65535 /end CHARACTERISTIC
/begin CHARACTERISTIC FaultManager.TPS2AdaptHiMax.Action_1 "Fault manager configuration.  Select up to 4 actions for each fault." VALUE 0x800039EC RecordLayout_8 0 CompuMethod_110 0 65535 /end CHARACTERISTIC
/begin CHARACTERISTIC FaultManager.TPS2AdaptHiMax.Action_1_Condition "Fault manager configuration.  Select up to 4 actions for each fault." VALUE 0x800039EE RecordLayout_8 0 CompuMethod_111 0 65535 /end CHARACTERISTIC
/begin CHARACTERISTIC FaultManager.TPS2AdaptHiMax.Action_2 "Fault manager configuration.  Select up to 4 actions for each fault." VALUE 0x800039F0 RecordLayout_8 0 CompuMethod_110 0 65535 /end CHARACTERISTIC
/begin CHARACTERISTIC FaultManager.TPS2AdaptHiMax.Action_2_Condition "Fault manager configuration.  Select up to 4 actions for each fault." VALUE 0x800039F2 RecordLayout_8 0 CompuMethod_111 0 65535 /end CHARACTERISTIC
/begin CHARACTERISTIC FaultManager.TPS2AdaptHiMax.Action_3 "Fault manager configuration.  Select up to 4 actions for each fault." VALUE 0x800039F4 RecordLayout_8 0 CompuMethod_110 0 65535 /end CHARACTERISTIC
/begin CHARACTERISTIC FaultManager.TPS2AdaptHiMax.Action_3_Condition "Fault manager configuration.  Select up to 4 actions for each fault." VALUE 0x800039F6 RecordLayout_8 0 CompuMethod_111 0 65535 /end CHARACTERISTIC
/begin CHARACTERISTIC FaultManager.TPS2AdaptHiMax.Action_4 "Fault manager configuration.  Select up to 4 actions for each fault." VALUE 0x800039F8 RecordLayout_8 0 CompuMethod_110 0 65535 /end CHARACTERISTIC
/begin CHARACTERISTIC FaultManager.TPS2AdaptHiMax.Action_4_Condition "Fault manager configuration.  Select up to 4 actions for each fault." VALUE 0x800039FA RecordLayout_8 0 CompuMethod_111 0 65535 /end CHARACTERISTIC
/begin CHARACTERISTIC FaultManager.TPS2AdaptHiMin.Mode "Fault manager configuration.  Select up to 4 actions for each fault." VALUE 0x800039FC RecordLayout_8 0 CompuMethod_108 0 65535 /end CHARACTERISTIC
/begin CHARACTERISTIC FaultManager.TPS2AdaptHiMin.ID "Fault manager configuration.  Select up to 4 actions for each fault." VALUE 0x800039FE RecordLayout_8 0 CompuMethod_1 0 65535 /end CHARACTERISTIC
/begin CHARACTERISTIC FaultManager.TPS2AdaptHiMin.Test "Fault manager configuration.  Select up to 4 actions for each fault." VALUE 0x80003A00 RecordLayout_8 0 CompuMethod_109 0 65535 /end CHARACTERISTIC
/begin CHARACTERISTIC FaultManager.TPS2AdaptHiMin.Faulty_Samples__X_ "Fault manager configuration.  Select up to 4 actions for each fault." VALUE 0x80003A02 RecordLayout_8 0 CompuMethod_1 0 65535 /end CHARACTERISTIC
/begin CHARACTERISTIC FaultManager.TPS2AdaptHiMin.Total_Samples__Y_ "Fault manager configuration.  Select up to 4 actions for each fault." VALUE 0x80003A04 RecordLayout_8 0 CompuMethod_1 0 65535 /end CHARACTERISTIC
/begin CHARACTERISTIC FaultManager.TPS2AdaptHiMin.Action_1 "Fault manager configuration.  Select up to 4 actions for each fault." VALUE 0x80003A06 RecordLayout_8 0 CompuMethod_110 0 65535 /end CHARACTERISTIC
/begin CHARACTERISTIC FaultManager.TPS2AdaptHiMin.Action_1_Condition "Fault manager configuration.  Select up to 4 actions for each fault." VALUE 0x80003A08 RecordLayout_8 0 CompuMethod_111 0 65535 /end CHARACTERISTIC
/begin CHARACTERISTIC FaultManager.TPS2AdaptHiMin.Action_2 "Fault manager configuration.  Select up to 4 actions for each fault." VALUE 0x80003A0A RecordLayout_8 0 CompuMethod_110 0 65535 /end CHARACTERISTIC
/begin CHARACTERISTIC FaultManager.TPS2AdaptHiMin.Action_2_Condition "Fault manager configuration.  Select up to 4 actions for each fault." VALUE 0x80003A0C RecordLayout_8 0 CompuMethod_111 0 65535 /end CHARACTERISTIC
/begin CHARACTERISTIC FaultManager.TPS2AdaptHiMin.Action_3 "Fault manager configuration.  Select up to 4 actions for each fault." VALUE 0x80003A0E RecordLayout_8 0 CompuMethod_110 0 65535 /end CHARACTERISTIC
/begin CHARACTERISTIC FaultManager.TPS2AdaptHiMin.Action_3_Condition "Fault manager configuration.  Select up to 4 actions for each fault." VALUE 0x80003A10 RecordLayout_8 0 CompuMethod_111 0 65535 /end CHARACTERISTIC
/begin CHARACTERISTIC FaultManager.TPS2AdaptHiMin.Action_4 "Fault manager configuration.  Select up to 4 actions for each fault." VALUE 0x80003A12 RecordLayout_8 0 CompuMethod_110 0 65535 /end CHARACTERISTIC
/begin CHARACTERISTIC FaultManager.TPS2AdaptHiMin.Action_4_Condition "Fault manager configuration.  Select up to 4 actions for each fault." VALUE 0x80003A14 RecordLayout_8 0 CompuMethod_111 0 65535 /end CHARACTERISTIC
/begin CHARACTERISTIC FaultManager.TPS2AdaptLoMax.Mode "Fault manager configuration.  Select up to 4 actions for each fault." VALUE 0x80003A16 RecordLayout_8 0 CompuMethod_108 0 65535 /end CHARACTERISTIC
/begin CHARACTERISTIC FaultManager.TPS2AdaptLoMax.ID "Fault manager configuration.  Select up to 4 actions for each fault." VALUE 0x80003A18 RecordLayout_8 0 CompuMethod_1 0 65535 /end CHARACTERISTIC
/begin CHARACTERISTIC FaultManager.TPS2AdaptLoMax.Test "Fault manager configuration.  Select up to 4 actions for each fault." VALUE 0x80003A1A RecordLayout_8 0 CompuMethod_109 0 65535 /end CHARACTERISTIC
/begin CHARACTERISTIC FaultManager.TPS2AdaptLoMax.Faulty_Samples__X_ "Fault manager configuration.  Select up to 4 actions for each fault." VALUE 0x80003A1C RecordLayout_8 0 CompuMethod_1 0 65535 /end CHARACTERISTIC
/begin CHARACTERISTIC FaultManager.TPS2AdaptLoMax.Total_Samples__Y_ "Fault manager configuration.  Select up to 4 actions for each fault." VALUE 0x80003A1E RecordLayout_8 0 CompuMethod_1 0 65535 /end CHARACTERISTIC
/begin CHARACTERISTIC FaultManager.TPS2AdaptLoMax.Action_1 "Fault manager configuration.  Select up to 4 actions for each fault." VALUE 0x80003A20 RecordLayout_8 0 CompuMethod_110 0 65535 /end CHARACTERISTIC
/begin CHARACTERISTIC FaultManager.TPS2AdaptLoMax.Action_1_Condition "Fault manager configuration.  Select up to 4 actions for each fault." VALUE 0x80003A22 RecordLayout_8 0 CompuMethod_111 0 65535 /end CHARACTERISTIC
/begin CHARACTERISTIC FaultManager.TPS2AdaptLoMax.Action_2 "Fault manager configuration.  Select up to 4 actions for each fault." VALUE 0x80003A24 RecordLayout_8 0 CompuMethod_110 0 65535 /end CHARACTERISTIC
/begin CHARACTERISTIC FaultManager.TPS2AdaptLoMax.Action_2_Condition "Fault manager configuration.  Select up to 4 actions for each fault." VALUE 0x80003A26 RecordLayout_8 0 CompuMethod_111 0 65535 /end CHARACTERISTIC
/begin CHARACTERISTIC FaultManager.TPS2AdaptLoMax.Action_3 "Fault manager configuration.  Select up to 4 actions for each fault." VALUE 0x80003A28 RecordLayout_8 0 CompuMethod_110 0 65535 /end CHARACTERISTIC
/begin CHARACTERISTIC FaultManager.TPS2AdaptLoMax.Action_3_Condition "Fault manager configuration.  Select up to 4 actions for each fault." VALUE 0x80003A2A RecordLayout_8 0 CompuMethod_111 0 65535 /end CHARACTERISTIC
/begin CHARACTERISTIC FaultManager.TPS2AdaptLoMax.Action_4 "Fault manager configuration.  Select up to 4 actions for each fault." VALUE 0x80003A2C RecordLayout_8 0 CompuMethod_110 0 65535 /end CHARACTERISTIC
/begin CHARACTERISTIC FaultManager.TPS2AdaptLoMax.Action_4_Condition "Fault manager configuration.  Select up to 4 actions for each fault." VALUE 0x80003A2E RecordLayout_8 0 CompuMethod_111 0 65535 /end CHARACTERISTIC
/begin CHARACTERISTIC FaultManager.TPS2AdaptLoMin.Mode "Fault manager configuration.  Select up to 4 actions for each fault." VALUE 0x80003A30 RecordLayout_8 0 CompuMethod_108 0 65535 /end CHARACTERISTIC
/begin CHARACTERISTIC FaultManager.TPS2AdaptLoMin.ID "Fault manager configuration.  Select up to 4 actions for each fault." VALUE 0x80003A32 RecordLayout_8 0 CompuMethod_1 0 65535 /end CHARACTERISTIC
/begin CHARACTERISTIC FaultManager.TPS2AdaptLoMin.Test "Fault manager configuration.  Select up to 4 actions for each fault." VALUE 0x80003A34 RecordLayout_8 0 CompuMethod_109 0 65535 /end CHARACTERISTIC
/begin CHARACTERISTIC FaultManager.TPS2AdaptLoMin.Faulty_Samples__X_ "Fault manager configuration.  Select up to 4 actions for each fault." VALUE 0x80003A36 RecordLayout_8 0 CompuMethod_1 0 65535 /end CHARACTERISTIC
/begin CHARACTERISTIC FaultManager.TPS2AdaptLoMin.Total_Samples__Y_ "Fault manager configuration.  Select up to 4 actions for each fault." VALUE 0x80003A38 RecordLayout_8 0 CompuMethod_1 0 65535 /end CHARACTERISTIC
/begin CHARACTERISTIC FaultManager.TPS2AdaptLoMin.Action_1 "Fault manager configuration.  Select up to 4 actions for each fault." VALUE 0x80003A3A RecordLayout_8 0 CompuMethod_110 0 65535 /end CHARACTERISTIC
/begin CHARACTERISTIC FaultManager.TPS2AdaptLoMin.Action_1_Condition "Fault manager configuration.  Select up to 4 actions for each fault." VALUE 0x80003A3C RecordLayout_8 0 CompuMethod_111 0 65535 /end CHARACTERISTIC
/begin CHARACTERISTIC FaultManager.TPS2AdaptLoMin.Action_2 "Fault manager configuration.  Select up to 4 actions for each fault." VALUE 0x80003A3E RecordLayout_8 0 CompuMethod_110 0 65535 /end CHARACTERISTIC
/begin CHARACTERISTIC FaultManager.TPS2AdaptLoMin.Action_2_Condition "Fault manager configuration.  Select up to 4 actions for each fault." VALUE 0x80003A40 RecordLayout_8 0 CompuMethod_111 0 65535 /end CHARACTERISTIC
/begin CHARACTERISTIC FaultManager.TPS2AdaptLoMin.Action_3 "Fault manager configuration.  Select up to 4 actions for each fault." VALUE 0x80003A42 RecordLayout_8 0 CompuMethod_110 0 65535 /end CHARACTERISTIC
/begin CHARACTERISTIC FaultManager.TPS2AdaptLoMin.Action_3_Condition "Fault manager configuration.  Select up to 4 actions for each fault." VALUE 0x80003A44 RecordLayout_8 0 CompuMethod_111 0 65535 /end CHARACTERISTIC
/begin CHARACTERISTIC FaultManager.TPS2AdaptLoMin.Action_4 "Fault manager configuration.  Select up to 4 actions for each fault." VALUE 0x80003A46 RecordLayout_8 0 CompuMethod_110 0 65535 /end CHARACTERISTIC
/begin CHARACTERISTIC FaultManager.TPS2AdaptLoMin.Action_4_Condition "Fault manager configuration.  Select up to 4 actions for each fault." VALUE 0x80003A48 RecordLayout_8 0 CompuMethod_111 0 65535 /end CHARACTERISTIC
/begin CHARACTERISTIC FaultManager.TPS2RangeHigh.Mode "Fault manager configuration.  Select up to 4 actions for each fault." VALUE 0x80003A4A RecordLayout_8 0 CompuMethod_108 0 65535 /end CHARACTERISTIC
/begin CHARACTERISTIC FaultManager.TPS2RangeHigh.ID "Fault manager configuration.  Select up to 4 actions for each fault." VALUE 0x80003A4C RecordLayout_8 0 CompuMethod_1 0 65535 /end CHARACTERISTIC
/begin CHARACTERISTIC FaultManager.TPS2RangeHigh.Test "Fault manager configuration.  Select up to 4 actions for each fault." VALUE 0x80003A4E RecordLayout_8 0 CompuMethod_109 0 65535 /end CHARACTERISTIC
/begin CHARACTERISTIC FaultManager.TPS2RangeHigh.Faulty_Samples__X_ "Fault manager configuration.  Select up to 4 actions for each fault." VALUE 0x80003A50 RecordLayout_8 0 CompuMethod_1 0 65535 /end CHARACTERISTIC
/begin CHARACTERISTIC FaultManager.TPS2RangeHigh.Total_Samples__Y_ "Fault manager configuration.  Select up to 4 actions for each fault." VALUE 0x80003A52 RecordLayout_8 0 CompuMethod_1 0 65535 /end CHARACTERISTIC
/begin CHARACTERISTIC FaultManager.TPS2RangeHigh.Action_1 "Fault manager configuration.  Select up to 4 actions for each fault." VALUE 0x80003A54 RecordLayout_8 0 CompuMethod_110 0 65535 /end CHARACTERISTIC
/begin CHARACTERISTIC FaultManager.TPS2RangeHigh.Action_1_Condition "Fault manager configuration.  Select up to 4 actions for each fault." VALUE 0x80003A56 RecordLayout_8 0 CompuMethod_111 0 65535 /end CHARACTERISTIC
/begin CHARACTERISTIC FaultManager.TPS2RangeHigh.Action_2 "Fault manager configuration.  Select up to 4 actions for each fault." VALUE 0x80003A58 RecordLayout_8 0 CompuMethod_110 0 65535 /end CHARACTERISTIC
/begin CHARACTERISTIC FaultManager.TPS2RangeHigh.Action_2_Condition "Fault manager configuration.  Select up to 4 actions for each fault." VALUE 0x80003A5A RecordLayout_8 0 CompuMethod_111 0 65535 /end CHARACTERISTIC
/begin CHARACTERISTIC FaultManager.TPS2RangeHigh.Action_3 "Fault manager configuration.  Select up to 4 actions for each fault." VALUE 0x80003A5C RecordLayout_8 0 CompuMethod_110 0 65535 /end CHARACTERISTIC
/begin CHARACTERISTIC FaultManager.TPS2RangeHigh.Action_3_Condition "Fault manager configuration.  Select up to 4 actions for each fault." VALUE 0x80003A5E RecordLayout_8 0 CompuMethod_111 0 65535 /end CHARACTERISTIC
/begin CHARACTERISTIC FaultManager.TPS2RangeHigh.Action_4 "Fault manager configuration.  Select up to 4 actions for each fault." VALUE 0x80003A60 RecordLayout_8 0 CompuMethod_110 0 65535 /end CHARACTERISTIC
/begin CHARACTERISTIC FaultManager.TPS2RangeHigh.Action_4_Condition "Fault manager configuration.  Select up to 4 actions for each fault." VALUE 0x80003A62 RecordLayout_8 0 CompuMethod_111 0 65535 /end CHARACTERISTIC
/begin CHARACTERISTIC FaultManager.TPS2RangeLow.Mode "Fault manager configuration.  Select up to 4 actions for each fault." VALUE 0x80003A64 RecordLayout_8 0 CompuMethod_108 0 65535 /end CHARACTERISTIC
/begin CHARACTERISTIC FaultManager.TPS2RangeLow.ID "Fault manager configuration.  Select up to 4 actions for each fault." VALUE 0x80003A66 RecordLayout_8 0 CompuMethod_1 0 65535 /end CHARACTERISTIC
/begin CHARACTERISTIC FaultManager.TPS2RangeLow.Test "Fault manager configuration.  Select up to 4 actions for each fault." VALUE 0x80003A68 RecordLayout_8 0 CompuMethod_109 0 65535 /end CHARACTERISTIC
/begin CHARACTERISTIC FaultManager.TPS2RangeLow.Faulty_Samples__X_ "Fault manager configuration.  Select up to 4 actions for each fault." VALUE 0x80003A6A RecordLayout_8 0 CompuMethod_1 0 65535 /end CHARACTERISTIC
/begin CHARACTERISTIC FaultManager.TPS2RangeLow.Total_Samples__Y_ "Fault manager configuration.  Select up to 4 actions for each fault." VALUE 0x80003A6C RecordLayout_8 0 CompuMethod_1 0 65535 /end CHARACTERISTIC
/begin CHARACTERISTIC FaultManager.TPS2RangeLow.Action_1 "Fault manager configuration.  Select up to 4 actions for each fault." VALUE 0x80003A6E RecordLayout_8 0 CompuMethod_110 0 65535 /end CHARACTERISTIC
/begin CHARACTERISTIC FaultManager.TPS2RangeLow.Action_1_Condition "Fault manager configuration.  Select up to 4 actions for each fault." VALUE 0x80003A70 RecordLayout_8 0 CompuMethod_111 0 65535 /end CHARACTERISTIC
/begin CHARACTERISTIC FaultManager.TPS2RangeLow.Action_2 "Fault manager configuration.  Select up to 4 actions for each fault." VALUE 0x80003A72 RecordLayout_8 0 CompuMethod_110 0 65535 /end CHARACTERISTIC
/begin CHARACTERISTIC FaultManager.TPS2RangeLow.Action_2_Condition "Fault manager configuration.  Select up to 4 actions for each fault." VALUE 0x80003A74 RecordLayout_8 0 CompuMethod_111 0 65535 /end CHARACTERISTIC
/begin CHARACTERISTIC FaultManager.TPS2RangeLow.Action_3 "Fault manager configuration.  Select up to 4 actions for each fault." VALUE 0x80003A76 RecordLayout_8 0 CompuMethod_110 0 65535 /end CHARACTERISTIC
/begin CHARACTERISTIC FaultManager.TPS2RangeLow.Action_3_Condition "Fault manager configuration.  Select up to 4 actions for each fault." VALUE 0x80003A78 RecordLayout_8 0 CompuMethod_111 0 65535 /end CHARACTERISTIC
/begin CHARACTERISTIC FaultManager.TPS2RangeLow.Action_4 "Fault manager configuration.  Select up to 4 actions for each fault." VALUE 0x80003A7A RecordLayout_8 0 CompuMethod_110 0 65535 /end CHARACTERISTIC
/begin CHARACTERISTIC FaultManager.TPS2RangeLow.Action_4_Condition "Fault manager configuration.  Select up to 4 actions for each fault." VALUE 0x80003A7C RecordLayout_8 0 CompuMethod_111 0 65535 /end CHARACTERISTIC
/begin CHARACTERISTIC FaultManager.TPS_Sensors_Conflict.Mode "Fault manager configuration.  Select up to 4 actions for each fault." VALUE 0x80003A7E RecordLayout_8 0 CompuMethod_108 0 65535 /end CHARACTERISTIC
/begin CHARACTERISTIC FaultManager.TPS_Sensors_Conflict.ID "Fault manager configuration.  Select up to 4 actions for each fault." VALUE 0x80003A80 RecordLayout_8 0 CompuMethod_1 0 65535 /end CHARACTERISTIC
/begin CHARACTERISTIC FaultManager.TPS_Sensors_Conflict.Test "Fault manager configuration.  Select up to 4 actions for each fault." VALUE 0x80003A82 RecordLayout_8 0 CompuMethod_109 0 65535 /end CHARACTERISTIC
/begin CHARACTERISTIC FaultManager.TPS_Sensors_Conflict.Faulty_Samples__X_ "Fault manager configuration.  Select up to 4 actions for each fault." VALUE 0x80003A84 RecordLayout_8 0 CompuMethod_1 0 65535 /end CHARACTERISTIC
/begin CHARACTERISTIC FaultManager.TPS_Sensors_Conflict.Total_Samples__Y_ "Fault manager configuration.  Select up to 4 actions for each fault." VALUE 0x80003A86 RecordLayout_8 0 CompuMethod_1 0 65535 /end CHARACTERISTIC
/begin CHARACTERISTIC FaultManager.TPS_Sensors_Conflict.Action_1 "Fault manager configuration.  Select up to 4 actions for each fault." VALUE 0x80003A88 RecordLayout_8 0 CompuMethod_110 0 65535 /end CHARACTERISTIC
/begin CHARACTERISTIC FaultManager.TPS_Sensors_Conflict.Action_1_Condition "Fault manager configuration.  Select up to 4 actions for each fault." VALUE 0x80003A8A RecordLayout_8 0 CompuMethod_111 0 65535 /end CHARACTERISTIC
/begin CHARACTERISTIC FaultManager.TPS_Sensors_Conflict.Action_2 "Fault manager configuration.  Select up to 4 actions for each fault." VALUE 0x80003A8C RecordLayout_8 0 CompuMethod_110 0 65535 /end CHARACTERISTIC
/begin CHARACTERISTIC FaultManager.TPS_Sensors_Conflict.Action_2_Condition "Fault manager configuration.  Select up to 4 actions for each fault." VALUE 0x80003A8E RecordLayout_8 0 CompuMethod_111 0 65535 /end CHARACTERISTIC
/begin CHARACTERISTIC FaultManager.TPS_Sensors_Conflict.Action_3 "Fault manager configuration.  Select up to 4 actions for each fault." VALUE 0x80003A90 RecordLayout_8 0 CompuMethod_110 0 65535 /end CHARACTERISTIC
/begin CHARACTERISTIC FaultManager.TPS_Sensors_Conflict.Action_3_Condition "Fault manager configuration.  Select up to 4 actions for each fault." VALUE 0x80003A92 RecordLayout_8 0 CompuMethod_111 0 65535 /end CHARACTERISTIC
/begin CHARACTERISTIC FaultManager.TPS_Sensors_Conflict.Action_4 "Fault manager configuration.  Select up to 4 actions for each fault." VALUE 0x80003A94 RecordLayout_8 0 CompuMethod_110 0 65535 /end CHARACTERISTIC
/begin CHARACTERISTIC FaultManager.TPS_Sensors_Conflict.Action_4_Condition "Fault manager configuration.  Select up to 4 actions for each fault." VALUE 0x80003A96 RecordLayout_8 0 CompuMethod_111 0 65535 /end CHARACTERISTIC
/begin CHARACTERISTIC FaultManager.VSPDRangeHigh.Mode "Fault manager configuration.  Select up to 4 actions for each fault." VALUE 0x80003A98 RecordLayout_8 0 CompuMethod_108 0 65535 /end CHARACTERISTIC
/begin CHARACTERISTIC FaultManager.VSPDRangeHigh.ID "Fault manager configuration.  Select up to 4 actions for each fault." VALUE 0x80003A9A RecordLayout_8 0 CompuMethod_1 0 65535 /end CHARACTERISTIC
/begin CHARACTERISTIC FaultManager.VSPDRangeHigh.Test "Fault manager configuration.  Select up to 4 actions for each fault." VALUE 0x80003A9C RecordLayout_8 0 CompuMethod_109 0 65535 /end CHARACTERISTIC
/begin CHARACTERISTIC FaultManager.VSPDRangeHigh.Faulty_Samples__X_ "Fault manager configuration.  Select up to 4 actions for each fault." VALUE 0x80003A9E RecordLayout_8 0 CompuMethod_1 0 65535 /end CHARACTERISTIC
/begin CHARACTERISTIC FaultManager.VSPDRangeHigh.Total_Samples__Y_ "Fault manager configuration.  Select up to 4 actions for each fault." VALUE 0x80003AA0 RecordLayout_8 0 CompuMethod_1 0 65535 /end CHARACTERISTIC
/begin CHARACTERISTIC FaultManager.VSPDRangeHigh.Action_1 "Fault manager configuration.  Select up to 4 actions for each fault." VALUE 0x80003AA2 RecordLayout_8 0 CompuMethod_110 0 65535 /end CHARACTERISTIC
/begin CHARACTERISTIC FaultManager.VSPDRangeHigh.Action_1_Condition "Fault manager configuration.  Select up to 4 actions for each fault." VALUE 0x80003AA4 RecordLayout_8 0 CompuMethod_111 0 65535 /end CHARACTERISTIC
/begin CHARACTERISTIC FaultManager.VSPDRangeHigh.Action_2 "Fault manager configuration.  Select up to 4 actions for each fault." VALUE 0x80003AA6 RecordLayout_8 0 CompuMethod_110 0 65535 /end CHARACTERISTIC
/begin CHARACTERISTIC FaultManager.VSPDRangeHigh.Action_2_Condition "Fault manager configuration.  Select up to 4 actions for each fault." VALUE 0x80003AA8 RecordLayout_8 0 CompuMethod_111 0 65535 /end CHARACTERISTIC
/begin CHARACTERISTIC FaultManager.VSPDRangeHigh.Action_3 "Fault manager configuration.  Select up to 4 actions for each fault." VALUE 0x80003AAA RecordLayout_8 0 CompuMethod_110 0 65535 /end CHARACTERISTIC
/begin CHARACTERISTIC FaultManager.VSPDRangeHigh.Action_3_Condition "Fault manager configuration.  Select up to 4 actions for each fault." VALUE 0x80003AAC RecordLayout_8 0 CompuMethod_111 0 65535 /end CHARACTERISTIC
/begin CHARACTERISTIC FaultManager.VSPDRangeHigh.Action_4 "Fault manager configuration.  Select up to 4 actions for each fault." VALUE 0x80003AAE RecordLayout_8 0 CompuMethod_110 0 65535 /end CHARACTERISTIC
/begin CHARACTERISTIC FaultManager.VSPDRangeHigh.Action_4_Condition "Fault manager configuration.  Select up to 4 actions for each fault." VALUE 0x80003AB0 RecordLayout_8 0 CompuMethod_111 0 65535 /end CHARACTERISTIC
/begin CHARACTERISTIC FaultManager.VSPDRangeLow.Mode "Fault manager configuration.  Select up to 4 actions for each fault." VALUE 0x80003AB2 RecordLayout_8 0 CompuMethod_108 0 65535 /end CHARACTERISTIC
/begin CHARACTERISTIC FaultManager.VSPDRangeLow.ID "Fault manager configuration.  Select up to 4 actions for each fault." VALUE 0x80003AB4 RecordLayout_8 0 CompuMethod_1 0 65535 /end CHARACTERISTIC
/begin CHARACTERISTIC FaultManager.VSPDRangeLow.Test "Fault manager configuration.  Select up to 4 actions for each fault." VALUE 0x80003AB6 RecordLayout_8 0 CompuMethod_109 0 65535 /end CHARACTERISTIC
/begin CHARACTERISTIC FaultManager.VSPDRangeLow.Faulty_Samples__X_ "Fault manager configuration.  Select up to 4 actions for each fault." VALUE 0x80003AB8 RecordLayout_8 0 CompuMethod_1 0 65535 /end CHARACTERISTIC
/begin CHARACTERISTIC FaultManager.VSPDRangeLow.Total_Samples__Y_ "Fault manager configuration.  Select up to 4 actions for each fault." VALUE 0x80003ABA RecordLayout_8 0 CompuMethod_1 0 65535 /end CHARACTERISTIC
/begin CHARACTERISTIC FaultManager.VSPDRangeLow.Action_1 "Fault manager configuration.  Select up to 4 actions for each fault." VALUE 0x80003ABC RecordLayout_8 0 CompuMethod_110 0 65535 /end CHARACTERISTIC
/begin CHARACTERISTIC FaultManager.VSPDRangeLow.Action_1_Condition "Fault manager configuration.  Select up to 4 actions for each fault." VALUE 0x80003ABE RecordLayout_8 0 CompuMethod_111 0 65535 /end CHARACTERISTIC
/begin CHARACTERISTIC FaultManager.VSPDRangeLow.Action_2 "Fault manager configuration.  Select up to 4 actions for each fault." VALUE 0x80003AC0 RecordLayout_8 0 CompuMethod_110 0 65535 /end CHARACTERISTIC
/begin CHARACTERISTIC FaultManager.VSPDRangeLow.Action_2_Condition "Fault manager configuration.  Select up to 4 actions for each fault." VALUE 0x80003AC2 RecordLayout_8 0 CompuMethod_111 0 65535 /end CHARACTERISTIC
/begin CHARACTERISTIC FaultManager.VSPDRangeLow.Action_3 "Fault manager configuration.  Select up to 4 actions for each fault." VALUE 0x80003AC4 RecordLayout_8 0 CompuMethod_110 0 65535 /end CHARACTERISTIC
/begin CHARACTERISTIC FaultManager.VSPDRangeLow.Action_3_Condition "Fault manager configuration.  Select up to 4 actions for each fault." VALUE 0x80003AC6 RecordLayout_8 0 CompuMethod_111 0 65535 /end CHARACTERISTIC
/begin CHARACTERISTIC FaultManager.VSPDRangeLow.Action_4 "Fault manager configuration.  Select up to 4 actions for each fault." VALUE 0x80003AC8 RecordLayout_8 0 CompuMethod_110 0 65535 /end CHARACTERISTIC
/begin CHARACTERISTIC FaultManager.VSPDRangeLow.Action_4_Condition "Fault manager configuration.  Select up to 4 actions for each fault." VALUE 0x80003ACA RecordLayout_8 0 CompuMethod_111 0 65535 /end CHARACTERISTIC
/begin CHARACTERISTIC FaultManager.Wastegate_Fault.Mode "Fault manager configuration.  Select up to 4 actions for each fault." VALUE 0x80003ACC RecordLayout_8 0 CompuMethod_108 0 65535 /end CHARACTERISTIC
/begin CHARACTERISTIC FaultManager.Wastegate_Fault.ID "Fault manager configuration.  Select up to 4 actions for each fault." VALUE 0x80003ACE RecordLayout_8 0 CompuMethod_1 0 65535 /end CHARACTERISTIC
/begin CHARACTERISTIC FaultManager.Wastegate_Fault.Test "Fault manager configuration.  Select up to 4 actions for each fault." VALUE 0x80003AD0 RecordLayout_8 0 CompuMethod_109 0 65535 /end CHARACTERISTIC
/begin CHARACTERISTIC FaultManager.Wastegate_Fault.Faulty_Samples__X_ "Fault manager configuration.  Select up to 4 actions for each fault." VALUE 0x80003AD2 RecordLayout_8 0 CompuMethod_1 0 65535 /end CHARACTERISTIC
/begin CHARACTERISTIC FaultManager.Wastegate_Fault.Total_Samples__Y_ "Fault manager configuration.  Select up to 4 actions for each fault." VALUE 0x80003AD4 RecordLayout_8 0 CompuMethod_1 0 65535 /end CHARACTERISTIC
/begin CHARACTERISTIC FaultManager.Wastegate_Fault.Action_1 "Fault manager configuration.  Select up to 4 actions for each fault." VALUE 0x80003AD6 RecordLayout_8 0 CompuMethod_110 0 65535 /end CHARACTERISTIC
/begin CHARACTERISTIC FaultManager.Wastegate_Fault.Action_1_Condition "Fault manager configuration.  Select up to 4 actions for each fault." VALUE 0x80003AD8 RecordLayout_8 0 CompuMethod_111 0 65535 /end CHARACTERISTIC
/begin CHARACTERISTIC FaultManager.Wastegate_Fault.Action_2 "Fault manager configuration.  Select up to 4 actions for each fault." VALUE 0x80003ADA RecordLayout_8 0 CompuMethod_110 0 65535 /end CHARACTERISTIC
/begin CHARACTERISTIC FaultManager.Wastegate_Fault.Action_2_Condition "Fault manager configuration.  Select up to 4 actions for each fault." VALUE 0x80003ADC RecordLayout_8 0 CompuMethod_111 0 65535 /end CHARACTERISTIC
/begin CHARACTERISTIC FaultManager.Wastegate_Fault.Action_3 "Fault manager configuration.  Select up to 4 actions for each fault." VALUE 0x80003ADE RecordLayout_8 0 CompuMethod_110 0 65535 /end CHARACTERISTIC
/begin CHARACTERISTIC FaultManager.Wastegate_Fault.Action_3_Condition "Fault manager configuration.  Select up to 4 actions for each fault." VALUE 0x80003AE0 RecordLayout_8 0 CompuMethod_111 0 65535 /end CHARACTERISTIC
/begin CHARACTERISTIC FaultManager.Wastegate_Fault.Action_4 "Fault manager configuration.  Select up to 4 actions for each fault." VALUE 0x80003AE2 RecordLayout_8 0 CompuMethod_110 0 65535 /end CHARACTERISTIC
/begin CHARACTERISTIC FaultManager.Wastegate_Fault.Action_4_Condition "Fault manager configuration.  Select up to 4 actions for each fault." VALUE 0x80003AE4 RecordLayout_8 0 CompuMethod_111 0 65535 /end CHARACTERISTIC
/begin CHARACTERISTIC FgndTimeStackMargin "When the available stack space drops below this threshold, the application performs a safety stop" VALUE 0x80003B04 RecordLayout_8 0 CompuMethod_52 0 4096 /end CHARACTERISTIC
/begin CHARACTERISTIC FuelAdaptDelta "O2_Error must be less than this delta to adapt the FuelFlowComp map" VALUE 0x80003BC1 RecordLayout_4 0 CompuMethod_33 0 2 /end CHARACTERISTIC
/begin CHARACTERISTIC FuelAdaptEnable "Determines whether the FuelFlowComp map will be adapted using the MAF sensor" VALUE 0x80003BC5 RecordLayout_1 0 CompuMethod_29 0 1 /end CHARACTERISTIC
/begin CHARACTERISTIC FuelAdaptGainTbl "Gain for updating FuelFlowComp map.  This fraction of the error is added to the map every 5ms." CURVE 0x80003BCE RecordLayout_4 0 CompuMethod_48 -1E+17 1E+17
 /begin AXIS_DESCR COM_AXIS O2ITermIn CompuMethod_33 9 -1E+17 1E+17 AXIS_PTS_REF O2ITermIdxArr /end AXIS_DESCR
/end CHARACTERISTIC
/begin CHARACTERISTIC FuelFlowCompAdaptMap "Adapt map based on O2 ITerm that is multiplied into FuelFlowComp." MAP 0x80003BF6 RecordLayout_4 0 CompuMethod_33 -1E+17 1E+17
 /begin AXIS_DESCR COM_AXIS RPM09In CompuMethod_25 9 0 14000 AXIS_PTS_REF RPM09IdxArr /end AXIS_DESCR
 /begin AXIS_DESCR COM_AXIS MAP09In CompuMethod_8 9 0 1000 AXIS_PTS_REF MAP09IdxArr /end AXIS_DESCR
/end CHARACTERISTIC
/begin CHARACTERISTIC FuelFlowCompMap "Fuel Flow Compensation Multiplier - gain to adjust modelling errors in mechanical fuel system." MAP 0x80003D3A RecordLayout_4 0 CompuMethod_33 -1E+17 1E+17
 /begin AXIS_DESCR COM_AXIS RPM09In CompuMethod_25 9 0 14000 AXIS_PTS_REF RPM09IdxArr /end AXIS_DESCR
 /begin AXIS_DESCR COM_AXIS MAP09In CompuMethod_8 9 0 1000 AXIS_PTS_REF MAP09IdxArr /end AXIS_DESCR
/end CHARACTERISTIC
/begin CHARACTERISTIC FuelLvlSensorPin "Analog input pin selection for FuelLvlSensorPin" VALUE 0x80003F8E RecordLayout_5 0 CompuMethod_23 -32768 32767 /end CHARACTERISTIC
/begin CHARACTERISTIC FuelLvlSensorPin_ref "Reference Voltage Selection" VALUE 0x80003F90 RecordLayout_1 0 CompuMethod_24 0 255 /end CHARACTERISTIC
/begin CHARACTERISTIC FuelPresPin "Analog input pin selection for FuelPresPin" VALUE 0x80003FC5 RecordLayout_5 0 CompuMethod_23 -32768 32767 /end CHARACTERISTIC
/begin CHARACTERISTIC FuelPresPin_ref "Reference Voltage Selection" VALUE 0x80003FC7 RecordLayout_1 0 CompuMethod_24 0 255 /end CHARACTERISTIC
/begin CHARACTERISTIC FuelPumpPin "Digital output pin selection for DOut9638p0005" VALUE 0x80003FC8 RecordLayout_5 0 CompuMethod_12 -32768 32767 /end CHARACTERISTIC
/begin CHARACTERISTIC FuelSensorPin "Frequency input pin selection for FuelSensorPin" VALUE 0x80003FEB RecordLayout_5 0 CompuMethod_121 -32768 32767 /end CHARACTERISTIC
/begin CHARACTERISTIC HeapMargin "When the available heap drops below this threshold, the application performs a safety stop" VALUE 0x800040B2 RecordLayout_8 0 CompuMethod_52 0 4096 /end CHARACTERISTIC
/begin CHARACTERISTIC IAC_PPin "PWM output pin selection for IAC_PPin" VALUE 0x800040CD RecordLayout_5 0 CompuMethod_102 -32768 32767 /end CHARACTERISTIC
/begin CHARACTERISTIC IAC_SPin "PWM output pin selection for IAC_SPin" VALUE 0x800040E8 RecordLayout_5 0 CompuMethod_102 -32768 32767 /end CHARACTERISTIC
/begin CHARACTERISTIC IACTypeCal "" VALUE 0x800040EA RecordLayout_1 0 CompuMethod_126 0 255 /end CHARACTERISTIC
/begin CHARACTERISTIC IATFanOff "IAT temp when the fan turns off" VALUE 0x800042D1 RecordLayout_4 0 CompuMethod_27 -1E+17 1E+17 /end CHARACTERISTIC
/begin CHARACTERISTIC IATFanOn "IAT temp when the fan turns on" VALUE 0x800042D5 RecordLayout_4 0 CompuMethod_27 -1E+17 1E+17 /end CHARACTERISTIC
/begin CHARACTERISTIC IATFanSpeed_StallMap "IAT Fan speed request" MAP 0x800042F5 RecordLayout_4 0 CompuMethod_6 0 100
 /begin AXIS_DESCR COM_AXIS IATFanSpeed_StallColIn CompuMethod_17 7 0 300 AXIS_PTS_REF IATFanSpeed_StallColIdxArr /end AXIS_DESCR
 /begin AXIS_DESCR COM_AXIS IATFanSpeed_StallRowIn CompuMethod_127 7 -40 250 AXIS_PTS_REF IATFanSpeed_StallRowIdxArr /end AXIS_DESCR
/end CHARACTERISTIC
/begin CHARACTERISTIC IATFanSpeedMap "ECT Fan speed request" MAP 0x800043F1 RecordLayout_4 0 CompuMethod_6 0 100
 /begin AXIS_DESCR COM_AXIS IATFanSpeedColIn CompuMethod_17 7 0 300 AXIS_PTS_REF IATFanSpeedColIdxArr /end AXIS_DESCR
 /begin AXIS_DESCR COM_AXIS IATFanSpeedRowIn CompuMethod_127 7 -40 250 AXIS_PTS_REF IATFanSpeedRowIdxArr /end AXIS_DESCR
/end CHARACTERISTIC
/begin CHARACTERISTIC IATSensorPin "Analog input pin selection for IATSensorPin" VALUE 0x80004511 RecordLayout_5 0 CompuMethod_23 -32768 32767 /end CHARACTERISTIC
/begin CHARACTERISTIC IATSensorPin_ref "Reference Voltage Selection" VALUE 0x80004513 RecordLayout_1 0 CompuMethod_24 0 255 /end CHARACTERISTIC
/begin CHARACTERISTIC IdleExitTimeConst "Time constant for idle air and spark ramp out" VALUE 0x80004550 RecordLayout_4 0 CompuMethod_128 0 100 /end CHARACTERISTIC
/begin CHARACTERISTIC IdleStackMargin "When the available stack space drops below this threshold, the application performs a safety stop" VALUE 0x80004554 RecordLayout_8 0 CompuMethod_52 0 1024 /end CHARACTERISTIC
/begin CHARACTERISTIC INJ_Behavior "Select the type of injector behavior.  Transient behavior will take more CPU time, but will allow make-up pulses.  Batch Mode always uses Standard Behavior." VALUE 0x8000455E RecordLayout_1 0 CompuMethod_130 0 255 /end CHARACTERISTIC
/begin CHARACTERISTIC INJ_InitialPin "First pin selection for Injector Sequence.  Goes up from here depending on the Sequence Type and number of cylinders" VALUE 0x8000455F RecordLayout_5 0 CompuMethod_131 -32768 32767 /end CHARACTERISTIC
/begin CHARACTERISTIC INJ_SequenceType "Select the type of injector sequence.  The number of pins used will depend on this selection" VALUE 0x80004561 RecordLayout_1 0 CompuMethod_132 0 255 /end CHARACTERISTIC
/begin CHARACTERISTIC InterruptStackMargin "When the available stack space drops below this threshold, the application performs a safety stop" VALUE 0x800046C7 RecordLayout_8 0 CompuMethod_52 0 1280 /end CHARACTERISTIC
/begin CHARACTERISTIC Lambda_1_Timeout "" VALUE 0x800046C9 RecordLayout_4 0 CompuMethod_69 -1E+17 1E+17 /end CHARACTERISTIC
/begin CHARACTERISTIC Lambda_2_Timeout "" VALUE 0x800046CD RecordLayout_4 0 CompuMethod_69 -1E+17 1E+17 /end CHARACTERISTIC
/begin CHARACTERISTIC MAF_Pin "Frequency input pin selection for MAF_Pin" VALUE 0x80004966 RecordLayout_5 0 CompuMethod_121 -32768 32767 /end CHARACTERISTIC
/begin CHARACTERISTIC MAPSensorPin "Analog input pin selection for MAPSensorPin" VALUE 0x80004C22 RecordLayout_5 0 CompuMethod_23 -32768 32767 /end CHARACTERISTIC
/begin CHARACTERISTIC MAPSensorPin_ref "Reference Voltage Selection" VALUE 0x80004C24 RecordLayout_1 0 CompuMethod_24 0 255 /end CHARACTERISTIC
/begin CHARACTERISTIC MaxETCSetPtLimitTbl "Maximum allowable ETC position." CURVE 0x80004C42 RecordLayout_4 0 CompuMethod_6 0 100
 /begin AXIS_DESCR COM_AXIS RPM09In CompuMethod_25 9 0 14000 AXIS_PTS_REF RPM09IdxArr /end AXIS_DESCR
/end CHARACTERISTIC
/begin CHARACTERISTIC MinETCSetpoint "Minimum setpoint for ETC." VALUE 0x80004E10 RecordLayout_4 0 CompuMethod_6 -1E+17 1E+17 /end CHARACTERISTIC
/begin CHARACTERISTIC OilPresPin "Analog input pin selection for OilPresPin" VALUE 0x80004F6F RecordLayout_5 0 CompuMethod_23 -32768 32767 /end CHARACTERISTIC
/begin CHARACTERISTIC OilPresPin_ref "Reference Voltage Selection" VALUE 0x80004F71 RecordLayout_1 0 CompuMethod_24 0 255 /end CHARACTERISTIC
/begin CHARACTERISTIC ScramblePin "Analog input pin selection for ScramblePin" VALUE 0x80005482 RecordLayout_5 0 CompuMethod_23 -32768 32767 /end CHARACTERISTIC
/begin CHARACTERISTIC ScramblePin_ref "Reference Voltage Selection" VALUE 0x80005484 RecordLayout_1 0 CompuMethod_24 0 255 /end CHARACTERISTIC
/begin CHARACTERISTIC SensVoltSensorPin "Analog input pin selection for SensVoltSensorPin" VALUE 0x800054A7 RecordLayout_5 0 CompuMethod_23 -32768 32767 /end CHARACTERISTIC
/begin CHARACTERISTIC SensVoltSensorPin_ref "Reference Voltage Selection" VALUE 0x800054A9 RecordLayout_1 0 CompuMethod_24 0 255 /end CHARACTERISTIC
/begin CHARACTERISTIC SysVoltage "Analog input pin selection for SysVoltage" VALUE 0x80005A9D RecordLayout_5 0 CompuMethod_23 -32768 32767 /end CHARACTERISTIC
/begin CHARACTERISTIC SysVoltage_ref "Reference Voltage Selection" VALUE 0x80005A9F RecordLayout_1 0 CompuMethod_24 0 255 /end CHARACTERISTIC
/begin CHARACTERISTIC ThrottleSource "Selects source of throttle command" VALUE 0x80005AC5 RecordLayout_1 0 CompuMethod_174 0 1 /end CHARACTERISTIC
/begin CHARACTERISTIC TPS1_FiltDecFiltC "Filter time constant for a decreasing signal." VALUE 0x80005B1C RecordLayout_4 0 CompuMethod_20 -1E+17 1E+17 /end CHARACTERISTIC
/begin CHARACTERISTIC TPS1_FiltIncFiltC "Filter time constant for a increasing signal." VALUE 0x80005B20 RecordLayout_4 0 CompuMethod_20 -1E+17 1E+17 /end CHARACTERISTIC
/begin CHARACTERISTIC TPS1AnalogInput "Analog input pin selection for TPS1AnalogInput" VALUE 0x80005B43 RecordLayout_5 0 CompuMethod_23 -32768 32767 /end CHARACTERISTIC
/begin CHARACTERISTIC TPS1AnalogInput_ref "Reference Voltage Selection" VALUE 0x80005B45 RecordLayout_1 0 CompuMethod_24 0 255 /end CHARACTERISTIC
/begin CHARACTERISTIC TPS2_FiltDecFiltC "Filter time constant for a decreasing signal." VALUE 0x80005B5B RecordLayout_4 0 CompuMethod_20 -1E+17 1E+17 /end CHARACTERISTIC
/begin CHARACTERISTIC TPS2_FiltIncFiltC "Filter time constant for a increasing signal." VALUE 0x80005B5F RecordLayout_4 0 CompuMethod_20 -1E+17 1E+17 /end CHARACTERISTIC
/begin CHARACTERISTIC TPS2AnalogInput "Analog input pin selection for TPS2AnalogInput" VALUE 0x80005B7E RecordLayout_5 0 CompuMethod_23 -32768 32767 /end CHARACTERISTIC
/begin CHARACTERISTIC TPS2AnalogInput_ref "Reference Voltage Selection" VALUE 0x80005B80 RecordLayout_1 0 CompuMethod_24 0 255 /end CHARACTERISTIC
/begin CHARACTERISTIC TwoStepPin "Digital input pin selection for TwoStepPin" VALUE 0x80005BA4 RecordLayout_5 0 CompuMethod_94 -32768 32767 /end CHARACTERISTIC
/begin CHARACTERISTIC VSPD_Pin "Frequency input pin selection for VSPD_Pin" VALUE 0x800067F8 RecordLayout_5 0 CompuMethod_121 -32768 32767 /end CHARACTERISTIC
/begin CHARACTERISTIC WASTEGATE "PWM output pin selection for WASTEGATE" VALUE 0x80006A6A RecordLayout_5 0 CompuMethod_102 -32768 32767 /end CHARACTERISTIC
/*~~~~~~~~~ 6.3.17 AXIS_PTS ~~~~~~~~~*/
/begin AXIS_PTS ACPres05IdxArr "Index of AC system high side pressure" 0x80000118 ACPres05In RecordLayout_6 0 CompuMethod_8 5 -150 10000 DEPOSIT ABSOLUTE /end AXIS_PTS
/begin AXIS_PTS ACPresFanSpeed_StallColIdxArr "ACPres Fan speed request" 0x80000138 ACPresFanSpeed_StallColIn RecordLayout_6 0 CompuMethod_17 7 0 300 DEPOSIT ABSOLUTE /end AXIS_PTS
/begin AXIS_PTS ACPresFanSpeed_StallRowIdxArr "ACPres Fan speed request" 0x80000218 ACPresFanSpeed_StallRowIn RecordLayout_6 0 CompuMethod_18 7 0 1000 DEPOSIT ABSOLUTE /end AXIS_PTS
/begin AXIS_PTS ACPresFanSpeedColIdxArr "ACPres Fan speed request" 0x80000234 ACPresFanSpeedColIn RecordLayout_6 0 CompuMethod_17 7 0 300 DEPOSIT ABSOLUTE /end AXIS_PTS
/begin AXIS_PTS ACPresFanSpeedRowIdxArr "ACPres Fan speed request" 0x80000314 ACPresFanSpeedRowIn RecordLayout_6 0 CompuMethod_19 7 0 1000 DEPOSIT ABSOLUTE /end AXIS_PTS
/begin AXIS_PTS AirMinGovSpeedErrorIdxArr "" 0x80000443 AirMinGovSpeedErrorIn RecordLayout_6 0 CompuMethod_2 9 -1E+17 1E+17 DEPOSIT ABSOLUTE /end AXIS_PTS
/begin AXIS_PTS APP17IdxArr "Index of APP for driver demand" 0x800004BD APP17In RecordLayout_6 0 CompuMethod_6 17 0 100 DEPOSIT ABSOLUTE /end AXIS_PTS
/begin AXIS_PTS APP1IdxArr "Look up table to allownon-linear characterization of sensors" 0x80000510 APP1ADC RecordLayout_6 0 CompuMethod_22 9 -1E+17 1E+17 DEPOSIT ABSOLUTE /end AXIS_PTS
/begin AXIS_PTS APP2IdxArr "Look up table to allownon-linear characterization of sensors" 0x800005AC APP2ADC RecordLayout_6 0 CompuMethod_22 9 -1E+17 1E+17 DEPOSIT ABSOLUTE /end AXIS_PTS
/begin AXIS_PTS ECT05IdxArr "Idex of ECT" 0x800020A5 ECT05In RecordLayout_6 0 CompuMethod_27 5 -40 200 DEPOSIT ABSOLUTE /end AXIS_PTS
/begin AXIS_PTS ECTFanSpeed_StallColIdxArr "ECT Fan speed request" 0x800020E9 ECTFanSpeed_StallColIn RecordLayout_6 0 CompuMethod_17 7 0 300 DEPOSIT ABSOLUTE /end AXIS_PTS
/begin AXIS_PTS ECTFanSpeed_StallRowIdxArr "ECT Fan speed request" 0x800021C9 ECTFanSpeed_StallRowIn RecordLayout_6 0 CompuMethod_81 7 -40 250 DEPOSIT ABSOLUTE /end AXIS_PTS
/begin AXIS_PTS ECTFanSpeedColIdxArr "ECT Fan speed request" 0x800021E5 ECTFanSpeedColIn RecordLayout_6 0 CompuMethod_17 7 0 300 DEPOSIT ABSOLUTE /end AXIS_PTS
/begin AXIS_PTS ECTFanSpeedRowIdxArr "ECT Fan speed request" 0x800022C5 ECTFanSpeedRowIn RecordLayout_6 0 CompuMethod_81 7 -40 250 DEPOSIT ABSOLUTE /end AXIS_PTS
/begin AXIS_PTS IAT_KeyUp09IdxArr "Index of IAT captured at key-up." 0x800040F4 IAT_KeyUp09In RecordLayout_6 0 CompuMethod_27 9 -1E+17 1E+17 DEPOSIT ABSOLUTE /end AXIS_PTS
/begin AXIS_PTS IATFanSpeed_StallColIdxArr "IAT Fan speed request" 0x800042D9 IATFanSpeed_StallColIn RecordLayout_6 0 CompuMethod_17 7 0 300 DEPOSIT ABSOLUTE /end AXIS_PTS
/begin AXIS_PTS IATFanSpeed_StallRowIdxArr "IAT Fan speed request" 0x800043B9 IATFanSpeed_StallRowIn RecordLayout_6 0 CompuMethod_127 7 -40 250 DEPOSIT ABSOLUTE /end AXIS_PTS
/begin AXIS_PTS IATFanSpeedColIdxArr "ECT Fan speed request" 0x800043D5 IATFanSpeedColIn RecordLayout_6 0 CompuMethod_17 7 0 300 DEPOSIT ABSOLUTE /end AXIS_PTS
/begin AXIS_PTS IATFanSpeedRowIdxArr "ECT Fan speed request" 0x800044B5 IATFanSpeedRowIn RecordLayout_6 0 CompuMethod_127 7 -40 250 DEPOSIT ABSOLUTE /end AXIS_PTS
/begin AXIS_PTS MAP09IdxArr "Index of MAP" 0x80004BA2 MAP09In RecordLayout_6 0 CompuMethod_8 9 0 1000 DEPOSIT ABSOLUTE /end AXIS_PTS
/begin AXIS_PTS O2ITermIdxArr "Index for O2 ITerm." 0x80004EBA O2ITermIn RecordLayout_6 0 CompuMethod_33 9 -1E+17 1E+17 DEPOSIT ABSOLUTE /end AXIS_PTS
/begin AXIS_PTS RPM09IdxArr "Index of RPM" 0x800053BC RPM09In RecordLayout_6 0 CompuMethod_25 9 0 14000 DEPOSIT ABSOLUTE /end AXIS_PTS
/begin AXIS_PTS TPS09IdxArr "Index of TPS" 0x80005AF8 TPS09In RecordLayout_6 0 CompuMethod_6 9 0 100 DEPOSIT ABSOLUTE /end AXIS_PTS
/begin AXIS_PTS VSPD17IdxArr "Index of VSPD" 0x80006832 VSPD17In RecordLayout_6 0 CompuMethod_180 17 -100 200 DEPOSIT ABSOLUTE /end AXIS_PTS
/*~~~~~~~~~ 6.3.106 RECORD_LAYOUTs ~~~~~~~~~*/
/begin RECORD_LAYOUT RecordLayout_1 FNC_VALUES 1 UBYTE ROW_DIR DIRECT /end RECORD_LAYOUT
/begin RECORD_LAYOUT RecordLayout_4 FNC_VALUES 1 FLOAT32_IEEE ROW_DIR DIRECT /end RECORD_LAYOUT
/begin RECORD_LAYOUT RecordLayout_5 FNC_VALUES 1 SWORD ROW_DIR DIRECT /end RECORD_LAYOUT
/begin RECORD_LAYOUT RecordLayout_6 AXIS_PTS_X 1 FLOAT32_IEEE /* IndexIncr */ INDEX_INCR /* Addressing */ DIRECT /end RECORD_LAYOUT
/begin RECORD_LAYOUT RecordLayout_8 FNC_VALUES 1 UWORD ROW_DIR DIRECT /end RECORD_LAYOUT
/*~~~~~~~~~ 6.3.31 COMPU_METHODs ~~~~~~~~~*/
/begin COMPU_METHOD CompuMethod_1 "" RAT_FUNC "%3.0" "" COEFFS 0 1 0 0 0 1 /end COMPU_METHOD
/begin COMPU_METHOD CompuMethod_2 "" RAT_FUNC "%6.2" "" COEFFS 0 1 0 0 0 1 /end COMPU_METHOD
/begin COMPU_METHOD CompuMethod_4 "" RAT_FUNC "%1.0" "bool" COEFFS 0 1 0 0 0 1 /end COMPU_METHOD
/begin COMPU_METHOD CompuMethod_5 "" TAB_VERB "%1.0" "" COMPU_TAB_REF CompuVtab_1 /end COMPU_METHOD
/begin COMPU_METHOD CompuMethod_6 "" RAT_FUNC "%6.2" "%" COEFFS 0 1 0 0 0 1 /end COMPU_METHOD
/begin COMPU_METHOD CompuMethod_7 "" TAB_VERB "%3.0" "" COMPU_TAB_REF CompuVtab_2 /end COMPU_METHOD
/begin COMPU_METHOD CompuMethod_8 "" RAT_FUNC "%6.2" "kPa" COEFFS 0 1 0 0 0 1 /end COMPU_METHOD
/begin COMPU_METHOD CompuMethod_9 "" RAT_FUNC "%6.2" "kpa" COEFFS 0 1 0 0 0 1 /end COMPU_METHOD
/begin COMPU_METHOD CompuMethod_10 "" RAT_FUNC "%6.2" "s" COEFFS 0 1 0 0 0 1 /end COMPU_METHOD
/begin COMPU_METHOD CompuMethod_11 "" RAT_FUNC "%1.0" "" COEFFS 0 1 0 0 0 1 /end COMPU_METHOD
/begin COMPU_METHOD CompuMethod_12 "" TAB_VERB "%5.0" "" COMPU_TAB_REF CompuVtab_3 /end COMPU_METHOD
/begin COMPU_METHOD CompuMethod_13 "" RAT_FUNC "%6.2" "kPaGauge" COEFFS 0 1 0 0 0 1 /end COMPU_METHOD
/begin COMPU_METHOD CompuMethod_14 "" RAT_FUNC "%6.2" "kPa Gauge" COEFFS 0 1 0 0 0 1 /end COMPU_METHOD
/begin COMPU_METHOD CompuMethod_15 "" RAT_FUNC "%6.2" "idx.frac" COEFFS 0 1 0 0 0 0.00195313 /end COMPU_METHOD
/begin COMPU_METHOD CompuMethod_16 "" RAT_FUNC "%5.0" "ADC" COEFFS 0 1 0 0 0 1 /end COMPU_METHOD
/begin COMPU_METHOD CompuMethod_17 "" RAT_FUNC "%6.2" "VSPD" COEFFS 0 1 0 0 0 1 /end COMPU_METHOD
/begin COMPU_METHOD CompuMethod_18 "" RAT_FUNC "%6.2" "ACPres" COEFFS 0 1 0 0 0 1 /end COMPU_METHOD
/begin COMPU_METHOD CompuMethod_19 "" RAT_FUNC "%6.2" "ACPRes" COEFFS 0 1 0 0 0 1 /end COMPU_METHOD
/begin COMPU_METHOD CompuMethod_20 "" RAT_FUNC "%6.2" "sec" COEFFS 0 1 0 0 0 1 /end COMPU_METHOD
/begin COMPU_METHOD CompuMethod_21 "" RAT_FUNC "%9.4" "kPa Gauge/ADC" COEFFS 0 1 0 0 0 1 /end COMPU_METHOD
/begin COMPU_METHOD CompuMethod_22 "" RAT_FUNC "%6.2" "ADC" COEFFS 0 1 0 0 0 1 /end COMPU_METHOD
/begin COMPU_METHOD CompuMethod_23 "" TAB_VERB "%5.0" "" COMPU_TAB_REF CompuVtab_4 /end COMPU_METHOD
/begin COMPU_METHOD CompuMethod_24 "" TAB_VERB "%3.0" "" COMPU_TAB_REF CompuVtab_5 /end COMPU_METHOD
/begin COMPU_METHOD CompuMethod_25 "" RAT_FUNC "%6.2" "RPM" COEFFS 0 1 0 0 0 1 /end COMPU_METHOD
/begin COMPU_METHOD CompuMethod_26 "" RAT_FUNC "%1.0" "Boolean" COEFFS 0 1 0 0 0 1 /end COMPU_METHOD
/begin COMPU_METHOD CompuMethod_27 "" RAT_FUNC "%6.2" "degC" COEFFS 0 1 0 0 0 1 /end COMPU_METHOD
/begin COMPU_METHOD CompuMethod_28 "" RAT_FUNC "%6.2" "Seconds" COEFFS 0 1 0 0 0 1 /end COMPU_METHOD
/begin COMPU_METHOD CompuMethod_29 "" TAB_VERB "%1.0" "bool" COMPU_TAB_REF CompuVtab_2 /end COMPU_METHOD
/begin COMPU_METHOD CompuMethod_30 "" RAT_FUNC "%6.2" "g/s" COEFFS 0 1 0 0 0 1 /end COMPU_METHOD
/begin COMPU_METHOD CompuMethod_31 "" TAB_VERB "%6.2" "" COMPU_TAB_REF CompuVtab_6 /end COMPU_METHOD
/begin COMPU_METHOD CompuMethod_32 "" TAB_VERB "%1.0" "" COMPU_TAB_REF CompuVtab_7 /end COMPU_METHOD
/begin COMPU_METHOD CompuMethod_33 "" RAT_FUNC "%6.2" "mult" COEFFS 0 1 0 0 0 1 /end COMPU_METHOD
/begin COMPU_METHOD CompuMethod_34 "" TAB_VERB "%1.0" "" COMPU_TAB_REF CompuVtab_8 /end COMPU_METHOD
/begin COMPU_METHOD CompuMethod_35 "" RAT_FUNC "%6.2" "ADC Counts" COEFFS 0 1 0 0 0 1 /end COMPU_METHOD
/begin COMPU_METHOD CompuMethod_36 "" TAB_VERB "%1.0" "" COMPU_TAB_REF CompuVtab_2 /end COMPU_METHOD
/begin COMPU_METHOD CompuMethod_37 "" RAT_FUNC "%1.0" "boolean" COEFFS 0 1 0 0 0 1 /end COMPU_METHOD
/begin COMPU_METHOD CompuMethod_38 "" RAT_FUNC "%6.2" "Percent" COEFFS 0 1 0 0 0 1 /end COMPU_METHOD
/begin COMPU_METHOD CompuMethod_39 "" TAB_VERB "%1.0" "" COMPU_TAB_REF CompuVtab_9 /end COMPU_METHOD
/begin COMPU_METHOD CompuMethod_40 "" TAB_VERB "%3.0" "" COMPU_TAB_REF CompuVtab_9 /end COMPU_METHOD
/begin COMPU_METHOD CompuMethod_41 "" TAB_VERB "%1.0" "" COMPU_TAB_REF CompuVtab_10 /end COMPU_METHOD
/begin COMPU_METHOD CompuMethod_42 "" TAB_VERB "%1.0" "" COMPU_TAB_REF CompuVtab_11 /end COMPU_METHOD
/begin COMPU_METHOD CompuMethod_43 "" TAB_VERB "%1.0" "" COMPU_TAB_REF CompuVtab_12 /end COMPU_METHOD
/begin COMPU_METHOD CompuMethod_44 "" RAT_FUNC "%6.2" "EquivRatio" COEFFS 0 1 0 0 0 1 /end COMPU_METHOD
/begin COMPU_METHOD CompuMethod_45 "" RAT_FUNC "%9.4" "EquivRatio/ADC" COEFFS 0 1 0 0 0 1 /end COMPU_METHOD
/begin COMPU_METHOD CompuMethod_47 "" TAB_VERB "%1.0" "" COMPU_TAB_REF CompuVtab_14 /end COMPU_METHOD
/begin COMPU_METHOD CompuMethod_48 "" RAT_FUNC "%5.4" "" COEFFS 0 1 0 0 0 1 /end COMPU_METHOD
/begin COMPU_METHOD CompuMethod_50 "" RAT_FUNC "%7.2" "%" COEFFS 0 1 0 0 0 1 /end COMPU_METHOD
/begin COMPU_METHOD CompuMethod_52 "" RAT_FUNC "%5.0" "" COEFFS 0 1 0 0 0 1 /end COMPU_METHOD
/begin COMPU_METHOD CompuMethod_61 "" RAT_FUNC "%6.2" "C" COEFFS 0 1 0 0 0 1 /end COMPU_METHOD
/begin COMPU_METHOD CompuMethod_69 "" RAT_FUNC "%6.2" "ms" COEFFS 0 1 0 0 0 1 /end COMPU_METHOD
/begin COMPU_METHOD CompuMethod_72 "" RAT_FUNC "%3.0" "" COEFFS 0 1 0 0 0 0.0015259 /end COMPU_METHOD
/begin COMPU_METHOD CompuMethod_81 "" RAT_FUNC "%6.2" "ECT" COEFFS 0 1 0 0 0 1 /end COMPU_METHOD
/begin COMPU_METHOD CompuMethod_92 "" TAB_VERB "%5.0" "" COMPU_TAB_REF CompuVtab_25 /end COMPU_METHOD
/begin COMPU_METHOD CompuMethod_93 "" TAB_VERB "%3.0" "" COMPU_TAB_REF CompuVtab_26 /end COMPU_METHOD
/begin COMPU_METHOD CompuMethod_94 "" TAB_VERB "%5.0" "" COMPU_TAB_REF CompuVtab_27 /end COMPU_METHOD
/begin COMPU_METHOD CompuMethod_102 "" TAB_VERB "%5.0" "" COMPU_TAB_REF CompuVtab_28 /end COMPU_METHOD
/begin COMPU_METHOD CompuMethod_103 "" RAT_FUNC "%6.2" "%/sec" COEFFS 0 1 0 0 0 1 /end COMPU_METHOD
/begin COMPU_METHOD CompuMethod_104 "" TAB_VERB "%3.0" "" COMPU_TAB_REF CompuVtab_29 /end COMPU_METHOD
/begin COMPU_METHOD CompuMethod_108 "" TAB_VERB "%3.0" "" COMPU_TAB_REF CompuVtab_32 /end COMPU_METHOD
/begin COMPU_METHOD CompuMethod_109 "" TAB_VERB "%3.0" "" COMPU_TAB_REF CompuVtab_33 /end COMPU_METHOD
/begin COMPU_METHOD CompuMethod_110 "" TAB_VERB "%3.0" "" COMPU_TAB_REF CompuVtab_34 /end COMPU_METHOD
/begin COMPU_METHOD CompuMethod_111 "" TAB_VERB "%3.0" "" COMPU_TAB_REF CompuVtab_35 /end COMPU_METHOD
/begin COMPU_METHOD CompuMethod_121 "" TAB_VERB "%5.0" "" COMPU_TAB_REF CompuVtab_37 /end COMPU_METHOD
/begin COMPU_METHOD CompuMethod_126 "" TAB_VERB "%3.0" "" COMPU_TAB_REF CompuVtab_41 /end COMPU_METHOD
/begin COMPU_METHOD CompuMethod_127 "" RAT_FUNC "%6.2" "IAT" COEFFS 0 1 0 0 0 1 /end COMPU_METHOD
/begin COMPU_METHOD CompuMethod_128 "" RAT_FUNC "%5.3" "sec" COEFFS 0 1 0 0 0 1 /end COMPU_METHOD
/begin COMPU_METHOD CompuMethod_130 "" TAB_VERB "%3.0" "" COMPU_TAB_REF CompuVtab_43 /end COMPU_METHOD
/begin COMPU_METHOD CompuMethod_131 "" TAB_VERB "%5.0" "" COMPU_TAB_REF CompuVtab_44 /end COMPU_METHOD
/begin COMPU_METHOD CompuMethod_132 "" TAB_VERB "%3.0" "" COMPU_TAB_REF CompuVtab_45 /end COMPU_METHOD
/begin COMPU_METHOD CompuMethod_174 "" TAB_VERB "%1.0" "" COMPU_TAB_REF CompuVtab_65 /end COMPU_METHOD
/begin COMPU_METHOD CompuMethod_180 "" RAT_FUNC "%6.2" "MPH" COEFFS 0 1 0 0 0 1 /end COMPU_METHOD
/*~~~~~~~~~ 6.3.34 COMPU_VTABs ~~~~~~~~~*/
/begin COMPU_VTAB CompuVtab_1 "" TAB_VERB 2 0 "Pass-Through" 1 "Override" /end COMPU_VTAB
/begin COMPU_VTAB CompuVtab_2 "" TAB_VERB 2 0 "Disabled" 1 "Enabled" /end COMPU_VTAB
/begin COMPU_VTAB CompuVtab_3 "" TAB_VERB 30 -1 "(None)" 0 "FUELP" 2 "HSOL1" 3 "HSOL2" 4 "HSOL3" 5 "HSOL4" 6 "START" 11 "OILP" 12 "FINJ1" 13 "FINJ2" 14 "FINJ3" 15 "FINJ4" 16 "FINJ5" 17 "FINJ6" 18 "AINJ1" 19 "AINJ2" 20 "AINJ3" 21 "AINJ4" 22 "AINJ5" 23 "AINJ6" 24 "TACH" 36 "EST 1" 37 "EST 2" 38 "EST 3" 39 "EST 4" 40 "EST 5" 41 "EST 6" 42 "EST 7" 43 "EST 8" 52 "MPRD" /end COMPU_VTAB
/begin COMPU_VTAB CompuVtab_4 "" TAB_VERB 26 -1 "(None)" 53 "ECUP" 54 "DRVP" 55 "XDRP" 56 "AN1M" 57 "AN2M" 58 "AN3M" 59 "AN4M" 60 "AN5M" 61 "AN6M" 62 "AN7M" 63 "AN8M" 64 "AN9M" 65 "AN10M" 66 "AN11M" 67 "AN12M" 68 "AN13M" 69 "AN14M" 70 "AN15M" 71 "AN16M" 72 "AN17M" 73 "AN18M" 74 "AN19M" 90 "O2A" 91 "O2B" 92 "XDRP_B" /end COMPU_VTAB
/begin COMPU_VTAB CompuVtab_5 "" TAB_VERB 2 0 "5V" 1 "2.7V" /end COMPU_VTAB
/begin COMPU_VTAB CompuVtab_6 "" TAB_VERB 90 0 "Normal Operation" 1 "Bad Resource ID" 2 "Hardware Not Supported" 3 "Behaviour Not Supported" 4 "Bad Attribute Data" 5 "Fail On Create" 6 "Fail On Set Attributes" 7 "Resource Not Created" 8 "Missing Attribute" 9 "Behaviour Method Not Supported" 10 "A Service Failed" 11 "Failed to destroy a resource" 12 "Resource Was Created" 13 "Resource Conflict" 14 "Invalid Encoder Type" 15 "2-Strike Not Supported" 16 "720degCA Pattern Not Supported" 17 "CAM Pattern Not Supported" 18 "Unknown CAM Pattern Supplied" 19 "Engine Speed Present" 20 "Hardware Interface Not Supported" 21 "Service Already Started" 22 "Register Write Failed to verify" 23 "Register access was denied" 24 "Out of free store memory" 25 "Software Q Overrun" 26 "Hardware Q Overrun" 27 "Feature unsupported in archive" 28 "Insufficient FW resource" 29 "OS Resource conflict" 30 "Driver Mode conflict" 31 "RTC time is illegal" 32 "FFS unmounted" 33 "Access from an ISR" 34 "FFS internal" 35 "Operation timed out" 36 "Task Kernel API Usage" 37 "Operation aborted" 38 "File not Found" 39 "Invalid characters in filename" 40 "Duplicate filename" 41 "Filename is too long" 42 "Dir not empty on remove" 43 "Dir not found" 44 "Dir name invalid" 45 "Dir exists" 46 "Dir too deep" 47 "Illegal Handle" 48 "End of File" 49 "Media Full" 50 "Media Write" 51 "Media Read" 52 "Media Write Protected" 53 "File Read Only" 54 "FS Media Changed" 55 "Internal USB" 56 "Voltage too high for USB IC" 57 "Encoder not created" 64 "TPU Chan Conflict" 65 "TPU Func Unavailable" 66 "TPU Config" 67 "TPU Primative Usage" 68 "TPU Primitive Count" 69 "TPU Restricted TPU channel" 70 "TPU Not Created" 71 "TPU Self Modify constant write err" 72 "TPU Error 0x48" 73 "TPU Error 0x49" 74 "TPU Error 0x4A" 75 "TPU Error 0x4B" 76 "TPU Error 0x4C" 77 "TPU Error 0x4D" 78 "TPU Error 0x4E" 79 "TPU Error 0x4F" 80 "TPU Error 0x50" 81 "TPU Error 0x51" 82 "TPU Error 0x52" 83 "TPU Error 0x53" 84 "TPU Error 0x54" 85 "TPU Error 0x55" 86 "TPU Error 0x56" 87 "TPU Error 0x57" 88 "TPU Error 0x58" 89 "TPU Error 0x59" 90 "TPU Error 0x5A" 91 "TPU Error 0x5B" 92 "TPU Error 0x5C" 93 "TPU Error 0x5D" 94 "TPU Error 0x5E" 95 "TPU Error 0x5F" /end COMPU_VTAB
/begin COMPU_VTAB CompuVtab_7 "" TAB_VERB 2 0 "ETC" 1 "IAC" /end COMPU_VTAB
/begin COMPU_VTAB CompuVtab_8 "" TAB_VERB 2 0 "Decreasing" 1 "Increasing" /end COMPU_VTAB
/begin COMPU_VTAB CompuVtab_9 "" TAB_VERB 4 0 "Before Model Initialize" 1 "After Model Init - Before STARTUP Event" 2 "After STARTUP Event - Before Run" 3 "Run" /end COMPU_VTAB
/begin COMPU_VTAB CompuVtab_10 "" TAB_VERB 4 0 "Initializing" 1 "Run" 2 "Pause" 3 "Stop" /end COMPU_VTAB
/begin COMPU_VTAB CompuVtab_11 "" TAB_VERB 9 0 "Running normally" 1 "Requested by user" 2 "Foreground stack margin violation" 3 "Background stack margin violation" 4 "Idle stack margin violation" 5 "Interrupt stack margin violation" 6 "Heap margin violation" 7 "Idle CPU margin violation" 8 "OS error detected" /end COMPU_VTAB
/begin COMPU_VTAB CompuVtab_12 "" TAB_VERB 9 0 "-" 1 "-" 2 "Application Monitor" 3 "Application Monitor" 4 "Application Monitor" 5 "Application Monitor" 6 "Application Monitor" 7 "Application Monitor" 8 "Application Monitor" /end COMPU_VTAB
/begin COMPU_VTAB CompuVtab_14 "" TAB_VERB 2 0 "Not Enabled" 1 "Enabled" /end COMPU_VTAB
/begin COMPU_VTAB CompuVtab_25 "" TAB_VERB 9 -1 "(None)" 36 "EST 1" 37 "EST 2" 38 "EST 3" 39 "EST 4" 40 "EST 5" 41 "EST 6" 42 "EST 7" 43 "EST 8" /end COMPU_VTAB
/begin COMPU_VTAB CompuVtab_26 "" TAB_VERB 4 0 "Standard (Coil per cylinder)" 1 "Banked (Fire on both phases until CAM sync)" 2 "Batch (Wasted spark)" 3 "Muxed (Distributed)" /end COMPU_VTAB
/begin COMPU_VTAB CompuVtab_27 "" TAB_VERB 26 -1 "(None)" 56 "AN1M" 57 "AN2M" 58 "AN3M" 59 "AN4M" 60 "AN5M" 61 "AN6M" 62 "AN7M" 63 "AN8M" 64 "AN9M" 65 "AN10M" 66 "AN11M" 67 "AN12M" 68 "AN13M" 69 "AN14M" 70 "AN15M" 71 "AN16M" 72 "AN17M" 73 "AN18M" 74 "AN19M" 90 "O2A" 91 "O2B" 93 "DG1M" 94 "DG2M" 96 "DG4M" 97 "ESTOP" /end COMPU_VTAB
/begin COMPU_VTAB CompuVtab_28 "" TAB_VERB 30 -1 "(None)" 0 "FUELP" 1 "ETC" 2 "HSOL1" 3 "HSOL2" 4 "HSOL3" 5 "HSOL4" 6 "START" 11 "OILP" 12 "FINJ1" 13 "FINJ2" 14 "FINJ3" 15 "FINJ4" 16 "FINJ5" 17 "FINJ6" 18 "AINJ1" 19 "AINJ2" 20 "AINJ3" 21 "AINJ4" 22 "AINJ5" 23 "AINJ6" 24 "TACH" 36 "EST 1" 37 "EST 2" 38 "EST 3" 39 "EST 4" 40 "EST 5" 41 "EST 6" 42 "EST 7" 43 "EST 8" /end COMPU_VTAB
/begin COMPU_VTAB CompuVtab_29 "" TAB_VERB 2 0 "PWM" 1 "OnOff" /end COMPU_VTAB
/begin COMPU_VTAB CompuVtab_32 "" TAB_VERB 6 0 "Disabled" 1 "Enabled" 2 "Sticky" 3 "Enabled - Persistent" 4 "Sticky - Persistent" 5 "Save Occurred" /end COMPU_VTAB
/begin COMPU_VTAB CompuVtab_33 "" TAB_VERB 2 0 "-" 1 "Test" /end COMPU_VTAB
/begin COMPU_VTAB CompuVtab_34 "" TAB_VERB 14 0 "CutThrottle" 1 "DFCODisable" 2 "DelayedEngineShutdown" 3 "DisableAC" 4 "DisableO2Ctrl" 5 "DisableVEAdapt" 6 "DisableWastegate" 7 "EngineProtectLED" 8 "EngineShutdown" 9 "HardRevLimit" 10 "MIL_LED" 11 "MediumRevLimit" 12 "SoftRevLimit" 13 "(None)" /end COMPU_VTAB
/begin COMPU_VTAB CompuVtab_35 "" TAB_VERB 8 0 "(None)" 1 "Suspected" 2 "Active" 3 "Suspected or Active" 4 "Occurred" 5 "Suspected or Occurred" 6 "Active or Occurred" 7 "Suspected or Active or Occurred" /end COMPU_VTAB
/begin COMPU_VTAB CompuVtab_37 "" TAB_VERB 5 -1 "(None)" 93 "DG1M" 94 "DG2M" 96 "DG4M" 100 "CNK" /end COMPU_VTAB
/begin COMPU_VTAB CompuVtab_41 "" TAB_VERB 2 0 "2-Wire" 1 "3-Wire" /end COMPU_VTAB
/begin COMPU_VTAB CompuVtab_43 "" TAB_VERB 2 0 "Standard" 1 "Transient" /end COMPU_VTAB
/begin COMPU_VTAB CompuVtab_44 "" TAB_VERB 13 -1 "(None)" 12 "FINJ1" 13 "FINJ2" 14 "FINJ3" 15 "FINJ4" 16 "FINJ5" 17 "FINJ6" 18 "AINJ1" 19 "AINJ2" 20 "AINJ3" 21 "AINJ4" 22 "AINJ5" 23 "AINJ6" /end COMPU_VTAB
/begin COMPU_VTAB CompuVtab_45 "" TAB_VERB 3 0 "Standard (Injector per cylinder)" 1 "Batch (Fire half fuel on half of the injectors every rev)" 2 " Wasted (Fire half fuel on all injectors every rev)" /end COMPU_VTAB
/begin COMPU_VTAB CompuVtab_65 "" TAB_VERB 2 0 "APP1" 1 "NORMAL" /end COMPU_VTAB
/begin FUNCTION BaseEngineController_LS ""
 /begin DEF_CHARACTERISTIC FaultManager.OilPresRangeLow.Action_4_Condition FaultManager.SensVoltRangeHigh.Mode FaultManager.SensVoltRangeHigh.ID FaultManager.SensVoltRangeHigh.Test FaultManager.SensVoltRangeHigh.Faulty_Samples__X_ FaultManager.SensVoltRangeHigh.Total_Samples__Y_ FaultManager.SensVoltRangeHigh.Action_1 FaultManager.SensVoltRangeHigh.Action_1_Condition FaultManager.SensVoltRangeHigh.Action_2 FaultManager.SensVoltRangeHigh.Action_2_Condition FaultManager.SensVoltRangeHigh.Action_3 FaultManager.SensVoltRangeHigh.Action_3_Condition FaultManager.SensVoltRangeHigh.Action_4 FaultManager.SensVoltRangeHigh.Action_4_Condition FaultManager.SensVoltRangeLow.Mode FaultManager.SensVoltRangeLow.ID FaultManager.SensVoltRangeLow.Test FaultManager.SensVoltRangeLow.Faulty_Samples__X_ FaultManager.SensVoltRangeLow.Total_Samples__Y_ FaultManager.SensVoltRangeLow.Action_1 FaultManager.SensVoltRangeLow.Action_1_Condition FaultManager.SensVoltRangeLow.Action_2 FaultManager.SensVoltRangeLow.Action_2_Condition FaultManager.SensVoltRangeLow.Action_3 FaultManager.SensVoltRangeLow.Action_3_Condition FaultManager.SensVoltRangeLow.Action_4 FaultManager.SensVoltRangeLow.Action_4_Condition FaultManager.SoftOverBoost_Fault.Mode FaultManager.SoftOverBoost_Fault.ID FaultManager.SoftOverBoost_Fault.Test FaultManager.SoftOverBoost_Fault.Faulty_Samples__X_ FaultManager.SoftOverBoost_Fault.Total_Samples__Y_ FaultManager.SoftOverBoost_Fault.Action_1 FaultManager.SoftOverBoost_Fault.Action_1_Condition FaultManager.SoftOverBoost_Fault.Action_2 FaultManager.SoftOverBoost_Fault.Action_2_Condition FaultManager.SoftOverBoost_Fault.Action_3 FaultManager.SoftOverBoost_Fault.Action_3_Condition FaultManager.SoftOverBoost_Fault.Action_4 FaultManager.SoftOverBoost_Fault.Action_4_Condition FaultManager.SoftOverspeed.Mode FaultManager.SoftOverspeed.ID FaultManager.SoftOverspeed.Test FaultManager.SoftOverspeed.Faulty_Samples__X_ FaultManager.SoftOverspeed.Total_Samples__Y_ FaultManager.SoftOverspeed.Action_1 FaultManager.SoftOverspeed.Action_1_Condition FaultManager.SoftOverspeed.Action_2 FaultManager.SoftOverspeed.Action_2_Condition FaultManager.SoftOverspeed.Action_3 FaultManager.SoftOverspeed.Action_3_Condition FaultManager.SoftOverspeed.Action_4 FaultManager.SoftOverspeed.Action_4_Condition FaultManager.SysVoltRangeHigh.Mode FaultManager.SysVoltRangeHigh.ID FaultManager.SysVoltRangeHigh.Test FaultManager.SysVoltRangeHigh.Faulty_Samples__X_ FaultManager.SysVoltRangeHigh.Total_Samples__Y_ FaultManager.SysVoltRangeHigh.Action_1 FaultManager.SysVoltRangeHigh.Action_1_Condition FaultManager.SysVoltRangeHigh.Action_2 FaultManager.SysVoltRangeHigh.Action_2_Condition FaultManager.SysVoltRangeHigh.Action_3 FaultManager.SysVoltRangeHigh.Action_3_Condition FaultManager.SysVoltRangeHigh.Action_4 FaultManager.SysVoltRangeHigh.Action_4_Condition FaultManager.SysVoltRangeLow.Mode FaultManager.SysVoltRangeLow.ID FaultManager.SysVoltRangeLow.Test FaultManager.SysVoltRangeLow.Faulty_Samples__X_ FaultManager.SysVoltRangeLow.Total_Samples__Y_ FaultManager.SysVoltRangeLow.Action_1 FaultManager.SysVoltRangeLow.Action_1_Condition FaultManager.SysVoltRangeLow.Action_2 FaultManager.SysVoltRangeLow.Action_2_Condition FaultManager.SysVoltRangeLow.Action_3 FaultManager.SysVoltRangeLow.Action_3_Condition FaultManager.SysVoltRangeLow.Action_4 FaultManager.SysVoltRangeLow.Action_4_Condition FaultManager.TPS1AdaptHiMax.Mode FaultManager.TPS1AdaptHiMax.ID FaultManager.TPS1AdaptHiMax.Test FaultManager.TPS1AdaptHiMax.Faulty_Samples__X_ FaultManager.TPS1AdaptHiMax.Total_Samples__Y_ FaultManager.TPS1AdaptHiMax.Action_1 FaultManager.TPS1AdaptHiMax.Action_1_Condition FaultManager.TPS1AdaptHiMax.Action_2 FaultManager.TPS1AdaptHiMax.Action_2_Condition FaultManager.TPS1AdaptHiMax.Action_3 FaultManager.TPS1AdaptHiMax.Action_3_Condition FaultManager.TPS1AdaptHiMax.Action_4 FaultManager.TPS1AdaptHiMax.Action_4_Condition FaultManager.TPS1AdaptHiMin.Mode FaultManager.TPS1AdaptHiMin.ID FaultManager.TPS1AdaptHiMin.Test FaultManager.TPS1AdaptHiMin.Faulty_Samples__X_ FaultManager.TPS1AdaptHiMin.Total_Samples__Y_ FaultManager.TPS1AdaptHiMin.Action_1 FaultManager.TPS1AdaptHiMin.Action_1_Condition FaultManager.TPS1AdaptHiMin.Action_2 FaultManager.TPS1AdaptHiMin.Action_2_Condition FaultManager.TPS1AdaptHiMin.Action_3 FaultManager.TPS1AdaptHiMin.Action_3_Condition FaultManager.TPS1AdaptHiMin.Action_4 FaultManager.TPS1AdaptHiMin.Action_4_Condition FaultManager.TPS1AdaptLoMax.Mode FaultManager.TPS1AdaptLoMax.ID FaultManager.TPS1AdaptLoMax.Test FaultManager.TPS1AdaptLoMax.Faulty_Samples__X_ FaultManager.TPS1AdaptLoMax.Total_Samples__Y_ FaultManager.TPS1AdaptLoMax.Action_1 FaultManager.TPS1AdaptLoMax.Action_1_Condition FaultManager.TPS1AdaptLoMax.Action_2 FaultManager.TPS1AdaptLoMax.Action_2_Condition FaultManager.TPS1AdaptLoMax.Action_3 FaultManager.TPS1AdaptLoMax.Action_3_Condition FaultManager.TPS1AdaptLoMax.Action_4 FaultManager.TPS1AdaptLoMax.Action_4_Condition FaultManager.TPS1AdaptLoMin.Mode FaultManager.TPS1AdaptLoMin.ID FaultManager.TPS1AdaptLoMin.Test FaultManager.TPS1AdaptLoMin.Faulty_Samples__X_ FaultManager.TPS1AdaptLoMin.Total_Samples__Y_ FaultManager.TPS1AdaptLoMin.Action_1 FaultManager.TPS1AdaptLoMin.Action_1_Condition FaultManager.TPS1AdaptLoMin.Action_2 FaultManager.TPS1AdaptLoMin.Action_2_Condition FaultManager.TPS1AdaptLoMin.Action_3 FaultManager.TPS1AdaptLoMin.Action_3_Condition FaultManager.TPS1AdaptLoMin.Action_4 FaultManager.TPS1AdaptLoMin.Action_4_Condition FaultManager.TPS1RangeHigh.Mode FaultManager.TPS1RangeHigh.ID FaultManager.TPS1RangeHigh.Test FaultManager.TPS1RangeHigh.Faulty_Samples__X_ FaultManager.TPS1RangeHigh.Total_Samples__Y_ FaultManager.TPS1RangeHigh.Action_1 FaultManager.TPS1RangeHigh.Action_1_Condition FaultManager.TPS1RangeHigh.Action_2 FaultManager.TPS1RangeHigh.Action_2_Condition FaultManager.TPS1RangeHigh.Action_3 FaultManager.TPS1RangeHigh.Action_3_Condition FaultManager.TPS1RangeHigh.Action_4 FaultManager.TPS1RangeHigh.Action_4_Condition FaultManager.TPS1RangeLow.Mode FaultManager.TPS1RangeLow.ID FaultManager.TPS1RangeLow.Test FaultManager.TPS1RangeLow.Faulty_Samples__X_ FaultManager.TPS1RangeLow.Total_Samples__Y_ FaultManager.TPS1RangeLow.Action_1 FaultManager.TPS1RangeLow.Action_1_Condition FaultManager.TPS1RangeLow.Action_2 FaultManager.TPS1RangeLow.Action_2_Condition FaultManager.TPS1RangeLow.Action_3 FaultManager.TPS1RangeLow.Action_3_Condition FaultManager.TPS1RangeLow.Action_4 FaultManager.TPS1RangeLow.Action_4_Condition FaultManager.TPS2AdaptHiMax.Mode FaultManager.TPS2AdaptHiMax.ID FaultManager.TPS2AdaptHiMax.Test FaultManager.TPS2AdaptHiMax.Faulty_Samples__X_ FaultManager.TPS2AdaptHiMax.Total_Samples__Y_ FaultManager.TPS2AdaptHiMax.Action_1 FaultManager.TPS2AdaptHiMax.Action_1_Condition FaultManager.TPS2AdaptHiMax.Action_2 FaultManager.TPS2AdaptHiMax.Action_2_Condition FaultManager.TPS2AdaptHiMax.Action_3 FaultManager.TPS2AdaptHiMax.Action_3_Condition FaultManager.TPS2AdaptHiMax.Action_4 FaultManager.TPS2AdaptHiMax.Action_4_Condition FaultManager.TPS2AdaptHiMin.Mode FaultManager.TPS2AdaptHiMin.ID FaultManager.TPS2AdaptHiMin.Test FaultManager.TPS2AdaptHiMin.Faulty_Samples__X_ FaultManager.TPS2AdaptHiMin.Total_Samples__Y_ FaultManager.TPS2AdaptHiMin.Action_1 FaultManager.TPS2AdaptHiMin.Action_1_Condition FaultManager.TPS2AdaptHiMin.Action_2 FaultManager.TPS2AdaptHiMin.Action_2_Condition FaultManager.TPS2AdaptHiMin.Action_3 FaultManager.TPS2AdaptHiMin.Action_3_Condition FaultManager.TPS2AdaptHiMin.Action_4 FaultManager.TPS2AdaptHiMin.Action_4_Condition FaultManager.TPS2AdaptLoMax.Mode FaultManager.TPS2AdaptLoMax.ID FaultManager.TPS2AdaptLoMax.Test FaultManager.TPS2AdaptLoMax.Faulty_Samples__X_ FaultManager.TPS2AdaptLoMax.Total_Samples__Y_ FaultManager.TPS2AdaptLoMax.Action_1 FaultManager.TPS2AdaptLoMax.Action_1_Condition FaultManager.TPS2AdaptLoMax.Action_2 FaultManager.TPS2AdaptLoMax.Action_2_Condition FaultManager.TPS2AdaptLoMax.Action_3 FaultManager.TPS2AdaptLoMax.Action_3_Condition FaultManager.TPS2AdaptLoMax.Action_4 FaultManager.TPS2AdaptLoMax.Action_4_Condition FaultManager.TPS2AdaptLoMin.Mode FaultManager.TPS2AdaptLoMin.ID FaultManager.TPS2AdaptLoMin.Test FaultManager.TPS2AdaptLoMin.Faulty_Samples__X_ FaultManager.TPS2AdaptLoMin.Total_Samples__Y_ FaultManager.TPS2AdaptLoMin.Action_1 FaultManager.TPS2AdaptLoMin.Action_1_Condition FaultManager.TPS2AdaptLoMin.Action_2 FaultManager.TPS2AdaptLoMin.Action_2_Condition FaultManager.TPS2AdaptLoMin.Action_3 FaultManager.TPS2AdaptLoMin.Action_3_Condition FaultManager.TPS2AdaptLoMin.Action_4 FaultManager.TPS2AdaptLoMin.Action_4_Condition FaultManager.TPS2RangeHigh.Mode FaultManager.TPS2RangeHigh.ID FaultManager.TPS2RangeHigh.Test FaultManager.TPS2RangeHigh.Faulty_Samples__X_ FaultManager.TPS2RangeHigh.Total_Samples__Y_ FaultManager.TPS2RangeHigh.Action_1 FaultManager.TPS2RangeHigh.Action_1_Condition FaultManager.TPS2RangeHigh.Action_2 FaultManager.TPS2RangeHigh.Action_2_Condition FaultManager.TPS2RangeHigh.Action_3 FaultManager.TPS2RangeHigh.Action_3_Condition FaultManager.TPS2RangeHigh.Action_4 FaultManager.TPS2RangeHigh.Action_4_Condition FaultManager.TPS2RangeLow.Mode FaultManager.TPS2RangeLow.ID FaultManager.TPS2RangeLow.Test FaultManager.TPS2RangeLow.Faulty_Samples__X_ FaultManager.TPS2RangeLow.Total_Samples__Y_ FaultManager.TPS2RangeLow.Action_1 FaultManager.TPS2RangeLow.Action_1_Condition FaultManager.TPS2RangeLow.Action_2 FaultManager.TPS2RangeLow.Action_2_Condition FaultManager.TPS2RangeLow.Action_3 FaultManager.TPS2RangeLow.Action_3_Condition FaultManager.TPS2RangeLow.Action_4 FaultManager.TPS2RangeLow.Action_4_Condition FaultManager.TPS_Sensors_Conflict.Mode FaultManager.TPS_Sensors_Conflict.ID FaultManager.TPS_Sensors_Conflict.Test FaultManager.TPS_Sensors_Conflict.Faulty_Samples__X_ FaultManager.TPS_Sensors_Conflict.Total_Samples__Y_ FaultManager.TPS_Sensors_Conflict.Action_1 FaultManager.TPS_Sensors_Conflict.Action_1_Condition FaultManager.TPS_Sensors_Conflict.Action_2 FaultManager.TPS_Sensors_Conflict.Action_2_Condition FaultManager.TPS_Sensors_Conflict.Action_3 FaultManager.TPS_Sensors_Conflict.Action_3_Condition FaultManager.TPS_Sensors_Conflict.Action_4 FaultManager.TPS_Sensors_Conflict.Action_4_Condition FaultManager.VSPDRangeHigh.Mode FaultManager.VSPDRangeHigh.ID FaultManager.VSPDRangeHigh.Test FaultManager.VSPDRangeHigh.Faulty_Samples__X_ FaultManager.VSPDRangeHigh.Total_Samples__Y_ FaultManager.VSPDRangeHigh.Action_1 FaultManager.VSPDRangeHigh.Action_1_Condition FaultManager.VSPDRangeHigh.Action_2 FaultManager.VSPDRangeHigh.Action_2_Condition FaultManager.VSPDRangeHigh.Action_3 FaultManager.VSPDRangeHigh.Action_3_Condition FaultManager.VSPDRangeHigh.Action_4 FaultManager.VSPDRangeHigh.Action_4_Condition FaultManager.VSPDRangeLow.Mode FaultManager.VSPDRangeLow.ID FaultManager.VSPDRangeLow.Test FaultManager.VSPDRangeLow.Faulty_Samples__X_ FaultManager.VSPDRangeLow.Total_Samples__Y_ FaultManager.VSPDRangeLow.Action_1 FaultManager.VSPDRangeLow.Action_1_Condition FaultManager.VSPDRangeLow.Action_2 FaultManager.VSPDRangeLow.Action_2_Condition FaultManager.VSPDRangeLow.Action_3 FaultManager.VSPDRangeLow.Action_3_Condition FaultManager.VSPDRangeLow.Action_4 FaultManager.VSPDRangeLow.Action_4_Condition FaultManager.Wastegate_Fault.Mode FaultManager.Wastegate_Fault.ID FaultManager.Wastegate_Fault.Test FaultManager.Wastegate_Fault.Faulty_Samples__X_ FaultManager.Wastegate_Fault.Total_Samples__Y_ FaultManager.Wastegate_Fault.Action_1 FaultManager.Wastegate_Fault.Action_1_Condition FaultManager.Wastegate_Fault.Action_2 FaultManager.Wastegate_Fault.Action_2_Condition FaultManager.Wastegate_Fault.Action_3 FaultManager.Wastegate_Fault.Action_3_Condition FaultManager.Wastegate_Fault.Action_4 FaultManager.Wastegate_Fault.Action_4_Condition /end DEF_CHARACTERISTIC
/end FUNCTION
/begin FUNCTION AC_Override "" /begin DEF_CHARACTERISTIC AC_new AC_ovr /end DEF_CHARACTERISTIC /end FUNCTION
/begin FUNCTION AC_Config "" /begin DEF_CHARACTERISTIC AC_Polarity /end DEF_CHARACTERISTIC /end FUNCTION
/begin FUNCTION AC_Control_1 ""
 /begin DEF_CHARACTERISTIC AC_TPSOff AC_TPSOn ACHighPresOffTbl ACHighPresOnTbl ACLowPresOffTbl ACLowPresOnTbl ACSpdFastOff ACSpdFastOn ACSpdSlowOff ACSpdSlowOn ACTempOffTbl ACTempOnTbl ACTimeFromStartDelay /end DEF_CHARACTERISTIC
 /begin OUT_MEASUREMENT ACHighPresOff ACHighPresOn ACLowChrg ACLowPresOff ACLowPresOn ACOutput ACOverPressure ACRpmHighEnbl ACRpmLowEnbl ACTempEnbl ACTempOff ACTempOn ACTpsEnble /end OUT_MEASUREMENT
/end FUNCTION
/begin FUNCTION Run ""
 /begin SUB_FUNCTION AC_Control_1 MinGovernor FAN_Control_1 Fuel_System_Manager AirFlow_Manager Base_Equiv_Ratio Spark_Manager Boost_Control O2_Control DFCO MaxGovernor /end SUB_FUNCTION
/end FUNCTION
/begin FUNCTION Controller "" /begin SUB_FUNCTION Run Stall Crank /end SUB_FUNCTION /end FUNCTION
/begin FUNCTION Control ""
 /begin SUB_FUNCTION Controller Diagnostics VirtualSensors ActuatorCharacterization /end SUB_FUNCTION
/end FUNCTION
/begin FUNCTION AiflowOffset "" /begin DEF_CHARACTERISTIC ACAirFlowOfst_Enab ACAirFlowOfstTbl BaseAirflowOfstTbl /end DEF_CHARACTERISTIC /begin OUT_MEASUREMENT ACAirFlowOfst BaseAirflowOfst BaseAirOffset /end OUT_MEASUREMENT /begin SUB_FUNCTION Ramp_Air_Into_Idle_State /end SUB_FUNCTION /end FUNCTION
/begin FUNCTION MinGovernor "" /begin DEF_CHARACTERISTIC IdleExitTimeConst /end DEF_CHARACTERISTIC
 /begin OUT_MEASUREMENT AirMinGovOutput IdleHandOffMult MinGovReset SpkMinGovOutput /end OUT_MEASUREMENT
 /begin SUB_FUNCTION AiflowOffset Universal_PID__Tunable___Scheduled_ Air_PID_Config Base_Airflow_Table_Adapt Idle_State_Determination Ramp_RPM Base_RPM_Set_Pt MotoringDetection Universal_PD__Tunable___Scheduled_ /end SUB_FUNCTION
/end FUNCTION
/begin FUNCTION AC_Fault ""
 /begin DEF_CHARACTERISTIC ACHighPressureDisable ACHighPressureTime ACLowPressureDisable ACLowPressureTime /end DEF_CHARACTERISTIC
/end FUNCTION
/begin FUNCTION Diagnostics ""
 /begin SUB_FUNCTION AC_Fault Overspeed_Protection Fuel_Economy Wrong_Fuel_Pressure_Fault_Logic Boost_Fault Lean_Protect MAP_Fault_Logic Low_Oil_Pressure_Fault_Logic Engine_Overheat_Fault_Logic /end SUB_FUNCTION
/end FUNCTION
/begin FUNCTION Outputs_Config ""
 /begin DEF_CHARACTERISTIC ACPin EST_InitialPin EST_OpenThreshold EST_SequenceType ETCPin FAN1Pin FAN1Pin_PWM FAN2Pin FAN2Pin_PWM FuelPumpPin IAC_PPin IAC_SPin INJ_Behavior INJ_InitialPin INJ_SequenceType WASTEGATE /end DEF_CHARACTERISTIC
/end FUNCTION
/begin FUNCTION I_O_Pins "" /begin SUB_FUNCTION Outputs_Config Inputs_Config Frequency_In_Config /end SUB_FUNCTION /end FUNCTION
/begin FUNCTION ACPres "" /begin OUT_MEASUREMENT ACPres ACPresADC ACPresRaw /end OUT_MEASUREMENT /begin SUB_FUNCTION ACPres_Override ACPres_Config /end SUB_FUNCTION /end FUNCTION
/begin FUNCTION LinearSensors ""
 /begin SUB_FUNCTION ACPres FuelOxygenationSensor FuelPres FuelSens _MAP MAPTime OilPres SensVolt SysVolt /end SUB_FUNCTION
/end FUNCTION
/begin FUNCTION Inputs ""
 /begin SUB_FUNCTION LinearSensors Digital PotentiometerSensors CAN EngineSpeed NonLinearSensors /end SUB_FUNCTION
/end FUNCTION
/begin FUNCTION ACPres_Override "" /begin DEF_CHARACTERISTIC ACPres_new ACPres_ovr /end DEF_CHARACTERISTIC /end FUNCTION
/begin FUNCTION ACPres_Index "" /begin OUT_MEASUREMENT ACPres05Idx ACPres05In /end OUT_MEASUREMENT /end FUNCTION
/begin FUNCTION Raw_Indexes ""
 /begin SUB_FUNCTION ACPres_Index CAT_Index ECT_Index IAT_Indexes MAP_Indexes OXY_Index RPM_Indexes SysVolt_Index TPS_Indexes VSPD_Index /end SUB_FUNCTION
/end FUNCTION
/begin FUNCTION VirtualSensors ""
 /begin SUB_FUNCTION Raw_Indexes Virtual_Indexes RawProcessed AirCalcs FuelLevel LoadBasedCalcs /end SUB_FUNCTION
/end FUNCTION
/begin FUNCTION ACPres_Config ""
 /begin DEF_CHARACTERISTIC ACPresDfltValue ACPresFilterConst ACPresGain ACPresInputHiFltPos ACPresInputLoFltPos ACPresOfst /end DEF_CHARACTERISTIC
/end FUNCTION
/begin FUNCTION FAN_Control ""
 /begin DEF_CHARACTERISTIC ACPresFanOff ACPresFanOn ACPresFanSpeed_StallMap ACSwFanSpeed_Stall ECTFanOff ECTFanOn ECTFanSpeed_StallMap FAN_Mode Fan1ACPres Fan1ACSw Fan1ECT Fan1IAT Fan2ACPres Fan2ACSw Fan2ECT Fan2IAT IATFanOff IATFanOn IATFanSpeed_StallMap /end DEF_CHARACTERISTIC
 /begin OUT_MEASUREMENT ACPresFanSpeed_Stall ACPresFanSpeed_StallColIdx ACPresFanSpeed_StallColIn ACPresFanSpeed_StallRowIdx ACPresFanSpeed_StallRowIn ECTFanSpeed_Stall ECTFanSpeed_StallColIdx ECTFanSpeed_StallColIn ECTFanSpeed_StallRowIdx ECTFanSpeed_StallRowIn IATFanSpeed_Stall IATFanSpeed_StallColIdx IATFanSpeed_StallColIn IATFanSpeed_StallRowIdx IATFanSpeed_StallRowIn /end OUT_MEASUREMENT
/end FUNCTION
/begin FUNCTION Stall "" /begin SUB_FUNCTION FAN_Control Fuel_Pump_at_Startup Stall_Throttle /end SUB_FUNCTION /end FUNCTION
/begin FUNCTION FAN_Control_1 ""
 /begin DEF_CHARACTERISTIC ACPresFanSpeedMap ACSwFanSpeed ECTFanSpeedMap IATFanSpeedMap /end DEF_CHARACTERISTIC
 /begin OUT_MEASUREMENT ACPresFanSpeed ACPresFanSpeedColIdx ACPresFanSpeedColIn ACPresFanSpeedRowIdx ACPresFanSpeedRowIn ECTFanSpeed ECTFanSpeedColIdx ECTFanSpeedColIn ECTFanSpeedRowIdx ECTFanSpeedRowIn Fan1Cmd Fan2Cmd IATFanSpeed IATFanSpeedColIdx IATFanSpeedColIn IATFanSpeedRowIdx IATFanSpeedRowIn /end OUT_MEASUREMENT
/end FUNCTION
/begin FUNCTION Inputs_Config ""
 /begin DEF_CHARACTERISTIC ACPresPin ACPresPin_ref ACSwPin ACSwPin_ref APP1AnalogInput APP1AnalogInput_ref APP2AnalogInput APP2AnalogInput_ref CATSensorPin CATSensorPin_ref ClutchSw_Pin ClutchSw_Pin_ref ECTSensorPin ECTSensorPin_ref ESTOPPin EVAPSensorPin EVAPSensorPin_ref FuelLvlSensorPin FuelLvlSensorPin_ref FuelPresPin FuelPresPin_ref FuelSensorPin IATSensorPin IATSensorPin_ref MAF_Pin MAPSensorPin MAPSensorPin_ref OilPresPin OilPresPin_ref ScramblePin ScramblePin_ref SensVoltSensorPin SensVoltSensorPin_ref SysVoltage SysVoltage_ref TPS1AnalogInput TPS1AnalogInput_ref TPS2AnalogInput TPS2AnalogInput_ref TwoStepPin VSPD_Pin /end DEF_CHARACTERISTIC
/end FUNCTION
/begin FUNCTION ACSw "" /begin OUT_MEASUREMENT ACSw ACSw_Raw /end OUT_MEASUREMENT /begin SUB_FUNCTION ACSw_Override ACSw_Config /end SUB_FUNCTION /end FUNCTION
/begin FUNCTION Digital ""
 /begin SUB_FUNCTION ACSw ClutchSw ESTOP MAF Scramble TwoStep Two_Step VSPD_Filt VSPD /end SUB_FUNCTION
/end FUNCTION
/begin FUNCTION ACSw_Override "" /begin DEF_CHARACTERISTIC ACSw_new ACSw_ovr /end DEF_CHARACTERISTIC /end FUNCTION
/begin FUNCTION ACSw_Config "" /begin DEF_CHARACTERISTIC ACSwPolarity ACSwSwitchPt /end DEF_CHARACTERISTIC /end FUNCTION
/begin FUNCTION O2_Fuel_Adapt ""
 /begin DEF_CHARACTERISTIC AdaptEnable FuelAdaptDelta FuelAdaptEnable FuelAdaptGainTbl FuelFlowCompAdaptMap FuelFlowCompMap /end DEF_CHARACTERISTIC
 /begin OUT_MEASUREMENT FuelAdapt_Error FuelAdaptEnabled FuelAdaptGain FuelFlowComp FuelFlowCompAdapt /end OUT_MEASUREMENT
 /begin SUB_FUNCTION Saturation__Tunable__2 Adapt_FuelFlowComp_Map O2_Control_Enable_Delay WarmUp_Disable /end SUB_FUNCTION
/end FUNCTION
/begin FUNCTION Fuel_System_Manager "" /begin SUB_FUNCTION O2_Fuel_Adapt Fuel_Calculation Injector_Manager /end SUB_FUNCTION /end FUNCTION
/begin FUNCTION Fuel_Calculation ""
 /begin OUT_MEASUREMENT AdjustedPerCylFuelRate GlobalBaseFuelRate PerCylBaseFuelRate /end OUT_MEASUREMENT
 /begin SUB_FUNCTION Calculate_Fuel_Flow /end SUB_FUNCTION
/end FUNCTION
/begin FUNCTION AnalogIn ""
 /begin OUT_MEASUREMENT ain_create_ACPresPin ain_create_ACSwPin ain_create_APP1AnalogInput ain_create_APP2AnalogInput ain_create_CATSensorPin ain_create_ClutchSw_Pin ain_create_ECTSensorPin ain_create_ECUP ain_create_EVAPSensorPin ain_create_FuelLvlSensorPin ain_create_FuelPresPin ain_create_IATSensorPin ain_create_MAPSensorPin ain_create_OilPresPin ain_create_ScramblePin ain_create_SensVoltSensorPin ain_create_SysVoltage ain_create_TPS1AnalogInput ain_create_TPS2AnalogInput ain_read_ACPresPin ain_read_ACSwPin ain_read_APP1AnalogInput ain_read_APP2AnalogInput ain_read_CATSensorPin ain_read_ClutchSw_Pin ain_read_ECTSensorPin ain_read_ECUP ain_read_EVAPSensorPin ain_read_FuelLvlSensorPin ain_read_FuelPresPin ain_read_IATSensorPin ain_read_MAPSensorPin ain_read_OilPresPin ain_read_ScramblePin ain_read_SensVoltSensorPin ain_read_SysVoltage ain_read_TPS1AnalogInput ain_read_TPS2AnalogInput /end OUT_MEASUREMENT
/end FUNCTION
/begin FUNCTION Resources ""
 /begin SUB_FUNCTION AnalogIn CAN_1 DigitalInput DiscreteOut Encoder SequenceOut FrequencyIn PWM Other /end SUB_FUNCTION
/end FUNCTION
/begin FUNCTION Debug ""
 /begin SUB_FUNCTION Resources Application_Monitor Application_Monitor_Config Event_Pause_Counters General /end SUB_FUNCTION
/end FUNCTION
/begin FUNCTION AirFlow_Manager ""
 /begin DEF_CHARACTERISTIC AirControlSource IACTypeCal MaxETCSetPtLimitTbl MinETCSetpoint ThrottleSource /end DEF_CHARACTERISTIC
 /begin OUT_MEASUREMENT ETCRequestFinal MaxETCSetPtLimit /end OUT_MEASUREMENT
/end FUNCTION
/begin FUNCTION PID_Gain_Select1 ""
 /begin DEF_CHARACTERISTIC AirMinGovDGain AirMinGovDGainErrorMultTbl AirMinGovIGain AirMinGovIGainErrorMultTbl AirMinGovPGain AirMinGovPGainErrorMultTbl /end DEF_CHARACTERISTIC
 /begin OUT_MEASUREMENT AirMinGovDGainErrorMult AirMinGovIGainErrorMult AirMinGovPGainErrorMult /end OUT_MEASUREMENT
/end FUNCTION
/begin FUNCTION Universal_PID__Tunable___Scheduled_ ""
 /begin OUT_MEASUREMENT AirMinGovDTerm AirMinGovError AirMinGovITerm AirMinGovPTerm AirMinGovSpeedErrorIdx AirMinGovSpeedErrorIn /end OUT_MEASUREMENT
 /begin SUB_FUNCTION PID_Gain_Select1 /end SUB_FUNCTION
/end FUNCTION
/begin FUNCTION Air_PID_Config ""
 /begin DEF_CHARACTERISTIC AirMinGovErrorGain AirMinGovITermLowerLimit AirMinGovITermUpperLimit AirMinGovPIDOutLowerLimit AirMinGovPIDOutUpperLimit /end DEF_CHARACTERISTIC
/end FUNCTION
/begin FUNCTION PotentiometerSensors "" /begin DEF_CHARACTERISTIC APP_AdaptMode /end DEF_CHARACTERISTIC
 /begin SUB_FUNCTION APP1 APP1_Adapt APP1ForcedAdapt APP2 APP2_Adapt APP2ForcedAdapt TPS1 TPS2 /end SUB_FUNCTION
/end FUNCTION
/begin FUNCTION Dash_Message_DBW ""
 /begin DEF_CHARACTERISTIC APP_FiltDecFiltC APP_FiltIncFiltC ETCReq_FiltDecFiltC ETCReq_FiltIncFiltC TPS1_FiltDecFiltC TPS1_FiltIncFiltC TPS2_FiltDecFiltC TPS2_FiltIncFiltC /end DEF_CHARACTERISTIC
 /begin OUT_MEASUREMENT APP_FiltDirection APP_FiltFilterConst APP_FiltFiltered ETCReq_FiltDirection ETCReq_FiltFilterConst ETCReq_FiltFiltered TPS1_FiltDirection TPS1_FiltFilterConst TPS1_FiltFiltered TPS2_FiltDirection TPS2_FiltFilterConst TPS2_FiltFiltered /end OUT_MEASUREMENT
/end FUNCTION
/begin FUNCTION AEM_Infinity_Dash ""
 /begin SUB_FUNCTION Dash_Message_DBW Dash_Message_1 Dash_Message_2 Dash_Message_6 Dash_Message_3 /end SUB_FUNCTION
/end FUNCTION
/begin FUNCTION Virtual_Indexes ""
 /begin OUT_MEASUREMENT App05Idx App05In RPMAccel17Idx RPMAccel17In TimeSinceRun09Idx TimeSinceRun09In /end OUT_MEASUREMENT
 /begin SUB_FUNCTION ECT_KeyUp IAT_KeyUp MAFPortIndex /end SUB_FUNCTION
/end FUNCTION
/begin FUNCTION APP1 "" /begin DEF_CHARACTERISTIC APP1Tbl /end DEF_CHARACTERISTIC /begin OUT_MEASUREMENT APP1 APP1ADC APP1Idx APP1Raw /end OUT_MEASUREMENT /begin SUB_FUNCTION APP1_Override APP1_Config /end SUB_FUNCTION /end FUNCTION
/begin FUNCTION APP1_Adapt_Override "" /begin DEF_CHARACTERISTIC APP1_Adapt_new APP1_Adapt_ovr /end DEF_CHARACTERISTIC /end FUNCTION
/begin FUNCTION APP1_Adapt ""
 /begin OUT_MEASUREMENT APP1_AdaptAdapt_Hi APP1_AdaptAdapt_Low APP1_AdaptADC APP1_AdaptPercent APP1_AdaptPercentRaw /end OUT_MEASUREMENT
 /begin SUB_FUNCTION APP1_Adapt_Override APP1_Adapt_Config /end SUB_FUNCTION
/end FUNCTION
/begin FUNCTION APP1_Adapt_Config ""
 /begin DEF_CHARACTERISTIC APP1_AdaptAdapt_Delta APP1_AdaptAdapt_Hi_Max APP1_AdaptAdapt_Hi_Min APP1_AdaptAdapt_Low_Max APP1_AdaptAdapt_Low_Min APP1_AdaptAdaptHiEnable APP1_AdaptAdaptLoEnable APP1_AdaptDfltValue APP1_AdaptFilterConst APP1_AdaptInputHiFltPos APP1_AdaptInputLoFltPos APP1_AdaptMaxLimit APP1_AdaptRev_Polarity /end DEF_CHARACTERISTIC
/end FUNCTION
/begin FUNCTION APP__Sensor_Arbitration1 "" /begin DEF_CHARACTERISTIC APP1_APP2_Max_Deviation /end DEF_CHARACTERISTIC /end FUNCTION
/begin FUNCTION RawProcessed "" /begin OUT_MEASUREMENT APPPcnt ECT_KeyUp /end OUT_MEASUREMENT
 /begin SUB_FUNCTION APP__Sensor_Arbitration1 Base_TPS_Request EngineState Capture_ECT_At_Startup Engine_Accel Gear_Estimator Fuel_Delta_Pressure_Calculation Capture_IAT_At_Startup O2_De_lag CutThrottle_APP_Limiting Time_Since_Key_On Time_Since_Run Time_Since_Stall TPS__Sensor_Arbitration VSPD_Selector /end SUB_FUNCTION
/end FUNCTION
/begin FUNCTION APP1_Override "" /begin DEF_CHARACTERISTIC APP1_new APP1_ovr /end DEF_CHARACTERISTIC /end FUNCTION
/begin FUNCTION Base_TPS_Request ""
 /begin DEF_CHARACTERISTIC ETCReqDecFiltC ETCReqFallRateTbl ETCReqIncFiltC ETCReqRiseRateTbl ETCRequestMap /end DEF_CHARACTERISTIC
 /begin OUT_MEASUREMENT APP17Idx APP17In ETCReqFallRate ETCReqFilterConst ETCReqRiseRate ETCRequest ETCRequestDirection FilteredETCRequest /end OUT_MEASUREMENT
/end FUNCTION
/begin FUNCTION APP1_Config "" /begin DEF_CHARACTERISTIC APP1Default APP1FiltConst APP1Max APP1MaxLimit APP1Min /end DEF_CHARACTERISTIC /end FUNCTION
/begin FUNCTION APP1ForcedAdapt "" /begin DEF_CHARACTERISTIC APP1HiAdaptADCThresh APP1LowAdaptADCThresh /end DEF_CHARACTERISTIC /end FUNCTION
/begin FUNCTION APP2 "" /begin DEF_CHARACTERISTIC APP2Tbl /end DEF_CHARACTERISTIC /begin OUT_MEASUREMENT APP2 APP2ADC APP2Idx APP2Raw /end OUT_MEASUREMENT /begin SUB_FUNCTION APP2_Override APP2_Config /end SUB_FUNCTION /end FUNCTION
/begin FUNCTION APP2_Adapt_Override "" /begin DEF_CHARACTERISTIC APP2_Adapt_new APP2_Adapt_ovr /end DEF_CHARACTERISTIC /end FUNCTION
/begin FUNCTION APP2_Adapt ""
 /begin OUT_MEASUREMENT APP2_AdaptAdapt_Hi APP2_AdaptAdapt_Low APP2_AdaptADC APP2_AdaptPercent APP2_AdaptPercentRaw /end OUT_MEASUREMENT
 /begin SUB_FUNCTION APP2_Adapt_Override APP2_Adapt_Config /end SUB_FUNCTION
/end FUNCTION
/begin FUNCTION APP2_Adapt_Config ""
 /begin DEF_CHARACTERISTIC APP2_AdaptAdapt_Delta APP2_AdaptAdapt_Hi_Max APP2_AdaptAdapt_Hi_Min APP2_AdaptAdapt_Low_Max APP2_AdaptAdapt_Low_Min APP2_AdaptAdaptHiEnable APP2_AdaptAdaptLoEnable APP2_AdaptDfltValue APP2_AdaptFilterConst APP2_AdaptInputHiFltPos APP2_AdaptInputLoFltPos APP2_AdaptMaxLimit APP2_AdaptRev_Polarity /end DEF_CHARACTERISTIC
/end FUNCTION
/begin FUNCTION APP2_Override "" /begin DEF_CHARACTERISTIC APP2_new APP2_ovr /end DEF_CHARACTERISTIC /end FUNCTION
/begin FUNCTION APP2_Config "" /begin DEF_CHARACTERISTIC APP2Default APP2FiltConst APP2Max APP2MaxLimit APP2Min /end DEF_CHARACTERISTIC /end FUNCTION
/begin FUNCTION APP2ForcedAdapt "" /begin DEF_CHARACTERISTIC APP2HiAdaptADCThresh APP2LowAdaptADCThresh /end DEF_CHARACTERISTIC /end FUNCTION
/begin FUNCTION Application_Monitor "" /begin DEF_CHARACTERISTIC ApplicationStatus /end DEF_CHARACTERISTIC
 /begin OUT_MEASUREMENT ApplicationInitStatus ApplicationStopReason ApplicationStopReasonBlock /end OUT_MEASUREMENT
/end FUNCTION
/begin FUNCTION Application_Monitor_Config ""
 /begin DEF_CHARACTERISTIC ApplicationMonitorEnable ApplicationPausePoint BgndStackMargin CPUMargin FgndTimeStackMargin HeapMargin IdleStackMargin InterruptStackMargin /end DEF_CHARACTERISTIC
/end FUNCTION
/begin FUNCTION Bank1_DataValidState_Ovr_Override "" /begin DEF_CHARACTERISTIC Bank1_DataValidState_Ovr_new Bank1_DataValidState_Ovr_ovr /end DEF_CHARACTERISTIC /end FUNCTION
/begin FUNCTION AEM_X_Lambda "" /begin DEF_CHARACTERISTIC Bank2_Enable Lambda_1_Timeout Lambda_2_Timeout /end DEF_CHARACTERISTIC
 /begin OUT_MEASUREMENT Bank1_DataValidState_Prb Bank1_HeaterVolts_Prb Bank1_Lambda_Prb Bank1_OxygenConcentration_Prb Bank1_SensorDetectedStatus_Prb Bank1_SensorFaultState_Prb Bank1_SensorStatus_Prb Bank1_SystemVolts_Prb Bank1_UsingFreeAreCalState_Prb Bank1EquivRatio Bank2_DataValidState_Prb Bank2_HeaterVolts_Prb Bank2_Lambda_Prb Bank2_OxygenConcentration_Prb Bank2_SensorDetectedStatus_Prb Bank2_SensorFaultState_Prb Bank2_SensorStatus_Prb Bank2_SystemVolts_Prb Bank2_UsingFreeAreCalState_Prb Bank2EquivRatio O2_EquivRatio_Avg /end OUT_MEASUREMENT
 /begin SUB_FUNCTION Bank1_DataValidState_Ovr_Override Bank1_EquivRatio Bank1_HeaterVolts_Ovr_Override Bank1_Lambda_Ovr_Override Bank1_OxygenConcentration_Ovr_Override Bank1_SensorDetectedStatus_Ovr_Override Bank1_SensorFaultState_Ovr_Override Bank1_SensorStatus_Ovr_Override Bank1_SystemVolts_Ovr_Override Bank1_UsingFreeAreCalState_Ovr_Override Bank2_DataValidState_Ovr_Override Bank2_EquivRatio Bank2_HeaterVolts_Ovr_Override Bank2_Lambda_Ovr_Override Bank2_OxygenConcentration_Ovr_Override Bank2_SensorDetectedStatus_Ovr_Override Bank2_SensorFaultState_Ovr_Override Bank2_SensorStatus_Ovr_Override Bank2_SystemVolts_Ovr_Override Bank2_UsingFreeAreCalState_Ovr_Override /end SUB_FUNCTION
/end FUNCTION
/begin FUNCTION CAN "" /begin SUB_FUNCTION AEM_X_Lambda AEM_GPS /end SUB_FUNCTION /end FUNCTION
/begin FUNCTION Bank1_EquivRatio "" /begin OUT_MEASUREMENT Bank1_EquivRatio Bank1_EquivRatioADC Bank1_EquivRatioRaw /end OUT_MEASUREMENT /begin SUB_FUNCTION Bank1_EquivRatio_Override Bank1_EquivRatio_Config /end SUB_FUNCTION /end FUNCTION
/begin FUNCTION Bank1_EquivRatio_Override "" /begin DEF_CHARACTERISTIC Bank1_EquivRatio_new Bank1_EquivRatio_ovr /end DEF_CHARACTERISTIC /end FUNCTION
/begin FUNCTION Bank1_EquivRatio_Config ""
 /begin DEF_CHARACTERISTIC Bank1_EquivRatioDfltValue Bank1_EquivRatioFilterConst Bank1_EquivRatioGain Bank1_EquivRatioInputHiFltPos Bank1_EquivRatioInputLoFltPos Bank1_EquivRatioOfst /end DEF_CHARACTERISTIC
/end FUNCTION
/begin FUNCTION Bank1_HeaterVolts_Ovr_Override "" /begin DEF_CHARACTERISTIC Bank1_HeaterVolts_Ovr_new Bank1_HeaterVolts_Ovr_ovr /end DEF_CHARACTERISTIC /end FUNCTION
/begin FUNCTION Bank1_Lambda_Ovr_Override "" /begin DEF_CHARACTERISTIC Bank1_Lambda_Ovr_new Bank1_Lambda_Ovr_ovr /end DEF_CHARACTERISTIC /end FUNCTION
/end MODULE
/end PROJECT
