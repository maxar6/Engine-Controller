ASAP2_VERSION 1 51
/begin PROJECT Project ""
/begin MODULE BaseEngin_018 ""
/begin MOD_COMMON /* MOD_COMMON Comment */ "" BYTE_ORDER MSB_FIRST ALIGNMENT_BYTE 1 ALIGNMENT_FLOAT32_IEEE 1 ALIGNMENT_FLOAT64_IEEE 1 ALIGNMENT_LONG 1 ALIGNMENT_WORD 1 /end MOD_COMMON
/begin CHARACTERISTIC FaultManager.EST6_Open.Action_1_Condition "Fault manager configuration.  Select up to 4 actions for each fault." VALUE 0x800032AB RecordLayout_8 0 CompuMethod_111 0 65535 /end CHARACTERISTIC
/begin CHARACTERISTIC FaultManager.EST6_Open.Action_2 "Fault manager configuration.  Select up to 4 actions for each fault." VALUE 0x800032AD RecordLayout_8 0 CompuMethod_110 0 65535 /end CHARACTERISTIC
/begin CHARACTERISTIC FaultManager.EST6_Open.Action_2_Condition "Fault manager configuration.  Select up to 4 actions for each fault." VALUE 0x800032AF RecordLayout_8 0 CompuMethod_111 0 65535 /end CHARACTERISTIC
/begin CHARACTERISTIC FaultManager.EST6_Open.Action_3 "Fault manager configuration.  Select up to 4 actions for each fault." VALUE 0x800032B1 RecordLayout_8 0 CompuMethod_110 0 65535 /end CHARACTERISTIC
/begin CHARACTERISTIC FaultManager.EST6_Open.Action_3_Condition "Fault manager configuration.  Select up to 4 actions for each fault." VALUE 0x800032B3 RecordLayout_8 0 CompuMethod_111 0 65535 /end CHARACTERISTIC
/begin CHARACTERISTIC FaultManager.EST6_Open.Action_4 "Fault manager configuration.  Select up to 4 actions for each fault." VALUE 0x800032B5 RecordLayout_8 0 CompuMethod_110 0 65535 /end CHARACTERISTIC
/begin CHARACTERISTIC FaultManager.EST6_Open.Action_4_Condition "Fault manager configuration.  Select up to 4 actions for each fault." VALUE 0x800032B7 RecordLayout_8 0 CompuMethod_111 0 65535 /end CHARACTERISTIC
/begin CHARACTERISTIC FaultManager.EST6_Short.Mode "Fault manager configuration.  Select up to 4 actions for each fault." VALUE 0x800032B9 RecordLayout_8 0 CompuMethod_108 0 65535 /end CHARACTERISTIC
/begin CHARACTERISTIC FaultManager.EST6_Short.ID "Fault manager configuration.  Select up to 4 actions for each fault." VALUE 0x800032BB RecordLayout_8 0 CompuMethod_1 0 65535 /end CHARACTERISTIC
/begin CHARACTERISTIC FaultManager.EST6_Short.Test "Fault manager configuration.  Select up to 4 actions for each fault." VALUE 0x800032BD RecordLayout_8 0 CompuMethod_109 0 65535 /end CHARACTERISTIC
/begin CHARACTERISTIC FaultManager.EST6_Short.Faulty_Samples__X_ "Fault manager configuration.  Select up to 4 actions for each fault." VALUE 0x800032BF RecordLayout_8 0 CompuMethod_1 0 65535 /end CHARACTERISTIC
/begin CHARACTERISTIC FaultManager.EST6_Short.Total_Samples__Y_ "Fault manager configuration.  Select up to 4 actions for each fault." VALUE 0x800032C1 RecordLayout_8 0 CompuMethod_1 0 65535 /end CHARACTERISTIC
/begin CHARACTERISTIC FaultManager.EST6_Short.Action_1 "Fault manager configuration.  Select up to 4 actions for each fault." VALUE 0x800032C3 RecordLayout_8 0 CompuMethod_110 0 65535 /end CHARACTERISTIC
/begin CHARACTERISTIC FaultManager.EST6_Short.Action_1_Condition "Fault manager configuration.  Select up to 4 actions for each fault." VALUE 0x800032C5 RecordLayout_8 0 CompuMethod_111 0 65535 /end CHARACTERISTIC
/begin CHARACTERISTIC FaultManager.EST6_Short.Action_2 "Fault manager configuration.  Select up to 4 actions for each fault." VALUE 0x800032C7 RecordLayout_8 0 CompuMethod_110 0 65535 /end CHARACTERISTIC
/begin CHARACTERISTIC FaultManager.EST6_Short.Action_2_Condition "Fault manager configuration.  Select up to 4 actions for each fault." VALUE 0x800032C9 RecordLayout_8 0 CompuMethod_111 0 65535 /end CHARACTERISTIC
/begin CHARACTERISTIC FaultManager.EST6_Short.Action_3 "Fault manager configuration.  Select up to 4 actions for each fault." VALUE 0x800032CB RecordLayout_8 0 CompuMethod_110 0 65535 /end CHARACTERISTIC
/begin CHARACTERISTIC FaultManager.EST6_Short.Action_3_Condition "Fault manager configuration.  Select up to 4 actions for each fault." VALUE 0x800032CD RecordLayout_8 0 CompuMethod_111 0 65535 /end CHARACTERISTIC
/begin CHARACTERISTIC FaultManager.EST6_Short.Action_4 "Fault manager configuration.  Select up to 4 actions for each fault." VALUE 0x800032CF RecordLayout_8 0 CompuMethod_110 0 65535 /end CHARACTERISTIC
/begin CHARACTERISTIC FaultManager.EST6_Short.Action_4_Condition "Fault manager configuration.  Select up to 4 actions for each fault." VALUE 0x800032D1 RecordLayout_8 0 CompuMethod_111 0 65535 /end CHARACTERISTIC
/begin CHARACTERISTIC FaultManager.EST7_Open.Mode "Fault manager configuration.  Select up to 4 actions for each fault." VALUE 0x800032D3 RecordLayout_8 0 CompuMethod_108 0 65535 /end CHARACTERISTIC
/begin CHARACTERISTIC FaultManager.EST7_Open.ID "Fault manager configuration.  Select up to 4 actions for each fault." VALUE 0x800032D5 RecordLayout_8 0 CompuMethod_1 0 65535 /end CHARACTERISTIC
/begin CHARACTERISTIC FaultManager.EST7_Open.Test "Fault manager configuration.  Select up to 4 actions for each fault." VALUE 0x800032D7 RecordLayout_8 0 CompuMethod_109 0 65535 /end CHARACTERISTIC
/begin CHARACTERISTIC FaultManager.EST7_Open.Faulty_Samples__X_ "Fault manager configuration.  Select up to 4 actions for each fault." VALUE 0x800032D9 RecordLayout_8 0 CompuMethod_1 0 65535 /end CHARACTERISTIC
/begin CHARACTERISTIC FaultManager.EST7_Open.Total_Samples__Y_ "Fault manager configuration.  Select up to 4 actions for each fault." VALUE 0x800032DB RecordLayout_8 0 CompuMethod_1 0 65535 /end CHARACTERISTIC
/begin CHARACTERISTIC FaultManager.EST7_Open.Action_1 "Fault manager configuration.  Select up to 4 actions for each fault." VALUE 0x800032DD RecordLayout_8 0 CompuMethod_110 0 65535 /end CHARACTERISTIC
/begin CHARACTERISTIC FaultManager.EST7_Open.Action_1_Condition "Fault manager configuration.  Select up to 4 actions for each fault." VALUE 0x800032DF RecordLayout_8 0 CompuMethod_111 0 65535 /end CHARACTERISTIC
/begin CHARACTERISTIC FaultManager.EST7_Open.Action_2 "Fault manager configuration.  Select up to 4 actions for each fault." VALUE 0x800032E1 RecordLayout_8 0 CompuMethod_110 0 65535 /end CHARACTERISTIC
/begin CHARACTERISTIC FaultManager.EST7_Open.Action_2_Condition "Fault manager configuration.  Select up to 4 actions for each fault." VALUE 0x800032E3 RecordLayout_8 0 CompuMethod_111 0 65535 /end CHARACTERISTIC
/begin CHARACTERISTIC FaultManager.EST7_Open.Action_3 "Fault manager configuration.  Select up to 4 actions for each fault." VALUE 0x800032E5 RecordLayout_8 0 CompuMethod_110 0 65535 /end CHARACTERISTIC
/begin CHARACTERISTIC FaultManager.EST7_Open.Action_3_Condition "Fault manager configuration.  Select up to 4 actions for each fault." VALUE 0x800032E7 RecordLayout_8 0 CompuMethod_111 0 65535 /end CHARACTERISTIC
/begin CHARACTERISTIC FaultManager.EST7_Open.Action_4 "Fault manager configuration.  Select up to 4 actions for each fault." VALUE 0x800032E9 RecordLayout_8 0 CompuMethod_110 0 65535 /end CHARACTERISTIC
/begin CHARACTERISTIC FaultManager.EST7_Open.Action_4_Condition "Fault manager configuration.  Select up to 4 actions for each fault." VALUE 0x800032EB RecordLayout_8 0 CompuMethod_111 0 65535 /end CHARACTERISTIC
/begin CHARACTERISTIC FaultManager.EST7_Short.Mode "Fault manager configuration.  Select up to 4 actions for each fault." VALUE 0x800032ED RecordLayout_8 0 CompuMethod_108 0 65535 /end CHARACTERISTIC
/begin CHARACTERISTIC FaultManager.EST7_Short.ID "Fault manager configuration.  Select up to 4 actions for each fault." VALUE 0x800032EF RecordLayout_8 0 CompuMethod_1 0 65535 /end CHARACTERISTIC
/begin CHARACTERISTIC FaultManager.EST7_Short.Test "Fault manager configuration.  Select up to 4 actions for each fault." VALUE 0x800032F1 RecordLayout_8 0 CompuMethod_109 0 65535 /end CHARACTERISTIC
/begin CHARACTERISTIC FaultManager.EST7_Short.Faulty_Samples__X_ "Fault manager configuration.  Select up to 4 actions for each fault." VALUE 0x800032F3 RecordLayout_8 0 CompuMethod_1 0 65535 /end CHARACTERISTIC
/begin CHARACTERISTIC FaultManager.EST7_Short.Total_Samples__Y_ "Fault manager configuration.  Select up to 4 actions for each fault." VALUE 0x800032F5 RecordLayout_8 0 CompuMethod_1 0 65535 /end CHARACTERISTIC
/begin CHARACTERISTIC FaultManager.EST7_Short.Action_1 "Fault manager configuration.  Select up to 4 actions for each fault." VALUE 0x800032F7 RecordLayout_8 0 CompuMethod_110 0 65535 /end CHARACTERISTIC
/begin CHARACTERISTIC FaultManager.EST7_Short.Action_1_Condition "Fault manager configuration.  Select up to 4 actions for each fault." VALUE 0x800032F9 RecordLayout_8 0 CompuMethod_111 0 65535 /end CHARACTERISTIC
/begin CHARACTERISTIC FaultManager.EST7_Short.Action_2 "Fault manager configuration.  Select up to 4 actions for each fault." VALUE 0x800032FB RecordLayout_8 0 CompuMethod_110 0 65535 /end CHARACTERISTIC
/begin CHARACTERISTIC FaultManager.EST7_Short.Action_2_Condition "Fault manager configuration.  Select up to 4 actions for each fault." VALUE 0x800032FD RecordLayout_8 0 CompuMethod_111 0 65535 /end CHARACTERISTIC
/begin CHARACTERISTIC FaultManager.EST7_Short.Action_3 "Fault manager configuration.  Select up to 4 actions for each fault." VALUE 0x800032FF RecordLayout_8 0 CompuMethod_110 0 65535 /end CHARACTERISTIC
/begin CHARACTERISTIC FaultManager.EST7_Short.Action_3_Condition "Fault manager configuration.  Select up to 4 actions for each fault." VALUE 0x80003301 RecordLayout_8 0 CompuMethod_111 0 65535 /end CHARACTERISTIC
/begin CHARACTERISTIC FaultManager.EST7_Short.Action_4 "Fault manager configuration.  Select up to 4 actions for each fault." VALUE 0x80003303 RecordLayout_8 0 CompuMethod_110 0 65535 /end CHARACTERISTIC
/begin CHARACTERISTIC FaultManager.EST7_Short.Action_4_Condition "Fault manager configuration.  Select up to 4 actions for each fault." VALUE 0x80003305 RecordLayout_8 0 CompuMethod_111 0 65535 /end CHARACTERISTIC
/begin CHARACTERISTIC FaultManager.EST8_Open.Mode "Fault manager configuration.  Select up to 4 actions for each fault." VALUE 0x80003307 RecordLayout_8 0 CompuMethod_108 0 65535 /end CHARACTERISTIC
/begin CHARACTERISTIC FaultManager.EST8_Open.ID "Fault manager configuration.  Select up to 4 actions for each fault." VALUE 0x80003309 RecordLayout_8 0 CompuMethod_1 0 65535 /end CHARACTERISTIC
/begin CHARACTERISTIC FaultManager.EST8_Open.Test "Fault manager configuration.  Select up to 4 actions for each fault." VALUE 0x8000330B RecordLayout_8 0 CompuMethod_109 0 65535 /end CHARACTERISTIC
/begin CHARACTERISTIC FaultManager.EST8_Open.Faulty_Samples__X_ "Fault manager configuration.  Select up to 4 actions for each fault." VALUE 0x8000330D RecordLayout_8 0 CompuMethod_1 0 65535 /end CHARACTERISTIC
/begin CHARACTERISTIC FaultManager.EST8_Open.Total_Samples__Y_ "Fault manager configuration.  Select up to 4 actions for each fault." VALUE 0x8000330F RecordLayout_8 0 CompuMethod_1 0 65535 /end CHARACTERISTIC
/begin CHARACTERISTIC FaultManager.EST8_Open.Action_1 "Fault manager configuration.  Select up to 4 actions for each fault." VALUE 0x80003311 RecordLayout_8 0 CompuMethod_110 0 65535 /end CHARACTERISTIC
/begin CHARACTERISTIC FaultManager.EST8_Open.Action_1_Condition "Fault manager configuration.  Select up to 4 actions for each fault." VALUE 0x80003313 RecordLayout_8 0 CompuMethod_111 0 65535 /end CHARACTERISTIC
/begin CHARACTERISTIC FaultManager.EST8_Open.Action_2 "Fault manager configuration.  Select up to 4 actions for each fault." VALUE 0x80003315 RecordLayout_8 0 CompuMethod_110 0 65535 /end CHARACTERISTIC
/begin CHARACTERISTIC FaultManager.EST8_Open.Action_2_Condition "Fault manager configuration.  Select up to 4 actions for each fault." VALUE 0x80003317 RecordLayout_8 0 CompuMethod_111 0 65535 /end CHARACTERISTIC
/begin CHARACTERISTIC FaultManager.EST8_Open.Action_3 "Fault manager configuration.  Select up to 4 actions for each fault." VALUE 0x80003319 RecordLayout_8 0 CompuMethod_110 0 65535 /end CHARACTERISTIC
/begin CHARACTERISTIC FaultManager.EST8_Open.Action_3_Condition "Fault manager configuration.  Select up to 4 actions for each fault." VALUE 0x8000331B RecordLayout_8 0 CompuMethod_111 0 65535 /end CHARACTERISTIC
/begin CHARACTERISTIC FaultManager.EST8_Open.Action_4 "Fault manager configuration.  Select up to 4 actions for each fault." VALUE 0x8000331D RecordLayout_8 0 CompuMethod_110 0 65535 /end CHARACTERISTIC
/begin CHARACTERISTIC FaultManager.EST8_Open.Action_4_Condition "Fault manager configuration.  Select up to 4 actions for each fault." VALUE 0x8000331F RecordLayout_8 0 CompuMethod_111 0 65535 /end CHARACTERISTIC
/begin CHARACTERISTIC FaultManager.EST8_Short.Mode "Fault manager configuration.  Select up to 4 actions for each fault." VALUE 0x80003321 RecordLayout_8 0 CompuMethod_108 0 65535 /end CHARACTERISTIC
/begin CHARACTERISTIC FaultManager.EST8_Short.ID "Fault manager configuration.  Select up to 4 actions for each fault." VALUE 0x80003323 RecordLayout_8 0 CompuMethod_1 0 65535 /end CHARACTERISTIC
/begin CHARACTERISTIC FaultManager.EST8_Short.Test "Fault manager configuration.  Select up to 4 actions for each fault." VALUE 0x80003325 RecordLayout_8 0 CompuMethod_109 0 65535 /end CHARACTERISTIC
/begin CHARACTERISTIC FaultManager.EST8_Short.Faulty_Samples__X_ "Fault manager configuration.  Select up to 4 actions for each fault." VALUE 0x80003327 RecordLayout_8 0 CompuMethod_1 0 65535 /end CHARACTERISTIC
/begin CHARACTERISTIC FaultManager.EST8_Short.Total_Samples__Y_ "Fault manager configuration.  Select up to 4 actions for each fault." VALUE 0x80003329 RecordLayout_8 0 CompuMethod_1 0 65535 /end CHARACTERISTIC
/begin CHARACTERISTIC FaultManager.EST8_Short.Action_1 "Fault manager configuration.  Select up to 4 actions for each fault." VALUE 0x8000332B RecordLayout_8 0 CompuMethod_110 0 65535 /end CHARACTERISTIC
/begin CHARACTERISTIC FaultManager.EST8_Short.Action_1_Condition "Fault manager configuration.  Select up to 4 actions for each fault." VALUE 0x8000332D RecordLayout_8 0 CompuMethod_111 0 65535 /end CHARACTERISTIC
/begin CHARACTERISTIC FaultManager.EST8_Short.Action_2 "Fault manager configuration.  Select up to 4 actions for each fault." VALUE 0x8000332F RecordLayout_8 0 CompuMethod_110 0 65535 /end CHARACTERISTIC
/begin CHARACTERISTIC FaultManager.EST8_Short.Action_2_Condition "Fault manager configuration.  Select up to 4 actions for each fault." VALUE 0x80003331 RecordLayout_8 0 CompuMethod_111 0 65535 /end CHARACTERISTIC
/begin CHARACTERISTIC FaultManager.EST8_Short.Action_3 "Fault manager configuration.  Select up to 4 actions for each fault." VALUE 0x80003333 RecordLayout_8 0 CompuMethod_110 0 65535 /end CHARACTERISTIC
/begin CHARACTERISTIC FaultManager.EST8_Short.Action_3_Condition "Fault manager configuration.  Select up to 4 actions for each fault." VALUE 0x80003335 RecordLayout_8 0 CompuMethod_111 0 65535 /end CHARACTERISTIC
/begin CHARACTERISTIC FaultManager.EST8_Short.Action_4 "Fault manager configuration.  Select up to 4 actions for each fault." VALUE 0x80003337 RecordLayout_8 0 CompuMethod_110 0 65535 /end CHARACTERISTIC
/begin CHARACTERISTIC FaultManager.EST8_Short.Action_4_Condition "Fault manager configuration.  Select up to 4 actions for each fault." VALUE 0x80003339 RecordLayout_8 0 CompuMethod_111 0 65535 /end CHARACTERISTIC
/begin CHARACTERISTIC FaultManager.ETCSpringTest.Mode "Fault manager configuration.  Select up to 4 actions for each fault." VALUE 0x8000333B RecordLayout_8 0 CompuMethod_108 0 65535 /end CHARACTERISTIC
/begin CHARACTERISTIC FaultManager.ETCSpringTest.ID "Fault manager configuration.  Select up to 4 actions for each fault." VALUE 0x8000333D RecordLayout_8 0 CompuMethod_1 0 65535 /end CHARACTERISTIC
/begin CHARACTERISTIC FaultManager.ETCSpringTest.Test "Fault manager configuration.  Select up to 4 actions for each fault." VALUE 0x8000333F RecordLayout_8 0 CompuMethod_109 0 65535 /end CHARACTERISTIC
/begin CHARACTERISTIC FaultManager.ETCSpringTest.Faulty_Samples__X_ "Fault manager configuration.  Select up to 4 actions for each fault." VALUE 0x80003341 RecordLayout_8 0 CompuMethod_1 0 65535 /end CHARACTERISTIC
/begin CHARACTERISTIC FaultManager.ETCSpringTest.Total_Samples__Y_ "Fault manager configuration.  Select up to 4 actions for each fault." VALUE 0x80003343 RecordLayout_8 0 CompuMethod_1 0 65535 /end CHARACTERISTIC
/begin CHARACTERISTIC FaultManager.ETCSpringTest.Action_1 "Fault manager configuration.  Select up to 4 actions for each fault." VALUE 0x80003345 RecordLayout_8 0 CompuMethod_110 0 65535 /end CHARACTERISTIC
/begin CHARACTERISTIC FaultManager.ETCSpringTest.Action_1_Condition "Fault manager configuration.  Select up to 4 actions for each fault." VALUE 0x80003347 RecordLayout_8 0 CompuMethod_111 0 65535 /end CHARACTERISTIC
/begin CHARACTERISTIC FaultManager.ETCSpringTest.Action_2 "Fault manager configuration.  Select up to 4 actions for each fault." VALUE 0x80003349 RecordLayout_8 0 CompuMethod_110 0 65535 /end CHARACTERISTIC
/begin CHARACTERISTIC FaultManager.ETCSpringTest.Action_2_Condition "Fault manager configuration.  Select up to 4 actions for each fault." VALUE 0x8000334B RecordLayout_8 0 CompuMethod_111 0 65535 /end CHARACTERISTIC
/begin CHARACTERISTIC FaultManager.ETCSpringTest.Action_3 "Fault manager configuration.  Select up to 4 actions for each fault." VALUE 0x8000334D RecordLayout_8 0 CompuMethod_110 0 65535 /end CHARACTERISTIC
/begin CHARACTERISTIC FaultManager.ETCSpringTest.Action_3_Condition "Fault manager configuration.  Select up to 4 actions for each fault." VALUE 0x8000334F RecordLayout_8 0 CompuMethod_111 0 65535 /end CHARACTERISTIC
/begin CHARACTERISTIC FaultManager.ETCSpringTest.Action_4 "Fault manager configuration.  Select up to 4 actions for each fault." VALUE 0x80003351 RecordLayout_8 0 CompuMethod_110 0 65535 /end CHARACTERISTIC
/begin CHARACTERISTIC FaultManager.ETCSpringTest.Action_4_Condition "Fault manager configuration.  Select up to 4 actions for each fault." VALUE 0x80003353 RecordLayout_8 0 CompuMethod_111 0 65535 /end CHARACTERISTIC
/begin CHARACTERISTIC FaultManager.ETC_Open_Fault.Mode "Fault manager configuration.  Select up to 4 actions for each fault." VALUE 0x80003355 RecordLayout_8 0 CompuMethod_108 0 65535 /end CHARACTERISTIC
/begin CHARACTERISTIC FaultManager.ETC_Open_Fault.ID "Fault manager configuration.  Select up to 4 actions for each fault." VALUE 0x80003357 RecordLayout_8 0 CompuMethod_1 0 65535 /end CHARACTERISTIC
/begin CHARACTERISTIC FaultManager.ETC_Open_Fault.Test "Fault manager configuration.  Select up to 4 actions for each fault." VALUE 0x80003359 RecordLayout_8 0 CompuMethod_109 0 65535 /end CHARACTERISTIC
/begin CHARACTERISTIC FaultManager.ETC_Open_Fault.Faulty_Samples__X_ "Fault manager configuration.  Select up to 4 actions for each fault." VALUE 0x8000335B RecordLayout_8 0 CompuMethod_1 0 65535 /end CHARACTERISTIC
/begin CHARACTERISTIC FaultManager.ETC_Open_Fault.Total_Samples__Y_ "Fault manager configuration.  Select up to 4 actions for each fault." VALUE 0x8000335D RecordLayout_8 0 CompuMethod_1 0 65535 /end CHARACTERISTIC
/begin CHARACTERISTIC FaultManager.ETC_Open_Fault.Action_1 "Fault manager configuration.  Select up to 4 actions for each fault." VALUE 0x8000335F RecordLayout_8 0 CompuMethod_110 0 65535 /end CHARACTERISTIC
/begin CHARACTERISTIC FaultManager.ETC_Open_Fault.Action_1_Condition "Fault manager configuration.  Select up to 4 actions for each fault." VALUE 0x80003361 RecordLayout_8 0 CompuMethod_111 0 65535 /end CHARACTERISTIC
/begin CHARACTERISTIC FaultManager.ETC_Open_Fault.Action_2 "Fault manager configuration.  Select up to 4 actions for each fault." VALUE 0x80003363 RecordLayout_8 0 CompuMethod_110 0 65535 /end CHARACTERISTIC
/begin CHARACTERISTIC FaultManager.ETC_Open_Fault.Action_2_Condition "Fault manager configuration.  Select up to 4 actions for each fault." VALUE 0x80003365 RecordLayout_8 0 CompuMethod_111 0 65535 /end CHARACTERISTIC
/begin CHARACTERISTIC FaultManager.ETC_Open_Fault.Action_3 "Fault manager configuration.  Select up to 4 actions for each fault." VALUE 0x80003367 RecordLayout_8 0 CompuMethod_110 0 65535 /end CHARACTERISTIC
/begin CHARACTERISTIC FaultManager.ETC_Open_Fault.Action_3_Condition "Fault manager configuration.  Select up to 4 actions for each fault." VALUE 0x80003369 RecordLayout_8 0 CompuMethod_111 0 65535 /end CHARACTERISTIC
/begin CHARACTERISTIC FaultManager.ETC_Open_Fault.Action_4 "Fault manager configuration.  Select up to 4 actions for each fault." VALUE 0x8000336B RecordLayout_8 0 CompuMethod_110 0 65535 /end CHARACTERISTIC
/begin CHARACTERISTIC FaultManager.ETC_Open_Fault.Action_4_Condition "Fault manager configuration.  Select up to 4 actions for each fault." VALUE 0x8000336D RecordLayout_8 0 CompuMethod_111 0 65535 /end CHARACTERISTIC
/begin CHARACTERISTIC FaultManager.ETC_Sticking.Mode "Fault manager configuration.  Select up to 4 actions for each fault." VALUE 0x8000336F RecordLayout_8 0 CompuMethod_108 0 65535 /end CHARACTERISTIC
/begin CHARACTERISTIC FaultManager.ETC_Sticking.ID "Fault manager configuration.  Select up to 4 actions for each fault." VALUE 0x80003371 RecordLayout_8 0 CompuMethod_1 0 65535 /end CHARACTERISTIC
/begin CHARACTERISTIC FaultManager.ETC_Sticking.Test "Fault manager configuration.  Select up to 4 actions for each fault." VALUE 0x80003373 RecordLayout_8 0 CompuMethod_109 0 65535 /end CHARACTERISTIC
/begin CHARACTERISTIC FaultManager.ETC_Sticking.Faulty_Samples__X_ "Fault manager configuration.  Select up to 4 actions for each fault." VALUE 0x80003375 RecordLayout_8 0 CompuMethod_1 0 65535 /end CHARACTERISTIC
/begin CHARACTERISTIC FaultManager.ETC_Sticking.Total_Samples__Y_ "Fault manager configuration.  Select up to 4 actions for each fault." VALUE 0x80003377 RecordLayout_8 0 CompuMethod_1 0 65535 /end CHARACTERISTIC
/begin CHARACTERISTIC FaultManager.ETC_Sticking.Action_1 "Fault manager configuration.  Select up to 4 actions for each fault." VALUE 0x80003379 RecordLayout_8 0 CompuMethod_110 0 65535 /end CHARACTERISTIC
/begin CHARACTERISTIC FaultManager.ETC_Sticking.Action_1_Condition "Fault manager configuration.  Select up to 4 actions for each fault." VALUE 0x8000337B RecordLayout_8 0 CompuMethod_111 0 65535 /end CHARACTERISTIC
/begin CHARACTERISTIC FaultManager.ETC_Sticking.Action_2 "Fault manager configuration.  Select up to 4 actions for each fault." VALUE 0x8000337D RecordLayout_8 0 CompuMethod_110 0 65535 /end CHARACTERISTIC
/begin CHARACTERISTIC FaultManager.ETC_Sticking.Action_2_Condition "Fault manager configuration.  Select up to 4 actions for each fault." VALUE 0x8000337F RecordLayout_8 0 CompuMethod_111 0 65535 /end CHARACTERISTIC
/begin CHARACTERISTIC FaultManager.ETC_Sticking.Action_3 "Fault manager configuration.  Select up to 4 actions for each fault." VALUE 0x80003381 RecordLayout_8 0 CompuMethod_110 0 65535 /end CHARACTERISTIC
/begin CHARACTERISTIC FaultManager.ETC_Sticking.Action_3_Condition "Fault manager configuration.  Select up to 4 actions for each fault." VALUE 0x80003383 RecordLayout_8 0 CompuMethod_111 0 65535 /end CHARACTERISTIC
/begin CHARACTERISTIC FaultManager.ETC_Sticking.Action_4 "Fault manager configuration.  Select up to 4 actions for each fault." VALUE 0x80003385 RecordLayout_8 0 CompuMethod_110 0 65535 /end CHARACTERISTIC
/begin CHARACTERISTIC FaultManager.ETC_Sticking.Action_4_Condition "Fault manager configuration.  Select up to 4 actions for each fault." VALUE 0x80003387 RecordLayout_8 0 CompuMethod_111 0 65535 /end CHARACTERISTIC
/begin CHARACTERISTIC FaultManager.EVAPRangeHigh.Mode "Fault manager configuration.  Select up to 4 actions for each fault." VALUE 0x80003389 RecordLayout_8 0 CompuMethod_108 0 65535 /end CHARACTERISTIC
/begin CHARACTERISTIC FaultManager.EVAPRangeHigh.ID "Fault manager configuration.  Select up to 4 actions for each fault." VALUE 0x8000338B RecordLayout_8 0 CompuMethod_1 0 65535 /end CHARACTERISTIC
/begin CHARACTERISTIC FaultManager.EVAPRangeHigh.Test "Fault manager configuration.  Select up to 4 actions for each fault." VALUE 0x8000338D RecordLayout_8 0 CompuMethod_109 0 65535 /end CHARACTERISTIC
/begin CHARACTERISTIC FaultManager.EVAPRangeHigh.Faulty_Samples__X_ "Fault manager configuration.  Select up to 4 actions for each fault." VALUE 0x8000338F RecordLayout_8 0 CompuMethod_1 0 65535 /end CHARACTERISTIC
/begin CHARACTERISTIC FaultManager.EVAPRangeHigh.Total_Samples__Y_ "Fault manager configuration.  Select up to 4 actions for each fault." VALUE 0x80003391 RecordLayout_8 0 CompuMethod_1 0 65535 /end CHARACTERISTIC
/begin CHARACTERISTIC FaultManager.EVAPRangeHigh.Action_1 "Fault manager configuration.  Select up to 4 actions for each fault." VALUE 0x80003393 RecordLayout_8 0 CompuMethod_110 0 65535 /end CHARACTERISTIC
/begin CHARACTERISTIC FaultManager.EVAPRangeHigh.Action_1_Condition "Fault manager configuration.  Select up to 4 actions for each fault." VALUE 0x80003395 RecordLayout_8 0 CompuMethod_111 0 65535 /end CHARACTERISTIC
/begin CHARACTERISTIC FaultManager.EVAPRangeHigh.Action_2 "Fault manager configuration.  Select up to 4 actions for each fault." VALUE 0x80003397 RecordLayout_8 0 CompuMethod_110 0 65535 /end CHARACTERISTIC
/begin CHARACTERISTIC FaultManager.EVAPRangeHigh.Action_2_Condition "Fault manager configuration.  Select up to 4 actions for each fault." VALUE 0x80003399 RecordLayout_8 0 CompuMethod_111 0 65535 /end CHARACTERISTIC
/begin CHARACTERISTIC FaultManager.EVAPRangeHigh.Action_3 "Fault manager configuration.  Select up to 4 actions for each fault." VALUE 0x8000339B RecordLayout_8 0 CompuMethod_110 0 65535 /end CHARACTERISTIC
/begin CHARACTERISTIC FaultManager.EVAPRangeHigh.Action_3_Condition "Fault manager configuration.  Select up to 4 actions for each fault." VALUE 0x8000339D RecordLayout_8 0 CompuMethod_111 0 65535 /end CHARACTERISTIC
/begin CHARACTERISTIC FaultManager.EVAPRangeHigh.Action_4 "Fault manager configuration.  Select up to 4 actions for each fault." VALUE 0x8000339F RecordLayout_8 0 CompuMethod_110 0 65535 /end CHARACTERISTIC
/begin CHARACTERISTIC FaultManager.EVAPRangeHigh.Action_4_Condition "Fault manager configuration.  Select up to 4 actions for each fault." VALUE 0x800033A1 RecordLayout_8 0 CompuMethod_111 0 65535 /end CHARACTERISTIC
/begin CHARACTERISTIC FaultManager.EVAPRangeLow.Mode "Fault manager configuration.  Select up to 4 actions for each fault." VALUE 0x800033A3 RecordLayout_8 0 CompuMethod_108 0 65535 /end CHARACTERISTIC
/begin CHARACTERISTIC FaultManager.EVAPRangeLow.ID "Fault manager configuration.  Select up to 4 actions for each fault." VALUE 0x800033A5 RecordLayout_8 0 CompuMethod_1 0 65535 /end CHARACTERISTIC
/begin CHARACTERISTIC FaultManager.EVAPRangeLow.Test "Fault manager configuration.  Select up to 4 actions for each fault." VALUE 0x800033A7 RecordLayout_8 0 CompuMethod_109 0 65535 /end CHARACTERISTIC
/begin CHARACTERISTIC FaultManager.EVAPRangeLow.Faulty_Samples__X_ "Fault manager configuration.  Select up to 4 actions for each fault." VALUE 0x800033A9 RecordLayout_8 0 CompuMethod_1 0 65535 /end CHARACTERISTIC
/begin CHARACTERISTIC FaultManager.EVAPRangeLow.Total_Samples__Y_ "Fault manager configuration.  Select up to 4 actions for each fault." VALUE 0x800033AB RecordLayout_8 0 CompuMethod_1 0 65535 /end CHARACTERISTIC
/begin CHARACTERISTIC FaultManager.EVAPRangeLow.Action_1 "Fault manager configuration.  Select up to 4 actions for each fault." VALUE 0x800033AD RecordLayout_8 0 CompuMethod_110 0 65535 /end CHARACTERISTIC
/begin CHARACTERISTIC FaultManager.EVAPRangeLow.Action_1_Condition "Fault manager configuration.  Select up to 4 actions for each fault." VALUE 0x800033AF RecordLayout_8 0 CompuMethod_111 0 65535 /end CHARACTERISTIC
/begin CHARACTERISTIC FaultManager.EVAPRangeLow.Action_2 "Fault manager configuration.  Select up to 4 actions for each fault." VALUE 0x800033B1 RecordLayout_8 0 CompuMethod_110 0 65535 /end CHARACTERISTIC
/begin CHARACTERISTIC FaultManager.EVAPRangeLow.Action_2_Condition "Fault manager configuration.  Select up to 4 actions for each fault." VALUE 0x800033B3 RecordLayout_8 0 CompuMethod_111 0 65535 /end CHARACTERISTIC
/begin CHARACTERISTIC FaultManager.EVAPRangeLow.Action_3 "Fault manager configuration.  Select up to 4 actions for each fault." VALUE 0x800033B5 RecordLayout_8 0 CompuMethod_110 0 65535 /end CHARACTERISTIC
/begin CHARACTERISTIC FaultManager.EVAPRangeLow.Action_3_Condition "Fault manager configuration.  Select up to 4 actions for each fault." VALUE 0x800033B7 RecordLayout_8 0 CompuMethod_111 0 65535 /end CHARACTERISTIC
/begin CHARACTERISTIC FaultManager.EVAPRangeLow.Action_4 "Fault manager configuration.  Select up to 4 actions for each fault." VALUE 0x800033B9 RecordLayout_8 0 CompuMethod_110 0 65535 /end CHARACTERISTIC
/begin CHARACTERISTIC FaultManager.EVAPRangeLow.Action_4_Condition "Fault manager configuration.  Select up to 4 actions for each fault." VALUE 0x800033BB RecordLayout_8 0 CompuMethod_111 0 65535 /end CHARACTERISTIC
/begin CHARACTERISTIC FaultManager.FuelAdaptRangeHi.Mode "Fault manager configuration.  Select up to 4 actions for each fault." VALUE 0x800033BD RecordLayout_8 0 CompuMethod_108 0 65535 /end CHARACTERISTIC
/begin CHARACTERISTIC FaultManager.FuelAdaptRangeHi.ID "Fault manager configuration.  Select up to 4 actions for each fault." VALUE 0x800033BF RecordLayout_8 0 CompuMethod_1 0 65535 /end CHARACTERISTIC
/begin CHARACTERISTIC FaultManager.FuelAdaptRangeHi.Test "Fault manager configuration.  Select up to 4 actions for each fault." VALUE 0x800033C1 RecordLayout_8 0 CompuMethod_109 0 65535 /end CHARACTERISTIC
/begin CHARACTERISTIC FaultManager.FuelAdaptRangeHi.Faulty_Samples__X_ "Fault manager configuration.  Select up to 4 actions for each fault." VALUE 0x800033C3 RecordLayout_8 0 CompuMethod_1 0 65535 /end CHARACTERISTIC
/begin CHARACTERISTIC FaultManager.FuelAdaptRangeHi.Total_Samples__Y_ "Fault manager configuration.  Select up to 4 actions for each fault." VALUE 0x800033C5 RecordLayout_8 0 CompuMethod_1 0 65535 /end CHARACTERISTIC
/begin CHARACTERISTIC FaultManager.FuelAdaptRangeHi.Action_1 "Fault manager configuration.  Select up to 4 actions for each fault." VALUE 0x800033C7 RecordLayout_8 0 CompuMethod_110 0 65535 /end CHARACTERISTIC
/begin CHARACTERISTIC FaultManager.FuelAdaptRangeHi.Action_1_Condition "Fault manager configuration.  Select up to 4 actions for each fault." VALUE 0x800033C9 RecordLayout_8 0 CompuMethod_111 0 65535 /end CHARACTERISTIC
/begin CHARACTERISTIC FaultManager.FuelAdaptRangeHi.Action_2 "Fault manager configuration.  Select up to 4 actions for each fault." VALUE 0x800033CB RecordLayout_8 0 CompuMethod_110 0 65535 /end CHARACTERISTIC
/begin CHARACTERISTIC FaultManager.FuelAdaptRangeHi.Action_2_Condition "Fault manager configuration.  Select up to 4 actions for each fault." VALUE 0x800033CD RecordLayout_8 0 CompuMethod_111 0 65535 /end CHARACTERISTIC
/begin CHARACTERISTIC FaultManager.FuelAdaptRangeHi.Action_3 "Fault manager configuration.  Select up to 4 actions for each fault." VALUE 0x800033CF RecordLayout_8 0 CompuMethod_110 0 65535 /end CHARACTERISTIC
/begin CHARACTERISTIC FaultManager.FuelAdaptRangeHi.Action_3_Condition "Fault manager configuration.  Select up to 4 actions for each fault." VALUE 0x800033D1 RecordLayout_8 0 CompuMethod_111 0 65535 /end CHARACTERISTIC
/begin CHARACTERISTIC FaultManager.FuelAdaptRangeHi.Action_4 "Fault manager configuration.  Select up to 4 actions for each fault." VALUE 0x800033D3 RecordLayout_8 0 CompuMethod_110 0 65535 /end CHARACTERISTIC
/begin CHARACTERISTIC FaultManager.FuelAdaptRangeHi.Action_4_Condition "Fault manager configuration.  Select up to 4 actions for each fault." VALUE 0x800033D5 RecordLayout_8 0 CompuMethod_111 0 65535 /end CHARACTERISTIC
/begin CHARACTERISTIC FaultManager.FuelAdaptRangeLow.Mode "Fault manager configuration.  Select up to 4 actions for each fault." VALUE 0x800033D7 RecordLayout_8 0 CompuMethod_108 0 65535 /end CHARACTERISTIC
/begin CHARACTERISTIC FaultManager.FuelAdaptRangeLow.ID "Fault manager configuration.  Select up to 4 actions for each fault." VALUE 0x800033D9 RecordLayout_8 0 CompuMethod_1 0 65535 /end CHARACTERISTIC
/begin CHARACTERISTIC FaultManager.FuelAdaptRangeLow.Test "Fault manager configuration.  Select up to 4 actions for each fault." VALUE 0x800033DB RecordLayout_8 0 CompuMethod_109 0 65535 /end CHARACTERISTIC
/begin CHARACTERISTIC FaultManager.FuelAdaptRangeLow.Faulty_Samples__X_ "Fault manager configuration.  Select up to 4 actions for each fault." VALUE 0x800033DD RecordLayout_8 0 CompuMethod_1 0 65535 /end CHARACTERISTIC
/begin CHARACTERISTIC FaultManager.FuelAdaptRangeLow.Total_Samples__Y_ "Fault manager configuration.  Select up to 4 actions for each fault." VALUE 0x800033DF RecordLayout_8 0 CompuMethod_1 0 65535 /end CHARACTERISTIC
/begin CHARACTERISTIC FaultManager.FuelAdaptRangeLow.Action_1 "Fault manager configuration.  Select up to 4 actions for each fault." VALUE 0x800033E1 RecordLayout_8 0 CompuMethod_110 0 65535 /end CHARACTERISTIC
/begin CHARACTERISTIC FaultManager.FuelAdaptRangeLow.Action_1_Condition "Fault manager configuration.  Select up to 4 actions for each fault." VALUE 0x800033E3 RecordLayout_8 0 CompuMethod_111 0 65535 /end CHARACTERISTIC
/begin CHARACTERISTIC FaultManager.FuelAdaptRangeLow.Action_2 "Fault manager configuration.  Select up to 4 actions for each fault." VALUE 0x800033E5 RecordLayout_8 0 CompuMethod_110 0 65535 /end CHARACTERISTIC
/begin CHARACTERISTIC FaultManager.FuelAdaptRangeLow.Action_2_Condition "Fault manager configuration.  Select up to 4 actions for each fault." VALUE 0x800033E7 RecordLayout_8 0 CompuMethod_111 0 65535 /end CHARACTERISTIC
/begin CHARACTERISTIC FaultManager.FuelAdaptRangeLow.Action_3 "Fault manager configuration.  Select up to 4 actions for each fault." VALUE 0x800033E9 RecordLayout_8 0 CompuMethod_110 0 65535 /end CHARACTERISTIC
/begin CHARACTERISTIC FaultManager.FuelAdaptRangeLow.Action_3_Condition "Fault manager configuration.  Select up to 4 actions for each fault." VALUE 0x800033EB RecordLayout_8 0 CompuMethod_111 0 65535 /end CHARACTERISTIC
/begin CHARACTERISTIC FaultManager.FuelAdaptRangeLow.Action_4 "Fault manager configuration.  Select up to 4 actions for each fault." VALUE 0x800033ED RecordLayout_8 0 CompuMethod_110 0 65535 /end CHARACTERISTIC
/begin CHARACTERISTIC FaultManager.FuelAdaptRangeLow.Action_4_Condition "Fault manager configuration.  Select up to 4 actions for each fault." VALUE 0x800033EF RecordLayout_8 0 CompuMethod_111 0 65535 /end CHARACTERISTIC
/begin CHARACTERISTIC FaultManager.FuelPresHigh_Fault.Mode "Fault manager configuration.  Select up to 4 actions for each fault." VALUE 0x800033F1 RecordLayout_8 0 CompuMethod_108 0 65535 /end CHARACTERISTIC
/begin CHARACTERISTIC FaultManager.FuelPresHigh_Fault.ID "Fault manager configuration.  Select up to 4 actions for each fault." VALUE 0x800033F3 RecordLayout_8 0 CompuMethod_1 0 65535 /end CHARACTERISTIC
/begin CHARACTERISTIC FaultManager.FuelPresHigh_Fault.Test "Fault manager configuration.  Select up to 4 actions for each fault." VALUE 0x800033F5 RecordLayout_8 0 CompuMethod_109 0 65535 /end CHARACTERISTIC
/begin CHARACTERISTIC FaultManager.FuelPresHigh_Fault.Faulty_Samples__X_ "Fault manager configuration.  Select up to 4 actions for each fault." VALUE 0x800033F7 RecordLayout_8 0 CompuMethod_1 0 65535 /end CHARACTERISTIC
/begin CHARACTERISTIC FaultManager.FuelPresHigh_Fault.Total_Samples__Y_ "Fault manager configuration.  Select up to 4 actions for each fault." VALUE 0x800033F9 RecordLayout_8 0 CompuMethod_1 0 65535 /end CHARACTERISTIC
/begin CHARACTERISTIC FaultManager.FuelPresHigh_Fault.Action_1 "Fault manager configuration.  Select up to 4 actions for each fault." VALUE 0x800033FB RecordLayout_8 0 CompuMethod_110 0 65535 /end CHARACTERISTIC
/begin CHARACTERISTIC FaultManager.FuelPresHigh_Fault.Action_1_Condition "Fault manager configuration.  Select up to 4 actions for each fault." VALUE 0x800033FD RecordLayout_8 0 CompuMethod_111 0 65535 /end CHARACTERISTIC
/begin CHARACTERISTIC FaultManager.FuelPresHigh_Fault.Action_2 "Fault manager configuration.  Select up to 4 actions for each fault." VALUE 0x800033FF RecordLayout_8 0 CompuMethod_110 0 65535 /end CHARACTERISTIC
/begin CHARACTERISTIC FaultManager.FuelPresHigh_Fault.Action_2_Condition "Fault manager configuration.  Select up to 4 actions for each fault." VALUE 0x80003401 RecordLayout_8 0 CompuMethod_111 0 65535 /end CHARACTERISTIC
/begin CHARACTERISTIC FaultManager.FuelPresHigh_Fault.Action_3 "Fault manager configuration.  Select up to 4 actions for each fault." VALUE 0x80003403 RecordLayout_8 0 CompuMethod_110 0 65535 /end CHARACTERISTIC
/begin CHARACTERISTIC FaultManager.FuelPresHigh_Fault.Action_3_Condition "Fault manager configuration.  Select up to 4 actions for each fault." VALUE 0x80003405 RecordLayout_8 0 CompuMethod_111 0 65535 /end CHARACTERISTIC
/begin CHARACTERISTIC FaultManager.FuelPresHigh_Fault.Action_4 "Fault manager configuration.  Select up to 4 actions for each fault." VALUE 0x80003407 RecordLayout_8 0 CompuMethod_110 0 65535 /end CHARACTERISTIC
/begin CHARACTERISTIC FaultManager.FuelPresHigh_Fault.Action_4_Condition "Fault manager configuration.  Select up to 4 actions for each fault." VALUE 0x80003409 RecordLayout_8 0 CompuMethod_111 0 65535 /end CHARACTERISTIC
/begin CHARACTERISTIC FaultManager.FuelPresLow_Fault.Mode "Fault manager configuration.  Select up to 4 actions for each fault." VALUE 0x8000340B RecordLayout_8 0 CompuMethod_108 0 65535 /end CHARACTERISTIC
/begin CHARACTERISTIC FaultManager.FuelPresLow_Fault.ID "Fault manager configuration.  Select up to 4 actions for each fault." VALUE 0x8000340D RecordLayout_8 0 CompuMethod_1 0 65535 /end CHARACTERISTIC
/begin CHARACTERISTIC FaultManager.FuelPresLow_Fault.Test "Fault manager configuration.  Select up to 4 actions for each fault." VALUE 0x8000340F RecordLayout_8 0 CompuMethod_109 0 65535 /end CHARACTERISTIC
/begin CHARACTERISTIC FaultManager.FuelPresLow_Fault.Faulty_Samples__X_ "Fault manager configuration.  Select up to 4 actions for each fault." VALUE 0x80003411 RecordLayout_8 0 CompuMethod_1 0 65535 /end CHARACTERISTIC
/begin CHARACTERISTIC FaultManager.FuelPresLow_Fault.Total_Samples__Y_ "Fault manager configuration.  Select up to 4 actions for each fault." VALUE 0x80003413 RecordLayout_8 0 CompuMethod_1 0 65535 /end CHARACTERISTIC
/begin CHARACTERISTIC FaultManager.FuelPresLow_Fault.Action_1 "Fault manager configuration.  Select up to 4 actions for each fault." VALUE 0x80003415 RecordLayout_8 0 CompuMethod_110 0 65535 /end CHARACTERISTIC
/begin CHARACTERISTIC FaultManager.FuelPresLow_Fault.Action_1_Condition "Fault manager configuration.  Select up to 4 actions for each fault." VALUE 0x80003417 RecordLayout_8 0 CompuMethod_111 0 65535 /end CHARACTERISTIC
/begin CHARACTERISTIC FaultManager.FuelPresLow_Fault.Action_2 "Fault manager configuration.  Select up to 4 actions for each fault." VALUE 0x80003419 RecordLayout_8 0 CompuMethod_110 0 65535 /end CHARACTERISTIC
/begin CHARACTERISTIC FaultManager.FuelPresLow_Fault.Action_2_Condition "Fault manager configuration.  Select up to 4 actions for each fault." VALUE 0x8000341B RecordLayout_8 0 CompuMethod_111 0 65535 /end CHARACTERISTIC
/begin CHARACTERISTIC FaultManager.FuelPresLow_Fault.Action_3 "Fault manager configuration.  Select up to 4 actions for each fault." VALUE 0x8000341D RecordLayout_8 0 CompuMethod_110 0 65535 /end CHARACTERISTIC
/begin CHARACTERISTIC FaultManager.FuelPresLow_Fault.Action_3_Condition "Fault manager configuration.  Select up to 4 actions for each fault." VALUE 0x8000341F RecordLayout_8 0 CompuMethod_111 0 65535 /end CHARACTERISTIC
/begin CHARACTERISTIC FaultManager.FuelPresLow_Fault.Action_4 "Fault manager configuration.  Select up to 4 actions for each fault." VALUE 0x80003421 RecordLayout_8 0 CompuMethod_110 0 65535 /end CHARACTERISTIC
/begin CHARACTERISTIC FaultManager.FuelPresLow_Fault.Action_4_Condition "Fault manager configuration.  Select up to 4 actions for each fault." VALUE 0x80003423 RecordLayout_8 0 CompuMethod_111 0 65535 /end CHARACTERISTIC
/begin CHARACTERISTIC FaultManager.FuelPresRangeHigh.Mode "Fault manager configuration.  Select up to 4 actions for each fault." VALUE 0x80003425 RecordLayout_8 0 CompuMethod_108 0 65535 /end CHARACTERISTIC
/begin CHARACTERISTIC FaultManager.FuelPresRangeHigh.ID "Fault manager configuration.  Select up to 4 actions for each fault." VALUE 0x80003427 RecordLayout_8 0 CompuMethod_1 0 65535 /end CHARACTERISTIC
/begin CHARACTERISTIC FaultManager.FuelPresRangeHigh.Test "Fault manager configuration.  Select up to 4 actions for each fault." VALUE 0x80003429 RecordLayout_8 0 CompuMethod_109 0 65535 /end CHARACTERISTIC
/begin CHARACTERISTIC FaultManager.FuelPresRangeHigh.Faulty_Samples__X_ "Fault manager configuration.  Select up to 4 actions for each fault." VALUE 0x8000342B RecordLayout_8 0 CompuMethod_1 0 65535 /end CHARACTERISTIC
/begin CHARACTERISTIC FaultManager.FuelPresRangeHigh.Total_Samples__Y_ "Fault manager configuration.  Select up to 4 actions for each fault." VALUE 0x8000342D RecordLayout_8 0 CompuMethod_1 0 65535 /end CHARACTERISTIC
/begin CHARACTERISTIC FaultManager.FuelPresRangeHigh.Action_1 "Fault manager configuration.  Select up to 4 actions for each fault." VALUE 0x8000342F RecordLayout_8 0 CompuMethod_110 0 65535 /end CHARACTERISTIC
/begin CHARACTERISTIC FaultManager.FuelPresRangeHigh.Action_1_Condition "Fault manager configuration.  Select up to 4 actions for each fault." VALUE 0x80003431 RecordLayout_8 0 CompuMethod_111 0 65535 /end CHARACTERISTIC
/begin CHARACTERISTIC FaultManager.FuelPresRangeHigh.Action_2 "Fault manager configuration.  Select up to 4 actions for each fault." VALUE 0x80003433 RecordLayout_8 0 CompuMethod_110 0 65535 /end CHARACTERISTIC
/begin CHARACTERISTIC FaultManager.FuelPresRangeHigh.Action_2_Condition "Fault manager configuration.  Select up to 4 actions for each fault." VALUE 0x80003435 RecordLayout_8 0 CompuMethod_111 0 65535 /end CHARACTERISTIC
/begin CHARACTERISTIC FaultManager.FuelPresRangeHigh.Action_3 "Fault manager configuration.  Select up to 4 actions for each fault." VALUE 0x80003437 RecordLayout_8 0 CompuMethod_110 0 65535 /end CHARACTERISTIC
/begin CHARACTERISTIC FaultManager.FuelPresRangeHigh.Action_3_Condition "Fault manager configuration.  Select up to 4 actions for each fault." VALUE 0x80003439 RecordLayout_8 0 CompuMethod_111 0 65535 /end CHARACTERISTIC
/begin CHARACTERISTIC FaultManager.FuelPresRangeHigh.Action_4 "Fault manager configuration.  Select up to 4 actions for each fault." VALUE 0x8000343B RecordLayout_8 0 CompuMethod_110 0 65535 /end CHARACTERISTIC
/begin CHARACTERISTIC FaultManager.FuelPresRangeHigh.Action_4_Condition "Fault manager configuration.  Select up to 4 actions for each fault." VALUE 0x8000343D RecordLayout_8 0 CompuMethod_111 0 65535 /end CHARACTERISTIC
/begin CHARACTERISTIC FaultManager.FuelPresRangeLow.Mode "Fault manager configuration.  Select up to 4 actions for each fault." VALUE 0x8000343F RecordLayout_8 0 CompuMethod_108 0 65535 /end CHARACTERISTIC
/begin CHARACTERISTIC FaultManager.FuelPresRangeLow.ID "Fault manager configuration.  Select up to 4 actions for each fault." VALUE 0x80003441 RecordLayout_8 0 CompuMethod_1 0 65535 /end CHARACTERISTIC
/begin CHARACTERISTIC FaultManager.FuelPresRangeLow.Test "Fault manager configuration.  Select up to 4 actions for each fault." VALUE 0x80003443 RecordLayout_8 0 CompuMethod_109 0 65535 /end CHARACTERISTIC
/begin CHARACTERISTIC FaultManager.FuelPresRangeLow.Faulty_Samples__X_ "Fault manager configuration.  Select up to 4 actions for each fault." VALUE 0x80003445 RecordLayout_8 0 CompuMethod_1 0 65535 /end CHARACTERISTIC
/begin CHARACTERISTIC FaultManager.FuelPresRangeLow.Total_Samples__Y_ "Fault manager configuration.  Select up to 4 actions for each fault." VALUE 0x80003447 RecordLayout_8 0 CompuMethod_1 0 65535 /end CHARACTERISTIC
/begin CHARACTERISTIC FaultManager.FuelPresRangeLow.Action_1 "Fault manager configuration.  Select up to 4 actions for each fault." VALUE 0x80003449 RecordLayout_8 0 CompuMethod_110 0 65535 /end CHARACTERISTIC
/begin CHARACTERISTIC FaultManager.FuelPresRangeLow.Action_1_Condition "Fault manager configuration.  Select up to 4 actions for each fault." VALUE 0x8000344B RecordLayout_8 0 CompuMethod_111 0 65535 /end CHARACTERISTIC
/begin CHARACTERISTIC FaultManager.FuelPresRangeLow.Action_2 "Fault manager configuration.  Select up to 4 actions for each fault." VALUE 0x8000344D RecordLayout_8 0 CompuMethod_110 0 65535 /end CHARACTERISTIC
/begin CHARACTERISTIC FaultManager.FuelPresRangeLow.Action_2_Condition "Fault manager configuration.  Select up to 4 actions for each fault." VALUE 0x8000344F RecordLayout_8 0 CompuMethod_111 0 65535 /end CHARACTERISTIC
/begin CHARACTERISTIC FaultManager.FuelPresRangeLow.Action_3 "Fault manager configuration.  Select up to 4 actions for each fault." VALUE 0x80003451 RecordLayout_8 0 CompuMethod_110 0 65535 /end CHARACTERISTIC
/begin CHARACTERISTIC FaultManager.FuelPresRangeLow.Action_3_Condition "Fault manager configuration.  Select up to 4 actions for each fault." VALUE 0x80003453 RecordLayout_8 0 CompuMethod_111 0 65535 /end CHARACTERISTIC
/begin CHARACTERISTIC FaultManager.FuelPresRangeLow.Action_4 "Fault manager configuration.  Select up to 4 actions for each fault." VALUE 0x80003455 RecordLayout_8 0 CompuMethod_110 0 65535 /end CHARACTERISTIC
/begin CHARACTERISTIC FaultManager.FuelPresRangeLow.Action_4_Condition "Fault manager configuration.  Select up to 4 actions for each fault." VALUE 0x80003457 RecordLayout_8 0 CompuMethod_111 0 65535 /end CHARACTERISTIC
/begin CHARACTERISTIC FaultManager.FuelSensRangeHigh.Mode "Fault manager configuration.  Select up to 4 actions for each fault." VALUE 0x80003459 RecordLayout_8 0 CompuMethod_108 0 65535 /end CHARACTERISTIC
/begin CHARACTERISTIC FaultManager.FuelSensRangeHigh.ID "Fault manager configuration.  Select up to 4 actions for each fault." VALUE 0x8000345B RecordLayout_8 0 CompuMethod_1 0 65535 /end CHARACTERISTIC
/begin CHARACTERISTIC FaultManager.FuelSensRangeHigh.Test "Fault manager configuration.  Select up to 4 actions for each fault." VALUE 0x8000345D RecordLayout_8 0 CompuMethod_109 0 65535 /end CHARACTERISTIC
/begin CHARACTERISTIC FaultManager.FuelSensRangeHigh.Faulty_Samples__X_ "Fault manager configuration.  Select up to 4 actions for each fault." VALUE 0x8000345F RecordLayout_8 0 CompuMethod_1 0 65535 /end CHARACTERISTIC
/begin CHARACTERISTIC FaultManager.FuelSensRangeHigh.Total_Samples__Y_ "Fault manager configuration.  Select up to 4 actions for each fault." VALUE 0x80003461 RecordLayout_8 0 CompuMethod_1 0 65535 /end CHARACTERISTIC
/begin CHARACTERISTIC FaultManager.FuelSensRangeHigh.Action_1 "Fault manager configuration.  Select up to 4 actions for each fault." VALUE 0x80003463 RecordLayout_8 0 CompuMethod_110 0 65535 /end CHARACTERISTIC
/begin CHARACTERISTIC FaultManager.FuelSensRangeHigh.Action_1_Condition "Fault manager configuration.  Select up to 4 actions for each fault." VALUE 0x80003465 RecordLayout_8 0 CompuMethod_111 0 65535 /end CHARACTERISTIC
/begin CHARACTERISTIC FaultManager.FuelSensRangeHigh.Action_2 "Fault manager configuration.  Select up to 4 actions for each fault." VALUE 0x80003467 RecordLayout_8 0 CompuMethod_110 0 65535 /end CHARACTERISTIC
/begin CHARACTERISTIC FaultManager.FuelSensRangeHigh.Action_2_Condition "Fault manager configuration.  Select up to 4 actions for each fault." VALUE 0x80003469 RecordLayout_8 0 CompuMethod_111 0 65535 /end CHARACTERISTIC
/begin CHARACTERISTIC FaultManager.FuelSensRangeHigh.Action_3 "Fault manager configuration.  Select up to 4 actions for each fault." VALUE 0x8000346B RecordLayout_8 0 CompuMethod_110 0 65535 /end CHARACTERISTIC
/begin CHARACTERISTIC FaultManager.FuelSensRangeHigh.Action_3_Condition "Fault manager configuration.  Select up to 4 actions for each fault." VALUE 0x8000346D RecordLayout_8 0 CompuMethod_111 0 65535 /end CHARACTERISTIC
/begin CHARACTERISTIC FaultManager.FuelSensRangeHigh.Action_4 "Fault manager configuration.  Select up to 4 actions for each fault." VALUE 0x8000346F RecordLayout_8 0 CompuMethod_110 0 65535 /end CHARACTERISTIC
/begin CHARACTERISTIC FaultManager.FuelSensRangeHigh.Action_4_Condition "Fault manager configuration.  Select up to 4 actions for each fault." VALUE 0x80003471 RecordLayout_8 0 CompuMethod_111 0 65535 /end CHARACTERISTIC
/begin CHARACTERISTIC FaultManager.FuelSensRangeLow.Mode "Fault manager configuration.  Select up to 4 actions for each fault." VALUE 0x80003473 RecordLayout_8 0 CompuMethod_108 0 65535 /end CHARACTERISTIC
/begin CHARACTERISTIC FaultManager.FuelSensRangeLow.ID "Fault manager configuration.  Select up to 4 actions for each fault." VALUE 0x80003475 RecordLayout_8 0 CompuMethod_1 0 65535 /end CHARACTERISTIC
/begin CHARACTERISTIC FaultManager.FuelSensRangeLow.Test "Fault manager configuration.  Select up to 4 actions for each fault." VALUE 0x80003477 RecordLayout_8 0 CompuMethod_109 0 65535 /end CHARACTERISTIC
/begin CHARACTERISTIC FaultManager.FuelSensRangeLow.Faulty_Samples__X_ "Fault manager configuration.  Select up to 4 actions for each fault." VALUE 0x80003479 RecordLayout_8 0 CompuMethod_1 0 65535 /end CHARACTERISTIC
/begin CHARACTERISTIC FaultManager.FuelSensRangeLow.Total_Samples__Y_ "Fault manager configuration.  Select up to 4 actions for each fault." VALUE 0x8000347B RecordLayout_8 0 CompuMethod_1 0 65535 /end CHARACTERISTIC
/begin CHARACTERISTIC FaultManager.FuelSensRangeLow.Action_1 "Fault manager configuration.  Select up to 4 actions for each fault." VALUE 0x8000347D RecordLayout_8 0 CompuMethod_110 0 65535 /end CHARACTERISTIC
/begin CHARACTERISTIC FaultManager.FuelSensRangeLow.Action_1_Condition "Fault manager configuration.  Select up to 4 actions for each fault." VALUE 0x8000347F RecordLayout_8 0 CompuMethod_111 0 65535 /end CHARACTERISTIC
/begin CHARACTERISTIC FaultManager.FuelSensRangeLow.Action_2 "Fault manager configuration.  Select up to 4 actions for each fault." VALUE 0x80003481 RecordLayout_8 0 CompuMethod_110 0 65535 /end CHARACTERISTIC
/begin CHARACTERISTIC FaultManager.FuelSensRangeLow.Action_2_Condition "Fault manager configuration.  Select up to 4 actions for each fault." VALUE 0x80003483 RecordLayout_8 0 CompuMethod_111 0 65535 /end CHARACTERISTIC
/begin CHARACTERISTIC FaultManager.FuelSensRangeLow.Action_3 "Fault manager configuration.  Select up to 4 actions for each fault." VALUE 0x80003485 RecordLayout_8 0 CompuMethod_110 0 65535 /end CHARACTERISTIC
/begin CHARACTERISTIC FaultManager.FuelSensRangeLow.Action_3_Condition "Fault manager configuration.  Select up to 4 actions for each fault." VALUE 0x80003487 RecordLayout_8 0 CompuMethod_111 0 65535 /end CHARACTERISTIC
/begin CHARACTERISTIC FaultManager.FuelSensRangeLow.Action_4 "Fault manager configuration.  Select up to 4 actions for each fault." VALUE 0x80003489 RecordLayout_8 0 CompuMethod_110 0 65535 /end CHARACTERISTIC
/begin CHARACTERISTIC FaultManager.FuelSensRangeLow.Action_4_Condition "Fault manager configuration.  Select up to 4 actions for each fault." VALUE 0x8000348B RecordLayout_8 0 CompuMethod_111 0 65535 /end CHARACTERISTIC
/begin CHARACTERISTIC FaultManager.HardOverBoost_Fault.Mode "Fault manager configuration.  Select up to 4 actions for each fault." VALUE 0x8000348D RecordLayout_8 0 CompuMethod_108 0 65535 /end CHARACTERISTIC
/begin CHARACTERISTIC FaultManager.HardOverBoost_Fault.ID "Fault manager configuration.  Select up to 4 actions for each fault." VALUE 0x8000348F RecordLayout_8 0 CompuMethod_1 0 65535 /end CHARACTERISTIC
/begin CHARACTERISTIC FaultManager.HardOverBoost_Fault.Test "Fault manager configuration.  Select up to 4 actions for each fault." VALUE 0x80003491 RecordLayout_8 0 CompuMethod_109 0 65535 /end CHARACTERISTIC
/begin CHARACTERISTIC FaultManager.HardOverBoost_Fault.Faulty_Samples__X_ "Fault manager configuration.  Select up to 4 actions for each fault." VALUE 0x80003493 RecordLayout_8 0 CompuMethod_1 0 65535 /end CHARACTERISTIC
/begin CHARACTERISTIC FaultManager.HardOverBoost_Fault.Total_Samples__Y_ "Fault manager configuration.  Select up to 4 actions for each fault." VALUE 0x80003495 RecordLayout_8 0 CompuMethod_1 0 65535 /end CHARACTERISTIC
/begin CHARACTERISTIC FaultManager.HardOverBoost_Fault.Action_1 "Fault manager configuration.  Select up to 4 actions for each fault." VALUE 0x80003497 RecordLayout_8 0 CompuMethod_110 0 65535 /end CHARACTERISTIC
/begin CHARACTERISTIC FaultManager.HardOverBoost_Fault.Action_1_Condition "Fault manager configuration.  Select up to 4 actions for each fault." VALUE 0x80003499 RecordLayout_8 0 CompuMethod_111 0 65535 /end CHARACTERISTIC
/begin CHARACTERISTIC FaultManager.HardOverBoost_Fault.Action_2 "Fault manager configuration.  Select up to 4 actions for each fault." VALUE 0x8000349B RecordLayout_8 0 CompuMethod_110 0 65535 /end CHARACTERISTIC
/begin CHARACTERISTIC FaultManager.HardOverBoost_Fault.Action_2_Condition "Fault manager configuration.  Select up to 4 actions for each fault." VALUE 0x8000349D RecordLayout_8 0 CompuMethod_111 0 65535 /end CHARACTERISTIC
/begin CHARACTERISTIC FaultManager.HardOverBoost_Fault.Action_3 "Fault manager configuration.  Select up to 4 actions for each fault." VALUE 0x8000349F RecordLayout_8 0 CompuMethod_110 0 65535 /end CHARACTERISTIC
/begin CHARACTERISTIC FaultManager.HardOverBoost_Fault.Action_3_Condition "Fault manager configuration.  Select up to 4 actions for each fault." VALUE 0x800034A1 RecordLayout_8 0 CompuMethod_111 0 65535 /end CHARACTERISTIC
/begin CHARACTERISTIC FaultManager.HardOverBoost_Fault.Action_4 "Fault manager configuration.  Select up to 4 actions for each fault." VALUE 0x800034A3 RecordLayout_8 0 CompuMethod_110 0 65535 /end CHARACTERISTIC
/begin CHARACTERISTIC FaultManager.HardOverBoost_Fault.Action_4_Condition "Fault manager configuration.  Select up to 4 actions for each fault." VALUE 0x800034A5 RecordLayout_8 0 CompuMethod_111 0 65535 /end CHARACTERISTIC
/begin CHARACTERISTIC FaultManager.HardOverspeed.Mode "Fault manager configuration.  Select up to 4 actions for each fault." VALUE 0x800034A7 RecordLayout_8 0 CompuMethod_108 0 65535 /end CHARACTERISTIC
/begin CHARACTERISTIC FaultManager.HardOverspeed.ID "Fault manager configuration.  Select up to 4 actions for each fault." VALUE 0x800034A9 RecordLayout_8 0 CompuMethod_1 0 65535 /end CHARACTERISTIC
/begin CHARACTERISTIC FaultManager.HardOverspeed.Test "Fault manager configuration.  Select up to 4 actions for each fault." VALUE 0x800034AB RecordLayout_8 0 CompuMethod_109 0 65535 /end CHARACTERISTIC
/begin CHARACTERISTIC FaultManager.HardOverspeed.Faulty_Samples__X_ "Fault manager configuration.  Select up to 4 actions for each fault." VALUE 0x800034AD RecordLayout_8 0 CompuMethod_1 0 65535 /end CHARACTERISTIC
/begin CHARACTERISTIC FaultManager.HardOverspeed.Total_Samples__Y_ "Fault manager configuration.  Select up to 4 actions for each fault." VALUE 0x800034AF RecordLayout_8 0 CompuMethod_1 0 65535 /end CHARACTERISTIC
/begin CHARACTERISTIC FaultManager.HardOverspeed.Action_1 "Fault manager configuration.  Select up to 4 actions for each fault." VALUE 0x800034B1 RecordLayout_8 0 CompuMethod_110 0 65535 /end CHARACTERISTIC
/begin CHARACTERISTIC FaultManager.HardOverspeed.Action_1_Condition "Fault manager configuration.  Select up to 4 actions for each fault." VALUE 0x800034B3 RecordLayout_8 0 CompuMethod_111 0 65535 /end CHARACTERISTIC
/begin CHARACTERISTIC FaultManager.HardOverspeed.Action_2 "Fault manager configuration.  Select up to 4 actions for each fault." VALUE 0x800034B5 RecordLayout_8 0 CompuMethod_110 0 65535 /end CHARACTERISTIC
/begin CHARACTERISTIC FaultManager.HardOverspeed.Action_2_Condition "Fault manager configuration.  Select up to 4 actions for each fault." VALUE 0x800034B7 RecordLayout_8 0 CompuMethod_111 0 65535 /end CHARACTERISTIC
/begin CHARACTERISTIC FaultManager.HardOverspeed.Action_3 "Fault manager configuration.  Select up to 4 actions for each fault." VALUE 0x800034B9 RecordLayout_8 0 CompuMethod_110 0 65535 /end CHARACTERISTIC
/begin CHARACTERISTIC FaultManager.HardOverspeed.Action_3_Condition "Fault manager configuration.  Select up to 4 actions for each fault." VALUE 0x800034BB RecordLayout_8 0 CompuMethod_111 0 65535 /end CHARACTERISTIC
/begin CHARACTERISTIC FaultManager.HardOverspeed.Action_4 "Fault manager configuration.  Select up to 4 actions for each fault." VALUE 0x800034BD RecordLayout_8 0 CompuMethod_110 0 65535 /end CHARACTERISTIC
/begin CHARACTERISTIC FaultManager.HardOverspeed.Action_4_Condition "Fault manager configuration.  Select up to 4 actions for each fault." VALUE 0x800034BF RecordLayout_8 0 CompuMethod_111 0 65535 /end CHARACTERISTIC
/begin CHARACTERISTIC FaultManager.IATRangeHigh.Mode "Fault manager configuration.  Select up to 4 actions for each fault." VALUE 0x800034C1 RecordLayout_8 0 CompuMethod_108 0 65535 /end CHARACTERISTIC
/begin CHARACTERISTIC FaultManager.IATRangeHigh.ID "Fault manager configuration.  Select up to 4 actions for each fault." VALUE 0x800034C3 RecordLayout_8 0 CompuMethod_1 0 65535 /end CHARACTERISTIC
/begin CHARACTERISTIC FaultManager.IATRangeHigh.Test "Fault manager configuration.  Select up to 4 actions for each fault." VALUE 0x800034C5 RecordLayout_8 0 CompuMethod_109 0 65535 /end CHARACTERISTIC
/begin CHARACTERISTIC FaultManager.IATRangeHigh.Faulty_Samples__X_ "Fault manager configuration.  Select up to 4 actions for each fault." VALUE 0x800034C7 RecordLayout_8 0 CompuMethod_1 0 65535 /end CHARACTERISTIC
/begin CHARACTERISTIC FaultManager.IATRangeHigh.Total_Samples__Y_ "Fault manager configuration.  Select up to 4 actions for each fault." VALUE 0x800034C9 RecordLayout_8 0 CompuMethod_1 0 65535 /end CHARACTERISTIC
/begin CHARACTERISTIC FaultManager.IATRangeHigh.Action_1 "Fault manager configuration.  Select up to 4 actions for each fault." VALUE 0x800034CB RecordLayout_8 0 CompuMethod_110 0 65535 /end CHARACTERISTIC
/begin CHARACTERISTIC FaultManager.IATRangeHigh.Action_1_Condition "Fault manager configuration.  Select up to 4 actions for each fault." VALUE 0x800034CD RecordLayout_8 0 CompuMethod_111 0 65535 /end CHARACTERISTIC
/begin CHARACTERISTIC FaultManager.IATRangeHigh.Action_2 "Fault manager configuration.  Select up to 4 actions for each fault." VALUE 0x800034CF RecordLayout_8 0 CompuMethod_110 0 65535 /end CHARACTERISTIC
/begin CHARACTERISTIC FaultManager.IATRangeHigh.Action_2_Condition "Fault manager configuration.  Select up to 4 actions for each fault." VALUE 0x800034D1 RecordLayout_8 0 CompuMethod_111 0 65535 /end CHARACTERISTIC
/begin CHARACTERISTIC FaultManager.IATRangeHigh.Action_3 "Fault manager configuration.  Select up to 4 actions for each fault." VALUE 0x800034D3 RecordLayout_8 0 CompuMethod_110 0 65535 /end CHARACTERISTIC
/begin CHARACTERISTIC FaultManager.IATRangeHigh.Action_3_Condition "Fault manager configuration.  Select up to 4 actions for each fault." VALUE 0x800034D5 RecordLayout_8 0 CompuMethod_111 0 65535 /end CHARACTERISTIC
/begin CHARACTERISTIC FaultManager.IATRangeHigh.Action_4 "Fault manager configuration.  Select up to 4 actions for each fault." VALUE 0x800034D7 RecordLayout_8 0 CompuMethod_110 0 65535 /end CHARACTERISTIC
/begin CHARACTERISTIC FaultManager.IATRangeHigh.Action_4_Condition "Fault manager configuration.  Select up to 4 actions for each fault." VALUE 0x800034D9 RecordLayout_8 0 CompuMethod_111 0 65535 /end CHARACTERISTIC
/begin CHARACTERISTIC FaultManager.IATRangeLow.Mode "Fault manager configuration.  Select up to 4 actions for each fault." VALUE 0x800034DB RecordLayout_8 0 CompuMethod_108 0 65535 /end CHARACTERISTIC
/begin CHARACTERISTIC FaultManager.IATRangeLow.ID "Fault manager configuration.  Select up to 4 actions for each fault." VALUE 0x800034DD RecordLayout_8 0 CompuMethod_1 0 65535 /end CHARACTERISTIC
/begin CHARACTERISTIC FaultManager.IATRangeLow.Test "Fault manager configuration.  Select up to 4 actions for each fault." VALUE 0x800034DF RecordLayout_8 0 CompuMethod_109 0 65535 /end CHARACTERISTIC
/begin CHARACTERISTIC FaultManager.IATRangeLow.Faulty_Samples__X_ "Fault manager configuration.  Select up to 4 actions for each fault." VALUE 0x800034E1 RecordLayout_8 0 CompuMethod_1 0 65535 /end CHARACTERISTIC
/begin CHARACTERISTIC FaultManager.IATRangeLow.Total_Samples__Y_ "Fault manager configuration.  Select up to 4 actions for each fault." VALUE 0x800034E3 RecordLayout_8 0 CompuMethod_1 0 65535 /end CHARACTERISTIC
/begin CHARACTERISTIC FaultManager.IATRangeLow.Action_1 "Fault manager configuration.  Select up to 4 actions for each fault." VALUE 0x800034E5 RecordLayout_8 0 CompuMethod_110 0 65535 /end CHARACTERISTIC
/begin CHARACTERISTIC FaultManager.IATRangeLow.Action_1_Condition "Fault manager configuration.  Select up to 4 actions for each fault." VALUE 0x800034E7 RecordLayout_8 0 CompuMethod_111 0 65535 /end CHARACTERISTIC
/begin CHARACTERISTIC FaultManager.IATRangeLow.Action_2 "Fault manager configuration.  Select up to 4 actions for each fault." VALUE 0x800034E9 RecordLayout_8 0 CompuMethod_110 0 65535 /end CHARACTERISTIC
/begin CHARACTERISTIC FaultManager.IATRangeLow.Action_2_Condition "Fault manager configuration.  Select up to 4 actions for each fault." VALUE 0x800034EB RecordLayout_8 0 CompuMethod_111 0 65535 /end CHARACTERISTIC
/begin CHARACTERISTIC FaultManager.IATRangeLow.Action_3 "Fault manager configuration.  Select up to 4 actions for each fault." VALUE 0x800034ED RecordLayout_8 0 CompuMethod_110 0 65535 /end CHARACTERISTIC
/begin CHARACTERISTIC FaultManager.IATRangeLow.Action_3_Condition "Fault manager configuration.  Select up to 4 actions for each fault." VALUE 0x800034EF RecordLayout_8 0 CompuMethod_111 0 65535 /end CHARACTERISTIC
/begin CHARACTERISTIC FaultManager.IATRangeLow.Action_4 "Fault manager configuration.  Select up to 4 actions for each fault." VALUE 0x800034F1 RecordLayout_8 0 CompuMethod_110 0 65535 /end CHARACTERISTIC
/begin CHARACTERISTIC FaultManager.IATRangeLow.Action_4_Condition "Fault manager configuration.  Select up to 4 actions for each fault." VALUE 0x800034F3 RecordLayout_8 0 CompuMethod_111 0 65535 /end CHARACTERISTIC
/begin CHARACTERISTIC FaultManager.Inj1Open.Mode "Fault manager configuration.  Select up to 4 actions for each fault." VALUE 0x800034F5 RecordLayout_8 0 CompuMethod_108 0 65535 /end CHARACTERISTIC
/begin CHARACTERISTIC FaultManager.Inj1Open.ID "Fault manager configuration.  Select up to 4 actions for each fault." VALUE 0x800034F7 RecordLayout_8 0 CompuMethod_1 0 65535 /end CHARACTERISTIC
/begin CHARACTERISTIC FaultManager.Inj1Open.Test "Fault manager configuration.  Select up to 4 actions for each fault." VALUE 0x800034F9 RecordLayout_8 0 CompuMethod_109 0 65535 /end CHARACTERISTIC
/begin CHARACTERISTIC FaultManager.Inj1Open.Faulty_Samples__X_ "Fault manager configuration.  Select up to 4 actions for each fault." VALUE 0x800034FB RecordLayout_8 0 CompuMethod_1 0 65535 /end CHARACTERISTIC
/begin CHARACTERISTIC FaultManager.Inj1Open.Total_Samples__Y_ "Fault manager configuration.  Select up to 4 actions for each fault." VALUE 0x800034FD RecordLayout_8 0 CompuMethod_1 0 65535 /end CHARACTERISTIC
/begin CHARACTERISTIC FaultManager.Inj1Open.Action_1 "Fault manager configuration.  Select up to 4 actions for each fault." VALUE 0x800034FF RecordLayout_8 0 CompuMethod_110 0 65535 /end CHARACTERISTIC
/begin CHARACTERISTIC FaultManager.Inj1Open.Action_1_Condition "Fault manager configuration.  Select up to 4 actions for each fault." VALUE 0x80003501 RecordLayout_8 0 CompuMethod_111 0 65535 /end CHARACTERISTIC
/begin CHARACTERISTIC FaultManager.Inj1Open.Action_2 "Fault manager configuration.  Select up to 4 actions for each fault." VALUE 0x80003503 RecordLayout_8 0 CompuMethod_110 0 65535 /end CHARACTERISTIC
/begin CHARACTERISTIC FaultManager.Inj1Open.Action_2_Condition "Fault manager configuration.  Select up to 4 actions for each fault." VALUE 0x80003505 RecordLayout_8 0 CompuMethod_111 0 65535 /end CHARACTERISTIC
/begin CHARACTERISTIC FaultManager.Inj1Open.Action_3 "Fault manager configuration.  Select up to 4 actions for each fault." VALUE 0x80003507 RecordLayout_8 0 CompuMethod_110 0 65535 /end CHARACTERISTIC
/begin CHARACTERISTIC FaultManager.Inj1Open.Action_3_Condition "Fault manager configuration.  Select up to 4 actions for each fault." VALUE 0x80003509 RecordLayout_8 0 CompuMethod_111 0 65535 /end CHARACTERISTIC
/begin CHARACTERISTIC FaultManager.Inj1Open.Action_4 "Fault manager configuration.  Select up to 4 actions for each fault." VALUE 0x8000350B RecordLayout_8 0 CompuMethod_110 0 65535 /end CHARACTERISTIC
/begin CHARACTERISTIC FaultManager.Inj1Open.Action_4_Condition "Fault manager configuration.  Select up to 4 actions for each fault." VALUE 0x8000350D RecordLayout_8 0 CompuMethod_111 0 65535 /end CHARACTERISTIC
/begin CHARACTERISTIC FaultManager.Inj2Open.Mode "Fault manager configuration.  Select up to 4 actions for each fault." VALUE 0x8000350F RecordLayout_8 0 CompuMethod_108 0 65535 /end CHARACTERISTIC
/begin CHARACTERISTIC FaultManager.Inj2Open.ID "Fault manager configuration.  Select up to 4 actions for each fault." VALUE 0x80003511 RecordLayout_8 0 CompuMethod_1 0 65535 /end CHARACTERISTIC
/begin CHARACTERISTIC FaultManager.Inj2Open.Test "Fault manager configuration.  Select up to 4 actions for each fault." VALUE 0x80003513 RecordLayout_8 0 CompuMethod_109 0 65535 /end CHARACTERISTIC
/begin CHARACTERISTIC FaultManager.Inj2Open.Faulty_Samples__X_ "Fault manager configuration.  Select up to 4 actions for each fault." VALUE 0x80003515 RecordLayout_8 0 CompuMethod_1 0 65535 /end CHARACTERISTIC
/begin CHARACTERISTIC FaultManager.Inj2Open.Total_Samples__Y_ "Fault manager configuration.  Select up to 4 actions for each fault." VALUE 0x80003517 RecordLayout_8 0 CompuMethod_1 0 65535 /end CHARACTERISTIC
/begin CHARACTERISTIC FaultManager.Inj2Open.Action_1 "Fault manager configuration.  Select up to 4 actions for each fault." VALUE 0x80003519 RecordLayout_8 0 CompuMethod_110 0 65535 /end CHARACTERISTIC
/begin CHARACTERISTIC FaultManager.Inj2Open.Action_1_Condition "Fault manager configuration.  Select up to 4 actions for each fault." VALUE 0x8000351B RecordLayout_8 0 CompuMethod_111 0 65535 /end CHARACTERISTIC
/begin CHARACTERISTIC FaultManager.Inj2Open.Action_2 "Fault manager configuration.  Select up to 4 actions for each fault." VALUE 0x8000351D RecordLayout_8 0 CompuMethod_110 0 65535 /end CHARACTERISTIC
/begin CHARACTERISTIC FaultManager.Inj2Open.Action_2_Condition "Fault manager configuration.  Select up to 4 actions for each fault." VALUE 0x8000351F RecordLayout_8 0 CompuMethod_111 0 65535 /end CHARACTERISTIC
/begin CHARACTERISTIC FaultManager.Inj2Open.Action_3 "Fault manager configuration.  Select up to 4 actions for each fault." VALUE 0x80003521 RecordLayout_8 0 CompuMethod_110 0 65535 /end CHARACTERISTIC
/begin CHARACTERISTIC FaultManager.Inj2Open.Action_3_Condition "Fault manager configuration.  Select up to 4 actions for each fault." VALUE 0x80003523 RecordLayout_8 0 CompuMethod_111 0 65535 /end CHARACTERISTIC
/begin CHARACTERISTIC FaultManager.Inj2Open.Action_4 "Fault manager configuration.  Select up to 4 actions for each fault." VALUE 0x80003525 RecordLayout_8 0 CompuMethod_110 0 65535 /end CHARACTERISTIC
/begin CHARACTERISTIC FaultManager.Inj2Open.Action_4_Condition "Fault manager configuration.  Select up to 4 actions for each fault." VALUE 0x80003527 RecordLayout_8 0 CompuMethod_111 0 65535 /end CHARACTERISTIC
/begin CHARACTERISTIC FaultManager.Inj3Open.Mode "Fault manager configuration.  Select up to 4 actions for each fault." VALUE 0x80003529 RecordLayout_8 0 CompuMethod_108 0 65535 /end CHARACTERISTIC
/begin CHARACTERISTIC FaultManager.Inj3Open.ID "Fault manager configuration.  Select up to 4 actions for each fault." VALUE 0x8000352B RecordLayout_8 0 CompuMethod_1 0 65535 /end CHARACTERISTIC
/begin CHARACTERISTIC FaultManager.Inj3Open.Test "Fault manager configuration.  Select up to 4 actions for each fault." VALUE 0x8000352D RecordLayout_8 0 CompuMethod_109 0 65535 /end CHARACTERISTIC
/begin CHARACTERISTIC FaultManager.Inj3Open.Faulty_Samples__X_ "Fault manager configuration.  Select up to 4 actions for each fault." VALUE 0x8000352F RecordLayout_8 0 CompuMethod_1 0 65535 /end CHARACTERISTIC
/begin CHARACTERISTIC FaultManager.Inj3Open.Total_Samples__Y_ "Fault manager configuration.  Select up to 4 actions for each fault." VALUE 0x80003531 RecordLayout_8 0 CompuMethod_1 0 65535 /end CHARACTERISTIC
/begin CHARACTERISTIC FaultManager.Inj3Open.Action_1 "Fault manager configuration.  Select up to 4 actions for each fault." VALUE 0x80003533 RecordLayout_8 0 CompuMethod_110 0 65535 /end CHARACTERISTIC
/begin CHARACTERISTIC FaultManager.Inj3Open.Action_1_Condition "Fault manager configuration.  Select up to 4 actions for each fault." VALUE 0x80003535 RecordLayout_8 0 CompuMethod_111 0 65535 /end CHARACTERISTIC
/begin CHARACTERISTIC FaultManager.Inj3Open.Action_2 "Fault manager configuration.  Select up to 4 actions for each fault." VALUE 0x80003537 RecordLayout_8 0 CompuMethod_110 0 65535 /end CHARACTERISTIC
/begin CHARACTERISTIC FaultManager.Inj3Open.Action_2_Condition "Fault manager configuration.  Select up to 4 actions for each fault." VALUE 0x80003539 RecordLayout_8 0 CompuMethod_111 0 65535 /end CHARACTERISTIC
/begin CHARACTERISTIC FaultManager.Inj3Open.Action_3 "Fault manager configuration.  Select up to 4 actions for each fault." VALUE 0x8000353B RecordLayout_8 0 CompuMethod_110 0 65535 /end CHARACTERISTIC
/begin CHARACTERISTIC FaultManager.Inj3Open.Action_3_Condition "Fault manager configuration.  Select up to 4 actions for each fault." VALUE 0x8000353D RecordLayout_8 0 CompuMethod_111 0 65535 /end CHARACTERISTIC
/begin CHARACTERISTIC FaultManager.Inj3Open.Action_4 "Fault manager configuration.  Select up to 4 actions for each fault." VALUE 0x8000353F RecordLayout_8 0 CompuMethod_110 0 65535 /end CHARACTERISTIC
/begin CHARACTERISTIC FaultManager.Inj3Open.Action_4_Condition "Fault manager configuration.  Select up to 4 actions for each fault." VALUE 0x80003541 RecordLayout_8 0 CompuMethod_111 0 65535 /end CHARACTERISTIC
/begin CHARACTERISTIC FaultManager.Inj4Open.Mode "Fault manager configuration.  Select up to 4 actions for each fault." VALUE 0x80003543 RecordLayout_8 0 CompuMethod_108 0 65535 /end CHARACTERISTIC
/begin CHARACTERISTIC FaultManager.Inj4Open.ID "Fault manager configuration.  Select up to 4 actions for each fault." VALUE 0x80003545 RecordLayout_8 0 CompuMethod_1 0 65535 /end CHARACTERISTIC
/begin CHARACTERISTIC FaultManager.Inj4Open.Test "Fault manager configuration.  Select up to 4 actions for each fault." VALUE 0x80003547 RecordLayout_8 0 CompuMethod_109 0 65535 /end CHARACTERISTIC
/begin CHARACTERISTIC FaultManager.Inj4Open.Faulty_Samples__X_ "Fault manager configuration.  Select up to 4 actions for each fault." VALUE 0x80003549 RecordLayout_8 0 CompuMethod_1 0 65535 /end CHARACTERISTIC
/begin CHARACTERISTIC FaultManager.Inj4Open.Total_Samples__Y_ "Fault manager configuration.  Select up to 4 actions for each fault." VALUE 0x8000354B RecordLayout_8 0 CompuMethod_1 0 65535 /end CHARACTERISTIC
/begin CHARACTERISTIC FaultManager.Inj4Open.Action_1 "Fault manager configuration.  Select up to 4 actions for each fault." VALUE 0x8000354D RecordLayout_8 0 CompuMethod_110 0 65535 /end CHARACTERISTIC
/begin CHARACTERISTIC FaultManager.Inj4Open.Action_1_Condition "Fault manager configuration.  Select up to 4 actions for each fault." VALUE 0x8000354F RecordLayout_8 0 CompuMethod_111 0 65535 /end CHARACTERISTIC
/begin CHARACTERISTIC FaultManager.Inj4Open.Action_2 "Fault manager configuration.  Select up to 4 actions for each fault." VALUE 0x80003551 RecordLayout_8 0 CompuMethod_110 0 65535 /end CHARACTERISTIC
/begin CHARACTERISTIC FaultManager.Inj4Open.Action_2_Condition "Fault manager configuration.  Select up to 4 actions for each fault." VALUE 0x80003553 RecordLayout_8 0 CompuMethod_111 0 65535 /end CHARACTERISTIC
/begin CHARACTERISTIC FaultManager.Inj4Open.Action_3 "Fault manager configuration.  Select up to 4 actions for each fault." VALUE 0x80003555 RecordLayout_8 0 CompuMethod_110 0 65535 /end CHARACTERISTIC
/begin CHARACTERISTIC FaultManager.Inj4Open.Action_3_Condition "Fault manager configuration.  Select up to 4 actions for each fault." VALUE 0x80003557 RecordLayout_8 0 CompuMethod_111 0 65535 /end CHARACTERISTIC
/begin CHARACTERISTIC FaultManager.Inj4Open.Action_4 "Fault manager configuration.  Select up to 4 actions for each fault." VALUE 0x80003559 RecordLayout_8 0 CompuMethod_110 0 65535 /end CHARACTERISTIC
/begin CHARACTERISTIC FaultManager.Inj4Open.Action_4_Condition "Fault manager configuration.  Select up to 4 actions for each fault." VALUE 0x8000355B RecordLayout_8 0 CompuMethod_111 0 65535 /end CHARACTERISTIC
/begin CHARACTERISTIC FaultManager.Inj5Open.Mode "Fault manager configuration.  Select up to 4 actions for each fault." VALUE 0x8000355D RecordLayout_8 0 CompuMethod_108 0 65535 /end CHARACTERISTIC
/begin CHARACTERISTIC FaultManager.Inj5Open.ID "Fault manager configuration.  Select up to 4 actions for each fault." VALUE 0x8000355F RecordLayout_8 0 CompuMethod_1 0 65535 /end CHARACTERISTIC
/begin CHARACTERISTIC FaultManager.Inj5Open.Test "Fault manager configuration.  Select up to 4 actions for each fault." VALUE 0x80003561 RecordLayout_8 0 CompuMethod_109 0 65535 /end CHARACTERISTIC
/begin CHARACTERISTIC FaultManager.Inj5Open.Faulty_Samples__X_ "Fault manager configuration.  Select up to 4 actions for each fault." VALUE 0x80003563 RecordLayout_8 0 CompuMethod_1 0 65535 /end CHARACTERISTIC
/begin CHARACTERISTIC FaultManager.Inj5Open.Total_Samples__Y_ "Fault manager configuration.  Select up to 4 actions for each fault." VALUE 0x80003565 RecordLayout_8 0 CompuMethod_1 0 65535 /end CHARACTERISTIC
/begin CHARACTERISTIC FaultManager.Inj5Open.Action_1 "Fault manager configuration.  Select up to 4 actions for each fault." VALUE 0x80003567 RecordLayout_8 0 CompuMethod_110 0 65535 /end CHARACTERISTIC
/begin CHARACTERISTIC FaultManager.Inj5Open.Action_1_Condition "Fault manager configuration.  Select up to 4 actions for each fault." VALUE 0x80003569 RecordLayout_8 0 CompuMethod_111 0 65535 /end CHARACTERISTIC
/begin CHARACTERISTIC FaultManager.Inj5Open.Action_2 "Fault manager configuration.  Select up to 4 actions for each fault." VALUE 0x8000356B RecordLayout_8 0 CompuMethod_110 0 65535 /end CHARACTERISTIC
/begin CHARACTERISTIC FaultManager.Inj5Open.Action_2_Condition "Fault manager configuration.  Select up to 4 actions for each fault." VALUE 0x8000356D RecordLayout_8 0 CompuMethod_111 0 65535 /end CHARACTERISTIC
/begin CHARACTERISTIC FaultManager.Inj5Open.Action_3 "Fault manager configuration.  Select up to 4 actions for each fault." VALUE 0x8000356F RecordLayout_8 0 CompuMethod_110 0 65535 /end CHARACTERISTIC
/begin CHARACTERISTIC FaultManager.Inj5Open.Action_3_Condition "Fault manager configuration.  Select up to 4 actions for each fault." VALUE 0x80003571 RecordLayout_8 0 CompuMethod_111 0 65535 /end CHARACTERISTIC
/begin CHARACTERISTIC FaultManager.Inj5Open.Action_4 "Fault manager configuration.  Select up to 4 actions for each fault." VALUE 0x80003573 RecordLayout_8 0 CompuMethod_110 0 65535 /end CHARACTERISTIC
/begin CHARACTERISTIC FaultManager.Inj5Open.Action_4_Condition "Fault manager configuration.  Select up to 4 actions for each fault." VALUE 0x80003575 RecordLayout_8 0 CompuMethod_111 0 65535 /end CHARACTERISTIC
/begin CHARACTERISTIC FaultManager.Inj6Open.Mode "Fault manager configuration.  Select up to 4 actions for each fault." VALUE 0x80003577 RecordLayout_8 0 CompuMethod_108 0 65535 /end CHARACTERISTIC
/begin CHARACTERISTIC FaultManager.Inj6Open.ID "Fault manager configuration.  Select up to 4 actions for each fault." VALUE 0x80003579 RecordLayout_8 0 CompuMethod_1 0 65535 /end CHARACTERISTIC
/begin CHARACTERISTIC FaultManager.Inj6Open.Test "Fault manager configuration.  Select up to 4 actions for each fault." VALUE 0x8000357B RecordLayout_8 0 CompuMethod_109 0 65535 /end CHARACTERISTIC
/begin CHARACTERISTIC FaultManager.Inj6Open.Faulty_Samples__X_ "Fault manager configuration.  Select up to 4 actions for each fault." VALUE 0x8000357D RecordLayout_8 0 CompuMethod_1 0 65535 /end CHARACTERISTIC
/begin CHARACTERISTIC FaultManager.Inj6Open.Total_Samples__Y_ "Fault manager configuration.  Select up to 4 actions for each fault." VALUE 0x8000357F RecordLayout_8 0 CompuMethod_1 0 65535 /end CHARACTERISTIC
/begin CHARACTERISTIC FaultManager.Inj6Open.Action_1 "Fault manager configuration.  Select up to 4 actions for each fault." VALUE 0x80003581 RecordLayout_8 0 CompuMethod_110 0 65535 /end CHARACTERISTIC
/begin CHARACTERISTIC FaultManager.Inj6Open.Action_1_Condition "Fault manager configuration.  Select up to 4 actions for each fault." VALUE 0x80003583 RecordLayout_8 0 CompuMethod_111 0 65535 /end CHARACTERISTIC
/begin CHARACTERISTIC FaultManager.Inj6Open.Action_2 "Fault manager configuration.  Select up to 4 actions for each fault." VALUE 0x80003585 RecordLayout_8 0 CompuMethod_110 0 65535 /end CHARACTERISTIC
/begin CHARACTERISTIC FaultManager.Inj6Open.Action_2_Condition "Fault manager configuration.  Select up to 4 actions for each fault." VALUE 0x80003587 RecordLayout_8 0 CompuMethod_111 0 65535 /end CHARACTERISTIC
/begin CHARACTERISTIC FaultManager.Inj6Open.Action_3 "Fault manager configuration.  Select up to 4 actions for each fault." VALUE 0x80003589 RecordLayout_8 0 CompuMethod_110 0 65535 /end CHARACTERISTIC
/begin CHARACTERISTIC FaultManager.Inj6Open.Action_3_Condition "Fault manager configuration.  Select up to 4 actions for each fault." VALUE 0x8000358B RecordLayout_8 0 CompuMethod_111 0 65535 /end CHARACTERISTIC
/begin CHARACTERISTIC FaultManager.Inj6Open.Action_4 "Fault manager configuration.  Select up to 4 actions for each fault." VALUE 0x8000358D RecordLayout_8 0 CompuMethod_110 0 65535 /end CHARACTERISTIC
/begin CHARACTERISTIC FaultManager.Inj6Open.Action_4_Condition "Fault manager configuration.  Select up to 4 actions for each fault." VALUE 0x8000358F RecordLayout_8 0 CompuMethod_111 0 65535 /end CHARACTERISTIC
/begin CHARACTERISTIC FaultManager.Inj7Open.Mode "Fault manager configuration.  Select up to 4 actions for each fault." VALUE 0x80003591 RecordLayout_8 0 CompuMethod_108 0 65535 /end CHARACTERISTIC
/begin CHARACTERISTIC FaultManager.Inj7Open.ID "Fault manager configuration.  Select up to 4 actions for each fault." VALUE 0x80003593 RecordLayout_8 0 CompuMethod_1 0 65535 /end CHARACTERISTIC
/begin CHARACTERISTIC FaultManager.Inj7Open.Test "Fault manager configuration.  Select up to 4 actions for each fault." VALUE 0x80003595 RecordLayout_8 0 CompuMethod_109 0 65535 /end CHARACTERISTIC
/begin CHARACTERISTIC FaultManager.Inj7Open.Faulty_Samples__X_ "Fault manager configuration.  Select up to 4 actions for each fault." VALUE 0x80003597 RecordLayout_8 0 CompuMethod_1 0 65535 /end CHARACTERISTIC
/begin CHARACTERISTIC FaultManager.Inj7Open.Total_Samples__Y_ "Fault manager configuration.  Select up to 4 actions for each fault." VALUE 0x80003599 RecordLayout_8 0 CompuMethod_1 0 65535 /end CHARACTERISTIC
/begin CHARACTERISTIC FaultManager.Inj7Open.Action_1 "Fault manager configuration.  Select up to 4 actions for each fault." VALUE 0x8000359B RecordLayout_8 0 CompuMethod_110 0 65535 /end CHARACTERISTIC
/begin CHARACTERISTIC FaultManager.Inj7Open.Action_1_Condition "Fault manager configuration.  Select up to 4 actions for each fault." VALUE 0x8000359D RecordLayout_8 0 CompuMethod_111 0 65535 /end CHARACTERISTIC
/begin CHARACTERISTIC FaultManager.Inj7Open.Action_2 "Fault manager configuration.  Select up to 4 actions for each fault." VALUE 0x8000359F RecordLayout_8 0 CompuMethod_110 0 65535 /end CHARACTERISTIC
/begin CHARACTERISTIC FaultManager.Inj7Open.Action_2_Condition "Fault manager configuration.  Select up to 4 actions for each fault." VALUE 0x800035A1 RecordLayout_8 0 CompuMethod_111 0 65535 /end CHARACTERISTIC
/begin CHARACTERISTIC FaultManager.Inj7Open.Action_3 "Fault manager configuration.  Select up to 4 actions for each fault." VALUE 0x800035A3 RecordLayout_8 0 CompuMethod_110 0 65535 /end CHARACTERISTIC
/begin CHARACTERISTIC FaultManager.Inj7Open.Action_3_Condition "Fault manager configuration.  Select up to 4 actions for each fault." VALUE 0x800035A5 RecordLayout_8 0 CompuMethod_111 0 65535 /end CHARACTERISTIC
/begin CHARACTERISTIC FaultManager.Inj7Open.Action_4 "Fault manager configuration.  Select up to 4 actions for each fault." VALUE 0x800035A7 RecordLayout_8 0 CompuMethod_110 0 65535 /end CHARACTERISTIC
/begin CHARACTERISTIC FaultManager.Inj7Open.Action_4_Condition "Fault manager configuration.  Select up to 4 actions for each fault." VALUE 0x800035A9 RecordLayout_8 0 CompuMethod_111 0 65535 /end CHARACTERISTIC
/begin CHARACTERISTIC FaultManager.Inj8Open.Mode "Fault manager configuration.  Select up to 4 actions for each fault." VALUE 0x800035AB RecordLayout_8 0 CompuMethod_108 0 65535 /end CHARACTERISTIC
/begin CHARACTERISTIC FaultManager.Inj8Open.ID "Fault manager configuration.  Select up to 4 actions for each fault." VALUE 0x800035AD RecordLayout_8 0 CompuMethod_1 0 65535 /end CHARACTERISTIC
/begin CHARACTERISTIC FaultManager.Inj8Open.Test "Fault manager configuration.  Select up to 4 actions for each fault." VALUE 0x800035AF RecordLayout_8 0 CompuMethod_109 0 65535 /end CHARACTERISTIC
/begin CHARACTERISTIC FaultManager.Inj8Open.Faulty_Samples__X_ "Fault manager configuration.  Select up to 4 actions for each fault." VALUE 0x800035B1 RecordLayout_8 0 CompuMethod_1 0 65535 /end CHARACTERISTIC
/begin CHARACTERISTIC FaultManager.Inj8Open.Total_Samples__Y_ "Fault manager configuration.  Select up to 4 actions for each fault." VALUE 0x800035B3 RecordLayout_8 0 CompuMethod_1 0 65535 /end CHARACTERISTIC
/begin CHARACTERISTIC FaultManager.Inj8Open.Action_1 "Fault manager configuration.  Select up to 4 actions for each fault." VALUE 0x800035B5 RecordLayout_8 0 CompuMethod_110 0 65535 /end CHARACTERISTIC
/begin CHARACTERISTIC FaultManager.Inj8Open.Action_1_Condition "Fault manager configuration.  Select up to 4 actions for each fault." VALUE 0x800035B7 RecordLayout_8 0 CompuMethod_111 0 65535 /end CHARACTERISTIC
/begin CHARACTERISTIC FaultManager.Inj8Open.Action_2 "Fault manager configuration.  Select up to 4 actions for each fault." VALUE 0x800035B9 RecordLayout_8 0 CompuMethod_110 0 65535 /end CHARACTERISTIC
/begin CHARACTERISTIC FaultManager.Inj8Open.Action_2_Condition "Fault manager configuration.  Select up to 4 actions for each fault." VALUE 0x800035BB RecordLayout_8 0 CompuMethod_111 0 65535 /end CHARACTERISTIC
/begin CHARACTERISTIC FaultManager.Inj8Open.Action_3 "Fault manager configuration.  Select up to 4 actions for each fault." VALUE 0x800035BD RecordLayout_8 0 CompuMethod_110 0 65535 /end CHARACTERISTIC
/begin CHARACTERISTIC FaultManager.Inj8Open.Action_3_Condition "Fault manager configuration.  Select up to 4 actions for each fault." VALUE 0x800035BF RecordLayout_8 0 CompuMethod_111 0 65535 /end CHARACTERISTIC
/begin CHARACTERISTIC FaultManager.Inj8Open.Action_4 "Fault manager configuration.  Select up to 4 actions for each fault." VALUE 0x800035C1 RecordLayout_8 0 CompuMethod_110 0 65535 /end CHARACTERISTIC
/begin CHARACTERISTIC FaultManager.Inj8Open.Action_4_Condition "Fault manager configuration.  Select up to 4 actions for each fault." VALUE 0x800035C3 RecordLayout_8 0 CompuMethod_111 0 65535 /end CHARACTERISTIC
/begin CHARACTERISTIC FaultManager.Lambda_1_NotReady.Mode "Fault manager configuration.  Select up to 4 actions for each fault." VALUE 0x800035C5 RecordLayout_8 0 CompuMethod_108 0 65535 /end CHARACTERISTIC
/begin CHARACTERISTIC FaultManager.Lambda_1_NotReady.ID "Fault manager configuration.  Select up to 4 actions for each fault." VALUE 0x800035C7 RecordLayout_8 0 CompuMethod_1 0 65535 /end CHARACTERISTIC
/begin CHARACTERISTIC FaultManager.Lambda_1_NotReady.Test "Fault manager configuration.  Select up to 4 actions for each fault." VALUE 0x800035C9 RecordLayout_8 0 CompuMethod_109 0 65535 /end CHARACTERISTIC
/begin CHARACTERISTIC FaultManager.Lambda_1_NotReady.Faulty_Samples__X_ "Fault manager configuration.  Select up to 4 actions for each fault." VALUE 0x800035CB RecordLayout_8 0 CompuMethod_1 0 65535 /end CHARACTERISTIC
/begin CHARACTERISTIC FaultManager.Lambda_1_NotReady.Total_Samples__Y_ "Fault manager configuration.  Select up to 4 actions for each fault." VALUE 0x800035CD RecordLayout_8 0 CompuMethod_1 0 65535 /end CHARACTERISTIC
/begin CHARACTERISTIC FaultManager.Lambda_1_NotReady.Action_1 "Fault manager configuration.  Select up to 4 actions for each fault." VALUE 0x800035CF RecordLayout_8 0 CompuMethod_110 0 65535 /end CHARACTERISTIC
/begin CHARACTERISTIC FaultManager.Lambda_1_NotReady.Action_1_Condition "Fault manager configuration.  Select up to 4 actions for each fault." VALUE 0x800035D1 RecordLayout_8 0 CompuMethod_111 0 65535 /end CHARACTERISTIC
/begin CHARACTERISTIC FaultManager.Lambda_1_NotReady.Action_2 "Fault manager configuration.  Select up to 4 actions for each fault." VALUE 0x800035D3 RecordLayout_8 0 CompuMethod_110 0 65535 /end CHARACTERISTIC
/begin CHARACTERISTIC FaultManager.Lambda_1_NotReady.Action_2_Condition "Fault manager configuration.  Select up to 4 actions for each fault." VALUE 0x800035D5 RecordLayout_8 0 CompuMethod_111 0 65535 /end CHARACTERISTIC
/begin CHARACTERISTIC FaultManager.Lambda_1_NotReady.Action_3 "Fault manager configuration.  Select up to 4 actions for each fault." VALUE 0x800035D7 RecordLayout_8 0 CompuMethod_110 0 65535 /end CHARACTERISTIC
/begin CHARACTERISTIC FaultManager.Lambda_1_NotReady.Action_3_Condition "Fault manager configuration.  Select up to 4 actions for each fault." VALUE 0x800035D9 RecordLayout_8 0 CompuMethod_111 0 65535 /end CHARACTERISTIC
/begin CHARACTERISTIC FaultManager.Lambda_1_NotReady.Action_4 "Fault manager configuration.  Select up to 4 actions for each fault." VALUE 0x800035DB RecordLayout_8 0 CompuMethod_110 0 65535 /end CHARACTERISTIC
/begin CHARACTERISTIC FaultManager.Lambda_1_NotReady.Action_4_Condition "Fault manager configuration.  Select up to 4 actions for each fault." VALUE 0x800035DD RecordLayout_8 0 CompuMethod_111 0 65535 /end CHARACTERISTIC
/begin CHARACTERISTIC FaultManager.Lambda_1_Timeout.Mode "Fault manager configuration.  Select up to 4 actions for each fault." VALUE 0x800035DF RecordLayout_8 0 CompuMethod_108 0 65535 /end CHARACTERISTIC
/begin CHARACTERISTIC FaultManager.Lambda_1_Timeout.ID "Fault manager configuration.  Select up to 4 actions for each fault." VALUE 0x800035E1 RecordLayout_8 0 CompuMethod_1 0 65535 /end CHARACTERISTIC
/begin CHARACTERISTIC FaultManager.Lambda_1_Timeout.Test "Fault manager configuration.  Select up to 4 actions for each fault." VALUE 0x800035E3 RecordLayout_8 0 CompuMethod_109 0 65535 /end CHARACTERISTIC
/begin CHARACTERISTIC FaultManager.Lambda_1_Timeout.Faulty_Samples__X_ "Fault manager configuration.  Select up to 4 actions for each fault." VALUE 0x800035E5 RecordLayout_8 0 CompuMethod_1 0 65535 /end CHARACTERISTIC
/begin CHARACTERISTIC FaultManager.Lambda_1_Timeout.Total_Samples__Y_ "Fault manager configuration.  Select up to 4 actions for each fault." VALUE 0x800035E7 RecordLayout_8 0 CompuMethod_1 0 65535 /end CHARACTERISTIC
/begin CHARACTERISTIC FaultManager.Lambda_1_Timeout.Action_1 "Fault manager configuration.  Select up to 4 actions for each fault." VALUE 0x800035E9 RecordLayout_8 0 CompuMethod_110 0 65535 /end CHARACTERISTIC
/begin CHARACTERISTIC FaultManager.Lambda_1_Timeout.Action_1_Condition "Fault manager configuration.  Select up to 4 actions for each fault." VALUE 0x800035EB RecordLayout_8 0 CompuMethod_111 0 65535 /end CHARACTERISTIC
/begin CHARACTERISTIC FaultManager.Lambda_1_Timeout.Action_2 "Fault manager configuration.  Select up to 4 actions for each fault." VALUE 0x800035ED RecordLayout_8 0 CompuMethod_110 0 65535 /end CHARACTERISTIC
/begin CHARACTERISTIC FaultManager.Lambda_1_Timeout.Action_2_Condition "Fault manager configuration.  Select up to 4 actions for each fault." VALUE 0x800035EF RecordLayout_8 0 CompuMethod_111 0 65535 /end CHARACTERISTIC
/begin CHARACTERISTIC FaultManager.Lambda_1_Timeout.Action_3 "Fault manager configuration.  Select up to 4 actions for each fault." VALUE 0x800035F1 RecordLayout_8 0 CompuMethod_110 0 65535 /end CHARACTERISTIC
/begin CHARACTERISTIC FaultManager.Lambda_1_Timeout.Action_3_Condition "Fault manager configuration.  Select up to 4 actions for each fault." VALUE 0x800035F3 RecordLayout_8 0 CompuMethod_111 0 65535 /end CHARACTERISTIC
/begin CHARACTERISTIC FaultManager.Lambda_1_Timeout.Action_4 "Fault manager configuration.  Select up to 4 actions for each fault." VALUE 0x800035F5 RecordLayout_8 0 CompuMethod_110 0 65535 /end CHARACTERISTIC
/begin CHARACTERISTIC FaultManager.Lambda_1_Timeout.Action_4_Condition "Fault manager configuration.  Select up to 4 actions for each fault." VALUE 0x800035F7 RecordLayout_8 0 CompuMethod_111 0 65535 /end CHARACTERISTIC
/begin CHARACTERISTIC FaultManager.Lambda_2_NotReady.Mode "Fault manager configuration.  Select up to 4 actions for each fault." VALUE 0x800035F9 RecordLayout_8 0 CompuMethod_108 0 65535 /end CHARACTERISTIC
/begin CHARACTERISTIC FaultManager.Lambda_2_NotReady.ID "Fault manager configuration.  Select up to 4 actions for each fault." VALUE 0x800035FB RecordLayout_8 0 CompuMethod_1 0 65535 /end CHARACTERISTIC
/begin CHARACTERISTIC FaultManager.Lambda_2_NotReady.Test "Fault manager configuration.  Select up to 4 actions for each fault." VALUE 0x800035FD RecordLayout_8 0 CompuMethod_109 0 65535 /end CHARACTERISTIC
/begin CHARACTERISTIC FaultManager.Lambda_2_NotReady.Faulty_Samples__X_ "Fault manager configuration.  Select up to 4 actions for each fault." VALUE 0x800035FF RecordLayout_8 0 CompuMethod_1 0 65535 /end CHARACTERISTIC
/begin CHARACTERISTIC FaultManager.Lambda_2_NotReady.Total_Samples__Y_ "Fault manager configuration.  Select up to 4 actions for each fault." VALUE 0x80003601 RecordLayout_8 0 CompuMethod_1 0 65535 /end CHARACTERISTIC
/begin CHARACTERISTIC FaultManager.Lambda_2_NotReady.Action_1 "Fault manager configuration.  Select up to 4 actions for each fault." VALUE 0x80003603 RecordLayout_8 0 CompuMethod_110 0 65535 /end CHARACTERISTIC
/begin CHARACTERISTIC FaultManager.Lambda_2_NotReady.Action_1_Condition "Fault manager configuration.  Select up to 4 actions for each fault." VALUE 0x80003605 RecordLayout_8 0 CompuMethod_111 0 65535 /end CHARACTERISTIC
/begin CHARACTERISTIC FaultManager.Lambda_2_NotReady.Action_2 "Fault manager configuration.  Select up to 4 actions for each fault." VALUE 0x80003607 RecordLayout_8 0 CompuMethod_110 0 65535 /end CHARACTERISTIC
/begin CHARACTERISTIC FaultManager.Lambda_2_NotReady.Action_2_Condition "Fault manager configuration.  Select up to 4 actions for each fault." VALUE 0x80003609 RecordLayout_8 0 CompuMethod_111 0 65535 /end CHARACTERISTIC
/begin CHARACTERISTIC FaultManager.Lambda_2_NotReady.Action_3 "Fault manager configuration.  Select up to 4 actions for each fault." VALUE 0x8000360B RecordLayout_8 0 CompuMethod_110 0 65535 /end CHARACTERISTIC
/begin CHARACTERISTIC FaultManager.Lambda_2_NotReady.Action_3_Condition "Fault manager configuration.  Select up to 4 actions for each fault." VALUE 0x8000360D RecordLayout_8 0 CompuMethod_111 0 65535 /end CHARACTERISTIC
/begin CHARACTERISTIC FaultManager.Lambda_2_NotReady.Action_4 "Fault manager configuration.  Select up to 4 actions for each fault." VALUE 0x8000360F RecordLayout_8 0 CompuMethod_110 0 65535 /end CHARACTERISTIC
/begin CHARACTERISTIC FaultManager.Lambda_2_NotReady.Action_4_Condition "Fault manager configuration.  Select up to 4 actions for each fault." VALUE 0x80003611 RecordLayout_8 0 CompuMethod_111 0 65535 /end CHARACTERISTIC
/begin CHARACTERISTIC FaultManager.Lambda_2_Timeout.Mode "Fault manager configuration.  Select up to 4 actions for each fault." VALUE 0x80003613 RecordLayout_8 0 CompuMethod_108 0 65535 /end CHARACTERISTIC
/begin CHARACTERISTIC FaultManager.Lambda_2_Timeout.ID "Fault manager configuration.  Select up to 4 actions for each fault." VALUE 0x80003615 RecordLayout_8 0 CompuMethod_1 0 65535 /end CHARACTERISTIC
/begin CHARACTERISTIC FaultManager.Lambda_2_Timeout.Test "Fault manager configuration.  Select up to 4 actions for each fault." VALUE 0x80003617 RecordLayout_8 0 CompuMethod_109 0 65535 /end CHARACTERISTIC
/begin CHARACTERISTIC FaultManager.Lambda_2_Timeout.Faulty_Samples__X_ "Fault manager configuration.  Select up to 4 actions for each fault." VALUE 0x80003619 RecordLayout_8 0 CompuMethod_1 0 65535 /end CHARACTERISTIC
/begin CHARACTERISTIC FaultManager.Lambda_2_Timeout.Total_Samples__Y_ "Fault manager configuration.  Select up to 4 actions for each fault." VALUE 0x8000361B RecordLayout_8 0 CompuMethod_1 0 65535 /end CHARACTERISTIC
/begin CHARACTERISTIC FaultManager.Lambda_2_Timeout.Action_1 "Fault manager configuration.  Select up to 4 actions for each fault." VALUE 0x8000361D RecordLayout_8 0 CompuMethod_110 0 65535 /end CHARACTERISTIC
/begin CHARACTERISTIC FaultManager.Lambda_2_Timeout.Action_1_Condition "Fault manager configuration.  Select up to 4 actions for each fault." VALUE 0x8000361F RecordLayout_8 0 CompuMethod_111 0 65535 /end CHARACTERISTIC
/begin CHARACTERISTIC FaultManager.Lambda_2_Timeout.Action_2 "Fault manager configuration.  Select up to 4 actions for each fault." VALUE 0x80003621 RecordLayout_8 0 CompuMethod_110 0 65535 /end CHARACTERISTIC
/begin CHARACTERISTIC FaultManager.Lambda_2_Timeout.Action_2_Condition "Fault manager configuration.  Select up to 4 actions for each fault." VALUE 0x80003623 RecordLayout_8 0 CompuMethod_111 0 65535 /end CHARACTERISTIC
/begin CHARACTERISTIC FaultManager.Lambda_2_Timeout.Action_3 "Fault manager configuration.  Select up to 4 actions for each fault." VALUE 0x80003625 RecordLayout_8 0 CompuMethod_110 0 65535 /end CHARACTERISTIC
/begin CHARACTERISTIC FaultManager.Lambda_2_Timeout.Action_3_Condition "Fault manager configuration.  Select up to 4 actions for each fault." VALUE 0x80003627 RecordLayout_8 0 CompuMethod_111 0 65535 /end CHARACTERISTIC
/begin CHARACTERISTIC FaultManager.Lambda_2_Timeout.Action_4 "Fault manager configuration.  Select up to 4 actions for each fault." VALUE 0x80003629 RecordLayout_8 0 CompuMethod_110 0 65535 /end CHARACTERISTIC
/begin CHARACTERISTIC FaultManager.Lambda_2_Timeout.Action_4_Condition "Fault manager configuration.  Select up to 4 actions for each fault." VALUE 0x8000362B RecordLayout_8 0 CompuMethod_111 0 65535 /end CHARACTERISTIC
/begin CHARACTERISTIC FaultManager.LeanProtect_Fault.Mode "Fault manager configuration.  Select up to 4 actions for each fault." VALUE 0x8000362D RecordLayout_8 0 CompuMethod_108 0 65535 /end CHARACTERISTIC
/begin CHARACTERISTIC FaultManager.LeanProtect_Fault.ID "Fault manager configuration.  Select up to 4 actions for each fault." VALUE 0x8000362F RecordLayout_8 0 CompuMethod_1 0 65535 /end CHARACTERISTIC
/begin CHARACTERISTIC FaultManager.LeanProtect_Fault.Test "Fault manager configuration.  Select up to 4 actions for each fault." VALUE 0x80003631 RecordLayout_8 0 CompuMethod_109 0 65535 /end CHARACTERISTIC
/begin CHARACTERISTIC FaultManager.LeanProtect_Fault.Faulty_Samples__X_ "Fault manager configuration.  Select up to 4 actions for each fault." VALUE 0x80003633 RecordLayout_8 0 CompuMethod_1 0 65535 /end CHARACTERISTIC
/begin CHARACTERISTIC FaultManager.LeanProtect_Fault.Total_Samples__Y_ "Fault manager configuration.  Select up to 4 actions for each fault." VALUE 0x80003635 RecordLayout_8 0 CompuMethod_1 0 65535 /end CHARACTERISTIC
/begin CHARACTERISTIC FaultManager.LeanProtect_Fault.Action_1 "Fault manager configuration.  Select up to 4 actions for each fault." VALUE 0x80003637 RecordLayout_8 0 CompuMethod_110 0 65535 /end CHARACTERISTIC
/begin CHARACTERISTIC FaultManager.LeanProtect_Fault.Action_1_Condition "Fault manager configuration.  Select up to 4 actions for each fault." VALUE 0x80003639 RecordLayout_8 0 CompuMethod_111 0 65535 /end CHARACTERISTIC
/begin CHARACTERISTIC FaultManager.LeanProtect_Fault.Action_2 "Fault manager configuration.  Select up to 4 actions for each fault." VALUE 0x8000363B RecordLayout_8 0 CompuMethod_110 0 65535 /end CHARACTERISTIC
/begin CHARACTERISTIC FaultManager.LeanProtect_Fault.Action_2_Condition "Fault manager configuration.  Select up to 4 actions for each fault." VALUE 0x8000363D RecordLayout_8 0 CompuMethod_111 0 65535 /end CHARACTERISTIC
/begin CHARACTERISTIC FaultManager.LeanProtect_Fault.Action_3 "Fault manager configuration.  Select up to 4 actions for each fault." VALUE 0x8000363F RecordLayout_8 0 CompuMethod_110 0 65535 /end CHARACTERISTIC
/begin CHARACTERISTIC FaultManager.LeanProtect_Fault.Action_3_Condition "Fault manager configuration.  Select up to 4 actions for each fault." VALUE 0x80003641 RecordLayout_8 0 CompuMethod_111 0 65535 /end CHARACTERISTIC
/begin CHARACTERISTIC FaultManager.LeanProtect_Fault.Action_4 "Fault manager configuration.  Select up to 4 actions for each fault." VALUE 0x80003643 RecordLayout_8 0 CompuMethod_110 0 65535 /end CHARACTERISTIC
/begin CHARACTERISTIC FaultManager.LeanProtect_Fault.Action_4_Condition "Fault manager configuration.  Select up to 4 actions for each fault." VALUE 0x80003645 RecordLayout_8 0 CompuMethod_111 0 65535 /end CHARACTERISTIC
/begin CHARACTERISTIC FaultManager.MAFRangeHigh.Mode "Fault manager configuration.  Select up to 4 actions for each fault." VALUE 0x80003647 RecordLayout_8 0 CompuMethod_108 0 65535 /end CHARACTERISTIC
/begin CHARACTERISTIC FaultManager.MAFRangeHigh.ID "Fault manager configuration.  Select up to 4 actions for each fault." VALUE 0x80003649 RecordLayout_8 0 CompuMethod_1 0 65535 /end CHARACTERISTIC
/begin CHARACTERISTIC FaultManager.MAFRangeHigh.Test "Fault manager configuration.  Select up to 4 actions for each fault." VALUE 0x8000364B RecordLayout_8 0 CompuMethod_109 0 65535 /end CHARACTERISTIC
/begin CHARACTERISTIC FaultManager.MAFRangeHigh.Faulty_Samples__X_ "Fault manager configuration.  Select up to 4 actions for each fault." VALUE 0x8000364D RecordLayout_8 0 CompuMethod_1 0 65535 /end CHARACTERISTIC
/begin CHARACTERISTIC FaultManager.MAFRangeHigh.Total_Samples__Y_ "Fault manager configuration.  Select up to 4 actions for each fault." VALUE 0x8000364F RecordLayout_8 0 CompuMethod_1 0 65535 /end CHARACTERISTIC
/begin CHARACTERISTIC FaultManager.MAFRangeHigh.Action_1 "Fault manager configuration.  Select up to 4 actions for each fault." VALUE 0x80003651 RecordLayout_8 0 CompuMethod_110 0 65535 /end CHARACTERISTIC
/begin CHARACTERISTIC FaultManager.MAFRangeHigh.Action_1_Condition "Fault manager configuration.  Select up to 4 actions for each fault." VALUE 0x80003653 RecordLayout_8 0 CompuMethod_111 0 65535 /end CHARACTERISTIC
/begin CHARACTERISTIC FaultManager.MAFRangeHigh.Action_2 "Fault manager configuration.  Select up to 4 actions for each fault." VALUE 0x80003655 RecordLayout_8 0 CompuMethod_110 0 65535 /end CHARACTERISTIC
/begin CHARACTERISTIC FaultManager.MAFRangeHigh.Action_2_Condition "Fault manager configuration.  Select up to 4 actions for each fault." VALUE 0x80003657 RecordLayout_8 0 CompuMethod_111 0 65535 /end CHARACTERISTIC
/begin CHARACTERISTIC FaultManager.MAFRangeHigh.Action_3 "Fault manager configuration.  Select up to 4 actions for each fault." VALUE 0x80003659 RecordLayout_8 0 CompuMethod_110 0 65535 /end CHARACTERISTIC
/begin CHARACTERISTIC FaultManager.MAFRangeHigh.Action_3_Condition "Fault manager configuration.  Select up to 4 actions for each fault." VALUE 0x8000365B RecordLayout_8 0 CompuMethod_111 0 65535 /end CHARACTERISTIC
/begin CHARACTERISTIC FaultManager.MAFRangeHigh.Action_4 "Fault manager configuration.  Select up to 4 actions for each fault." VALUE 0x8000365D RecordLayout_8 0 CompuMethod_110 0 65535 /end CHARACTERISTIC
/begin CHARACTERISTIC FaultManager.MAFRangeHigh.Action_4_Condition "Fault manager configuration.  Select up to 4 actions for each fault." VALUE 0x8000365F RecordLayout_8 0 CompuMethod_111 0 65535 /end CHARACTERISTIC
/begin CHARACTERISTIC FaultManager.MAFRangeLow.Mode "Fault manager configuration.  Select up to 4 actions for each fault." VALUE 0x80003661 RecordLayout_8 0 CompuMethod_108 0 65535 /end CHARACTERISTIC
/begin CHARACTERISTIC FaultManager.MAFRangeLow.ID "Fault manager configuration.  Select up to 4 actions for each fault." VALUE 0x80003663 RecordLayout_8 0 CompuMethod_1 0 65535 /end CHARACTERISTIC
/begin CHARACTERISTIC FaultManager.MAFRangeLow.Test "Fault manager configuration.  Select up to 4 actions for each fault." VALUE 0x80003665 RecordLayout_8 0 CompuMethod_109 0 65535 /end CHARACTERISTIC
/begin CHARACTERISTIC FaultManager.MAFRangeLow.Faulty_Samples__X_ "Fault manager configuration.  Select up to 4 actions for each fault." VALUE 0x80003667 RecordLayout_8 0 CompuMethod_1 0 65535 /end CHARACTERISTIC
/begin CHARACTERISTIC FaultManager.MAFRangeLow.Total_Samples__Y_ "Fault manager configuration.  Select up to 4 actions for each fault." VALUE 0x80003669 RecordLayout_8 0 CompuMethod_1 0 65535 /end CHARACTERISTIC
/begin CHARACTERISTIC FaultManager.MAFRangeLow.Action_1 "Fault manager configuration.  Select up to 4 actions for each fault." VALUE 0x8000366B RecordLayout_8 0 CompuMethod_110 0 65535 /end CHARACTERISTIC
/begin CHARACTERISTIC FaultManager.MAFRangeLow.Action_1_Condition "Fault manager configuration.  Select up to 4 actions for each fault." VALUE 0x8000366D RecordLayout_8 0 CompuMethod_111 0 65535 /end CHARACTERISTIC
/begin CHARACTERISTIC FaultManager.MAFRangeLow.Action_2 "Fault manager configuration.  Select up to 4 actions for each fault." VALUE 0x8000366F RecordLayout_8 0 CompuMethod_110 0 65535 /end CHARACTERISTIC
/begin CHARACTERISTIC FaultManager.MAFRangeLow.Action_2_Condition "Fault manager configuration.  Select up to 4 actions for each fault." VALUE 0x80003671 RecordLayout_8 0 CompuMethod_111 0 65535 /end CHARACTERISTIC
/begin CHARACTERISTIC FaultManager.MAFRangeLow.Action_3 "Fault manager configuration.  Select up to 4 actions for each fault." VALUE 0x80003673 RecordLayout_8 0 CompuMethod_110 0 65535 /end CHARACTERISTIC
/begin CHARACTERISTIC FaultManager.MAFRangeLow.Action_3_Condition "Fault manager configuration.  Select up to 4 actions for each fault." VALUE 0x80003675 RecordLayout_8 0 CompuMethod_111 0 65535 /end CHARACTERISTIC
/begin CHARACTERISTIC FaultManager.MAFRangeLow.Action_4 "Fault manager configuration.  Select up to 4 actions for each fault." VALUE 0x80003677 RecordLayout_8 0 CompuMethod_110 0 65535 /end CHARACTERISTIC
/begin CHARACTERISTIC FaultManager.MAFRangeLow.Action_4_Condition "Fault manager configuration.  Select up to 4 actions for each fault." VALUE 0x80003679 RecordLayout_8 0 CompuMethod_111 0 65535 /end CHARACTERISTIC
/begin CHARACTERISTIC FaultManager.MAPRangeHigh.Mode "Fault manager configuration.  Select up to 4 actions for each fault." VALUE 0x8000367B RecordLayout_8 0 CompuMethod_108 0 65535 /end CHARACTERISTIC
/begin CHARACTERISTIC FaultManager.MAPRangeHigh.ID "Fault manager configuration.  Select up to 4 actions for each fault." VALUE 0x8000367D RecordLayout_8 0 CompuMethod_1 0 65535 /end CHARACTERISTIC
/begin CHARACTERISTIC FaultManager.MAPRangeHigh.Test "Fault manager configuration.  Select up to 4 actions for each fault." VALUE 0x8000367F RecordLayout_8 0 CompuMethod_109 0 65535 /end CHARACTERISTIC
/begin CHARACTERISTIC FaultManager.MAPRangeHigh.Faulty_Samples__X_ "Fault manager configuration.  Select up to 4 actions for each fault." VALUE 0x80003681 RecordLayout_8 0 CompuMethod_1 0 65535 /end CHARACTERISTIC
/begin CHARACTERISTIC FaultManager.MAPRangeHigh.Total_Samples__Y_ "Fault manager configuration.  Select up to 4 actions for each fault." VALUE 0x80003683 RecordLayout_8 0 CompuMethod_1 0 65535 /end CHARACTERISTIC
/begin CHARACTERISTIC FaultManager.MAPRangeHigh.Action_1 "Fault manager configuration.  Select up to 4 actions for each fault." VALUE 0x80003685 RecordLayout_8 0 CompuMethod_110 0 65535 /end CHARACTERISTIC
/begin CHARACTERISTIC FaultManager.MAPRangeHigh.Action_1_Condition "Fault manager configuration.  Select up to 4 actions for each fault." VALUE 0x80003687 RecordLayout_8 0 CompuMethod_111 0 65535 /end CHARACTERISTIC
/begin CHARACTERISTIC FaultManager.MAPRangeHigh.Action_2 "Fault manager configuration.  Select up to 4 actions for each fault." VALUE 0x80003689 RecordLayout_8 0 CompuMethod_110 0 65535 /end CHARACTERISTIC
/begin CHARACTERISTIC FaultManager.MAPRangeHigh.Action_2_Condition "Fault manager configuration.  Select up to 4 actions for each fault." VALUE 0x8000368B RecordLayout_8 0 CompuMethod_111 0 65535 /end CHARACTERISTIC
/begin CHARACTERISTIC FaultManager.MAPRangeHigh.Action_3 "Fault manager configuration.  Select up to 4 actions for each fault." VALUE 0x8000368D RecordLayout_8 0 CompuMethod_110 0 65535 /end CHARACTERISTIC
/begin CHARACTERISTIC FaultManager.MAPRangeHigh.Action_3_Condition "Fault manager configuration.  Select up to 4 actions for each fault." VALUE 0x8000368F RecordLayout_8 0 CompuMethod_111 0 65535 /end CHARACTERISTIC
/begin CHARACTERISTIC FaultManager.MAPRangeHigh.Action_4 "Fault manager configuration.  Select up to 4 actions for each fault." VALUE 0x80003691 RecordLayout_8 0 CompuMethod_110 0 65535 /end CHARACTERISTIC
/begin CHARACTERISTIC FaultManager.MAPRangeHigh.Action_4_Condition "Fault manager configuration.  Select up to 4 actions for each fault." VALUE 0x80003693 RecordLayout_8 0 CompuMethod_111 0 65535 /end CHARACTERISTIC
/begin CHARACTERISTIC FaultManager.MAPRangeLow.Mode "Fault manager configuration.  Select up to 4 actions for each fault." VALUE 0x80003695 RecordLayout_8 0 CompuMethod_108 0 65535 /end CHARACTERISTIC
/begin CHARACTERISTIC FaultManager.MAPRangeLow.ID "Fault manager configuration.  Select up to 4 actions for each fault." VALUE 0x80003697 RecordLayout_8 0 CompuMethod_1 0 65535 /end CHARACTERISTIC
/begin CHARACTERISTIC FaultManager.MAPRangeLow.Test "Fault manager configuration.  Select up to 4 actions for each fault." VALUE 0x80003699 RecordLayout_8 0 CompuMethod_109 0 65535 /end CHARACTERISTIC
/begin CHARACTERISTIC FaultManager.MAPRangeLow.Faulty_Samples__X_ "Fault manager configuration.  Select up to 4 actions for each fault." VALUE 0x8000369B RecordLayout_8 0 CompuMethod_1 0 65535 /end CHARACTERISTIC
/begin CHARACTERISTIC FaultManager.MAPRangeLow.Total_Samples__Y_ "Fault manager configuration.  Select up to 4 actions for each fault." VALUE 0x8000369D RecordLayout_8 0 CompuMethod_1 0 65535 /end CHARACTERISTIC
/begin CHARACTERISTIC FaultManager.MAPRangeLow.Action_1 "Fault manager configuration.  Select up to 4 actions for each fault." VALUE 0x8000369F RecordLayout_8 0 CompuMethod_110 0 65535 /end CHARACTERISTIC
/begin CHARACTERISTIC FaultManager.MAPRangeLow.Action_1_Condition "Fault manager configuration.  Select up to 4 actions for each fault." VALUE 0x800036A1 RecordLayout_8 0 CompuMethod_111 0 65535 /end CHARACTERISTIC
/begin CHARACTERISTIC FaultManager.MAPRangeLow.Action_2 "Fault manager configuration.  Select up to 4 actions for each fault." VALUE 0x800036A3 RecordLayout_8 0 CompuMethod_110 0 65535 /end CHARACTERISTIC
/begin CHARACTERISTIC FaultManager.MAPRangeLow.Action_2_Condition "Fault manager configuration.  Select up to 4 actions for each fault." VALUE 0x800036A5 RecordLayout_8 0 CompuMethod_111 0 65535 /end CHARACTERISTIC
/begin CHARACTERISTIC FaultManager.MAPRangeLow.Action_3 "Fault manager configuration.  Select up to 4 actions for each fault." VALUE 0x800036A7 RecordLayout_8 0 CompuMethod_110 0 65535 /end CHARACTERISTIC
/begin CHARACTERISTIC FaultManager.MAPRangeLow.Action_3_Condition "Fault manager configuration.  Select up to 4 actions for each fault." VALUE 0x800036A9 RecordLayout_8 0 CompuMethod_111 0 65535 /end CHARACTERISTIC
/begin CHARACTERISTIC FaultManager.MAPRangeLow.Action_4 "Fault manager configuration.  Select up to 4 actions for each fault." VALUE 0x800036AB RecordLayout_8 0 CompuMethod_110 0 65535 /end CHARACTERISTIC
/begin CHARACTERISTIC FaultManager.MAPRangeLow.Action_4_Condition "Fault manager configuration.  Select up to 4 actions for each fault." VALUE 0x800036AD RecordLayout_8 0 CompuMethod_111 0 65535 /end CHARACTERISTIC
/begin CHARACTERISTIC FaultManager.MAPTimeRangeHigh.Mode "Fault manager configuration.  Select up to 4 actions for each fault." VALUE 0x800036AF RecordLayout_8 0 CompuMethod_108 0 65535 /end CHARACTERISTIC
/begin CHARACTERISTIC FaultManager.MAPTimeRangeHigh.ID "Fault manager configuration.  Select up to 4 actions for each fault." VALUE 0x800036B1 RecordLayout_8 0 CompuMethod_1 0 65535 /end CHARACTERISTIC
/begin CHARACTERISTIC FaultManager.MAPTimeRangeHigh.Test "Fault manager configuration.  Select up to 4 actions for each fault." VALUE 0x800036B3 RecordLayout_8 0 CompuMethod_109 0 65535 /end CHARACTERISTIC
/begin CHARACTERISTIC FaultManager.MAPTimeRangeHigh.Faulty_Samples__X_ "Fault manager configuration.  Select up to 4 actions for each fault." VALUE 0x800036B5 RecordLayout_8 0 CompuMethod_1 0 65535 /end CHARACTERISTIC
/begin CHARACTERISTIC FaultManager.MAPTimeRangeHigh.Total_Samples__Y_ "Fault manager configuration.  Select up to 4 actions for each fault." VALUE 0x800036B7 RecordLayout_8 0 CompuMethod_1 0 65535 /end CHARACTERISTIC
/begin CHARACTERISTIC FaultManager.MAPTimeRangeHigh.Action_1 "Fault manager configuration.  Select up to 4 actions for each fault." VALUE 0x800036B9 RecordLayout_8 0 CompuMethod_110 0 65535 /end CHARACTERISTIC
/begin CHARACTERISTIC FaultManager.MAPTimeRangeHigh.Action_1_Condition "Fault manager configuration.  Select up to 4 actions for each fault." VALUE 0x800036BB RecordLayout_8 0 CompuMethod_111 0 65535 /end CHARACTERISTIC
/begin CHARACTERISTIC FaultManager.MAPTimeRangeHigh.Action_2 "Fault manager configuration.  Select up to 4 actions for each fault." VALUE 0x800036BD RecordLayout_8 0 CompuMethod_110 0 65535 /end CHARACTERISTIC
/begin CHARACTERISTIC FaultManager.MAPTimeRangeHigh.Action_2_Condition "Fault manager configuration.  Select up to 4 actions for each fault." VALUE 0x800036BF RecordLayout_8 0 CompuMethod_111 0 65535 /end CHARACTERISTIC
/begin CHARACTERISTIC FaultManager.MAPTimeRangeHigh.Action_3 "Fault manager configuration.  Select up to 4 actions for each fault." VALUE 0x800036C1 RecordLayout_8 0 CompuMethod_110 0 65535 /end CHARACTERISTIC
/begin CHARACTERISTIC FaultManager.MAPTimeRangeHigh.Action_3_Condition "Fault manager configuration.  Select up to 4 actions for each fault." VALUE 0x800036C3 RecordLayout_8 0 CompuMethod_111 0 65535 /end CHARACTERISTIC
/begin CHARACTERISTIC FaultManager.MAPTimeRangeHigh.Action_4 "Fault manager configuration.  Select up to 4 actions for each fault." VALUE 0x800036C5 RecordLayout_8 0 CompuMethod_110 0 65535 /end CHARACTERISTIC
/begin CHARACTERISTIC FaultManager.MAPTimeRangeHigh.Action_4_Condition "Fault manager configuration.  Select up to 4 actions for each fault." VALUE 0x800036C7 RecordLayout_8 0 CompuMethod_111 0 65535 /end CHARACTERISTIC
/begin CHARACTERISTIC FaultManager.MAPTimeRangeLow.Mode "Fault manager configuration.  Select up to 4 actions for each fault." VALUE 0x800036C9 RecordLayout_8 0 CompuMethod_108 0 65535 /end CHARACTERISTIC
/begin CHARACTERISTIC FaultManager.MAPTimeRangeLow.ID "Fault manager configuration.  Select up to 4 actions for each fault." VALUE 0x800036CB RecordLayout_8 0 CompuMethod_1 0 65535 /end CHARACTERISTIC
/begin CHARACTERISTIC FaultManager.MAPTimeRangeLow.Test "Fault manager configuration.  Select up to 4 actions for each fault." VALUE 0x800036CD RecordLayout_8 0 CompuMethod_109 0 65535 /end CHARACTERISTIC
/begin CHARACTERISTIC FaultManager.MAPTimeRangeLow.Faulty_Samples__X_ "Fault manager configuration.  Select up to 4 actions for each fault." VALUE 0x800036CF RecordLayout_8 0 CompuMethod_1 0 65535 /end CHARACTERISTIC
/begin CHARACTERISTIC FaultManager.MAPTimeRangeLow.Total_Samples__Y_ "Fault manager configuration.  Select up to 4 actions for each fault." VALUE 0x800036D1 RecordLayout_8 0 CompuMethod_1 0 65535 /end CHARACTERISTIC
/begin CHARACTERISTIC FaultManager.MAPTimeRangeLow.Action_1 "Fault manager configuration.  Select up to 4 actions for each fault." VALUE 0x800036D3 RecordLayout_8 0 CompuMethod_110 0 65535 /end CHARACTERISTIC
/begin CHARACTERISTIC FaultManager.MAPTimeRangeLow.Action_1_Condition "Fault manager configuration.  Select up to 4 actions for each fault." VALUE 0x800036D5 RecordLayout_8 0 CompuMethod_111 0 65535 /end CHARACTERISTIC
/begin CHARACTERISTIC FaultManager.MAPTimeRangeLow.Action_2 "Fault manager configuration.  Select up to 4 actions for each fault." VALUE 0x800036D7 RecordLayout_8 0 CompuMethod_110 0 65535 /end CHARACTERISTIC
/begin CHARACTERISTIC FaultManager.MAPTimeRangeLow.Action_2_Condition "Fault manager configuration.  Select up to 4 actions for each fault." VALUE 0x800036D9 RecordLayout_8 0 CompuMethod_111 0 65535 /end CHARACTERISTIC
/begin CHARACTERISTIC FaultManager.MAPTimeRangeLow.Action_3 "Fault manager configuration.  Select up to 4 actions for each fault." VALUE 0x800036DB RecordLayout_8 0 CompuMethod_110 0 65535 /end CHARACTERISTIC
/begin CHARACTERISTIC FaultManager.MAPTimeRangeLow.Action_3_Condition "Fault manager configuration.  Select up to 4 actions for each fault." VALUE 0x800036DD RecordLayout_8 0 CompuMethod_111 0 65535 /end CHARACTERISTIC
/begin CHARACTERISTIC FaultManager.MAPTimeRangeLow.Action_4 "Fault manager configuration.  Select up to 4 actions for each fault." VALUE 0x800036DF RecordLayout_8 0 CompuMethod_110 0 65535 /end CHARACTERISTIC
/begin CHARACTERISTIC FaultManager.MAPTimeRangeLow.Action_4_Condition "Fault manager configuration.  Select up to 4 actions for each fault." VALUE 0x800036E1 RecordLayout_8 0 CompuMethod_111 0 65535 /end CHARACTERISTIC
/begin CHARACTERISTIC FaultManager.MAP_IR_HI.Mode "Fault manager configuration.  Select up to 4 actions for each fault." VALUE 0x800036E3 RecordLayout_8 0 CompuMethod_108 0 65535 /end CHARACTERISTIC
/begin CHARACTERISTIC FaultManager.MAP_IR_HI.ID "Fault manager configuration.  Select up to 4 actions for each fault." VALUE 0x800036E5 RecordLayout_8 0 CompuMethod_1 0 65535 /end CHARACTERISTIC
/begin CHARACTERISTIC FaultManager.MAP_IR_HI.Test "Fault manager configuration.  Select up to 4 actions for each fault." VALUE 0x800036E7 RecordLayout_8 0 CompuMethod_109 0 65535 /end CHARACTERISTIC
/begin CHARACTERISTIC FaultManager.MAP_IR_HI.Faulty_Samples__X_ "Fault manager configuration.  Select up to 4 actions for each fault." VALUE 0x800036E9 RecordLayout_8 0 CompuMethod_1 0 65535 /end CHARACTERISTIC
/begin CHARACTERISTIC FaultManager.MAP_IR_HI.Total_Samples__Y_ "Fault manager configuration.  Select up to 4 actions for each fault." VALUE 0x800036EB RecordLayout_8 0 CompuMethod_1 0 65535 /end CHARACTERISTIC
/begin CHARACTERISTIC FaultManager.MAP_IR_HI.Action_1 "Fault manager configuration.  Select up to 4 actions for each fault." VALUE 0x800036ED RecordLayout_8 0 CompuMethod_110 0 65535 /end CHARACTERISTIC
/begin CHARACTERISTIC FaultManager.MAP_IR_HI.Action_1_Condition "Fault manager configuration.  Select up to 4 actions for each fault." VALUE 0x800036EF RecordLayout_8 0 CompuMethod_111 0 65535 /end CHARACTERISTIC
/begin CHARACTERISTIC FaultManager.MAP_IR_HI.Action_2 "Fault manager configuration.  Select up to 4 actions for each fault." VALUE 0x800036F1 RecordLayout_8 0 CompuMethod_110 0 65535 /end CHARACTERISTIC
/begin CHARACTERISTIC FaultManager.MAP_IR_HI.Action_2_Condition "Fault manager configuration.  Select up to 4 actions for each fault." VALUE 0x800036F3 RecordLayout_8 0 CompuMethod_111 0 65535 /end CHARACTERISTIC
/begin CHARACTERISTIC FaultManager.MAP_IR_HI.Action_3 "Fault manager configuration.  Select up to 4 actions for each fault." VALUE 0x800036F5 RecordLayout_8 0 CompuMethod_110 0 65535 /end CHARACTERISTIC
/begin CHARACTERISTIC FaultManager.MAP_IR_HI.Action_3_Condition "Fault manager configuration.  Select up to 4 actions for each fault." VALUE 0x800036F7 RecordLayout_8 0 CompuMethod_111 0 65535 /end CHARACTERISTIC
/begin CHARACTERISTIC FaultManager.MAP_IR_HI.Action_4 "Fault manager configuration.  Select up to 4 actions for each fault." VALUE 0x800036F9 RecordLayout_8 0 CompuMethod_110 0 65535 /end CHARACTERISTIC
/begin CHARACTERISTIC FaultManager.MAP_IR_HI.Action_4_Condition "Fault manager configuration.  Select up to 4 actions for each fault." VALUE 0x800036FB RecordLayout_8 0 CompuMethod_111 0 65535 /end CHARACTERISTIC
/begin CHARACTERISTIC FaultManager.MAP_IR_LO.Mode "Fault manager configuration.  Select up to 4 actions for each fault." VALUE 0x800036FD RecordLayout_8 0 CompuMethod_108 0 65535 /end CHARACTERISTIC
/begin CHARACTERISTIC FaultManager.MAP_IR_LO.ID "Fault manager configuration.  Select up to 4 actions for each fault." VALUE 0x800036FF RecordLayout_8 0 CompuMethod_1 0 65535 /end CHARACTERISTIC
/begin CHARACTERISTIC FaultManager.MAP_IR_LO.Test "Fault manager configuration.  Select up to 4 actions for each fault." VALUE 0x80003701 RecordLayout_8 0 CompuMethod_109 0 65535 /end CHARACTERISTIC
/begin CHARACTERISTIC FaultManager.MAP_IR_LO.Faulty_Samples__X_ "Fault manager configuration.  Select up to 4 actions for each fault." VALUE 0x80003703 RecordLayout_8 0 CompuMethod_1 0 65535 /end CHARACTERISTIC
/begin CHARACTERISTIC FaultManager.MAP_IR_LO.Total_Samples__Y_ "Fault manager configuration.  Select up to 4 actions for each fault." VALUE 0x80003705 RecordLayout_8 0 CompuMethod_1 0 65535 /end CHARACTERISTIC
/begin CHARACTERISTIC FaultManager.MAP_IR_LO.Action_1 "Fault manager configuration.  Select up to 4 actions for each fault." VALUE 0x80003707 RecordLayout_8 0 CompuMethod_110 0 65535 /end CHARACTERISTIC
/begin CHARACTERISTIC FaultManager.MAP_IR_LO.Action_1_Condition "Fault manager configuration.  Select up to 4 actions for each fault." VALUE 0x80003709 RecordLayout_8 0 CompuMethod_111 0 65535 /end CHARACTERISTIC
/begin CHARACTERISTIC FaultManager.MAP_IR_LO.Action_2 "Fault manager configuration.  Select up to 4 actions for each fault." VALUE 0x8000370B RecordLayout_8 0 CompuMethod_110 0 65535 /end CHARACTERISTIC
/begin CHARACTERISTIC FaultManager.MAP_IR_LO.Action_2_Condition "Fault manager configuration.  Select up to 4 actions for each fault." VALUE 0x8000370D RecordLayout_8 0 CompuMethod_111 0 65535 /end CHARACTERISTIC
/begin CHARACTERISTIC FaultManager.MAP_IR_LO.Action_3 "Fault manager configuration.  Select up to 4 actions for each fault." VALUE 0x8000370F RecordLayout_8 0 CompuMethod_110 0 65535 /end CHARACTERISTIC
/begin CHARACTERISTIC FaultManager.MAP_IR_LO.Action_3_Condition "Fault manager configuration.  Select up to 4 actions for each fault." VALUE 0x80003711 RecordLayout_8 0 CompuMethod_111 0 65535 /end CHARACTERISTIC
/begin CHARACTERISTIC FaultManager.MAP_IR_LO.Action_4 "Fault manager configuration.  Select up to 4 actions for each fault." VALUE 0x80003713 RecordLayout_8 0 CompuMethod_110 0 65535 /end CHARACTERISTIC
/begin CHARACTERISTIC FaultManager.MAP_IR_LO.Action_4_Condition "Fault manager configuration.  Select up to 4 actions for each fault." VALUE 0x80003715 RecordLayout_8 0 CompuMethod_111 0 65535 /end CHARACTERISTIC
/begin CHARACTERISTIC FaultManager.MAP_STICKING.Mode "Fault manager configuration.  Select up to 4 actions for each fault." VALUE 0x80003717 RecordLayout_8 0 CompuMethod_108 0 65535 /end CHARACTERISTIC
/begin CHARACTERISTIC FaultManager.MAP_STICKING.ID "Fault manager configuration.  Select up to 4 actions for each fault." VALUE 0x80003719 RecordLayout_8 0 CompuMethod_1 0 65535 /end CHARACTERISTIC
/begin CHARACTERISTIC FaultManager.MAP_STICKING.Test "Fault manager configuration.  Select up to 4 actions for each fault." VALUE 0x8000371B RecordLayout_8 0 CompuMethod_109 0 65535 /end CHARACTERISTIC
/begin CHARACTERISTIC FaultManager.MAP_STICKING.Faulty_Samples__X_ "Fault manager configuration.  Select up to 4 actions for each fault." VALUE 0x8000371D RecordLayout_8 0 CompuMethod_1 0 65535 /end CHARACTERISTIC
/begin CHARACTERISTIC FaultManager.MAP_STICKING.Total_Samples__Y_ "Fault manager configuration.  Select up to 4 actions for each fault." VALUE 0x8000371F RecordLayout_8 0 CompuMethod_1 0 65535 /end CHARACTERISTIC
/begin CHARACTERISTIC FaultManager.MAP_STICKING.Action_1 "Fault manager configuration.  Select up to 4 actions for each fault." VALUE 0x80003721 RecordLayout_8 0 CompuMethod_110 0 65535 /end CHARACTERISTIC
/begin CHARACTERISTIC FaultManager.MAP_STICKING.Action_1_Condition "Fault manager configuration.  Select up to 4 actions for each fault." VALUE 0x80003723 RecordLayout_8 0 CompuMethod_111 0 65535 /end CHARACTERISTIC
/begin CHARACTERISTIC FaultManager.MAP_STICKING.Action_2 "Fault manager configuration.  Select up to 4 actions for each fault." VALUE 0x80003725 RecordLayout_8 0 CompuMethod_110 0 65535 /end CHARACTERISTIC
/begin CHARACTERISTIC FaultManager.MAP_STICKING.Action_2_Condition "Fault manager configuration.  Select up to 4 actions for each fault." VALUE 0x80003727 RecordLayout_8 0 CompuMethod_111 0 65535 /end CHARACTERISTIC
/begin CHARACTERISTIC FaultManager.MAP_STICKING.Action_3 "Fault manager configuration.  Select up to 4 actions for each fault." VALUE 0x80003729 RecordLayout_8 0 CompuMethod_110 0 65535 /end CHARACTERISTIC
/begin CHARACTERISTIC FaultManager.MAP_STICKING.Action_3_Condition "Fault manager configuration.  Select up to 4 actions for each fault." VALUE 0x8000372B RecordLayout_8 0 CompuMethod_111 0 65535 /end CHARACTERISTIC
/begin CHARACTERISTIC FaultManager.MAP_STICKING.Action_4 "Fault manager configuration.  Select up to 4 actions for each fault." VALUE 0x8000372D RecordLayout_8 0 CompuMethod_110 0 65535 /end CHARACTERISTIC
/begin CHARACTERISTIC FaultManager.MAP_STICKING.Action_4_Condition "Fault manager configuration.  Select up to 4 actions for each fault." VALUE 0x8000372F RecordLayout_8 0 CompuMethod_111 0 65535 /end CHARACTERISTIC
/begin CHARACTERISTIC FaultManager.MediumOverspeed.Mode "Fault manager configuration.  Select up to 4 actions for each fault." VALUE 0x80003731 RecordLayout_8 0 CompuMethod_108 0 65535 /end CHARACTERISTIC
/begin CHARACTERISTIC FaultManager.MediumOverspeed.ID "Fault manager configuration.  Select up to 4 actions for each fault." VALUE 0x80003733 RecordLayout_8 0 CompuMethod_1 0 65535 /end CHARACTERISTIC
/begin CHARACTERISTIC FaultManager.MediumOverspeed.Test "Fault manager configuration.  Select up to 4 actions for each fault." VALUE 0x80003735 RecordLayout_8 0 CompuMethod_109 0 65535 /end CHARACTERISTIC
/begin CHARACTERISTIC FaultManager.MediumOverspeed.Faulty_Samples__X_ "Fault manager configuration.  Select up to 4 actions for each fault." VALUE 0x80003737 RecordLayout_8 0 CompuMethod_1 0 65535 /end CHARACTERISTIC
/begin CHARACTERISTIC FaultManager.MediumOverspeed.Total_Samples__Y_ "Fault manager configuration.  Select up to 4 actions for each fault." VALUE 0x80003739 RecordLayout_8 0 CompuMethod_1 0 65535 /end CHARACTERISTIC
/begin CHARACTERISTIC FaultManager.MediumOverspeed.Action_1 "Fault manager configuration.  Select up to 4 actions for each fault." VALUE 0x8000373B RecordLayout_8 0 CompuMethod_110 0 65535 /end CHARACTERISTIC
/begin CHARACTERISTIC FaultManager.MediumOverspeed.Action_1_Condition "Fault manager configuration.  Select up to 4 actions for each fault." VALUE 0x8000373D RecordLayout_8 0 CompuMethod_111 0 65535 /end CHARACTERISTIC
/begin CHARACTERISTIC FaultManager.MediumOverspeed.Action_2 "Fault manager configuration.  Select up to 4 actions for each fault." VALUE 0x8000373F RecordLayout_8 0 CompuMethod_110 0 65535 /end CHARACTERISTIC
/begin CHARACTERISTIC FaultManager.MediumOverspeed.Action_2_Condition "Fault manager configuration.  Select up to 4 actions for each fault." VALUE 0x80003741 RecordLayout_8 0 CompuMethod_111 0 65535 /end CHARACTERISTIC
/begin CHARACTERISTIC FaultManager.MediumOverspeed.Action_3 "Fault manager configuration.  Select up to 4 actions for each fault." VALUE 0x80003743 RecordLayout_8 0 CompuMethod_110 0 65535 /end CHARACTERISTIC
/begin CHARACTERISTIC FaultManager.MediumOverspeed.Action_3_Condition "Fault manager configuration.  Select up to 4 actions for each fault." VALUE 0x80003745 RecordLayout_8 0 CompuMethod_111 0 65535 /end CHARACTERISTIC
/begin CHARACTERISTIC FaultManager.MediumOverspeed.Action_4 "Fault manager configuration.  Select up to 4 actions for each fault." VALUE 0x80003747 RecordLayout_8 0 CompuMethod_110 0 65535 /end CHARACTERISTIC
/begin CHARACTERISTIC FaultManager.MediumOverspeed.Action_4_Condition "Fault manager configuration.  Select up to 4 actions for each fault." VALUE 0x80003749 RecordLayout_8 0 CompuMethod_111 0 65535 /end CHARACTERISTIC
/begin CHARACTERISTIC FaultManager.NoOil_Fault.Mode "Fault manager configuration.  Select up to 4 actions for each fault." VALUE 0x8000374B RecordLayout_8 0 CompuMethod_108 0 65535 /end CHARACTERISTIC
/begin CHARACTERISTIC FaultManager.NoOil_Fault.ID "Fault manager configuration.  Select up to 4 actions for each fault." VALUE 0x8000374D RecordLayout_8 0 CompuMethod_1 0 65535 /end CHARACTERISTIC
/begin CHARACTERISTIC FaultManager.NoOil_Fault.Test "Fault manager configuration.  Select up to 4 actions for each fault." VALUE 0x8000374F RecordLayout_8 0 CompuMethod_109 0 65535 /end CHARACTERISTIC
/begin CHARACTERISTIC FaultManager.NoOil_Fault.Faulty_Samples__X_ "Fault manager configuration.  Select up to 4 actions for each fault." VALUE 0x80003751 RecordLayout_8 0 CompuMethod_1 0 65535 /end CHARACTERISTIC
/begin CHARACTERISTIC FaultManager.NoOil_Fault.Total_Samples__Y_ "Fault manager configuration.  Select up to 4 actions for each fault." VALUE 0x80003753 RecordLayout_8 0 CompuMethod_1 0 65535 /end CHARACTERISTIC
/begin CHARACTERISTIC FaultManager.NoOil_Fault.Action_1 "Fault manager configuration.  Select up to 4 actions for each fault." VALUE 0x80003755 RecordLayout_8 0 CompuMethod_110 0 65535 /end CHARACTERISTIC
/begin CHARACTERISTIC FaultManager.NoOil_Fault.Action_1_Condition "Fault manager configuration.  Select up to 4 actions for each fault." VALUE 0x80003757 RecordLayout_8 0 CompuMethod_111 0 65535 /end CHARACTERISTIC
/begin CHARACTERISTIC FaultManager.NoOil_Fault.Action_2 "Fault manager configuration.  Select up to 4 actions for each fault." VALUE 0x80003759 RecordLayout_8 0 CompuMethod_110 0 65535 /end CHARACTERISTIC
/begin CHARACTERISTIC FaultManager.NoOil_Fault.Action_2_Condition "Fault manager configuration.  Select up to 4 actions for each fault." VALUE 0x8000375B RecordLayout_8 0 CompuMethod_111 0 65535 /end CHARACTERISTIC
/begin CHARACTERISTIC FaultManager.NoOil_Fault.Action_3 "Fault manager configuration.  Select up to 4 actions for each fault." VALUE 0x8000375D RecordLayout_8 0 CompuMethod_110 0 65535 /end CHARACTERISTIC
/begin CHARACTERISTIC FaultManager.NoOil_Fault.Action_3_Condition "Fault manager configuration.  Select up to 4 actions for each fault." VALUE 0x8000375F RecordLayout_8 0 CompuMethod_111 0 65535 /end CHARACTERISTIC
/begin CHARACTERISTIC FaultManager.NoOil_Fault.Action_4 "Fault manager configuration.  Select up to 4 actions for each fault." VALUE 0x80003761 RecordLayout_8 0 CompuMethod_110 0 65535 /end CHARACTERISTIC
/begin CHARACTERISTIC FaultManager.NoOil_Fault.Action_4_Condition "Fault manager configuration.  Select up to 4 actions for each fault." VALUE 0x80003763 RecordLayout_8 0 CompuMethod_111 0 65535 /end CHARACTERISTIC
/begin CHARACTERISTIC FaultManager.O2FailedLean.Mode "Fault manager configuration.  Select up to 4 actions for each fault." VALUE 0x80003765 RecordLayout_8 0 CompuMethod_108 0 65535 /end CHARACTERISTIC
/begin CHARACTERISTIC FaultManager.O2FailedLean.ID "Fault manager configuration.  Select up to 4 actions for each fault." VALUE 0x80003767 RecordLayout_8 0 CompuMethod_1 0 65535 /end CHARACTERISTIC
/begin CHARACTERISTIC FaultManager.O2FailedLean.Test "Fault manager configuration.  Select up to 4 actions for each fault." VALUE 0x80003769 RecordLayout_8 0 CompuMethod_109 0 65535 /end CHARACTERISTIC
/begin CHARACTERISTIC FaultManager.O2FailedLean.Faulty_Samples__X_ "Fault manager configuration.  Select up to 4 actions for each fault." VALUE 0x8000376B RecordLayout_8 0 CompuMethod_1 0 65535 /end CHARACTERISTIC
/begin CHARACTERISTIC FaultManager.O2FailedLean.Total_Samples__Y_ "Fault manager configuration.  Select up to 4 actions for each fault." VALUE 0x8000376D RecordLayout_8 0 CompuMethod_1 0 65535 /end CHARACTERISTIC
/begin CHARACTERISTIC FaultManager.O2FailedLean.Action_1 "Fault manager configuration.  Select up to 4 actions for each fault." VALUE 0x8000376F RecordLayout_8 0 CompuMethod_110 0 65535 /end CHARACTERISTIC
/begin CHARACTERISTIC FaultManager.O2FailedLean.Action_1_Condition "Fault manager configuration.  Select up to 4 actions for each fault." VALUE 0x80003771 RecordLayout_8 0 CompuMethod_111 0 65535 /end CHARACTERISTIC
/begin CHARACTERISTIC FaultManager.O2FailedLean.Action_2 "Fault manager configuration.  Select up to 4 actions for each fault." VALUE 0x80003773 RecordLayout_8 0 CompuMethod_110 0 65535 /end CHARACTERISTIC
/begin CHARACTERISTIC FaultManager.O2FailedLean.Action_2_Condition "Fault manager configuration.  Select up to 4 actions for each fault." VALUE 0x80003775 RecordLayout_8 0 CompuMethod_111 0 65535 /end CHARACTERISTIC
/begin CHARACTERISTIC FaultManager.O2FailedLean.Action_3 "Fault manager configuration.  Select up to 4 actions for each fault." VALUE 0x80003777 RecordLayout_8 0 CompuMethod_110 0 65535 /end CHARACTERISTIC
/begin CHARACTERISTIC FaultManager.O2FailedLean.Action_3_Condition "Fault manager configuration.  Select up to 4 actions for each fault." VALUE 0x80003779 RecordLayout_8 0 CompuMethod_111 0 65535 /end CHARACTERISTIC
/begin CHARACTERISTIC FaultManager.O2FailedLean.Action_4 "Fault manager configuration.  Select up to 4 actions for each fault." VALUE 0x8000377B RecordLayout_8 0 CompuMethod_110 0 65535 /end CHARACTERISTIC
/begin CHARACTERISTIC FaultManager.O2FailedLean.Action_4_Condition "Fault manager configuration.  Select up to 4 actions for each fault." VALUE 0x8000377D RecordLayout_8 0 CompuMethod_111 0 65535 /end CHARACTERISTIC
/begin CHARACTERISTIC FaultManager.O2FailedRich.Mode "Fault manager configuration.  Select up to 4 actions for each fault." VALUE 0x8000377F RecordLayout_8 0 CompuMethod_108 0 65535 /end CHARACTERISTIC
/begin CHARACTERISTIC FaultManager.O2FailedRich.ID "Fault manager configuration.  Select up to 4 actions for each fault." VALUE 0x80003781 RecordLayout_8 0 CompuMethod_1 0 65535 /end CHARACTERISTIC
/begin CHARACTERISTIC FaultManager.O2FailedRich.Test "Fault manager configuration.  Select up to 4 actions for each fault." VALUE 0x80003783 RecordLayout_8 0 CompuMethod_109 0 65535 /end CHARACTERISTIC
/begin CHARACTERISTIC FaultManager.O2FailedRich.Faulty_Samples__X_ "Fault manager configuration.  Select up to 4 actions for each fault." VALUE 0x80003785 RecordLayout_8 0 CompuMethod_1 0 65535 /end CHARACTERISTIC
/begin CHARACTERISTIC FaultManager.O2FailedRich.Total_Samples__Y_ "Fault manager configuration.  Select up to 4 actions for each fault." VALUE 0x80003787 RecordLayout_8 0 CompuMethod_1 0 65535 /end CHARACTERISTIC
/begin CHARACTERISTIC FaultManager.O2FailedRich.Action_1 "Fault manager configuration.  Select up to 4 actions for each fault." VALUE 0x80003789 RecordLayout_8 0 CompuMethod_110 0 65535 /end CHARACTERISTIC
/begin CHARACTERISTIC FaultManager.O2FailedRich.Action_1_Condition "Fault manager configuration.  Select up to 4 actions for each fault." VALUE 0x8000378B RecordLayout_8 0 CompuMethod_111 0 65535 /end CHARACTERISTIC
/begin CHARACTERISTIC FaultManager.O2FailedRich.Action_2 "Fault manager configuration.  Select up to 4 actions for each fault." VALUE 0x8000378D RecordLayout_8 0 CompuMethod_110 0 65535 /end CHARACTERISTIC
/begin CHARACTERISTIC FaultManager.O2FailedRich.Action_2_Condition "Fault manager configuration.  Select up to 4 actions for each fault." VALUE 0x8000378F RecordLayout_8 0 CompuMethod_111 0 65535 /end CHARACTERISTIC
/begin CHARACTERISTIC FaultManager.O2FailedRich.Action_3 "Fault manager configuration.  Select up to 4 actions for each fault." VALUE 0x80003791 RecordLayout_8 0 CompuMethod_110 0 65535 /end CHARACTERISTIC
/begin CHARACTERISTIC FaultManager.O2FailedRich.Action_3_Condition "Fault manager configuration.  Select up to 4 actions for each fault." VALUE 0x80003793 RecordLayout_8 0 CompuMethod_111 0 65535 /end CHARACTERISTIC
/begin CHARACTERISTIC FaultManager.O2FailedRich.Action_4 "Fault manager configuration.  Select up to 4 actions for each fault." VALUE 0x80003795 RecordLayout_8 0 CompuMethod_110 0 65535 /end CHARACTERISTIC
/begin CHARACTERISTIC FaultManager.O2FailedRich.Action_4_Condition "Fault manager configuration.  Select up to 4 actions for each fault." VALUE 0x80003797 RecordLayout_8 0 CompuMethod_111 0 65535 /end CHARACTERISTIC
/begin CHARACTERISTIC FaultManager.O2NotActive.Mode "Fault manager configuration.  Select up to 4 actions for each fault." VALUE 0x80003799 RecordLayout_8 0 CompuMethod_108 0 65535 /end CHARACTERISTIC
/begin CHARACTERISTIC FaultManager.O2NotActive.ID "Fault manager configuration.  Select up to 4 actions for each fault." VALUE 0x8000379B RecordLayout_8 0 CompuMethod_1 0 65535 /end CHARACTERISTIC
/begin CHARACTERISTIC FaultManager.O2NotActive.Test "Fault manager configuration.  Select up to 4 actions for each fault." VALUE 0x8000379D RecordLayout_8 0 CompuMethod_109 0 65535 /end CHARACTERISTIC
/begin CHARACTERISTIC FaultManager.O2NotActive.Faulty_Samples__X_ "Fault manager configuration.  Select up to 4 actions for each fault." VALUE 0x8000379F RecordLayout_8 0 CompuMethod_1 0 65535 /end CHARACTERISTIC
/begin CHARACTERISTIC FaultManager.O2NotActive.Total_Samples__Y_ "Fault manager configuration.  Select up to 4 actions for each fault." VALUE 0x800037A1 RecordLayout_8 0 CompuMethod_1 0 65535 /end CHARACTERISTIC
/begin CHARACTERISTIC FaultManager.O2NotActive.Action_1 "Fault manager configuration.  Select up to 4 actions for each fault." VALUE 0x800037A3 RecordLayout_8 0 CompuMethod_110 0 65535 /end CHARACTERISTIC
/begin CHARACTERISTIC FaultManager.O2NotActive.Action_1_Condition "Fault manager configuration.  Select up to 4 actions for each fault." VALUE 0x800037A5 RecordLayout_8 0 CompuMethod_111 0 65535 /end CHARACTERISTIC
/begin CHARACTERISTIC FaultManager.O2NotActive.Action_2 "Fault manager configuration.  Select up to 4 actions for each fault." VALUE 0x800037A7 RecordLayout_8 0 CompuMethod_110 0 65535 /end CHARACTERISTIC
/begin CHARACTERISTIC FaultManager.O2NotActive.Action_2_Condition "Fault manager configuration.  Select up to 4 actions for each fault." VALUE 0x800037A9 RecordLayout_8 0 CompuMethod_111 0 65535 /end CHARACTERISTIC
/begin CHARACTERISTIC FaultManager.O2NotActive.Action_3 "Fault manager configuration.  Select up to 4 actions for each fault." VALUE 0x800037AB RecordLayout_8 0 CompuMethod_110 0 65535 /end CHARACTERISTIC
/begin CHARACTERISTIC FaultManager.O2NotActive.Action_3_Condition "Fault manager configuration.  Select up to 4 actions for each fault." VALUE 0x800037AD RecordLayout_8 0 CompuMethod_111 0 65535 /end CHARACTERISTIC
/begin CHARACTERISTIC FaultManager.O2NotActive.Action_4 "Fault manager configuration.  Select up to 4 actions for each fault." VALUE 0x800037AF RecordLayout_8 0 CompuMethod_110 0 65535 /end CHARACTERISTIC
/begin CHARACTERISTIC FaultManager.O2NotActive.Action_4_Condition "Fault manager configuration.  Select up to 4 actions for each fault." VALUE 0x800037B1 RecordLayout_8 0 CompuMethod_111 0 65535 /end CHARACTERISTIC
/begin CHARACTERISTIC FaultManager.OilPresRangeHigh.Mode "Fault manager configuration.  Select up to 4 actions for each fault." VALUE 0x800037B3 RecordLayout_8 0 CompuMethod_108 0 65535 /end CHARACTERISTIC
/begin CHARACTERISTIC FaultManager.OilPresRangeHigh.ID "Fault manager configuration.  Select up to 4 actions for each fault." VALUE 0x800037B5 RecordLayout_8 0 CompuMethod_1 0 65535 /end CHARACTERISTIC
/begin CHARACTERISTIC FaultManager.OilPresRangeHigh.Test "Fault manager configuration.  Select up to 4 actions for each fault." VALUE 0x800037B7 RecordLayout_8 0 CompuMethod_109 0 65535 /end CHARACTERISTIC
/begin CHARACTERISTIC FaultManager.OilPresRangeHigh.Faulty_Samples__X_ "Fault manager configuration.  Select up to 4 actions for each fault." VALUE 0x800037B9 RecordLayout_8 0 CompuMethod_1 0 65535 /end CHARACTERISTIC
/begin CHARACTERISTIC FaultManager.OilPresRangeHigh.Total_Samples__Y_ "Fault manager configuration.  Select up to 4 actions for each fault." VALUE 0x800037BB RecordLayout_8 0 CompuMethod_1 0 65535 /end CHARACTERISTIC
/begin CHARACTERISTIC FaultManager.OilPresRangeHigh.Action_1 "Fault manager configuration.  Select up to 4 actions for each fault." VALUE 0x800037BD RecordLayout_8 0 CompuMethod_110 0 65535 /end CHARACTERISTIC
/begin CHARACTERISTIC FaultManager.OilPresRangeHigh.Action_1_Condition "Fault manager configuration.  Select up to 4 actions for each fault." VALUE 0x800037BF RecordLayout_8 0 CompuMethod_111 0 65535 /end CHARACTERISTIC
/begin CHARACTERISTIC FaultManager.OilPresRangeHigh.Action_2 "Fault manager configuration.  Select up to 4 actions for each fault." VALUE 0x800037C1 RecordLayout_8 0 CompuMethod_110 0 65535 /end CHARACTERISTIC
/begin CHARACTERISTIC FaultManager.OilPresRangeHigh.Action_2_Condition "Fault manager configuration.  Select up to 4 actions for each fault." VALUE 0x800037C3 RecordLayout_8 0 CompuMethod_111 0 65535 /end CHARACTERISTIC
/begin CHARACTERISTIC FaultManager.OilPresRangeHigh.Action_3 "Fault manager configuration.  Select up to 4 actions for each fault." VALUE 0x800037C5 RecordLayout_8 0 CompuMethod_110 0 65535 /end CHARACTERISTIC
/begin CHARACTERISTIC FaultManager.OilPresRangeHigh.Action_3_Condition "Fault manager configuration.  Select up to 4 actions for each fault." VALUE 0x800037C7 RecordLayout_8 0 CompuMethod_111 0 65535 /end CHARACTERISTIC
/begin CHARACTERISTIC FaultManager.OilPresRangeHigh.Action_4 "Fault manager configuration.  Select up to 4 actions for each fault." VALUE 0x800037C9 RecordLayout_8 0 CompuMethod_110 0 65535 /end CHARACTERISTIC
/begin CHARACTERISTIC FaultManager.OilPresRangeHigh.Action_4_Condition "Fault manager configuration.  Select up to 4 actions for each fault." VALUE 0x800037CB RecordLayout_8 0 CompuMethod_111 0 65535 /end CHARACTERISTIC
/begin CHARACTERISTIC FaultManager.OilPresRangeLow.Mode "Fault manager configuration.  Select up to 4 actions for each fault." VALUE 0x800037CD RecordLayout_8 0 CompuMethod_108 0 65535 /end CHARACTERISTIC
/begin CHARACTERISTIC FaultManager.OilPresRangeLow.ID "Fault manager configuration.  Select up to 4 actions for each fault." VALUE 0x800037CF RecordLayout_8 0 CompuMethod_1 0 65535 /end CHARACTERISTIC
/begin CHARACTERISTIC FaultManager.OilPresRangeLow.Test "Fault manager configuration.  Select up to 4 actions for each fault." VALUE 0x800037D1 RecordLayout_8 0 CompuMethod_109 0 65535 /end CHARACTERISTIC
/begin CHARACTERISTIC FaultManager.OilPresRangeLow.Faulty_Samples__X_ "Fault manager configuration.  Select up to 4 actions for each fault." VALUE 0x800037D3 RecordLayout_8 0 CompuMethod_1 0 65535 /end CHARACTERISTIC
/begin CHARACTERISTIC FaultManager.OilPresRangeLow.Total_Samples__Y_ "Fault manager configuration.  Select up to 4 actions for each fault." VALUE 0x800037D5 RecordLayout_8 0 CompuMethod_1 0 65535 /end CHARACTERISTIC
/begin CHARACTERISTIC FaultManager.OilPresRangeLow.Action_1 "Fault manager configuration.  Select up to 4 actions for each fault." VALUE 0x800037D7 RecordLayout_8 0 CompuMethod_110 0 65535 /end CHARACTERISTIC
/begin CHARACTERISTIC FaultManager.OilPresRangeLow.Action_1_Condition "Fault manager configuration.  Select up to 4 actions for each fault." VALUE 0x800037D9 RecordLayout_8 0 CompuMethod_111 0 65535 /end CHARACTERISTIC
/begin CHARACTERISTIC FaultManager.OilPresRangeLow.Action_2 "Fault manager configuration.  Select up to 4 actions for each fault." VALUE 0x800037DB RecordLayout_8 0 CompuMethod_110 0 65535 /end CHARACTERISTIC
/begin CHARACTERISTIC FaultManager.OilPresRangeLow.Action_2_Condition "Fault manager configuration.  Select up to 4 actions for each fault." VALUE 0x800037DD RecordLayout_8 0 CompuMethod_111 0 65535 /end CHARACTERISTIC
/begin CHARACTERISTIC FaultManager.OilPresRangeLow.Action_3 "Fault manager configuration.  Select up to 4 actions for each fault." VALUE 0x800037DF RecordLayout_8 0 CompuMethod_110 0 65535 /end CHARACTERISTIC
/begin CHARACTERISTIC FaultManager.OilPresRangeLow.Action_3_Condition "Fault manager configuration.  Select up to 4 actions for each fault." VALUE 0x800037E1 RecordLayout_8 0 CompuMethod_111 0 65535 /end CHARACTERISTIC
/begin CHARACTERISTIC FaultManager.OilPresRangeLow.Action_4 "Fault manager configuration.  Select up to 4 actions for each fault." VALUE 0x800037E3 RecordLayout_8 0 CompuMethod_110 0 65535 /end CHARACTERISTIC
/begin CHARACTERISTIC FaultManager.OilPresRangeLow.Action_4_Condition "Fault manager configuration.  Select up to 4 actions for each fault." VALUE 0x800037E5 RecordLayout_8 0 CompuMethod_111 0 65535 /end CHARACTERISTIC
/begin CHARACTERISTIC FaultManager.SensVoltRangeHigh.Mode "Fault manager configuration.  Select up to 4 actions for each fault." VALUE 0x800037E7 RecordLayout_8 0 CompuMethod_108 0 65535 /end CHARACTERISTIC
/begin CHARACTERISTIC FaultManager.SensVoltRangeHigh.ID "Fault manager configuration.  Select up to 4 actions for each fault." VALUE 0x800037E9 RecordLayout_8 0 CompuMethod_1 0 65535 /end CHARACTERISTIC
/begin CHARACTERISTIC FaultManager.SensVoltRangeHigh.Test "Fault manager configuration.  Select up to 4 actions for each fault." VALUE 0x800037EB RecordLayout_8 0 CompuMethod_109 0 65535 /end CHARACTERISTIC
/begin CHARACTERISTIC FaultManager.SensVoltRangeHigh.Faulty_Samples__X_ "Fault manager configuration.  Select up to 4 actions for each fault." VALUE 0x800037ED RecordLayout_8 0 CompuMethod_1 0 65535 /end CHARACTERISTIC
/begin CHARACTERISTIC FaultManager.SensVoltRangeHigh.Total_Samples__Y_ "Fault manager configuration.  Select up to 4 actions for each fault." VALUE 0x800037EF RecordLayout_8 0 CompuMethod_1 0 65535 /end CHARACTERISTIC
/begin CHARACTERISTIC FaultManager.SensVoltRangeHigh.Action_1 "Fault manager configuration.  Select up to 4 actions for each fault." VALUE 0x800037F1 RecordLayout_8 0 CompuMethod_110 0 65535 /end CHARACTERISTIC
/begin CHARACTERISTIC FaultManager.SensVoltRangeHigh.Action_1_Condition "Fault manager configuration.  Select up to 4 actions for each fault." VALUE 0x800037F3 RecordLayout_8 0 CompuMethod_111 0 65535 /end CHARACTERISTIC
/begin CHARACTERISTIC FaultManager.SensVoltRangeHigh.Action_2 "Fault manager configuration.  Select up to 4 actions for each fault." VALUE 0x800037F5 RecordLayout_8 0 CompuMethod_110 0 65535 /end CHARACTERISTIC
/begin CHARACTERISTIC FaultManager.SensVoltRangeHigh.Action_2_Condition "Fault manager configuration.  Select up to 4 actions for each fault." VALUE 0x800037F7 RecordLayout_8 0 CompuMethod_111 0 65535 /end CHARACTERISTIC
/begin CHARACTERISTIC FaultManager.SensVoltRangeHigh.Action_3 "Fault manager configuration.  Select up to 4 actions for each fault." VALUE 0x800037F9 RecordLayout_8 0 CompuMethod_110 0 65535 /end CHARACTERISTIC
/begin CHARACTERISTIC FaultManager.SensVoltRangeHigh.Action_3_Condition "Fault manager configuration.  Select up to 4 actions for each fault." VALUE 0x800037FB RecordLayout_8 0 CompuMethod_111 0 65535 /end CHARACTERISTIC
/begin CHARACTERISTIC FaultManager.SensVoltRangeHigh.Action_4 "Fault manager configuration.  Select up to 4 actions for each fault." VALUE 0x800037FD RecordLayout_8 0 CompuMethod_110 0 65535 /end CHARACTERISTIC
/begin CHARACTERISTIC FaultManager.SensVoltRangeHigh.Action_4_Condition "Fault manager configuration.  Select up to 4 actions for each fault." VALUE 0x800037FF RecordLayout_8 0 CompuMethod_111 0 65535 /end CHARACTERISTIC
/begin CHARACTERISTIC FaultManager.SensVoltRangeLow.Mode "Fault manager configuration.  Select up to 4 actions for each fault." VALUE 0x80003801 RecordLayout_8 0 CompuMethod_108 0 65535 /end CHARACTERISTIC
/begin RECORD_LAYOUT RecordLayout_8 FNC_VALUES 1 UWORD ROW_DIR DIRECT /end RECORD_LAYOUT
/*~~~~~~~~~ 6.3.31 COMPU_METHODs ~~~~~~~~~*/
/begin COMPU_METHOD CompuMethod_1 "" RAT_FUNC "%3.0" "" COEFFS 0 1 0 0 0 1 /end COMPU_METHOD
/begin COMPU_METHOD CompuMethod_108 "" TAB_VERB "%3.0" "" COMPU_TAB_REF CompuVtab_33 /end COMPU_METHOD
/begin COMPU_METHOD CompuMethod_109 "" TAB_VERB "%3.0" "" COMPU_TAB_REF CompuVtab_34 /end COMPU_METHOD
/begin COMPU_METHOD CompuMethod_110 "" TAB_VERB "%3.0" "" COMPU_TAB_REF CompuVtab_35 /end COMPU_METHOD
/begin COMPU_METHOD CompuMethod_111 "" TAB_VERB "%3.0" "" COMPU_TAB_REF CompuVtab_36 /end COMPU_METHOD
/begin COMPU_VTAB CompuVtab_33 "" TAB_VERB 6 0 "Disabled" 1 "Enabled" 2 "Sticky" 3 "Enabled - Persistent" 4 "Sticky - Persistent" 5 "Save Occurred" /end COMPU_VTAB
/begin COMPU_VTAB CompuVtab_34 "" TAB_VERB 2 0 "-" 1 "Test" /end COMPU_VTAB
/begin COMPU_VTAB CompuVtab_35 "" TAB_VERB 14 0 "CutThrottle" 1 "DFCODisable" 2 "DelayedEngineShutdown" 3 "DisableAC" 4 "DisableO2Ctrl" 5 "DisableVEAdapt" 6 "DisableWastegate" 7 "EngineProtectLED" 8 "EngineShutdown" 9 "HardRevLimit" 10 "MIL_LED" 11 "MediumRevLimit" 12 "SoftRevLimit" 13 "(None)" /end COMPU_VTAB
/begin COMPU_VTAB CompuVtab_36 "" TAB_VERB 8 0 "(None)" 1 "Suspected" 2 "Active" 3 "Suspected or Active" 4 "Occurred" 5 "Suspected or Occurred" 6 "Active or Occurred" 7 "Suspected or Active or Occurred" /end COMPU_VTAB
/begin FUNCTION BaseEngineController_LS ""
 /begin DEF_CHARACTERISTIC FaultManager.EST6_Open.Action_1_Condition FaultManager.EST6_Open.Action_2 FaultManager.EST6_Open.Action_2_Condition FaultManager.EST6_Open.Action_3 FaultManager.EST6_Open.Action_3_Condition FaultManager.EST6_Open.Action_4 FaultManager.EST6_Open.Action_4_Condition FaultManager.EST6_Short.Mode FaultManager.EST6_Short.ID FaultManager.EST6_Short.Test FaultManager.EST6_Short.Faulty_Samples__X_ FaultManager.EST6_Short.Total_Samples__Y_ FaultManager.EST6_Short.Action_1 FaultManager.EST6_Short.Action_1_Condition FaultManager.EST6_Short.Action_2 FaultManager.EST6_Short.Action_2_Condition FaultManager.EST6_Short.Action_3 FaultManager.EST6_Short.Action_3_Condition FaultManager.EST6_Short.Action_4 FaultManager.EST6_Short.Action_4_Condition FaultManager.EST7_Open.Mode FaultManager.EST7_Open.ID FaultManager.EST7_Open.Test FaultManager.EST7_Open.Faulty_Samples__X_ FaultManager.EST7_Open.Total_Samples__Y_ FaultManager.EST7_Open.Action_1 FaultManager.EST7_Open.Action_1_Condition FaultManager.EST7_Open.Action_2 FaultManager.EST7_Open.Action_2_Condition FaultManager.EST7_Open.Action_3 FaultManager.EST7_Open.Action_3_Condition FaultManager.EST7_Open.Action_4 FaultManager.EST7_Open.Action_4_Condition FaultManager.EST7_Short.Mode FaultManager.EST7_Short.ID FaultManager.EST7_Short.Test FaultManager.EST7_Short.Faulty_Samples__X_ FaultManager.EST7_Short.Total_Samples__Y_ FaultManager.EST7_Short.Action_1 FaultManager.EST7_Short.Action_1_Condition FaultManager.EST7_Short.Action_2 FaultManager.EST7_Short.Action_2_Condition FaultManager.EST7_Short.Action_3 FaultManager.EST7_Short.Action_3_Condition FaultManager.EST7_Short.Action_4 FaultManager.EST7_Short.Action_4_Condition FaultManager.EST8_Open.Mode FaultManager.EST8_Open.ID FaultManager.EST8_Open.Test FaultManager.EST8_Open.Faulty_Samples__X_ FaultManager.EST8_Open.Total_Samples__Y_ FaultManager.EST8_Open.Action_1 FaultManager.EST8_Open.Action_1_Condition FaultManager.EST8_Open.Action_2 FaultManager.EST8_Open.Action_2_Condition FaultManager.EST8_Open.Action_3 FaultManager.EST8_Open.Action_3_Condition FaultManager.EST8_Open.Action_4 FaultManager.EST8_Open.Action_4_Condition FaultManager.EST8_Short.Mode FaultManager.EST8_Short.ID FaultManager.EST8_Short.Test FaultManager.EST8_Short.Faulty_Samples__X_ FaultManager.EST8_Short.Total_Samples__Y_ FaultManager.EST8_Short.Action_1 FaultManager.EST8_Short.Action_1_Condition FaultManager.EST8_Short.Action_2 FaultManager.EST8_Short.Action_2_Condition FaultManager.EST8_Short.Action_3 FaultManager.EST8_Short.Action_3_Condition FaultManager.EST8_Short.Action_4 FaultManager.EST8_Short.Action_4_Condition FaultManager.ETCSpringTest.Mode FaultManager.ETCSpringTest.ID FaultManager.ETCSpringTest.Test FaultManager.ETCSpringTest.Faulty_Samples__X_ FaultManager.ETCSpringTest.Total_Samples__Y_ FaultManager.ETCSpringTest.Action_1 FaultManager.ETCSpringTest.Action_1_Condition FaultManager.ETCSpringTest.Action_2 FaultManager.ETCSpringTest.Action_2_Condition FaultManager.ETCSpringTest.Action_3 FaultManager.ETCSpringTest.Action_3_Condition FaultManager.ETCSpringTest.Action_4 FaultManager.ETCSpringTest.Action_4_Condition FaultManager.ETC_Open_Fault.Mode FaultManager.ETC_Open_Fault.ID FaultManager.ETC_Open_Fault.Test FaultManager.ETC_Open_Fault.Faulty_Samples__X_ FaultManager.ETC_Open_Fault.Total_Samples__Y_ FaultManager.ETC_Open_Fault.Action_1 FaultManager.ETC_Open_Fault.Action_1_Condition FaultManager.ETC_Open_Fault.Action_2 FaultManager.ETC_Open_Fault.Action_2_Condition FaultManager.ETC_Open_Fault.Action_3 FaultManager.ETC_Open_Fault.Action_3_Condition FaultManager.ETC_Open_Fault.Action_4 FaultManager.ETC_Open_Fault.Action_4_Condition FaultManager.ETC_Sticking.Mode FaultManager.ETC_Sticking.ID FaultManager.ETC_Sticking.Test FaultManager.ETC_Sticking.Faulty_Samples__X_ FaultManager.ETC_Sticking.Total_Samples__Y_ FaultManager.ETC_Sticking.Action_1 FaultManager.ETC_Sticking.Action_1_Condition FaultManager.ETC_Sticking.Action_2 FaultManager.ETC_Sticking.Action_2_Condition FaultManager.ETC_Sticking.Action_3 FaultManager.ETC_Sticking.Action_3_Condition FaultManager.ETC_Sticking.Action_4 FaultManager.ETC_Sticking.Action_4_Condition FaultManager.EVAPRangeHigh.Mode FaultManager.EVAPRangeHigh.ID FaultManager.EVAPRangeHigh.Test FaultManager.EVAPRangeHigh.Faulty_Samples__X_ FaultManager.EVAPRangeHigh.Total_Samples__Y_ FaultManager.EVAPRangeHigh.Action_1 FaultManager.EVAPRangeHigh.Action_1_Condition FaultManager.EVAPRangeHigh.Action_2 FaultManager.EVAPRangeHigh.Action_2_Condition FaultManager.EVAPRangeHigh.Action_3 FaultManager.EVAPRangeHigh.Action_3_Condition FaultManager.EVAPRangeHigh.Action_4 FaultManager.EVAPRangeHigh.Action_4_Condition FaultManager.EVAPRangeLow.Mode FaultManager.EVAPRangeLow.ID FaultManager.EVAPRangeLow.Test FaultManager.EVAPRangeLow.Faulty_Samples__X_ FaultManager.EVAPRangeLow.Total_Samples__Y_ FaultManager.EVAPRangeLow.Action_1 FaultManager.EVAPRangeLow.Action_1_Condition FaultManager.EVAPRangeLow.Action_2 FaultManager.EVAPRangeLow.Action_2_Condition FaultManager.EVAPRangeLow.Action_3 FaultManager.EVAPRangeLow.Action_3_Condition FaultManager.EVAPRangeLow.Action_4 FaultManager.EVAPRangeLow.Action_4_Condition FaultManager.FuelAdaptRangeHi.Mode FaultManager.FuelAdaptRangeHi.ID FaultManager.FuelAdaptRangeHi.Test FaultManager.FuelAdaptRangeHi.Faulty_Samples__X_ FaultManager.FuelAdaptRangeHi.Total_Samples__Y_ FaultManager.FuelAdaptRangeHi.Action_1 FaultManager.FuelAdaptRangeHi.Action_1_Condition FaultManager.FuelAdaptRangeHi.Action_2 FaultManager.FuelAdaptRangeHi.Action_2_Condition FaultManager.FuelAdaptRangeHi.Action_3 FaultManager.FuelAdaptRangeHi.Action_3_Condition FaultManager.FuelAdaptRangeHi.Action_4 FaultManager.FuelAdaptRangeHi.Action_4_Condition FaultManager.FuelAdaptRangeLow.Mode FaultManager.FuelAdaptRangeLow.ID FaultManager.FuelAdaptRangeLow.Test FaultManager.FuelAdaptRangeLow.Faulty_Samples__X_ FaultManager.FuelAdaptRangeLow.Total_Samples__Y_ FaultManager.FuelAdaptRangeLow.Action_1 FaultManager.FuelAdaptRangeLow.Action_1_Condition FaultManager.FuelAdaptRangeLow.Action_2 FaultManager.FuelAdaptRangeLow.Action_2_Condition FaultManager.FuelAdaptRangeLow.Action_3 FaultManager.FuelAdaptRangeLow.Action_3_Condition FaultManager.FuelAdaptRangeLow.Action_4 FaultManager.FuelAdaptRangeLow.Action_4_Condition FaultManager.FuelPresHigh_Fault.Mode FaultManager.FuelPresHigh_Fault.ID FaultManager.FuelPresHigh_Fault.Test FaultManager.FuelPresHigh_Fault.Faulty_Samples__X_ FaultManager.FuelPresHigh_Fault.Total_Samples__Y_ FaultManager.FuelPresHigh_Fault.Action_1 FaultManager.FuelPresHigh_Fault.Action_1_Condition FaultManager.FuelPresHigh_Fault.Action_2 FaultManager.FuelPresHigh_Fault.Action_2_Condition FaultManager.FuelPresHigh_Fault.Action_3 FaultManager.FuelPresHigh_Fault.Action_3_Condition FaultManager.FuelPresHigh_Fault.Action_4 FaultManager.FuelPresHigh_Fault.Action_4_Condition FaultManager.FuelPresLow_Fault.Mode FaultManager.FuelPresLow_Fault.ID FaultManager.FuelPresLow_Fault.Test FaultManager.FuelPresLow_Fault.Faulty_Samples__X_ FaultManager.FuelPresLow_Fault.Total_Samples__Y_ FaultManager.FuelPresLow_Fault.Action_1 FaultManager.FuelPresLow_Fault.Action_1_Condition FaultManager.FuelPresLow_Fault.Action_2 FaultManager.FuelPresLow_Fault.Action_2_Condition FaultManager.FuelPresLow_Fault.Action_3 FaultManager.FuelPresLow_Fault.Action_3_Condition FaultManager.FuelPresLow_Fault.Action_4 FaultManager.FuelPresLow_Fault.Action_4_Condition FaultManager.FuelPresRangeHigh.Mode FaultManager.FuelPresRangeHigh.ID FaultManager.FuelPresRangeHigh.Test FaultManager.FuelPresRangeHigh.Faulty_Samples__X_ FaultManager.FuelPresRangeHigh.Total_Samples__Y_ FaultManager.FuelPresRangeHigh.Action_1 FaultManager.FuelPresRangeHigh.Action_1_Condition FaultManager.FuelPresRangeHigh.Action_2 FaultManager.FuelPresRangeHigh.Action_2_Condition FaultManager.FuelPresRangeHigh.Action_3 FaultManager.FuelPresRangeHigh.Action_3_Condition FaultManager.FuelPresRangeHigh.Action_4 FaultManager.FuelPresRangeHigh.Action_4_Condition FaultManager.FuelPresRangeLow.Mode FaultManager.FuelPresRangeLow.ID FaultManager.FuelPresRangeLow.Test FaultManager.FuelPresRangeLow.Faulty_Samples__X_ FaultManager.FuelPresRangeLow.Total_Samples__Y_ FaultManager.FuelPresRangeLow.Action_1 FaultManager.FuelPresRangeLow.Action_1_Condition FaultManager.FuelPresRangeLow.Action_2 FaultManager.FuelPresRangeLow.Action_2_Condition FaultManager.FuelPresRangeLow.Action_3 FaultManager.FuelPresRangeLow.Action_3_Condition FaultManager.FuelPresRangeLow.Action_4 FaultManager.FuelPresRangeLow.Action_4_Condition FaultManager.FuelSensRangeHigh.Mode FaultManager.FuelSensRangeHigh.ID FaultManager.FuelSensRangeHigh.Test FaultManager.FuelSensRangeHigh.Faulty_Samples__X_ FaultManager.FuelSensRangeHigh.Total_Samples__Y_ FaultManager.FuelSensRangeHigh.Action_1 FaultManager.FuelSensRangeHigh.Action_1_Condition FaultManager.FuelSensRangeHigh.Action_2 FaultManager.FuelSensRangeHigh.Action_2_Condition FaultManager.FuelSensRangeHigh.Action_3 FaultManager.FuelSensRangeHigh.Action_3_Condition FaultManager.FuelSensRangeHigh.Action_4 FaultManager.FuelSensRangeHigh.Action_4_Condition FaultManager.FuelSensRangeLow.Mode FaultManager.FuelSensRangeLow.ID FaultManager.FuelSensRangeLow.Test FaultManager.FuelSensRangeLow.Faulty_Samples__X_ FaultManager.FuelSensRangeLow.Total_Samples__Y_ FaultManager.FuelSensRangeLow.Action_1 FaultManager.FuelSensRangeLow.Action_1_Condition FaultManager.FuelSensRangeLow.Action_2 FaultManager.FuelSensRangeLow.Action_2_Condition FaultManager.FuelSensRangeLow.Action_3 FaultManager.FuelSensRangeLow.Action_3_Condition FaultManager.FuelSensRangeLow.Action_4 FaultManager.FuelSensRangeLow.Action_4_Condition FaultManager.HardOverBoost_Fault.Mode FaultManager.HardOverBoost_Fault.ID FaultManager.HardOverBoost_Fault.Test FaultManager.HardOverBoost_Fault.Faulty_Samples__X_ FaultManager.HardOverBoost_Fault.Total_Samples__Y_ FaultManager.HardOverBoost_Fault.Action_1 FaultManager.HardOverBoost_Fault.Action_1_Condition FaultManager.HardOverBoost_Fault.Action_2 FaultManager.HardOverBoost_Fault.Action_2_Condition FaultManager.HardOverBoost_Fault.Action_3 FaultManager.HardOverBoost_Fault.Action_3_Condition FaultManager.HardOverBoost_Fault.Action_4 FaultManager.HardOverBoost_Fault.Action_4_Condition FaultManager.HardOverspeed.Mode FaultManager.HardOverspeed.ID FaultManager.HardOverspeed.Test FaultManager.HardOverspeed.Faulty_Samples__X_ FaultManager.HardOverspeed.Total_Samples__Y_ FaultManager.HardOverspeed.Action_1 FaultManager.HardOverspeed.Action_1_Condition FaultManager.HardOverspeed.Action_2 FaultManager.HardOverspeed.Action_2_Condition FaultManager.HardOverspeed.Action_3 FaultManager.HardOverspeed.Action_3_Condition FaultManager.HardOverspeed.Action_4 FaultManager.HardOverspeed.Action_4_Condition FaultManager.IATRangeHigh.Mode FaultManager.IATRangeHigh.ID FaultManager.IATRangeHigh.Test FaultManager.IATRangeHigh.Faulty_Samples__X_ FaultManager.IATRangeHigh.Total_Samples__Y_ FaultManager.IATRangeHigh.Action_1 FaultManager.IATRangeHigh.Action_1_Condition FaultManager.IATRangeHigh.Action_2 FaultManager.IATRangeHigh.Action_2_Condition FaultManager.IATRangeHigh.Action_3 FaultManager.IATRangeHigh.Action_3_Condition FaultManager.IATRangeHigh.Action_4 FaultManager.IATRangeHigh.Action_4_Condition FaultManager.IATRangeLow.Mode FaultManager.IATRangeLow.ID FaultManager.IATRangeLow.Test FaultManager.IATRangeLow.Faulty_Samples__X_ FaultManager.IATRangeLow.Total_Samples__Y_ FaultManager.IATRangeLow.Action_1 FaultManager.IATRangeLow.Action_1_Condition FaultManager.IATRangeLow.Action_2 FaultManager.IATRangeLow.Action_2_Condition FaultManager.IATRangeLow.Action_3 FaultManager.IATRangeLow.Action_3_Condition FaultManager.IATRangeLow.Action_4 FaultManager.IATRangeLow.Action_4_Condition FaultManager.Inj1Open.Mode FaultManager.Inj1Open.ID FaultManager.Inj1Open.Test FaultManager.Inj1Open.Faulty_Samples__X_ FaultManager.Inj1Open.Total_Samples__Y_ FaultManager.Inj1Open.Action_1 FaultManager.Inj1Open.Action_1_Condition FaultManager.Inj1Open.Action_2 FaultManager.Inj1Open.Action_2_Condition FaultManager.Inj1Open.Action_3 FaultManager.Inj1Open.Action_3_Condition FaultManager.Inj1Open.Action_4 FaultManager.Inj1Open.Action_4_Condition FaultManager.Inj2Open.Mode FaultManager.Inj2Open.ID FaultManager.Inj2Open.Test FaultManager.Inj2Open.Faulty_Samples__X_ FaultManager.Inj2Open.Total_Samples__Y_ FaultManager.Inj2Open.Action_1 FaultManager.Inj2Open.Action_1_Condition FaultManager.Inj2Open.Action_2 FaultManager.Inj2Open.Action_2_Condition FaultManager.Inj2Open.Action_3 FaultManager.Inj2Open.Action_3_Condition FaultManager.Inj2Open.Action_4 FaultManager.Inj2Open.Action_4_Condition FaultManager.Inj3Open.Mode FaultManager.Inj3Open.ID FaultManager.Inj3Open.Test FaultManager.Inj3Open.Faulty_Samples__X_ FaultManager.Inj3Open.Total_Samples__Y_ FaultManager.Inj3Open.Action_1 FaultManager.Inj3Open.Action_1_Condition FaultManager.Inj3Open.Action_2 FaultManager.Inj3Open.Action_2_Condition FaultManager.Inj3Open.Action_3 FaultManager.Inj3Open.Action_3_Condition FaultManager.Inj3Open.Action_4 FaultManager.Inj3Open.Action_4_Condition FaultManager.Inj4Open.Mode FaultManager.Inj4Open.ID FaultManager.Inj4Open.Test FaultManager.Inj4Open.Faulty_Samples__X_ FaultManager.Inj4Open.Total_Samples__Y_ FaultManager.Inj4Open.Action_1 FaultManager.Inj4Open.Action_1_Condition FaultManager.Inj4Open.Action_2 FaultManager.Inj4Open.Action_2_Condition FaultManager.Inj4Open.Action_3 FaultManager.Inj4Open.Action_3_Condition FaultManager.Inj4Open.Action_4 FaultManager.Inj4Open.Action_4_Condition FaultManager.Inj5Open.Mode FaultManager.Inj5Open.ID FaultManager.Inj5Open.Test FaultManager.Inj5Open.Faulty_Samples__X_ FaultManager.Inj5Open.Total_Samples__Y_ FaultManager.Inj5Open.Action_1 FaultManager.Inj5Open.Action_1_Condition FaultManager.Inj5Open.Action_2 FaultManager.Inj5Open.Action_2_Condition FaultManager.Inj5Open.Action_3 FaultManager.Inj5Open.Action_3_Condition FaultManager.Inj5Open.Action_4 FaultManager.Inj5Open.Action_4_Condition FaultManager.Inj6Open.Mode FaultManager.Inj6Open.ID FaultManager.Inj6Open.Test FaultManager.Inj6Open.Faulty_Samples__X_ FaultManager.Inj6Open.Total_Samples__Y_ FaultManager.Inj6Open.Action_1 FaultManager.Inj6Open.Action_1_Condition FaultManager.Inj6Open.Action_2 FaultManager.Inj6Open.Action_2_Condition FaultManager.Inj6Open.Action_3 FaultManager.Inj6Open.Action_3_Condition FaultManager.Inj6Open.Action_4 FaultManager.Inj6Open.Action_4_Condition FaultManager.Inj7Open.Mode FaultManager.Inj7Open.ID FaultManager.Inj7Open.Test FaultManager.Inj7Open.Faulty_Samples__X_ FaultManager.Inj7Open.Total_Samples__Y_ FaultManager.Inj7Open.Action_1 FaultManager.Inj7Open.Action_1_Condition FaultManager.Inj7Open.Action_2 FaultManager.Inj7Open.Action_2_Condition FaultManager.Inj7Open.Action_3 FaultManager.Inj7Open.Action_3_Condition FaultManager.Inj7Open.Action_4 FaultManager.Inj7Open.Action_4_Condition FaultManager.Inj8Open.Mode FaultManager.Inj8Open.ID FaultManager.Inj8Open.Test FaultManager.Inj8Open.Faulty_Samples__X_ FaultManager.Inj8Open.Total_Samples__Y_ FaultManager.Inj8Open.Action_1 FaultManager.Inj8Open.Action_1_Condition FaultManager.Inj8Open.Action_2 FaultManager.Inj8Open.Action_2_Condition FaultManager.Inj8Open.Action_3 FaultManager.Inj8Open.Action_3_Condition FaultManager.Inj8Open.Action_4 FaultManager.Inj8Open.Action_4_Condition FaultManager.Lambda_1_NotReady.Mode FaultManager.Lambda_1_NotReady.ID FaultManager.Lambda_1_NotReady.Test FaultManager.Lambda_1_NotReady.Faulty_Samples__X_ FaultManager.Lambda_1_NotReady.Total_Samples__Y_ FaultManager.Lambda_1_NotReady.Action_1 FaultManager.Lambda_1_NotReady.Action_1_Condition FaultManager.Lambda_1_NotReady.Action_2 FaultManager.Lambda_1_NotReady.Action_2_Condition FaultManager.Lambda_1_NotReady.Action_3 FaultManager.Lambda_1_NotReady.Action_3_Condition FaultManager.Lambda_1_NotReady.Action_4 FaultManager.Lambda_1_NotReady.Action_4_Condition FaultManager.Lambda_1_Timeout.Mode FaultManager.Lambda_1_Timeout.ID FaultManager.Lambda_1_Timeout.Test FaultManager.Lambda_1_Timeout.Faulty_Samples__X_ FaultManager.Lambda_1_Timeout.Total_Samples__Y_ FaultManager.Lambda_1_Timeout.Action_1 FaultManager.Lambda_1_Timeout.Action_1_Condition FaultManager.Lambda_1_Timeout.Action_2 FaultManager.Lambda_1_Timeout.Action_2_Condition FaultManager.Lambda_1_Timeout.Action_3 FaultManager.Lambda_1_Timeout.Action_3_Condition FaultManager.Lambda_1_Timeout.Action_4 FaultManager.Lambda_1_Timeout.Action_4_Condition FaultManager.Lambda_2_NotReady.Mode FaultManager.Lambda_2_NotReady.ID FaultManager.Lambda_2_NotReady.Test FaultManager.Lambda_2_NotReady.Faulty_Samples__X_ FaultManager.Lambda_2_NotReady.Total_Samples__Y_ FaultManager.Lambda_2_NotReady.Action_1 FaultManager.Lambda_2_NotReady.Action_1_Condition FaultManager.Lambda_2_NotReady.Action_2 FaultManager.Lambda_2_NotReady.Action_2_Condition FaultManager.Lambda_2_NotReady.Action_3 FaultManager.Lambda_2_NotReady.Action_3_Condition FaultManager.Lambda_2_NotReady.Action_4 FaultManager.Lambda_2_NotReady.Action_4_Condition FaultManager.Lambda_2_Timeout.Mode FaultManager.Lambda_2_Timeout.ID FaultManager.Lambda_2_Timeout.Test FaultManager.Lambda_2_Timeout.Faulty_Samples__X_ FaultManager.Lambda_2_Timeout.Total_Samples__Y_ FaultManager.Lambda_2_Timeout.Action_1 FaultManager.Lambda_2_Timeout.Action_1_Condition FaultManager.Lambda_2_Timeout.Action_2 FaultManager.Lambda_2_Timeout.Action_2_Condition FaultManager.Lambda_2_Timeout.Action_3 FaultManager.Lambda_2_Timeout.Action_3_Condition FaultManager.Lambda_2_Timeout.Action_4 FaultManager.Lambda_2_Timeout.Action_4_Condition FaultManager.LeanProtect_Fault.Mode FaultManager.LeanProtect_Fault.ID FaultManager.LeanProtect_Fault.Test FaultManager.LeanProtect_Fault.Faulty_Samples__X_ FaultManager.LeanProtect_Fault.Total_Samples__Y_ FaultManager.LeanProtect_Fault.Action_1 FaultManager.LeanProtect_Fault.Action_1_Condition FaultManager.LeanProtect_Fault.Action_2 FaultManager.LeanProtect_Fault.Action_2_Condition FaultManager.LeanProtect_Fault.Action_3 FaultManager.LeanProtect_Fault.Action_3_Condition FaultManager.LeanProtect_Fault.Action_4 FaultManager.LeanProtect_Fault.Action_4_Condition FaultManager.MAFRangeHigh.Mode FaultManager.MAFRangeHigh.ID FaultManager.MAFRangeHigh.Test FaultManager.MAFRangeHigh.Faulty_Samples__X_ FaultManager.MAFRangeHigh.Total_Samples__Y_ FaultManager.MAFRangeHigh.Action_1 FaultManager.MAFRangeHigh.Action_1_Condition FaultManager.MAFRangeHigh.Action_2 FaultManager.MAFRangeHigh.Action_2_Condition FaultManager.MAFRangeHigh.Action_3 FaultManager.MAFRangeHigh.Action_3_Condition FaultManager.MAFRangeHigh.Action_4 FaultManager.MAFRangeHigh.Action_4_Condition FaultManager.MAFRangeLow.Mode FaultManager.MAFRangeLow.ID FaultManager.MAFRangeLow.Test FaultManager.MAFRangeLow.Faulty_Samples__X_ FaultManager.MAFRangeLow.Total_Samples__Y_ FaultManager.MAFRangeLow.Action_1 FaultManager.MAFRangeLow.Action_1_Condition FaultManager.MAFRangeLow.Action_2 FaultManager.MAFRangeLow.Action_2_Condition FaultManager.MAFRangeLow.Action_3 FaultManager.MAFRangeLow.Action_3_Condition FaultManager.MAFRangeLow.Action_4 FaultManager.MAFRangeLow.Action_4_Condition FaultManager.MAPRangeHigh.Mode FaultManager.MAPRangeHigh.ID FaultManager.MAPRangeHigh.Test FaultManager.MAPRangeHigh.Faulty_Samples__X_ FaultManager.MAPRangeHigh.Total_Samples__Y_ FaultManager.MAPRangeHigh.Action_1 FaultManager.MAPRangeHigh.Action_1_Condition FaultManager.MAPRangeHigh.Action_2 FaultManager.MAPRangeHigh.Action_2_Condition FaultManager.MAPRangeHigh.Action_3 FaultManager.MAPRangeHigh.Action_3_Condition FaultManager.MAPRangeHigh.Action_4 FaultManager.MAPRangeHigh.Action_4_Condition FaultManager.MAPRangeLow.Mode FaultManager.MAPRangeLow.ID FaultManager.MAPRangeLow.Test FaultManager.MAPRangeLow.Faulty_Samples__X_ FaultManager.MAPRangeLow.Total_Samples__Y_ FaultManager.MAPRangeLow.Action_1 FaultManager.MAPRangeLow.Action_1_Condition FaultManager.MAPRangeLow.Action_2 FaultManager.MAPRangeLow.Action_2_Condition FaultManager.MAPRangeLow.Action_3 FaultManager.MAPRangeLow.Action_3_Condition FaultManager.MAPRangeLow.Action_4 FaultManager.MAPRangeLow.Action_4_Condition FaultManager.MAPTimeRangeHigh.Mode FaultManager.MAPTimeRangeHigh.ID FaultManager.MAPTimeRangeHigh.Test FaultManager.MAPTimeRangeHigh.Faulty_Samples__X_ FaultManager.MAPTimeRangeHigh.Total_Samples__Y_ FaultManager.MAPTimeRangeHigh.Action_1 FaultManager.MAPTimeRangeHigh.Action_1_Condition FaultManager.MAPTimeRangeHigh.Action_2 FaultManager.MAPTimeRangeHigh.Action_2_Condition FaultManager.MAPTimeRangeHigh.Action_3 FaultManager.MAPTimeRangeHigh.Action_3_Condition FaultManager.MAPTimeRangeHigh.Action_4 FaultManager.MAPTimeRangeHigh.Action_4_Condition FaultManager.MAPTimeRangeLow.Mode FaultManager.MAPTimeRangeLow.ID FaultManager.MAPTimeRangeLow.Test FaultManager.MAPTimeRangeLow.Faulty_Samples__X_ FaultManager.MAPTimeRangeLow.Total_Samples__Y_ FaultManager.MAPTimeRangeLow.Action_1 FaultManager.MAPTimeRangeLow.Action_1_Condition FaultManager.MAPTimeRangeLow.Action_2 FaultManager.MAPTimeRangeLow.Action_2_Condition FaultManager.MAPTimeRangeLow.Action_3 FaultManager.MAPTimeRangeLow.Action_3_Condition FaultManager.MAPTimeRangeLow.Action_4 FaultManager.MAPTimeRangeLow.Action_4_Condition FaultManager.MAP_IR_HI.Mode FaultManager.MAP_IR_HI.ID FaultManager.MAP_IR_HI.Test FaultManager.MAP_IR_HI.Faulty_Samples__X_ FaultManager.MAP_IR_HI.Total_Samples__Y_ FaultManager.MAP_IR_HI.Action_1 FaultManager.MAP_IR_HI.Action_1_Condition FaultManager.MAP_IR_HI.Action_2 FaultManager.MAP_IR_HI.Action_2_Condition FaultManager.MAP_IR_HI.Action_3 FaultManager.MAP_IR_HI.Action_3_Condition FaultManager.MAP_IR_HI.Action_4 FaultManager.MAP_IR_HI.Action_4_Condition FaultManager.MAP_IR_LO.Mode FaultManager.MAP_IR_LO.ID FaultManager.MAP_IR_LO.Test FaultManager.MAP_IR_LO.Faulty_Samples__X_ FaultManager.MAP_IR_LO.Total_Samples__Y_ FaultManager.MAP_IR_LO.Action_1 FaultManager.MAP_IR_LO.Action_1_Condition FaultManager.MAP_IR_LO.Action_2 FaultManager.MAP_IR_LO.Action_2_Condition FaultManager.MAP_IR_LO.Action_3 FaultManager.MAP_IR_LO.Action_3_Condition FaultManager.MAP_IR_LO.Action_4 FaultManager.MAP_IR_LO.Action_4_Condition FaultManager.MAP_STICKING.Mode FaultManager.MAP_STICKING.ID FaultManager.MAP_STICKING.Test FaultManager.MAP_STICKING.Faulty_Samples__X_ FaultManager.MAP_STICKING.Total_Samples__Y_ FaultManager.MAP_STICKING.Action_1 FaultManager.MAP_STICKING.Action_1_Condition FaultManager.MAP_STICKING.Action_2 FaultManager.MAP_STICKING.Action_2_Condition FaultManager.MAP_STICKING.Action_3 FaultManager.MAP_STICKING.Action_3_Condition FaultManager.MAP_STICKING.Action_4 FaultManager.MAP_STICKING.Action_4_Condition FaultManager.MediumOverspeed.Mode FaultManager.MediumOverspeed.ID FaultManager.MediumOverspeed.Test FaultManager.MediumOverspeed.Faulty_Samples__X_ FaultManager.MediumOverspeed.Total_Samples__Y_ FaultManager.MediumOverspeed.Action_1 FaultManager.MediumOverspeed.Action_1_Condition FaultManager.MediumOverspeed.Action_2 FaultManager.MediumOverspeed.Action_2_Condition FaultManager.MediumOverspeed.Action_3 FaultManager.MediumOverspeed.Action_3_Condition FaultManager.MediumOverspeed.Action_4 FaultManager.MediumOverspeed.Action_4_Condition FaultManager.NoOil_Fault.Mode FaultManager.NoOil_Fault.ID FaultManager.NoOil_Fault.Test FaultManager.NoOil_Fault.Faulty_Samples__X_ FaultManager.NoOil_Fault.Total_Samples__Y_ FaultManager.NoOil_Fault.Action_1 FaultManager.NoOil_Fault.Action_1_Condition FaultManager.NoOil_Fault.Action_2 FaultManager.NoOil_Fault.Action_2_Condition FaultManager.NoOil_Fault.Action_3 FaultManager.NoOil_Fault.Action_3_Condition FaultManager.NoOil_Fault.Action_4 FaultManager.NoOil_Fault.Action_4_Condition FaultManager.O2FailedLean.Mode FaultManager.O2FailedLean.ID FaultManager.O2FailedLean.Test FaultManager.O2FailedLean.Faulty_Samples__X_ FaultManager.O2FailedLean.Total_Samples__Y_ FaultManager.O2FailedLean.Action_1 FaultManager.O2FailedLean.Action_1_Condition FaultManager.O2FailedLean.Action_2 FaultManager.O2FailedLean.Action_2_Condition FaultManager.O2FailedLean.Action_3 FaultManager.O2FailedLean.Action_3_Condition FaultManager.O2FailedLean.Action_4 FaultManager.O2FailedLean.Action_4_Condition FaultManager.O2FailedRich.Mode FaultManager.O2FailedRich.ID FaultManager.O2FailedRich.Test FaultManager.O2FailedRich.Faulty_Samples__X_ FaultManager.O2FailedRich.Total_Samples__Y_ FaultManager.O2FailedRich.Action_1 FaultManager.O2FailedRich.Action_1_Condition FaultManager.O2FailedRich.Action_2 FaultManager.O2FailedRich.Action_2_Condition FaultManager.O2FailedRich.Action_3 FaultManager.O2FailedRich.Action_3_Condition FaultManager.O2FailedRich.Action_4 FaultManager.O2FailedRich.Action_4_Condition FaultManager.O2NotActive.Mode FaultManager.O2NotActive.ID FaultManager.O2NotActive.Test FaultManager.O2NotActive.Faulty_Samples__X_ FaultManager.O2NotActive.Total_Samples__Y_ FaultManager.O2NotActive.Action_1 FaultManager.O2NotActive.Action_1_Condition FaultManager.O2NotActive.Action_2 FaultManager.O2NotActive.Action_2_Condition FaultManager.O2NotActive.Action_3 FaultManager.O2NotActive.Action_3_Condition FaultManager.O2NotActive.Action_4 FaultManager.O2NotActive.Action_4_Condition FaultManager.OilPresRangeHigh.Mode FaultManager.OilPresRangeHigh.ID FaultManager.OilPresRangeHigh.Test FaultManager.OilPresRangeHigh.Faulty_Samples__X_ FaultManager.OilPresRangeHigh.Total_Samples__Y_ FaultManager.OilPresRangeHigh.Action_1 FaultManager.OilPresRangeHigh.Action_1_Condition FaultManager.OilPresRangeHigh.Action_2 FaultManager.OilPresRangeHigh.Action_2_Condition FaultManager.OilPresRangeHigh.Action_3 FaultManager.OilPresRangeHigh.Action_3_Condition FaultManager.OilPresRangeHigh.Action_4 FaultManager.OilPresRangeHigh.Action_4_Condition FaultManager.OilPresRangeLow.Mode FaultManager.OilPresRangeLow.ID FaultManager.OilPresRangeLow.Test FaultManager.OilPresRangeLow.Faulty_Samples__X_ FaultManager.OilPresRangeLow.Total_Samples__Y_ FaultManager.OilPresRangeLow.Action_1 FaultManager.OilPresRangeLow.Action_1_Condition FaultManager.OilPresRangeLow.Action_2 FaultManager.OilPresRangeLow.Action_2_Condition FaultManager.OilPresRangeLow.Action_3 FaultManager.OilPresRangeLow.Action_3_Condition FaultManager.OilPresRangeLow.Action_4 FaultManager.OilPresRangeLow.Action_4_Condition FaultManager.SensVoltRangeHigh.Mode FaultManager.SensVoltRangeHigh.ID FaultManager.SensVoltRangeHigh.Test FaultManager.SensVoltRangeHigh.Faulty_Samples__X_ FaultManager.SensVoltRangeHigh.Total_Samples__Y_ FaultManager.SensVoltRangeHigh.Action_1 FaultManager.SensVoltRangeHigh.Action_1_Condition FaultManager.SensVoltRangeHigh.Action_2 FaultManager.SensVoltRangeHigh.Action_2_Condition FaultManager.SensVoltRangeHigh.Action_3 FaultManager.SensVoltRangeHigh.Action_3_Condition FaultManager.SensVoltRangeHigh.Action_4 FaultManager.SensVoltRangeHigh.Action_4_Condition FaultManager.SensVoltRangeLow.Mode /end DEF_CHARACTERISTIC
/end FUNCTION
/end MODULE
/end PROJECT
