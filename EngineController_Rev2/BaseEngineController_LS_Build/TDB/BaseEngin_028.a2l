ASAP2_VERSION 1 51
/begin PROJECT Project ""
/begin MODULE BaseEngin_028 ""
/begin MOD_COMMON /* MOD_COMMON Comment */ "" BYTE_ORDER MSB_FIRST ALIGNMENT_BYTE 1 ALIGNMENT_FLOAT32_IEEE 1 ALIGNMENT_FLOAT64_IEEE 1 ALIGNMENT_LONG 1 ALIGNMENT_WORD 1 /end MOD_COMMON
/begin CHARACTERISTIC FaultManager.EST7_Open.Action_1 "Fault manager configuration.  Select up to 4 actions for each fault." VALUE 0x80002E4D RecordLayout_4 0 CompuMethod_113 0 65535 /end CHARACTERISTIC
/begin CHARACTERISTIC FaultManager.EST7_Open.Action_1_Condition "Fault manager configuration.  Select up to 4 actions for each fault." VALUE 0x80002E4F RecordLayout_4 0 CompuMethod_114 0 65535 /end CHARACTERISTIC
/begin CHARACTERISTIC FaultManager.EST7_Open.Action_2 "Fault manager configuration.  Select up to 4 actions for each fault." VALUE 0x80002E51 RecordLayout_4 0 CompuMethod_113 0 65535 /end CHARACTERISTIC
/begin CHARACTERISTIC FaultManager.EST7_Open.Action_2_Condition "Fault manager configuration.  Select up to 4 actions for each fault." VALUE 0x80002E53 RecordLayout_4 0 CompuMethod_114 0 65535 /end CHARACTERISTIC
/begin CHARACTERISTIC FaultManager.EST7_Open.Action_3 "Fault manager configuration.  Select up to 4 actions for each fault." VALUE 0x80002E55 RecordLayout_4 0 CompuMethod_113 0 65535 /end CHARACTERISTIC
/begin CHARACTERISTIC FaultManager.EST7_Open.Action_3_Condition "Fault manager configuration.  Select up to 4 actions for each fault." VALUE 0x80002E57 RecordLayout_4 0 CompuMethod_114 0 65535 /end CHARACTERISTIC
/begin CHARACTERISTIC FaultManager.EST7_Open.Action_4 "Fault manager configuration.  Select up to 4 actions for each fault." VALUE 0x80002E59 RecordLayout_4 0 CompuMethod_113 0 65535 /end CHARACTERISTIC
/begin CHARACTERISTIC FaultManager.EST7_Open.Action_4_Condition "Fault manager configuration.  Select up to 4 actions for each fault." VALUE 0x80002E5B RecordLayout_4 0 CompuMethod_114 0 65535 /end CHARACTERISTIC
/begin CHARACTERISTIC FaultManager.EST7_Short.Mode "Fault manager configuration.  Select up to 4 actions for each fault." VALUE 0x80002E5D RecordLayout_4 0 CompuMethod_111 0 65535 /end CHARACTERISTIC
/begin CHARACTERISTIC FaultManager.EST7_Short.ID "Fault manager configuration.  Select up to 4 actions for each fault." VALUE 0x80002E5F RecordLayout_4 0 CompuMethod_1 0 65535 /end CHARACTERISTIC
/begin CHARACTERISTIC FaultManager.EST7_Short.Test "Fault manager configuration.  Select up to 4 actions for each fault." VALUE 0x80002E61 RecordLayout_4 0 CompuMethod_112 0 65535 /end CHARACTERISTIC
/begin CHARACTERISTIC FaultManager.EST7_Short.Faulty_Samples__X_ "Fault manager configuration.  Select up to 4 actions for each fault." VALUE 0x80002E63 RecordLayout_4 0 CompuMethod_1 0 65535 /end CHARACTERISTIC
/begin CHARACTERISTIC FaultManager.EST7_Short.Total_Samples__Y_ "Fault manager configuration.  Select up to 4 actions for each fault." VALUE 0x80002E65 RecordLayout_4 0 CompuMethod_1 0 65535 /end CHARACTERISTIC
/begin CHARACTERISTIC FaultManager.EST7_Short.Action_1 "Fault manager configuration.  Select up to 4 actions for each fault." VALUE 0x80002E67 RecordLayout_4 0 CompuMethod_113 0 65535 /end CHARACTERISTIC
/begin CHARACTERISTIC FaultManager.EST7_Short.Action_1_Condition "Fault manager configuration.  Select up to 4 actions for each fault." VALUE 0x80002E69 RecordLayout_4 0 CompuMethod_114 0 65535 /end CHARACTERISTIC
/begin CHARACTERISTIC FaultManager.EST7_Short.Action_2 "Fault manager configuration.  Select up to 4 actions for each fault." VALUE 0x80002E6B RecordLayout_4 0 CompuMethod_113 0 65535 /end CHARACTERISTIC
/begin CHARACTERISTIC FaultManager.EST7_Short.Action_2_Condition "Fault manager configuration.  Select up to 4 actions for each fault." VALUE 0x80002E6D RecordLayout_4 0 CompuMethod_114 0 65535 /end CHARACTERISTIC
/begin CHARACTERISTIC FaultManager.EST7_Short.Action_3 "Fault manager configuration.  Select up to 4 actions for each fault." VALUE 0x80002E6F RecordLayout_4 0 CompuMethod_113 0 65535 /end CHARACTERISTIC
/begin CHARACTERISTIC FaultManager.EST7_Short.Action_3_Condition "Fault manager configuration.  Select up to 4 actions for each fault." VALUE 0x80002E71 RecordLayout_4 0 CompuMethod_114 0 65535 /end CHARACTERISTIC
/begin CHARACTERISTIC FaultManager.EST7_Short.Action_4 "Fault manager configuration.  Select up to 4 actions for each fault." VALUE 0x80002E73 RecordLayout_4 0 CompuMethod_113 0 65535 /end CHARACTERISTIC
/begin CHARACTERISTIC FaultManager.EST7_Short.Action_4_Condition "Fault manager configuration.  Select up to 4 actions for each fault." VALUE 0x80002E75 RecordLayout_4 0 CompuMethod_114 0 65535 /end CHARACTERISTIC
/begin CHARACTERISTIC FaultManager.EST8_Open.Mode "Fault manager configuration.  Select up to 4 actions for each fault." VALUE 0x80002E77 RecordLayout_4 0 CompuMethod_111 0 65535 /end CHARACTERISTIC
/begin CHARACTERISTIC FaultManager.EST8_Open.ID "Fault manager configuration.  Select up to 4 actions for each fault." VALUE 0x80002E79 RecordLayout_4 0 CompuMethod_1 0 65535 /end CHARACTERISTIC
/begin CHARACTERISTIC FaultManager.EST8_Open.Test "Fault manager configuration.  Select up to 4 actions for each fault." VALUE 0x80002E7B RecordLayout_4 0 CompuMethod_112 0 65535 /end CHARACTERISTIC
/begin CHARACTERISTIC FaultManager.EST8_Open.Faulty_Samples__X_ "Fault manager configuration.  Select up to 4 actions for each fault." VALUE 0x80002E7D RecordLayout_4 0 CompuMethod_1 0 65535 /end CHARACTERISTIC
/begin CHARACTERISTIC FaultManager.EST8_Open.Total_Samples__Y_ "Fault manager configuration.  Select up to 4 actions for each fault." VALUE 0x80002E7F RecordLayout_4 0 CompuMethod_1 0 65535 /end CHARACTERISTIC
/begin CHARACTERISTIC FaultManager.EST8_Open.Action_1 "Fault manager configuration.  Select up to 4 actions for each fault." VALUE 0x80002E81 RecordLayout_4 0 CompuMethod_113 0 65535 /end CHARACTERISTIC
/begin CHARACTERISTIC FaultManager.EST8_Open.Action_1_Condition "Fault manager configuration.  Select up to 4 actions for each fault." VALUE 0x80002E83 RecordLayout_4 0 CompuMethod_114 0 65535 /end CHARACTERISTIC
/begin CHARACTERISTIC FaultManager.EST8_Open.Action_2 "Fault manager configuration.  Select up to 4 actions for each fault." VALUE 0x80002E85 RecordLayout_4 0 CompuMethod_113 0 65535 /end CHARACTERISTIC
/begin CHARACTERISTIC FaultManager.EST8_Open.Action_2_Condition "Fault manager configuration.  Select up to 4 actions for each fault." VALUE 0x80002E87 RecordLayout_4 0 CompuMethod_114 0 65535 /end CHARACTERISTIC
/begin CHARACTERISTIC FaultManager.EST8_Open.Action_3 "Fault manager configuration.  Select up to 4 actions for each fault." VALUE 0x80002E89 RecordLayout_4 0 CompuMethod_113 0 65535 /end CHARACTERISTIC
/begin CHARACTERISTIC FaultManager.EST8_Open.Action_3_Condition "Fault manager configuration.  Select up to 4 actions for each fault." VALUE 0x80002E8B RecordLayout_4 0 CompuMethod_114 0 65535 /end CHARACTERISTIC
/begin CHARACTERISTIC FaultManager.EST8_Open.Action_4 "Fault manager configuration.  Select up to 4 actions for each fault." VALUE 0x80002E8D RecordLayout_4 0 CompuMethod_113 0 65535 /end CHARACTERISTIC
/begin CHARACTERISTIC FaultManager.EST8_Open.Action_4_Condition "Fault manager configuration.  Select up to 4 actions for each fault." VALUE 0x80002E8F RecordLayout_4 0 CompuMethod_114 0 65535 /end CHARACTERISTIC
/begin CHARACTERISTIC FaultManager.EST8_Short.Mode "Fault manager configuration.  Select up to 4 actions for each fault." VALUE 0x80002E91 RecordLayout_4 0 CompuMethod_111 0 65535 /end CHARACTERISTIC
/begin CHARACTERISTIC FaultManager.EST8_Short.ID "Fault manager configuration.  Select up to 4 actions for each fault." VALUE 0x80002E93 RecordLayout_4 0 CompuMethod_1 0 65535 /end CHARACTERISTIC
/begin CHARACTERISTIC FaultManager.EST8_Short.Test "Fault manager configuration.  Select up to 4 actions for each fault." VALUE 0x80002E95 RecordLayout_4 0 CompuMethod_112 0 65535 /end CHARACTERISTIC
/begin CHARACTERISTIC FaultManager.EST8_Short.Faulty_Samples__X_ "Fault manager configuration.  Select up to 4 actions for each fault." VALUE 0x80002E97 RecordLayout_4 0 CompuMethod_1 0 65535 /end CHARACTERISTIC
/begin CHARACTERISTIC FaultManager.EST8_Short.Total_Samples__Y_ "Fault manager configuration.  Select up to 4 actions for each fault." VALUE 0x80002E99 RecordLayout_4 0 CompuMethod_1 0 65535 /end CHARACTERISTIC
/begin CHARACTERISTIC FaultManager.EST8_Short.Action_1 "Fault manager configuration.  Select up to 4 actions for each fault." VALUE 0x80002E9B RecordLayout_4 0 CompuMethod_113 0 65535 /end CHARACTERISTIC
/begin CHARACTERISTIC FaultManager.EST8_Short.Action_1_Condition "Fault manager configuration.  Select up to 4 actions for each fault." VALUE 0x80002E9D RecordLayout_4 0 CompuMethod_114 0 65535 /end CHARACTERISTIC
/begin CHARACTERISTIC FaultManager.EST8_Short.Action_2 "Fault manager configuration.  Select up to 4 actions for each fault." VALUE 0x80002E9F RecordLayout_4 0 CompuMethod_113 0 65535 /end CHARACTERISTIC
/begin CHARACTERISTIC FaultManager.EST8_Short.Action_2_Condition "Fault manager configuration.  Select up to 4 actions for each fault." VALUE 0x80002EA1 RecordLayout_4 0 CompuMethod_114 0 65535 /end CHARACTERISTIC
/begin CHARACTERISTIC FaultManager.EST8_Short.Action_3 "Fault manager configuration.  Select up to 4 actions for each fault." VALUE 0x80002EA3 RecordLayout_4 0 CompuMethod_113 0 65535 /end CHARACTERISTIC
/begin CHARACTERISTIC FaultManager.EST8_Short.Action_3_Condition "Fault manager configuration.  Select up to 4 actions for each fault." VALUE 0x80002EA5 RecordLayout_4 0 CompuMethod_114 0 65535 /end CHARACTERISTIC
/begin CHARACTERISTIC FaultManager.EST8_Short.Action_4 "Fault manager configuration.  Select up to 4 actions for each fault." VALUE 0x80002EA7 RecordLayout_4 0 CompuMethod_113 0 65535 /end CHARACTERISTIC
/begin CHARACTERISTIC FaultManager.EST8_Short.Action_4_Condition "Fault manager configuration.  Select up to 4 actions for each fault." VALUE 0x80002EA9 RecordLayout_4 0 CompuMethod_114 0 65535 /end CHARACTERISTIC
/begin CHARACTERISTIC FaultManager.ETCSpringTest.Mode "Fault manager configuration.  Select up to 4 actions for each fault." VALUE 0x80002EAB RecordLayout_4 0 CompuMethod_111 0 65535 /end CHARACTERISTIC
/begin CHARACTERISTIC FaultManager.ETCSpringTest.ID "Fault manager configuration.  Select up to 4 actions for each fault." VALUE 0x80002EAD RecordLayout_4 0 CompuMethod_1 0 65535 /end CHARACTERISTIC
/begin CHARACTERISTIC FaultManager.ETCSpringTest.Test "Fault manager configuration.  Select up to 4 actions for each fault." VALUE 0x80002EAF RecordLayout_4 0 CompuMethod_112 0 65535 /end CHARACTERISTIC
/begin CHARACTERISTIC FaultManager.ETCSpringTest.Faulty_Samples__X_ "Fault manager configuration.  Select up to 4 actions for each fault." VALUE 0x80002EB1 RecordLayout_4 0 CompuMethod_1 0 65535 /end CHARACTERISTIC
/begin CHARACTERISTIC FaultManager.ETCSpringTest.Total_Samples__Y_ "Fault manager configuration.  Select up to 4 actions for each fault." VALUE 0x80002EB3 RecordLayout_4 0 CompuMethod_1 0 65535 /end CHARACTERISTIC
/begin CHARACTERISTIC FaultManager.ETCSpringTest.Action_1 "Fault manager configuration.  Select up to 4 actions for each fault." VALUE 0x80002EB5 RecordLayout_4 0 CompuMethod_113 0 65535 /end CHARACTERISTIC
/begin CHARACTERISTIC FaultManager.ETCSpringTest.Action_1_Condition "Fault manager configuration.  Select up to 4 actions for each fault." VALUE 0x80002EB7 RecordLayout_4 0 CompuMethod_114 0 65535 /end CHARACTERISTIC
/begin CHARACTERISTIC FaultManager.ETCSpringTest.Action_2 "Fault manager configuration.  Select up to 4 actions for each fault." VALUE 0x80002EB9 RecordLayout_4 0 CompuMethod_113 0 65535 /end CHARACTERISTIC
/begin CHARACTERISTIC FaultManager.ETCSpringTest.Action_2_Condition "Fault manager configuration.  Select up to 4 actions for each fault." VALUE 0x80002EBB RecordLayout_4 0 CompuMethod_114 0 65535 /end CHARACTERISTIC
/begin CHARACTERISTIC FaultManager.ETCSpringTest.Action_3 "Fault manager configuration.  Select up to 4 actions for each fault." VALUE 0x80002EBD RecordLayout_4 0 CompuMethod_113 0 65535 /end CHARACTERISTIC
/begin CHARACTERISTIC FaultManager.ETCSpringTest.Action_3_Condition "Fault manager configuration.  Select up to 4 actions for each fault." VALUE 0x80002EBF RecordLayout_4 0 CompuMethod_114 0 65535 /end CHARACTERISTIC
/begin CHARACTERISTIC FaultManager.ETCSpringTest.Action_4 "Fault manager configuration.  Select up to 4 actions for each fault." VALUE 0x80002EC1 RecordLayout_4 0 CompuMethod_113 0 65535 /end CHARACTERISTIC
/begin CHARACTERISTIC FaultManager.ETCSpringTest.Action_4_Condition "Fault manager configuration.  Select up to 4 actions for each fault." VALUE 0x80002EC3 RecordLayout_4 0 CompuMethod_114 0 65535 /end CHARACTERISTIC
/begin CHARACTERISTIC FaultManager.ETC_Open_Fault.Mode "Fault manager configuration.  Select up to 4 actions for each fault." VALUE 0x80002EC5 RecordLayout_4 0 CompuMethod_111 0 65535 /end CHARACTERISTIC
/begin CHARACTERISTIC FaultManager.ETC_Open_Fault.ID "Fault manager configuration.  Select up to 4 actions for each fault." VALUE 0x80002EC7 RecordLayout_4 0 CompuMethod_1 0 65535 /end CHARACTERISTIC
/begin CHARACTERISTIC FaultManager.ETC_Open_Fault.Test "Fault manager configuration.  Select up to 4 actions for each fault." VALUE 0x80002EC9 RecordLayout_4 0 CompuMethod_112 0 65535 /end CHARACTERISTIC
/begin CHARACTERISTIC FaultManager.ETC_Open_Fault.Faulty_Samples__X_ "Fault manager configuration.  Select up to 4 actions for each fault." VALUE 0x80002ECB RecordLayout_4 0 CompuMethod_1 0 65535 /end CHARACTERISTIC
/begin CHARACTERISTIC FaultManager.ETC_Open_Fault.Total_Samples__Y_ "Fault manager configuration.  Select up to 4 actions for each fault." VALUE 0x80002ECD RecordLayout_4 0 CompuMethod_1 0 65535 /end CHARACTERISTIC
/begin CHARACTERISTIC FaultManager.ETC_Open_Fault.Action_1 "Fault manager configuration.  Select up to 4 actions for each fault." VALUE 0x80002ECF RecordLayout_4 0 CompuMethod_113 0 65535 /end CHARACTERISTIC
/begin CHARACTERISTIC FaultManager.ETC_Open_Fault.Action_1_Condition "Fault manager configuration.  Select up to 4 actions for each fault." VALUE 0x80002ED1 RecordLayout_4 0 CompuMethod_114 0 65535 /end CHARACTERISTIC
/begin CHARACTERISTIC FaultManager.ETC_Open_Fault.Action_2 "Fault manager configuration.  Select up to 4 actions for each fault." VALUE 0x80002ED3 RecordLayout_4 0 CompuMethod_113 0 65535 /end CHARACTERISTIC
/begin CHARACTERISTIC FaultManager.ETC_Open_Fault.Action_2_Condition "Fault manager configuration.  Select up to 4 actions for each fault." VALUE 0x80002ED5 RecordLayout_4 0 CompuMethod_114 0 65535 /end CHARACTERISTIC
/begin CHARACTERISTIC FaultManager.ETC_Open_Fault.Action_3 "Fault manager configuration.  Select up to 4 actions for each fault." VALUE 0x80002ED7 RecordLayout_4 0 CompuMethod_113 0 65535 /end CHARACTERISTIC
/begin CHARACTERISTIC FaultManager.ETC_Open_Fault.Action_3_Condition "Fault manager configuration.  Select up to 4 actions for each fault." VALUE 0x80002ED9 RecordLayout_4 0 CompuMethod_114 0 65535 /end CHARACTERISTIC
/begin CHARACTERISTIC FaultManager.ETC_Open_Fault.Action_4 "Fault manager configuration.  Select up to 4 actions for each fault." VALUE 0x80002EDB RecordLayout_4 0 CompuMethod_113 0 65535 /end CHARACTERISTIC
/begin CHARACTERISTIC FaultManager.ETC_Open_Fault.Action_4_Condition "Fault manager configuration.  Select up to 4 actions for each fault." VALUE 0x80002EDD RecordLayout_4 0 CompuMethod_114 0 65535 /end CHARACTERISTIC
/begin CHARACTERISTIC FaultManager.ETC_Sticking.Mode "Fault manager configuration.  Select up to 4 actions for each fault." VALUE 0x80002EDF RecordLayout_4 0 CompuMethod_111 0 65535 /end CHARACTERISTIC
/begin CHARACTERISTIC FaultManager.ETC_Sticking.ID "Fault manager configuration.  Select up to 4 actions for each fault." VALUE 0x80002EE1 RecordLayout_4 0 CompuMethod_1 0 65535 /end CHARACTERISTIC
/begin CHARACTERISTIC FaultManager.ETC_Sticking.Test "Fault manager configuration.  Select up to 4 actions for each fault." VALUE 0x80002EE3 RecordLayout_4 0 CompuMethod_112 0 65535 /end CHARACTERISTIC
/begin CHARACTERISTIC FaultManager.ETC_Sticking.Faulty_Samples__X_ "Fault manager configuration.  Select up to 4 actions for each fault." VALUE 0x80002EE5 RecordLayout_4 0 CompuMethod_1 0 65535 /end CHARACTERISTIC
/begin CHARACTERISTIC FaultManager.ETC_Sticking.Total_Samples__Y_ "Fault manager configuration.  Select up to 4 actions for each fault." VALUE 0x80002EE7 RecordLayout_4 0 CompuMethod_1 0 65535 /end CHARACTERISTIC
/begin CHARACTERISTIC FaultManager.ETC_Sticking.Action_1 "Fault manager configuration.  Select up to 4 actions for each fault." VALUE 0x80002EE9 RecordLayout_4 0 CompuMethod_113 0 65535 /end CHARACTERISTIC
/begin CHARACTERISTIC FaultManager.ETC_Sticking.Action_1_Condition "Fault manager configuration.  Select up to 4 actions for each fault." VALUE 0x80002EEB RecordLayout_4 0 CompuMethod_114 0 65535 /end CHARACTERISTIC
/begin CHARACTERISTIC FaultManager.ETC_Sticking.Action_2 "Fault manager configuration.  Select up to 4 actions for each fault." VALUE 0x80002EED RecordLayout_4 0 CompuMethod_113 0 65535 /end CHARACTERISTIC
/begin CHARACTERISTIC FaultManager.ETC_Sticking.Action_2_Condition "Fault manager configuration.  Select up to 4 actions for each fault." VALUE 0x80002EEF RecordLayout_4 0 CompuMethod_114 0 65535 /end CHARACTERISTIC
/begin CHARACTERISTIC FaultManager.ETC_Sticking.Action_3 "Fault manager configuration.  Select up to 4 actions for each fault." VALUE 0x80002EF1 RecordLayout_4 0 CompuMethod_113 0 65535 /end CHARACTERISTIC
/begin CHARACTERISTIC FaultManager.ETC_Sticking.Action_3_Condition "Fault manager configuration.  Select up to 4 actions for each fault." VALUE 0x80002EF3 RecordLayout_4 0 CompuMethod_114 0 65535 /end CHARACTERISTIC
/begin CHARACTERISTIC FaultManager.ETC_Sticking.Action_4 "Fault manager configuration.  Select up to 4 actions for each fault." VALUE 0x80002EF5 RecordLayout_4 0 CompuMethod_113 0 65535 /end CHARACTERISTIC
/begin CHARACTERISTIC FaultManager.ETC_Sticking.Action_4_Condition "Fault manager configuration.  Select up to 4 actions for each fault." VALUE 0x80002EF7 RecordLayout_4 0 CompuMethod_114 0 65535 /end CHARACTERISTIC
/begin CHARACTERISTIC FaultManager.EVAPRangeHigh.Mode "Fault manager configuration.  Select up to 4 actions for each fault." VALUE 0x80002EF9 RecordLayout_4 0 CompuMethod_111 0 65535 /end CHARACTERISTIC
/begin CHARACTERISTIC FaultManager.EVAPRangeHigh.ID "Fault manager configuration.  Select up to 4 actions for each fault." VALUE 0x80002EFB RecordLayout_4 0 CompuMethod_1 0 65535 /end CHARACTERISTIC
/begin CHARACTERISTIC FaultManager.EVAPRangeHigh.Test "Fault manager configuration.  Select up to 4 actions for each fault." VALUE 0x80002EFD RecordLayout_4 0 CompuMethod_112 0 65535 /end CHARACTERISTIC
/begin CHARACTERISTIC FaultManager.EVAPRangeHigh.Faulty_Samples__X_ "Fault manager configuration.  Select up to 4 actions for each fault." VALUE 0x80002EFF RecordLayout_4 0 CompuMethod_1 0 65535 /end CHARACTERISTIC
/begin CHARACTERISTIC FaultManager.EVAPRangeHigh.Total_Samples__Y_ "Fault manager configuration.  Select up to 4 actions for each fault." VALUE 0x80002F01 RecordLayout_4 0 CompuMethod_1 0 65535 /end CHARACTERISTIC
/begin CHARACTERISTIC FaultManager.EVAPRangeHigh.Action_1 "Fault manager configuration.  Select up to 4 actions for each fault." VALUE 0x80002F03 RecordLayout_4 0 CompuMethod_113 0 65535 /end CHARACTERISTIC
/begin CHARACTERISTIC FaultManager.EVAPRangeHigh.Action_1_Condition "Fault manager configuration.  Select up to 4 actions for each fault." VALUE 0x80002F05 RecordLayout_4 0 CompuMethod_114 0 65535 /end CHARACTERISTIC
/begin CHARACTERISTIC FaultManager.EVAPRangeHigh.Action_2 "Fault manager configuration.  Select up to 4 actions for each fault." VALUE 0x80002F07 RecordLayout_4 0 CompuMethod_113 0 65535 /end CHARACTERISTIC
/begin CHARACTERISTIC FaultManager.EVAPRangeHigh.Action_2_Condition "Fault manager configuration.  Select up to 4 actions for each fault." VALUE 0x80002F09 RecordLayout_4 0 CompuMethod_114 0 65535 /end CHARACTERISTIC
/begin CHARACTERISTIC FaultManager.EVAPRangeHigh.Action_3 "Fault manager configuration.  Select up to 4 actions for each fault." VALUE 0x80002F0B RecordLayout_4 0 CompuMethod_113 0 65535 /end CHARACTERISTIC
/begin CHARACTERISTIC FaultManager.EVAPRangeHigh.Action_3_Condition "Fault manager configuration.  Select up to 4 actions for each fault." VALUE 0x80002F0D RecordLayout_4 0 CompuMethod_114 0 65535 /end CHARACTERISTIC
/begin CHARACTERISTIC FaultManager.EVAPRangeHigh.Action_4 "Fault manager configuration.  Select up to 4 actions for each fault." VALUE 0x80002F0F RecordLayout_4 0 CompuMethod_113 0 65535 /end CHARACTERISTIC
/begin CHARACTERISTIC FaultManager.EVAPRangeHigh.Action_4_Condition "Fault manager configuration.  Select up to 4 actions for each fault." VALUE 0x80002F11 RecordLayout_4 0 CompuMethod_114 0 65535 /end CHARACTERISTIC
/begin CHARACTERISTIC FaultManager.EVAPRangeLow.Mode "Fault manager configuration.  Select up to 4 actions for each fault." VALUE 0x80002F13 RecordLayout_4 0 CompuMethod_111 0 65535 /end CHARACTERISTIC
/begin CHARACTERISTIC FaultManager.EVAPRangeLow.ID "Fault manager configuration.  Select up to 4 actions for each fault." VALUE 0x80002F15 RecordLayout_4 0 CompuMethod_1 0 65535 /end CHARACTERISTIC
/begin CHARACTERISTIC FaultManager.EVAPRangeLow.Test "Fault manager configuration.  Select up to 4 actions for each fault." VALUE 0x80002F17 RecordLayout_4 0 CompuMethod_112 0 65535 /end CHARACTERISTIC
/begin CHARACTERISTIC FaultManager.EVAPRangeLow.Faulty_Samples__X_ "Fault manager configuration.  Select up to 4 actions for each fault." VALUE 0x80002F19 RecordLayout_4 0 CompuMethod_1 0 65535 /end CHARACTERISTIC
/begin CHARACTERISTIC FaultManager.EVAPRangeLow.Total_Samples__Y_ "Fault manager configuration.  Select up to 4 actions for each fault." VALUE 0x80002F1B RecordLayout_4 0 CompuMethod_1 0 65535 /end CHARACTERISTIC
/begin CHARACTERISTIC FaultManager.EVAPRangeLow.Action_1 "Fault manager configuration.  Select up to 4 actions for each fault." VALUE 0x80002F1D RecordLayout_4 0 CompuMethod_113 0 65535 /end CHARACTERISTIC
/begin CHARACTERISTIC FaultManager.EVAPRangeLow.Action_1_Condition "Fault manager configuration.  Select up to 4 actions for each fault." VALUE 0x80002F1F RecordLayout_4 0 CompuMethod_114 0 65535 /end CHARACTERISTIC
/begin CHARACTERISTIC FaultManager.EVAPRangeLow.Action_2 "Fault manager configuration.  Select up to 4 actions for each fault." VALUE 0x80002F21 RecordLayout_4 0 CompuMethod_113 0 65535 /end CHARACTERISTIC
/begin CHARACTERISTIC FaultManager.EVAPRangeLow.Action_2_Condition "Fault manager configuration.  Select up to 4 actions for each fault." VALUE 0x80002F23 RecordLayout_4 0 CompuMethod_114 0 65535 /end CHARACTERISTIC
/begin CHARACTERISTIC FaultManager.EVAPRangeLow.Action_3 "Fault manager configuration.  Select up to 4 actions for each fault." VALUE 0x80002F25 RecordLayout_4 0 CompuMethod_113 0 65535 /end CHARACTERISTIC
/begin CHARACTERISTIC FaultManager.EVAPRangeLow.Action_3_Condition "Fault manager configuration.  Select up to 4 actions for each fault." VALUE 0x80002F27 RecordLayout_4 0 CompuMethod_114 0 65535 /end CHARACTERISTIC
/begin CHARACTERISTIC FaultManager.EVAPRangeLow.Action_4 "Fault manager configuration.  Select up to 4 actions for each fault." VALUE 0x80002F29 RecordLayout_4 0 CompuMethod_113 0 65535 /end CHARACTERISTIC
/begin CHARACTERISTIC FaultManager.EVAPRangeLow.Action_4_Condition "Fault manager configuration.  Select up to 4 actions for each fault." VALUE 0x80002F2B RecordLayout_4 0 CompuMethod_114 0 65535 /end CHARACTERISTIC
/begin CHARACTERISTIC FaultManager.FuelAdaptRangeHi.Mode "Fault manager configuration.  Select up to 4 actions for each fault." VALUE 0x80002F2D RecordLayout_4 0 CompuMethod_111 0 65535 /end CHARACTERISTIC
/begin CHARACTERISTIC FaultManager.FuelAdaptRangeHi.ID "Fault manager configuration.  Select up to 4 actions for each fault." VALUE 0x80002F2F RecordLayout_4 0 CompuMethod_1 0 65535 /end CHARACTERISTIC
/begin CHARACTERISTIC FaultManager.FuelAdaptRangeHi.Test "Fault manager configuration.  Select up to 4 actions for each fault." VALUE 0x80002F31 RecordLayout_4 0 CompuMethod_112 0 65535 /end CHARACTERISTIC
/begin CHARACTERISTIC FaultManager.FuelAdaptRangeHi.Faulty_Samples__X_ "Fault manager configuration.  Select up to 4 actions for each fault." VALUE 0x80002F33 RecordLayout_4 0 CompuMethod_1 0 65535 /end CHARACTERISTIC
/begin CHARACTERISTIC FaultManager.FuelAdaptRangeHi.Total_Samples__Y_ "Fault manager configuration.  Select up to 4 actions for each fault." VALUE 0x80002F35 RecordLayout_4 0 CompuMethod_1 0 65535 /end CHARACTERISTIC
/begin CHARACTERISTIC FaultManager.FuelAdaptRangeHi.Action_1 "Fault manager configuration.  Select up to 4 actions for each fault." VALUE 0x80002F37 RecordLayout_4 0 CompuMethod_113 0 65535 /end CHARACTERISTIC
/begin CHARACTERISTIC FaultManager.FuelAdaptRangeHi.Action_1_Condition "Fault manager configuration.  Select up to 4 actions for each fault." VALUE 0x80002F39 RecordLayout_4 0 CompuMethod_114 0 65535 /end CHARACTERISTIC
/begin CHARACTERISTIC FaultManager.FuelAdaptRangeHi.Action_2 "Fault manager configuration.  Select up to 4 actions for each fault." VALUE 0x80002F3B RecordLayout_4 0 CompuMethod_113 0 65535 /end CHARACTERISTIC
/begin CHARACTERISTIC FaultManager.FuelAdaptRangeHi.Action_2_Condition "Fault manager configuration.  Select up to 4 actions for each fault." VALUE 0x80002F3D RecordLayout_4 0 CompuMethod_114 0 65535 /end CHARACTERISTIC
/begin CHARACTERISTIC FaultManager.FuelAdaptRangeHi.Action_3 "Fault manager configuration.  Select up to 4 actions for each fault." VALUE 0x80002F3F RecordLayout_4 0 CompuMethod_113 0 65535 /end CHARACTERISTIC
/begin CHARACTERISTIC FaultManager.FuelAdaptRangeHi.Action_3_Condition "Fault manager configuration.  Select up to 4 actions for each fault." VALUE 0x80002F41 RecordLayout_4 0 CompuMethod_114 0 65535 /end CHARACTERISTIC
/begin CHARACTERISTIC FaultManager.FuelAdaptRangeHi.Action_4 "Fault manager configuration.  Select up to 4 actions for each fault." VALUE 0x80002F43 RecordLayout_4 0 CompuMethod_113 0 65535 /end CHARACTERISTIC
/begin CHARACTERISTIC FaultManager.FuelAdaptRangeHi.Action_4_Condition "Fault manager configuration.  Select up to 4 actions for each fault." VALUE 0x80002F45 RecordLayout_4 0 CompuMethod_114 0 65535 /end CHARACTERISTIC
/begin CHARACTERISTIC FaultManager.FuelAdaptRangeLow.Mode "Fault manager configuration.  Select up to 4 actions for each fault." VALUE 0x80002F47 RecordLayout_4 0 CompuMethod_111 0 65535 /end CHARACTERISTIC
/begin CHARACTERISTIC FaultManager.FuelAdaptRangeLow.ID "Fault manager configuration.  Select up to 4 actions for each fault." VALUE 0x80002F49 RecordLayout_4 0 CompuMethod_1 0 65535 /end CHARACTERISTIC
/begin CHARACTERISTIC FaultManager.FuelAdaptRangeLow.Test "Fault manager configuration.  Select up to 4 actions for each fault." VALUE 0x80002F4B RecordLayout_4 0 CompuMethod_112 0 65535 /end CHARACTERISTIC
/begin CHARACTERISTIC FaultManager.FuelAdaptRangeLow.Faulty_Samples__X_ "Fault manager configuration.  Select up to 4 actions for each fault." VALUE 0x80002F4D RecordLayout_4 0 CompuMethod_1 0 65535 /end CHARACTERISTIC
/begin CHARACTERISTIC FaultManager.FuelAdaptRangeLow.Total_Samples__Y_ "Fault manager configuration.  Select up to 4 actions for each fault." VALUE 0x80002F4F RecordLayout_4 0 CompuMethod_1 0 65535 /end CHARACTERISTIC
/begin CHARACTERISTIC FaultManager.FuelAdaptRangeLow.Action_1 "Fault manager configuration.  Select up to 4 actions for each fault." VALUE 0x80002F51 RecordLayout_4 0 CompuMethod_113 0 65535 /end CHARACTERISTIC
/begin CHARACTERISTIC FaultManager.FuelAdaptRangeLow.Action_1_Condition "Fault manager configuration.  Select up to 4 actions for each fault." VALUE 0x80002F53 RecordLayout_4 0 CompuMethod_114 0 65535 /end CHARACTERISTIC
/begin CHARACTERISTIC FaultManager.FuelAdaptRangeLow.Action_2 "Fault manager configuration.  Select up to 4 actions for each fault." VALUE 0x80002F55 RecordLayout_4 0 CompuMethod_113 0 65535 /end CHARACTERISTIC
/begin CHARACTERISTIC FaultManager.FuelAdaptRangeLow.Action_2_Condition "Fault manager configuration.  Select up to 4 actions for each fault." VALUE 0x80002F57 RecordLayout_4 0 CompuMethod_114 0 65535 /end CHARACTERISTIC
/begin CHARACTERISTIC FaultManager.FuelAdaptRangeLow.Action_3 "Fault manager configuration.  Select up to 4 actions for each fault." VALUE 0x80002F59 RecordLayout_4 0 CompuMethod_113 0 65535 /end CHARACTERISTIC
/begin CHARACTERISTIC FaultManager.FuelAdaptRangeLow.Action_3_Condition "Fault manager configuration.  Select up to 4 actions for each fault." VALUE 0x80002F5B RecordLayout_4 0 CompuMethod_114 0 65535 /end CHARACTERISTIC
/begin CHARACTERISTIC FaultManager.FuelAdaptRangeLow.Action_4 "Fault manager configuration.  Select up to 4 actions for each fault." VALUE 0x80002F5D RecordLayout_4 0 CompuMethod_113 0 65535 /end CHARACTERISTIC
/begin CHARACTERISTIC FaultManager.FuelAdaptRangeLow.Action_4_Condition "Fault manager configuration.  Select up to 4 actions for each fault." VALUE 0x80002F5F RecordLayout_4 0 CompuMethod_114 0 65535 /end CHARACTERISTIC
/begin CHARACTERISTIC FaultManager.FuelPresHigh_Fault.Mode "Fault manager configuration.  Select up to 4 actions for each fault." VALUE 0x80002F61 RecordLayout_4 0 CompuMethod_111 0 65535 /end CHARACTERISTIC
/begin CHARACTERISTIC FaultManager.FuelPresHigh_Fault.ID "Fault manager configuration.  Select up to 4 actions for each fault." VALUE 0x80002F63 RecordLayout_4 0 CompuMethod_1 0 65535 /end CHARACTERISTIC
/begin CHARACTERISTIC FaultManager.FuelPresHigh_Fault.Test "Fault manager configuration.  Select up to 4 actions for each fault." VALUE 0x80002F65 RecordLayout_4 0 CompuMethod_112 0 65535 /end CHARACTERISTIC
/begin CHARACTERISTIC FaultManager.FuelPresHigh_Fault.Faulty_Samples__X_ "Fault manager configuration.  Select up to 4 actions for each fault." VALUE 0x80002F67 RecordLayout_4 0 CompuMethod_1 0 65535 /end CHARACTERISTIC
/begin CHARACTERISTIC FaultManager.FuelPresHigh_Fault.Total_Samples__Y_ "Fault manager configuration.  Select up to 4 actions for each fault." VALUE 0x80002F69 RecordLayout_4 0 CompuMethod_1 0 65535 /end CHARACTERISTIC
/begin CHARACTERISTIC FaultManager.FuelPresHigh_Fault.Action_1 "Fault manager configuration.  Select up to 4 actions for each fault." VALUE 0x80002F6B RecordLayout_4 0 CompuMethod_113 0 65535 /end CHARACTERISTIC
/begin CHARACTERISTIC FaultManager.FuelPresHigh_Fault.Action_1_Condition "Fault manager configuration.  Select up to 4 actions for each fault." VALUE 0x80002F6D RecordLayout_4 0 CompuMethod_114 0 65535 /end CHARACTERISTIC
/begin CHARACTERISTIC FaultManager.FuelPresHigh_Fault.Action_2 "Fault manager configuration.  Select up to 4 actions for each fault." VALUE 0x80002F6F RecordLayout_4 0 CompuMethod_113 0 65535 /end CHARACTERISTIC
/begin CHARACTERISTIC FaultManager.FuelPresHigh_Fault.Action_2_Condition "Fault manager configuration.  Select up to 4 actions for each fault." VALUE 0x80002F71 RecordLayout_4 0 CompuMethod_114 0 65535 /end CHARACTERISTIC
/begin CHARACTERISTIC FaultManager.FuelPresHigh_Fault.Action_3 "Fault manager configuration.  Select up to 4 actions for each fault." VALUE 0x80002F73 RecordLayout_4 0 CompuMethod_113 0 65535 /end CHARACTERISTIC
/begin CHARACTERISTIC FaultManager.FuelPresHigh_Fault.Action_3_Condition "Fault manager configuration.  Select up to 4 actions for each fault." VALUE 0x80002F75 RecordLayout_4 0 CompuMethod_114 0 65535 /end CHARACTERISTIC
/begin CHARACTERISTIC FaultManager.FuelPresHigh_Fault.Action_4 "Fault manager configuration.  Select up to 4 actions for each fault." VALUE 0x80002F77 RecordLayout_4 0 CompuMethod_113 0 65535 /end CHARACTERISTIC
/begin CHARACTERISTIC FaultManager.FuelPresHigh_Fault.Action_4_Condition "Fault manager configuration.  Select up to 4 actions for each fault." VALUE 0x80002F79 RecordLayout_4 0 CompuMethod_114 0 65535 /end CHARACTERISTIC
/begin CHARACTERISTIC FaultManager.FuelPresLow_Fault.Mode "Fault manager configuration.  Select up to 4 actions for each fault." VALUE 0x80002F7B RecordLayout_4 0 CompuMethod_111 0 65535 /end CHARACTERISTIC
/begin CHARACTERISTIC FaultManager.FuelPresLow_Fault.ID "Fault manager configuration.  Select up to 4 actions for each fault." VALUE 0x80002F7D RecordLayout_4 0 CompuMethod_1 0 65535 /end CHARACTERISTIC
/begin CHARACTERISTIC FaultManager.FuelPresLow_Fault.Test "Fault manager configuration.  Select up to 4 actions for each fault." VALUE 0x80002F7F RecordLayout_4 0 CompuMethod_112 0 65535 /end CHARACTERISTIC
/begin CHARACTERISTIC FaultManager.FuelPresLow_Fault.Faulty_Samples__X_ "Fault manager configuration.  Select up to 4 actions for each fault." VALUE 0x80002F81 RecordLayout_4 0 CompuMethod_1 0 65535 /end CHARACTERISTIC
/begin CHARACTERISTIC FaultManager.FuelPresLow_Fault.Total_Samples__Y_ "Fault manager configuration.  Select up to 4 actions for each fault." VALUE 0x80002F83 RecordLayout_4 0 CompuMethod_1 0 65535 /end CHARACTERISTIC
/begin CHARACTERISTIC FaultManager.FuelPresLow_Fault.Action_1 "Fault manager configuration.  Select up to 4 actions for each fault." VALUE 0x80002F85 RecordLayout_4 0 CompuMethod_113 0 65535 /end CHARACTERISTIC
/begin CHARACTERISTIC FaultManager.FuelPresLow_Fault.Action_1_Condition "Fault manager configuration.  Select up to 4 actions for each fault." VALUE 0x80002F87 RecordLayout_4 0 CompuMethod_114 0 65535 /end CHARACTERISTIC
/begin CHARACTERISTIC FaultManager.FuelPresLow_Fault.Action_2 "Fault manager configuration.  Select up to 4 actions for each fault." VALUE 0x80002F89 RecordLayout_4 0 CompuMethod_113 0 65535 /end CHARACTERISTIC
/begin CHARACTERISTIC FaultManager.FuelPresLow_Fault.Action_2_Condition "Fault manager configuration.  Select up to 4 actions for each fault." VALUE 0x80002F8B RecordLayout_4 0 CompuMethod_114 0 65535 /end CHARACTERISTIC
/begin CHARACTERISTIC FaultManager.FuelPresLow_Fault.Action_3 "Fault manager configuration.  Select up to 4 actions for each fault." VALUE 0x80002F8D RecordLayout_4 0 CompuMethod_113 0 65535 /end CHARACTERISTIC
/begin CHARACTERISTIC FaultManager.FuelPresLow_Fault.Action_3_Condition "Fault manager configuration.  Select up to 4 actions for each fault." VALUE 0x80002F8F RecordLayout_4 0 CompuMethod_114 0 65535 /end CHARACTERISTIC
/begin CHARACTERISTIC FaultManager.FuelPresLow_Fault.Action_4 "Fault manager configuration.  Select up to 4 actions for each fault." VALUE 0x80002F91 RecordLayout_4 0 CompuMethod_113 0 65535 /end CHARACTERISTIC
/begin CHARACTERISTIC FaultManager.FuelPresLow_Fault.Action_4_Condition "Fault manager configuration.  Select up to 4 actions for each fault." VALUE 0x80002F93 RecordLayout_4 0 CompuMethod_114 0 65535 /end CHARACTERISTIC
/begin CHARACTERISTIC FaultManager.FuelPresRangeHigh.Mode "Fault manager configuration.  Select up to 4 actions for each fault." VALUE 0x80002F95 RecordLayout_4 0 CompuMethod_111 0 65535 /end CHARACTERISTIC
/begin CHARACTERISTIC FaultManager.FuelPresRangeHigh.ID "Fault manager configuration.  Select up to 4 actions for each fault." VALUE 0x80002F97 RecordLayout_4 0 CompuMethod_1 0 65535 /end CHARACTERISTIC
/begin CHARACTERISTIC FaultManager.FuelPresRangeHigh.Test "Fault manager configuration.  Select up to 4 actions for each fault." VALUE 0x80002F99 RecordLayout_4 0 CompuMethod_112 0 65535 /end CHARACTERISTIC
/begin CHARACTERISTIC FaultManager.FuelPresRangeHigh.Faulty_Samples__X_ "Fault manager configuration.  Select up to 4 actions for each fault." VALUE 0x80002F9B RecordLayout_4 0 CompuMethod_1 0 65535 /end CHARACTERISTIC
/begin CHARACTERISTIC FaultManager.FuelPresRangeHigh.Total_Samples__Y_ "Fault manager configuration.  Select up to 4 actions for each fault." VALUE 0x80002F9D RecordLayout_4 0 CompuMethod_1 0 65535 /end CHARACTERISTIC
/begin CHARACTERISTIC FaultManager.FuelPresRangeHigh.Action_1 "Fault manager configuration.  Select up to 4 actions for each fault." VALUE 0x80002F9F RecordLayout_4 0 CompuMethod_113 0 65535 /end CHARACTERISTIC
/begin CHARACTERISTIC FaultManager.FuelPresRangeHigh.Action_1_Condition "Fault manager configuration.  Select up to 4 actions for each fault." VALUE 0x80002FA1 RecordLayout_4 0 CompuMethod_114 0 65535 /end CHARACTERISTIC
/begin CHARACTERISTIC FaultManager.FuelPresRangeHigh.Action_2 "Fault manager configuration.  Select up to 4 actions for each fault." VALUE 0x80002FA3 RecordLayout_4 0 CompuMethod_113 0 65535 /end CHARACTERISTIC
/begin CHARACTERISTIC FaultManager.FuelPresRangeHigh.Action_2_Condition "Fault manager configuration.  Select up to 4 actions for each fault." VALUE 0x80002FA5 RecordLayout_4 0 CompuMethod_114 0 65535 /end CHARACTERISTIC
/begin CHARACTERISTIC FaultManager.FuelPresRangeHigh.Action_3 "Fault manager configuration.  Select up to 4 actions for each fault." VALUE 0x80002FA7 RecordLayout_4 0 CompuMethod_113 0 65535 /end CHARACTERISTIC
/begin CHARACTERISTIC FaultManager.FuelPresRangeHigh.Action_3_Condition "Fault manager configuration.  Select up to 4 actions for each fault." VALUE 0x80002FA9 RecordLayout_4 0 CompuMethod_114 0 65535 /end CHARACTERISTIC
/begin CHARACTERISTIC FaultManager.FuelPresRangeHigh.Action_4 "Fault manager configuration.  Select up to 4 actions for each fault." VALUE 0x80002FAB RecordLayout_4 0 CompuMethod_113 0 65535 /end CHARACTERISTIC
/begin CHARACTERISTIC FaultManager.FuelPresRangeHigh.Action_4_Condition "Fault manager configuration.  Select up to 4 actions for each fault." VALUE 0x80002FAD RecordLayout_4 0 CompuMethod_114 0 65535 /end CHARACTERISTIC
/begin CHARACTERISTIC FaultManager.FuelPresRangeLow.Mode "Fault manager configuration.  Select up to 4 actions for each fault." VALUE 0x80002FAF RecordLayout_4 0 CompuMethod_111 0 65535 /end CHARACTERISTIC
/begin CHARACTERISTIC FaultManager.FuelPresRangeLow.ID "Fault manager configuration.  Select up to 4 actions for each fault." VALUE 0x80002FB1 RecordLayout_4 0 CompuMethod_1 0 65535 /end CHARACTERISTIC
/begin CHARACTERISTIC FaultManager.FuelPresRangeLow.Test "Fault manager configuration.  Select up to 4 actions for each fault." VALUE 0x80002FB3 RecordLayout_4 0 CompuMethod_112 0 65535 /end CHARACTERISTIC
/begin CHARACTERISTIC FaultManager.FuelPresRangeLow.Faulty_Samples__X_ "Fault manager configuration.  Select up to 4 actions for each fault." VALUE 0x80002FB5 RecordLayout_4 0 CompuMethod_1 0 65535 /end CHARACTERISTIC
/begin CHARACTERISTIC FaultManager.FuelPresRangeLow.Total_Samples__Y_ "Fault manager configuration.  Select up to 4 actions for each fault." VALUE 0x80002FB7 RecordLayout_4 0 CompuMethod_1 0 65535 /end CHARACTERISTIC
/begin CHARACTERISTIC FaultManager.FuelPresRangeLow.Action_1 "Fault manager configuration.  Select up to 4 actions for each fault." VALUE 0x80002FB9 RecordLayout_4 0 CompuMethod_113 0 65535 /end CHARACTERISTIC
/begin CHARACTERISTIC FaultManager.FuelPresRangeLow.Action_1_Condition "Fault manager configuration.  Select up to 4 actions for each fault." VALUE 0x80002FBB RecordLayout_4 0 CompuMethod_114 0 65535 /end CHARACTERISTIC
/begin CHARACTERISTIC FaultManager.FuelPresRangeLow.Action_2 "Fault manager configuration.  Select up to 4 actions for each fault." VALUE 0x80002FBD RecordLayout_4 0 CompuMethod_113 0 65535 /end CHARACTERISTIC
/begin CHARACTERISTIC FaultManager.FuelPresRangeLow.Action_2_Condition "Fault manager configuration.  Select up to 4 actions for each fault." VALUE 0x80002FBF RecordLayout_4 0 CompuMethod_114 0 65535 /end CHARACTERISTIC
/begin CHARACTERISTIC FaultManager.FuelPresRangeLow.Action_3 "Fault manager configuration.  Select up to 4 actions for each fault." VALUE 0x80002FC1 RecordLayout_4 0 CompuMethod_113 0 65535 /end CHARACTERISTIC
/begin CHARACTERISTIC FaultManager.FuelPresRangeLow.Action_3_Condition "Fault manager configuration.  Select up to 4 actions for each fault." VALUE 0x80002FC3 RecordLayout_4 0 CompuMethod_114 0 65535 /end CHARACTERISTIC
/begin CHARACTERISTIC FaultManager.FuelPresRangeLow.Action_4 "Fault manager configuration.  Select up to 4 actions for each fault." VALUE 0x80002FC5 RecordLayout_4 0 CompuMethod_113 0 65535 /end CHARACTERISTIC
/begin CHARACTERISTIC FaultManager.FuelPresRangeLow.Action_4_Condition "Fault manager configuration.  Select up to 4 actions for each fault." VALUE 0x80002FC7 RecordLayout_4 0 CompuMethod_114 0 65535 /end CHARACTERISTIC
/begin CHARACTERISTIC FaultManager.FuelSensRangeHigh.Mode "Fault manager configuration.  Select up to 4 actions for each fault." VALUE 0x80002FC9 RecordLayout_4 0 CompuMethod_111 0 65535 /end CHARACTERISTIC
/begin CHARACTERISTIC FaultManager.FuelSensRangeHigh.ID "Fault manager configuration.  Select up to 4 actions for each fault." VALUE 0x80002FCB RecordLayout_4 0 CompuMethod_1 0 65535 /end CHARACTERISTIC
/begin CHARACTERISTIC FaultManager.FuelSensRangeHigh.Test "Fault manager configuration.  Select up to 4 actions for each fault." VALUE 0x80002FCD RecordLayout_4 0 CompuMethod_112 0 65535 /end CHARACTERISTIC
/begin CHARACTERISTIC FaultManager.FuelSensRangeHigh.Faulty_Samples__X_ "Fault manager configuration.  Select up to 4 actions for each fault." VALUE 0x80002FCF RecordLayout_4 0 CompuMethod_1 0 65535 /end CHARACTERISTIC
/begin CHARACTERISTIC FaultManager.FuelSensRangeHigh.Total_Samples__Y_ "Fault manager configuration.  Select up to 4 actions for each fault." VALUE 0x80002FD1 RecordLayout_4 0 CompuMethod_1 0 65535 /end CHARACTERISTIC
/begin CHARACTERISTIC FaultManager.FuelSensRangeHigh.Action_1 "Fault manager configuration.  Select up to 4 actions for each fault." VALUE 0x80002FD3 RecordLayout_4 0 CompuMethod_113 0 65535 /end CHARACTERISTIC
/begin CHARACTERISTIC FaultManager.FuelSensRangeHigh.Action_1_Condition "Fault manager configuration.  Select up to 4 actions for each fault." VALUE 0x80002FD5 RecordLayout_4 0 CompuMethod_114 0 65535 /end CHARACTERISTIC
/begin CHARACTERISTIC FaultManager.FuelSensRangeHigh.Action_2 "Fault manager configuration.  Select up to 4 actions for each fault." VALUE 0x80002FD7 RecordLayout_4 0 CompuMethod_113 0 65535 /end CHARACTERISTIC
/begin CHARACTERISTIC FaultManager.FuelSensRangeHigh.Action_2_Condition "Fault manager configuration.  Select up to 4 actions for each fault." VALUE 0x80002FD9 RecordLayout_4 0 CompuMethod_114 0 65535 /end CHARACTERISTIC
/begin CHARACTERISTIC FaultManager.FuelSensRangeHigh.Action_3 "Fault manager configuration.  Select up to 4 actions for each fault." VALUE 0x80002FDB RecordLayout_4 0 CompuMethod_113 0 65535 /end CHARACTERISTIC
/begin CHARACTERISTIC FaultManager.FuelSensRangeHigh.Action_3_Condition "Fault manager configuration.  Select up to 4 actions for each fault." VALUE 0x80002FDD RecordLayout_4 0 CompuMethod_114 0 65535 /end CHARACTERISTIC
/begin CHARACTERISTIC FaultManager.FuelSensRangeHigh.Action_4 "Fault manager configuration.  Select up to 4 actions for each fault." VALUE 0x80002FDF RecordLayout_4 0 CompuMethod_113 0 65535 /end CHARACTERISTIC
/begin CHARACTERISTIC FaultManager.FuelSensRangeHigh.Action_4_Condition "Fault manager configuration.  Select up to 4 actions for each fault." VALUE 0x80002FE1 RecordLayout_4 0 CompuMethod_114 0 65535 /end CHARACTERISTIC
/begin CHARACTERISTIC FaultManager.FuelSensRangeLow.Mode "Fault manager configuration.  Select up to 4 actions for each fault." VALUE 0x80002FE3 RecordLayout_4 0 CompuMethod_111 0 65535 /end CHARACTERISTIC
/begin CHARACTERISTIC FaultManager.FuelSensRangeLow.ID "Fault manager configuration.  Select up to 4 actions for each fault." VALUE 0x80002FE5 RecordLayout_4 0 CompuMethod_1 0 65535 /end CHARACTERISTIC
/begin CHARACTERISTIC FaultManager.FuelSensRangeLow.Test "Fault manager configuration.  Select up to 4 actions for each fault." VALUE 0x80002FE7 RecordLayout_4 0 CompuMethod_112 0 65535 /end CHARACTERISTIC
/begin CHARACTERISTIC FaultManager.FuelSensRangeLow.Faulty_Samples__X_ "Fault manager configuration.  Select up to 4 actions for each fault." VALUE 0x80002FE9 RecordLayout_4 0 CompuMethod_1 0 65535 /end CHARACTERISTIC
/begin CHARACTERISTIC FaultManager.FuelSensRangeLow.Total_Samples__Y_ "Fault manager configuration.  Select up to 4 actions for each fault." VALUE 0x80002FEB RecordLayout_4 0 CompuMethod_1 0 65535 /end CHARACTERISTIC
/begin CHARACTERISTIC FaultManager.FuelSensRangeLow.Action_1 "Fault manager configuration.  Select up to 4 actions for each fault." VALUE 0x80002FED RecordLayout_4 0 CompuMethod_113 0 65535 /end CHARACTERISTIC
/begin CHARACTERISTIC FaultManager.FuelSensRangeLow.Action_1_Condition "Fault manager configuration.  Select up to 4 actions for each fault." VALUE 0x80002FEF RecordLayout_4 0 CompuMethod_114 0 65535 /end CHARACTERISTIC
/begin CHARACTERISTIC FaultManager.FuelSensRangeLow.Action_2 "Fault manager configuration.  Select up to 4 actions for each fault." VALUE 0x80002FF1 RecordLayout_4 0 CompuMethod_113 0 65535 /end CHARACTERISTIC
/begin CHARACTERISTIC FaultManager.FuelSensRangeLow.Action_2_Condition "Fault manager configuration.  Select up to 4 actions for each fault." VALUE 0x80002FF3 RecordLayout_4 0 CompuMethod_114 0 65535 /end CHARACTERISTIC
/begin CHARACTERISTIC FaultManager.FuelSensRangeLow.Action_3 "Fault manager configuration.  Select up to 4 actions for each fault." VALUE 0x80002FF5 RecordLayout_4 0 CompuMethod_113 0 65535 /end CHARACTERISTIC
/begin CHARACTERISTIC FaultManager.FuelSensRangeLow.Action_3_Condition "Fault manager configuration.  Select up to 4 actions for each fault." VALUE 0x80002FF7 RecordLayout_4 0 CompuMethod_114 0 65535 /end CHARACTERISTIC
/begin CHARACTERISTIC FaultManager.FuelSensRangeLow.Action_4 "Fault manager configuration.  Select up to 4 actions for each fault." VALUE 0x80002FF9 RecordLayout_4 0 CompuMethod_113 0 65535 /end CHARACTERISTIC
/begin CHARACTERISTIC FaultManager.FuelSensRangeLow.Action_4_Condition "Fault manager configuration.  Select up to 4 actions for each fault." VALUE 0x80002FFB RecordLayout_4 0 CompuMethod_114 0 65535 /end CHARACTERISTIC
/begin CHARACTERISTIC FaultManager.Fuel_LvlRangeHigh.Mode "Fault manager configuration.  Select up to 4 actions for each fault." VALUE 0x80002FFD RecordLayout_4 0 CompuMethod_111 0 65535 /end CHARACTERISTIC
/begin CHARACTERISTIC FaultManager.Fuel_LvlRangeHigh.ID "Fault manager configuration.  Select up to 4 actions for each fault." VALUE 0x80002FFF RecordLayout_4 0 CompuMethod_1 0 65535 /end CHARACTERISTIC
/begin CHARACTERISTIC FaultManager.Fuel_LvlRangeHigh.Test "Fault manager configuration.  Select up to 4 actions for each fault." VALUE 0x80003001 RecordLayout_4 0 CompuMethod_112 0 65535 /end CHARACTERISTIC
/begin CHARACTERISTIC FaultManager.Fuel_LvlRangeHigh.Faulty_Samples__X_ "Fault manager configuration.  Select up to 4 actions for each fault." VALUE 0x80003003 RecordLayout_4 0 CompuMethod_1 0 65535 /end CHARACTERISTIC
/begin CHARACTERISTIC FaultManager.Fuel_LvlRangeHigh.Total_Samples__Y_ "Fault manager configuration.  Select up to 4 actions for each fault." VALUE 0x80003005 RecordLayout_4 0 CompuMethod_1 0 65535 /end CHARACTERISTIC
/begin CHARACTERISTIC FaultManager.Fuel_LvlRangeHigh.Action_1 "Fault manager configuration.  Select up to 4 actions for each fault." VALUE 0x80003007 RecordLayout_4 0 CompuMethod_113 0 65535 /end CHARACTERISTIC
/begin CHARACTERISTIC FaultManager.Fuel_LvlRangeHigh.Action_1_Condition "Fault manager configuration.  Select up to 4 actions for each fault." VALUE 0x80003009 RecordLayout_4 0 CompuMethod_114 0 65535 /end CHARACTERISTIC
/begin CHARACTERISTIC FaultManager.Fuel_LvlRangeHigh.Action_2 "Fault manager configuration.  Select up to 4 actions for each fault." VALUE 0x8000300B RecordLayout_4 0 CompuMethod_113 0 65535 /end CHARACTERISTIC
/begin CHARACTERISTIC FaultManager.Fuel_LvlRangeHigh.Action_2_Condition "Fault manager configuration.  Select up to 4 actions for each fault." VALUE 0x8000300D RecordLayout_4 0 CompuMethod_114 0 65535 /end CHARACTERISTIC
/begin CHARACTERISTIC FaultManager.Fuel_LvlRangeHigh.Action_3 "Fault manager configuration.  Select up to 4 actions for each fault." VALUE 0x8000300F RecordLayout_4 0 CompuMethod_113 0 65535 /end CHARACTERISTIC
/begin CHARACTERISTIC FaultManager.Fuel_LvlRangeHigh.Action_3_Condition "Fault manager configuration.  Select up to 4 actions for each fault." VALUE 0x80003011 RecordLayout_4 0 CompuMethod_114 0 65535 /end CHARACTERISTIC
/begin CHARACTERISTIC FaultManager.Fuel_LvlRangeHigh.Action_4 "Fault manager configuration.  Select up to 4 actions for each fault." VALUE 0x80003013 RecordLayout_4 0 CompuMethod_113 0 65535 /end CHARACTERISTIC
/begin CHARACTERISTIC FaultManager.Fuel_LvlRangeHigh.Action_4_Condition "Fault manager configuration.  Select up to 4 actions for each fault." VALUE 0x80003015 RecordLayout_4 0 CompuMethod_114 0 65535 /end CHARACTERISTIC
/begin CHARACTERISTIC FaultManager.Fuel_LvlRangeLow.Mode "Fault manager configuration.  Select up to 4 actions for each fault." VALUE 0x80003017 RecordLayout_4 0 CompuMethod_111 0 65535 /end CHARACTERISTIC
/begin CHARACTERISTIC FaultManager.Fuel_LvlRangeLow.ID "Fault manager configuration.  Select up to 4 actions for each fault." VALUE 0x80003019 RecordLayout_4 0 CompuMethod_1 0 65535 /end CHARACTERISTIC
/begin CHARACTERISTIC FaultManager.Fuel_LvlRangeLow.Test "Fault manager configuration.  Select up to 4 actions for each fault." VALUE 0x8000301B RecordLayout_4 0 CompuMethod_112 0 65535 /end CHARACTERISTIC
/begin CHARACTERISTIC FaultManager.Fuel_LvlRangeLow.Faulty_Samples__X_ "Fault manager configuration.  Select up to 4 actions for each fault." VALUE 0x8000301D RecordLayout_4 0 CompuMethod_1 0 65535 /end CHARACTERISTIC
/begin CHARACTERISTIC FaultManager.Fuel_LvlRangeLow.Total_Samples__Y_ "Fault manager configuration.  Select up to 4 actions for each fault." VALUE 0x8000301F RecordLayout_4 0 CompuMethod_1 0 65535 /end CHARACTERISTIC
/begin CHARACTERISTIC FaultManager.Fuel_LvlRangeLow.Action_1 "Fault manager configuration.  Select up to 4 actions for each fault." VALUE 0x80003021 RecordLayout_4 0 CompuMethod_113 0 65535 /end CHARACTERISTIC
/begin CHARACTERISTIC FaultManager.Fuel_LvlRangeLow.Action_1_Condition "Fault manager configuration.  Select up to 4 actions for each fault." VALUE 0x80003023 RecordLayout_4 0 CompuMethod_114 0 65535 /end CHARACTERISTIC
/begin CHARACTERISTIC FaultManager.Fuel_LvlRangeLow.Action_2 "Fault manager configuration.  Select up to 4 actions for each fault." VALUE 0x80003025 RecordLayout_4 0 CompuMethod_113 0 65535 /end CHARACTERISTIC
/begin CHARACTERISTIC FaultManager.Fuel_LvlRangeLow.Action_2_Condition "Fault manager configuration.  Select up to 4 actions for each fault." VALUE 0x80003027 RecordLayout_4 0 CompuMethod_114 0 65535 /end CHARACTERISTIC
/begin CHARACTERISTIC FaultManager.Fuel_LvlRangeLow.Action_3 "Fault manager configuration.  Select up to 4 actions for each fault." VALUE 0x80003029 RecordLayout_4 0 CompuMethod_113 0 65535 /end CHARACTERISTIC
/begin CHARACTERISTIC FaultManager.Fuel_LvlRangeLow.Action_3_Condition "Fault manager configuration.  Select up to 4 actions for each fault." VALUE 0x8000302B RecordLayout_4 0 CompuMethod_114 0 65535 /end CHARACTERISTIC
/begin CHARACTERISTIC FaultManager.Fuel_LvlRangeLow.Action_4 "Fault manager configuration.  Select up to 4 actions for each fault." VALUE 0x8000302D RecordLayout_4 0 CompuMethod_113 0 65535 /end CHARACTERISTIC
/begin CHARACTERISTIC FaultManager.Fuel_LvlRangeLow.Action_4_Condition "Fault manager configuration.  Select up to 4 actions for each fault." VALUE 0x8000302F RecordLayout_4 0 CompuMethod_114 0 65535 /end CHARACTERISTIC
/begin CHARACTERISTIC FaultManager.GPS_DateTime_Timeout.Mode "Fault manager configuration.  Select up to 4 actions for each fault." VALUE 0x80003031 RecordLayout_4 0 CompuMethod_111 0 65535 /end CHARACTERISTIC
/begin CHARACTERISTIC FaultManager.GPS_DateTime_Timeout.ID "Fault manager configuration.  Select up to 4 actions for each fault." VALUE 0x80003033 RecordLayout_4 0 CompuMethod_1 0 65535 /end CHARACTERISTIC
/begin CHARACTERISTIC FaultManager.GPS_DateTime_Timeout.Test "Fault manager configuration.  Select up to 4 actions for each fault." VALUE 0x80003035 RecordLayout_4 0 CompuMethod_112 0 65535 /end CHARACTERISTIC
/begin CHARACTERISTIC FaultManager.GPS_DateTime_Timeout.Faulty_Samples__X_ "Fault manager configuration.  Select up to 4 actions for each fault." VALUE 0x80003037 RecordLayout_4 0 CompuMethod_1 0 65535 /end CHARACTERISTIC
/begin CHARACTERISTIC FaultManager.GPS_DateTime_Timeout.Total_Samples__Y_ "Fault manager configuration.  Select up to 4 actions for each fault." VALUE 0x80003039 RecordLayout_4 0 CompuMethod_1 0 65535 /end CHARACTERISTIC
/begin CHARACTERISTIC FaultManager.GPS_DateTime_Timeout.Action_1 "Fault manager configuration.  Select up to 4 actions for each fault." VALUE 0x8000303B RecordLayout_4 0 CompuMethod_113 0 65535 /end CHARACTERISTIC
/begin CHARACTERISTIC FaultManager.GPS_DateTime_Timeout.Action_1_Condition "Fault manager configuration.  Select up to 4 actions for each fault." VALUE 0x8000303D RecordLayout_4 0 CompuMethod_114 0 65535 /end CHARACTERISTIC
/begin CHARACTERISTIC FaultManager.GPS_DateTime_Timeout.Action_2 "Fault manager configuration.  Select up to 4 actions for each fault." VALUE 0x8000303F RecordLayout_4 0 CompuMethod_113 0 65535 /end CHARACTERISTIC
/begin CHARACTERISTIC FaultManager.GPS_DateTime_Timeout.Action_2_Condition "Fault manager configuration.  Select up to 4 actions for each fault." VALUE 0x80003041 RecordLayout_4 0 CompuMethod_114 0 65535 /end CHARACTERISTIC
/begin CHARACTERISTIC FaultManager.GPS_DateTime_Timeout.Action_3 "Fault manager configuration.  Select up to 4 actions for each fault." VALUE 0x80003043 RecordLayout_4 0 CompuMethod_113 0 65535 /end CHARACTERISTIC
/begin CHARACTERISTIC FaultManager.GPS_DateTime_Timeout.Action_3_Condition "Fault manager configuration.  Select up to 4 actions for each fault." VALUE 0x80003045 RecordLayout_4 0 CompuMethod_114 0 65535 /end CHARACTERISTIC
/begin CHARACTERISTIC FaultManager.GPS_DateTime_Timeout.Action_4 "Fault manager configuration.  Select up to 4 actions for each fault." VALUE 0x80003047 RecordLayout_4 0 CompuMethod_113 0 65535 /end CHARACTERISTIC
/begin CHARACTERISTIC FaultManager.GPS_DateTime_Timeout.Action_4_Condition "Fault manager configuration.  Select up to 4 actions for each fault." VALUE 0x80003049 RecordLayout_4 0 CompuMethod_114 0 65535 /end CHARACTERISTIC
/begin CHARACTERISTIC FaultManager.GPS_LatLong_Timeout.Mode "Fault manager configuration.  Select up to 4 actions for each fault." VALUE 0x8000304B RecordLayout_4 0 CompuMethod_111 0 65535 /end CHARACTERISTIC
/begin CHARACTERISTIC FaultManager.GPS_LatLong_Timeout.ID "Fault manager configuration.  Select up to 4 actions for each fault." VALUE 0x8000304D RecordLayout_4 0 CompuMethod_1 0 65535 /end CHARACTERISTIC
/begin CHARACTERISTIC FaultManager.GPS_LatLong_Timeout.Test "Fault manager configuration.  Select up to 4 actions for each fault." VALUE 0x8000304F RecordLayout_4 0 CompuMethod_112 0 65535 /end CHARACTERISTIC
/begin CHARACTERISTIC FaultManager.GPS_LatLong_Timeout.Faulty_Samples__X_ "Fault manager configuration.  Select up to 4 actions for each fault." VALUE 0x80003051 RecordLayout_4 0 CompuMethod_1 0 65535 /end CHARACTERISTIC
/begin CHARACTERISTIC FaultManager.GPS_LatLong_Timeout.Total_Samples__Y_ "Fault manager configuration.  Select up to 4 actions for each fault." VALUE 0x80003053 RecordLayout_4 0 CompuMethod_1 0 65535 /end CHARACTERISTIC
/begin CHARACTERISTIC FaultManager.GPS_LatLong_Timeout.Action_1 "Fault manager configuration.  Select up to 4 actions for each fault." VALUE 0x80003055 RecordLayout_4 0 CompuMethod_113 0 65535 /end CHARACTERISTIC
/begin CHARACTERISTIC FaultManager.GPS_LatLong_Timeout.Action_1_Condition "Fault manager configuration.  Select up to 4 actions for each fault." VALUE 0x80003057 RecordLayout_4 0 CompuMethod_114 0 65535 /end CHARACTERISTIC
/begin CHARACTERISTIC FaultManager.GPS_LatLong_Timeout.Action_2 "Fault manager configuration.  Select up to 4 actions for each fault." VALUE 0x80003059 RecordLayout_4 0 CompuMethod_113 0 65535 /end CHARACTERISTIC
/begin CHARACTERISTIC FaultManager.GPS_LatLong_Timeout.Action_2_Condition "Fault manager configuration.  Select up to 4 actions for each fault." VALUE 0x8000305B RecordLayout_4 0 CompuMethod_114 0 65535 /end CHARACTERISTIC
/begin CHARACTERISTIC FaultManager.GPS_LatLong_Timeout.Action_3 "Fault manager configuration.  Select up to 4 actions for each fault." VALUE 0x8000305D RecordLayout_4 0 CompuMethod_113 0 65535 /end CHARACTERISTIC
/begin CHARACTERISTIC FaultManager.GPS_LatLong_Timeout.Action_3_Condition "Fault manager configuration.  Select up to 4 actions for each fault." VALUE 0x8000305F RecordLayout_4 0 CompuMethod_114 0 65535 /end CHARACTERISTIC
/begin CHARACTERISTIC FaultManager.GPS_LatLong_Timeout.Action_4 "Fault manager configuration.  Select up to 4 actions for each fault." VALUE 0x80003061 RecordLayout_4 0 CompuMethod_113 0 65535 /end CHARACTERISTIC
/begin CHARACTERISTIC FaultManager.GPS_LatLong_Timeout.Action_4_Condition "Fault manager configuration.  Select up to 4 actions for each fault." VALUE 0x80003063 RecordLayout_4 0 CompuMethod_114 0 65535 /end CHARACTERISTIC
/begin CHARACTERISTIC FaultManager.GPS_NotReady.Mode "Fault manager configuration.  Select up to 4 actions for each fault." VALUE 0x80003065 RecordLayout_4 0 CompuMethod_111 0 65535 /end CHARACTERISTIC
/begin CHARACTERISTIC FaultManager.GPS_NotReady.ID "Fault manager configuration.  Select up to 4 actions for each fault." VALUE 0x80003067 RecordLayout_4 0 CompuMethod_1 0 65535 /end CHARACTERISTIC
/begin CHARACTERISTIC FaultManager.GPS_NotReady.Test "Fault manager configuration.  Select up to 4 actions for each fault." VALUE 0x80003069 RecordLayout_4 0 CompuMethod_112 0 65535 /end CHARACTERISTIC
/begin CHARACTERISTIC FaultManager.GPS_NotReady.Faulty_Samples__X_ "Fault manager configuration.  Select up to 4 actions for each fault." VALUE 0x8000306B RecordLayout_4 0 CompuMethod_1 0 65535 /end CHARACTERISTIC
/begin CHARACTERISTIC FaultManager.GPS_NotReady.Total_Samples__Y_ "Fault manager configuration.  Select up to 4 actions for each fault." VALUE 0x8000306D RecordLayout_4 0 CompuMethod_1 0 65535 /end CHARACTERISTIC
/begin CHARACTERISTIC FaultManager.GPS_NotReady.Action_1 "Fault manager configuration.  Select up to 4 actions for each fault." VALUE 0x8000306F RecordLayout_4 0 CompuMethod_113 0 65535 /end CHARACTERISTIC
/begin CHARACTERISTIC FaultManager.GPS_NotReady.Action_1_Condition "Fault manager configuration.  Select up to 4 actions for each fault." VALUE 0x80003071 RecordLayout_4 0 CompuMethod_114 0 65535 /end CHARACTERISTIC
/begin CHARACTERISTIC FaultManager.GPS_NotReady.Action_2 "Fault manager configuration.  Select up to 4 actions for each fault." VALUE 0x80003073 RecordLayout_4 0 CompuMethod_113 0 65535 /end CHARACTERISTIC
/begin CHARACTERISTIC FaultManager.GPS_NotReady.Action_2_Condition "Fault manager configuration.  Select up to 4 actions for each fault." VALUE 0x80003075 RecordLayout_4 0 CompuMethod_114 0 65535 /end CHARACTERISTIC
/begin CHARACTERISTIC FaultManager.GPS_NotReady.Action_3 "Fault manager configuration.  Select up to 4 actions for each fault." VALUE 0x80003077 RecordLayout_4 0 CompuMethod_113 0 65535 /end CHARACTERISTIC
/begin CHARACTERISTIC FaultManager.GPS_NotReady.Action_3_Condition "Fault manager configuration.  Select up to 4 actions for each fault." VALUE 0x80003079 RecordLayout_4 0 CompuMethod_114 0 65535 /end CHARACTERISTIC
/begin CHARACTERISTIC FaultManager.GPS_NotReady.Action_4 "Fault manager configuration.  Select up to 4 actions for each fault." VALUE 0x8000307B RecordLayout_4 0 CompuMethod_113 0 65535 /end CHARACTERISTIC
/begin CHARACTERISTIC FaultManager.GPS_NotReady.Action_4_Condition "Fault manager configuration.  Select up to 4 actions for each fault." VALUE 0x8000307D RecordLayout_4 0 CompuMethod_114 0 65535 /end CHARACTERISTIC
/begin CHARACTERISTIC FaultManager.GPS_SpeedDir_Timeout.Mode "Fault manager configuration.  Select up to 4 actions for each fault." VALUE 0x8000307F RecordLayout_4 0 CompuMethod_111 0 65535 /end CHARACTERISTIC
/begin CHARACTERISTIC FaultManager.GPS_SpeedDir_Timeout.ID "Fault manager configuration.  Select up to 4 actions for each fault." VALUE 0x80003081 RecordLayout_4 0 CompuMethod_1 0 65535 /end CHARACTERISTIC
/begin CHARACTERISTIC FaultManager.GPS_SpeedDir_Timeout.Test "Fault manager configuration.  Select up to 4 actions for each fault." VALUE 0x80003083 RecordLayout_4 0 CompuMethod_112 0 65535 /end CHARACTERISTIC
/begin CHARACTERISTIC FaultManager.GPS_SpeedDir_Timeout.Faulty_Samples__X_ "Fault manager configuration.  Select up to 4 actions for each fault." VALUE 0x80003085 RecordLayout_4 0 CompuMethod_1 0 65535 /end CHARACTERISTIC
/begin CHARACTERISTIC FaultManager.GPS_SpeedDir_Timeout.Total_Samples__Y_ "Fault manager configuration.  Select up to 4 actions for each fault." VALUE 0x80003087 RecordLayout_4 0 CompuMethod_1 0 65535 /end CHARACTERISTIC
/begin CHARACTERISTIC FaultManager.GPS_SpeedDir_Timeout.Action_1 "Fault manager configuration.  Select up to 4 actions for each fault." VALUE 0x80003089 RecordLayout_4 0 CompuMethod_113 0 65535 /end CHARACTERISTIC
/begin CHARACTERISTIC FaultManager.GPS_SpeedDir_Timeout.Action_1_Condition "Fault manager configuration.  Select up to 4 actions for each fault." VALUE 0x8000308B RecordLayout_4 0 CompuMethod_114 0 65535 /end CHARACTERISTIC
/begin CHARACTERISTIC FaultManager.GPS_SpeedDir_Timeout.Action_2 "Fault manager configuration.  Select up to 4 actions for each fault." VALUE 0x8000308D RecordLayout_4 0 CompuMethod_113 0 65535 /end CHARACTERISTIC
/begin CHARACTERISTIC FaultManager.GPS_SpeedDir_Timeout.Action_2_Condition "Fault manager configuration.  Select up to 4 actions for each fault." VALUE 0x8000308F RecordLayout_4 0 CompuMethod_114 0 65535 /end CHARACTERISTIC
/begin CHARACTERISTIC FaultManager.GPS_SpeedDir_Timeout.Action_3 "Fault manager configuration.  Select up to 4 actions for each fault." VALUE 0x80003091 RecordLayout_4 0 CompuMethod_113 0 65535 /end CHARACTERISTIC
/begin CHARACTERISTIC FaultManager.GPS_SpeedDir_Timeout.Action_3_Condition "Fault manager configuration.  Select up to 4 actions for each fault." VALUE 0x80003093 RecordLayout_4 0 CompuMethod_114 0 65535 /end CHARACTERISTIC
/begin CHARACTERISTIC FaultManager.GPS_SpeedDir_Timeout.Action_4 "Fault manager configuration.  Select up to 4 actions for each fault." VALUE 0x80003095 RecordLayout_4 0 CompuMethod_113 0 65535 /end CHARACTERISTIC
/begin CHARACTERISTIC FaultManager.GPS_SpeedDir_Timeout.Action_4_Condition "Fault manager configuration.  Select up to 4 actions for each fault." VALUE 0x80003097 RecordLayout_4 0 CompuMethod_114 0 65535 /end CHARACTERISTIC
/begin CHARACTERISTIC FaultManager.HardOverBoost_Fault.Mode "Fault manager configuration.  Select up to 4 actions for each fault." VALUE 0x80003099 RecordLayout_4 0 CompuMethod_111 0 65535 /end CHARACTERISTIC
/begin CHARACTERISTIC FaultManager.HardOverBoost_Fault.ID "Fault manager configuration.  Select up to 4 actions for each fault." VALUE 0x8000309B RecordLayout_4 0 CompuMethod_1 0 65535 /end CHARACTERISTIC
/begin CHARACTERISTIC FaultManager.HardOverBoost_Fault.Test "Fault manager configuration.  Select up to 4 actions for each fault." VALUE 0x8000309D RecordLayout_4 0 CompuMethod_112 0 65535 /end CHARACTERISTIC
/begin CHARACTERISTIC FaultManager.HardOverBoost_Fault.Faulty_Samples__X_ "Fault manager configuration.  Select up to 4 actions for each fault." VALUE 0x8000309F RecordLayout_4 0 CompuMethod_1 0 65535 /end CHARACTERISTIC
/begin CHARACTERISTIC FaultManager.HardOverBoost_Fault.Total_Samples__Y_ "Fault manager configuration.  Select up to 4 actions for each fault." VALUE 0x800030A1 RecordLayout_4 0 CompuMethod_1 0 65535 /end CHARACTERISTIC
/begin CHARACTERISTIC FaultManager.HardOverBoost_Fault.Action_1 "Fault manager configuration.  Select up to 4 actions for each fault." VALUE 0x800030A3 RecordLayout_4 0 CompuMethod_113 0 65535 /end CHARACTERISTIC
/begin CHARACTERISTIC FaultManager.HardOverBoost_Fault.Action_1_Condition "Fault manager configuration.  Select up to 4 actions for each fault." VALUE 0x800030A5 RecordLayout_4 0 CompuMethod_114 0 65535 /end CHARACTERISTIC
/begin CHARACTERISTIC FaultManager.HardOverBoost_Fault.Action_2 "Fault manager configuration.  Select up to 4 actions for each fault." VALUE 0x800030A7 RecordLayout_4 0 CompuMethod_113 0 65535 /end CHARACTERISTIC
/begin CHARACTERISTIC FaultManager.HardOverBoost_Fault.Action_2_Condition "Fault manager configuration.  Select up to 4 actions for each fault." VALUE 0x800030A9 RecordLayout_4 0 CompuMethod_114 0 65535 /end CHARACTERISTIC
/begin CHARACTERISTIC FaultManager.HardOverBoost_Fault.Action_3 "Fault manager configuration.  Select up to 4 actions for each fault." VALUE 0x800030AB RecordLayout_4 0 CompuMethod_113 0 65535 /end CHARACTERISTIC
/begin CHARACTERISTIC FaultManager.HardOverBoost_Fault.Action_3_Condition "Fault manager configuration.  Select up to 4 actions for each fault." VALUE 0x800030AD RecordLayout_4 0 CompuMethod_114 0 65535 /end CHARACTERISTIC
/begin CHARACTERISTIC FaultManager.HardOverBoost_Fault.Action_4 "Fault manager configuration.  Select up to 4 actions for each fault." VALUE 0x800030AF RecordLayout_4 0 CompuMethod_113 0 65535 /end CHARACTERISTIC
/begin CHARACTERISTIC FaultManager.HardOverBoost_Fault.Action_4_Condition "Fault manager configuration.  Select up to 4 actions for each fault." VALUE 0x800030B1 RecordLayout_4 0 CompuMethod_114 0 65535 /end CHARACTERISTIC
/begin CHARACTERISTIC FaultManager.HardOverspeed.Mode "Fault manager configuration.  Select up to 4 actions for each fault." VALUE 0x800030B3 RecordLayout_4 0 CompuMethod_111 0 65535 /end CHARACTERISTIC
/begin CHARACTERISTIC FaultManager.HardOverspeed.ID "Fault manager configuration.  Select up to 4 actions for each fault." VALUE 0x800030B5 RecordLayout_4 0 CompuMethod_1 0 65535 /end CHARACTERISTIC
/begin CHARACTERISTIC FaultManager.HardOverspeed.Test "Fault manager configuration.  Select up to 4 actions for each fault." VALUE 0x800030B7 RecordLayout_4 0 CompuMethod_112 0 65535 /end CHARACTERISTIC
/begin CHARACTERISTIC FaultManager.HardOverspeed.Faulty_Samples__X_ "Fault manager configuration.  Select up to 4 actions for each fault." VALUE 0x800030B9 RecordLayout_4 0 CompuMethod_1 0 65535 /end CHARACTERISTIC
/begin CHARACTERISTIC FaultManager.HardOverspeed.Total_Samples__Y_ "Fault manager configuration.  Select up to 4 actions for each fault." VALUE 0x800030BB RecordLayout_4 0 CompuMethod_1 0 65535 /end CHARACTERISTIC
/begin CHARACTERISTIC FaultManager.HardOverspeed.Action_1 "Fault manager configuration.  Select up to 4 actions for each fault." VALUE 0x800030BD RecordLayout_4 0 CompuMethod_113 0 65535 /end CHARACTERISTIC
/begin CHARACTERISTIC FaultManager.HardOverspeed.Action_1_Condition "Fault manager configuration.  Select up to 4 actions for each fault." VALUE 0x800030BF RecordLayout_4 0 CompuMethod_114 0 65535 /end CHARACTERISTIC
/begin CHARACTERISTIC FaultManager.HardOverspeed.Action_2 "Fault manager configuration.  Select up to 4 actions for each fault." VALUE 0x800030C1 RecordLayout_4 0 CompuMethod_113 0 65535 /end CHARACTERISTIC
/begin CHARACTERISTIC FaultManager.HardOverspeed.Action_2_Condition "Fault manager configuration.  Select up to 4 actions for each fault." VALUE 0x800030C3 RecordLayout_4 0 CompuMethod_114 0 65535 /end CHARACTERISTIC
/begin CHARACTERISTIC FaultManager.HardOverspeed.Action_3 "Fault manager configuration.  Select up to 4 actions for each fault." VALUE 0x800030C5 RecordLayout_4 0 CompuMethod_113 0 65535 /end CHARACTERISTIC
/begin CHARACTERISTIC FaultManager.HardOverspeed.Action_3_Condition "Fault manager configuration.  Select up to 4 actions for each fault." VALUE 0x800030C7 RecordLayout_4 0 CompuMethod_114 0 65535 /end CHARACTERISTIC
/begin CHARACTERISTIC FaultManager.HardOverspeed.Action_4 "Fault manager configuration.  Select up to 4 actions for each fault." VALUE 0x800030C9 RecordLayout_4 0 CompuMethod_113 0 65535 /end CHARACTERISTIC
/begin CHARACTERISTIC FaultManager.HardOverspeed.Action_4_Condition "Fault manager configuration.  Select up to 4 actions for each fault." VALUE 0x800030CB RecordLayout_4 0 CompuMethod_114 0 65535 /end CHARACTERISTIC
/begin CHARACTERISTIC FaultManager.IATRangeHigh.Mode "Fault manager configuration.  Select up to 4 actions for each fault." VALUE 0x800030CD RecordLayout_4 0 CompuMethod_111 0 65535 /end CHARACTERISTIC
/begin CHARACTERISTIC FaultManager.IATRangeHigh.ID "Fault manager configuration.  Select up to 4 actions for each fault." VALUE 0x800030CF RecordLayout_4 0 CompuMethod_1 0 65535 /end CHARACTERISTIC
/begin CHARACTERISTIC FaultManager.IATRangeHigh.Test "Fault manager configuration.  Select up to 4 actions for each fault." VALUE 0x800030D1 RecordLayout_4 0 CompuMethod_112 0 65535 /end CHARACTERISTIC
/begin CHARACTERISTIC FaultManager.IATRangeHigh.Faulty_Samples__X_ "Fault manager configuration.  Select up to 4 actions for each fault." VALUE 0x800030D3 RecordLayout_4 0 CompuMethod_1 0 65535 /end CHARACTERISTIC
/begin CHARACTERISTIC FaultManager.IATRangeHigh.Total_Samples__Y_ "Fault manager configuration.  Select up to 4 actions for each fault." VALUE 0x800030D5 RecordLayout_4 0 CompuMethod_1 0 65535 /end CHARACTERISTIC
/begin CHARACTERISTIC FaultManager.IATRangeHigh.Action_1 "Fault manager configuration.  Select up to 4 actions for each fault." VALUE 0x800030D7 RecordLayout_4 0 CompuMethod_113 0 65535 /end CHARACTERISTIC
/begin CHARACTERISTIC FaultManager.IATRangeHigh.Action_1_Condition "Fault manager configuration.  Select up to 4 actions for each fault." VALUE 0x800030D9 RecordLayout_4 0 CompuMethod_114 0 65535 /end CHARACTERISTIC
/begin CHARACTERISTIC FaultManager.IATRangeHigh.Action_2 "Fault manager configuration.  Select up to 4 actions for each fault." VALUE 0x800030DB RecordLayout_4 0 CompuMethod_113 0 65535 /end CHARACTERISTIC
/begin CHARACTERISTIC FaultManager.IATRangeHigh.Action_2_Condition "Fault manager configuration.  Select up to 4 actions for each fault." VALUE 0x800030DD RecordLayout_4 0 CompuMethod_114 0 65535 /end CHARACTERISTIC
/begin CHARACTERISTIC FaultManager.IATRangeHigh.Action_3 "Fault manager configuration.  Select up to 4 actions for each fault." VALUE 0x800030DF RecordLayout_4 0 CompuMethod_113 0 65535 /end CHARACTERISTIC
/begin CHARACTERISTIC FaultManager.IATRangeHigh.Action_3_Condition "Fault manager configuration.  Select up to 4 actions for each fault." VALUE 0x800030E1 RecordLayout_4 0 CompuMethod_114 0 65535 /end CHARACTERISTIC
/begin CHARACTERISTIC FaultManager.IATRangeHigh.Action_4 "Fault manager configuration.  Select up to 4 actions for each fault." VALUE 0x800030E3 RecordLayout_4 0 CompuMethod_113 0 65535 /end CHARACTERISTIC
/begin CHARACTERISTIC FaultManager.IATRangeHigh.Action_4_Condition "Fault manager configuration.  Select up to 4 actions for each fault." VALUE 0x800030E5 RecordLayout_4 0 CompuMethod_114 0 65535 /end CHARACTERISTIC
/begin CHARACTERISTIC FaultManager.IATRangeLow.Mode "Fault manager configuration.  Select up to 4 actions for each fault." VALUE 0x800030E7 RecordLayout_4 0 CompuMethod_111 0 65535 /end CHARACTERISTIC
/begin CHARACTERISTIC FaultManager.IATRangeLow.ID "Fault manager configuration.  Select up to 4 actions for each fault." VALUE 0x800030E9 RecordLayout_4 0 CompuMethod_1 0 65535 /end CHARACTERISTIC
/begin CHARACTERISTIC FaultManager.IATRangeLow.Test "Fault manager configuration.  Select up to 4 actions for each fault." VALUE 0x800030EB RecordLayout_4 0 CompuMethod_112 0 65535 /end CHARACTERISTIC
/begin CHARACTERISTIC FaultManager.IATRangeLow.Faulty_Samples__X_ "Fault manager configuration.  Select up to 4 actions for each fault." VALUE 0x800030ED RecordLayout_4 0 CompuMethod_1 0 65535 /end CHARACTERISTIC
/begin CHARACTERISTIC FaultManager.IATRangeLow.Total_Samples__Y_ "Fault manager configuration.  Select up to 4 actions for each fault." VALUE 0x800030EF RecordLayout_4 0 CompuMethod_1 0 65535 /end CHARACTERISTIC
/begin CHARACTERISTIC FaultManager.IATRangeLow.Action_1 "Fault manager configuration.  Select up to 4 actions for each fault." VALUE 0x800030F1 RecordLayout_4 0 CompuMethod_113 0 65535 /end CHARACTERISTIC
/begin CHARACTERISTIC FaultManager.IATRangeLow.Action_1_Condition "Fault manager configuration.  Select up to 4 actions for each fault." VALUE 0x800030F3 RecordLayout_4 0 CompuMethod_114 0 65535 /end CHARACTERISTIC
/begin CHARACTERISTIC FaultManager.IATRangeLow.Action_2 "Fault manager configuration.  Select up to 4 actions for each fault." VALUE 0x800030F5 RecordLayout_4 0 CompuMethod_113 0 65535 /end CHARACTERISTIC
/begin CHARACTERISTIC FaultManager.IATRangeLow.Action_2_Condition "Fault manager configuration.  Select up to 4 actions for each fault." VALUE 0x800030F7 RecordLayout_4 0 CompuMethod_114 0 65535 /end CHARACTERISTIC
/begin CHARACTERISTIC FaultManager.IATRangeLow.Action_3 "Fault manager configuration.  Select up to 4 actions for each fault." VALUE 0x800030F9 RecordLayout_4 0 CompuMethod_113 0 65535 /end CHARACTERISTIC
/begin CHARACTERISTIC FaultManager.IATRangeLow.Action_3_Condition "Fault manager configuration.  Select up to 4 actions for each fault." VALUE 0x800030FB RecordLayout_4 0 CompuMethod_114 0 65535 /end CHARACTERISTIC
/begin CHARACTERISTIC FaultManager.IATRangeLow.Action_4 "Fault manager configuration.  Select up to 4 actions for each fault." VALUE 0x800030FD RecordLayout_4 0 CompuMethod_113 0 65535 /end CHARACTERISTIC
/begin CHARACTERISTIC FaultManager.IATRangeLow.Action_4_Condition "Fault manager configuration.  Select up to 4 actions for each fault." VALUE 0x800030FF RecordLayout_4 0 CompuMethod_114 0 65535 /end CHARACTERISTIC
/begin CHARACTERISTIC FaultManager.Inj1Open.Mode "Fault manager configuration.  Select up to 4 actions for each fault." VALUE 0x80003101 RecordLayout_4 0 CompuMethod_111 0 65535 /end CHARACTERISTIC
/begin CHARACTERISTIC FaultManager.Inj1Open.ID "Fault manager configuration.  Select up to 4 actions for each fault." VALUE 0x80003103 RecordLayout_4 0 CompuMethod_1 0 65535 /end CHARACTERISTIC
/begin CHARACTERISTIC FaultManager.Inj1Open.Test "Fault manager configuration.  Select up to 4 actions for each fault." VALUE 0x80003105 RecordLayout_4 0 CompuMethod_112 0 65535 /end CHARACTERISTIC
/begin CHARACTERISTIC FaultManager.Inj1Open.Faulty_Samples__X_ "Fault manager configuration.  Select up to 4 actions for each fault." VALUE 0x80003107 RecordLayout_4 0 CompuMethod_1 0 65535 /end CHARACTERISTIC
/begin CHARACTERISTIC FaultManager.Inj1Open.Total_Samples__Y_ "Fault manager configuration.  Select up to 4 actions for each fault." VALUE 0x80003109 RecordLayout_4 0 CompuMethod_1 0 65535 /end CHARACTERISTIC
/begin CHARACTERISTIC FaultManager.Inj1Open.Action_1 "Fault manager configuration.  Select up to 4 actions for each fault." VALUE 0x8000310B RecordLayout_4 0 CompuMethod_113 0 65535 /end CHARACTERISTIC
/begin CHARACTERISTIC FaultManager.Inj1Open.Action_1_Condition "Fault manager configuration.  Select up to 4 actions for each fault." VALUE 0x8000310D RecordLayout_4 0 CompuMethod_114 0 65535 /end CHARACTERISTIC
/begin CHARACTERISTIC FaultManager.Inj1Open.Action_2 "Fault manager configuration.  Select up to 4 actions for each fault." VALUE 0x8000310F RecordLayout_4 0 CompuMethod_113 0 65535 /end CHARACTERISTIC
/begin CHARACTERISTIC FaultManager.Inj1Open.Action_2_Condition "Fault manager configuration.  Select up to 4 actions for each fault." VALUE 0x80003111 RecordLayout_4 0 CompuMethod_114 0 65535 /end CHARACTERISTIC
/begin CHARACTERISTIC FaultManager.Inj1Open.Action_3 "Fault manager configuration.  Select up to 4 actions for each fault." VALUE 0x80003113 RecordLayout_4 0 CompuMethod_113 0 65535 /end CHARACTERISTIC
/begin CHARACTERISTIC FaultManager.Inj1Open.Action_3_Condition "Fault manager configuration.  Select up to 4 actions for each fault." VALUE 0x80003115 RecordLayout_4 0 CompuMethod_114 0 65535 /end CHARACTERISTIC
/begin CHARACTERISTIC FaultManager.Inj1Open.Action_4 "Fault manager configuration.  Select up to 4 actions for each fault." VALUE 0x80003117 RecordLayout_4 0 CompuMethod_113 0 65535 /end CHARACTERISTIC
/begin CHARACTERISTIC FaultManager.Inj1Open.Action_4_Condition "Fault manager configuration.  Select up to 4 actions for each fault." VALUE 0x80003119 RecordLayout_4 0 CompuMethod_114 0 65535 /end CHARACTERISTIC
/begin CHARACTERISTIC FaultManager.Inj2Open.Mode "Fault manager configuration.  Select up to 4 actions for each fault." VALUE 0x8000311B RecordLayout_4 0 CompuMethod_111 0 65535 /end CHARACTERISTIC
/begin CHARACTERISTIC FaultManager.Inj2Open.ID "Fault manager configuration.  Select up to 4 actions for each fault." VALUE 0x8000311D RecordLayout_4 0 CompuMethod_1 0 65535 /end CHARACTERISTIC
/begin CHARACTERISTIC FaultManager.Inj2Open.Test "Fault manager configuration.  Select up to 4 actions for each fault." VALUE 0x8000311F RecordLayout_4 0 CompuMethod_112 0 65535 /end CHARACTERISTIC
/begin CHARACTERISTIC FaultManager.Inj2Open.Faulty_Samples__X_ "Fault manager configuration.  Select up to 4 actions for each fault." VALUE 0x80003121 RecordLayout_4 0 CompuMethod_1 0 65535 /end CHARACTERISTIC
/begin CHARACTERISTIC FaultManager.Inj2Open.Total_Samples__Y_ "Fault manager configuration.  Select up to 4 actions for each fault." VALUE 0x80003123 RecordLayout_4 0 CompuMethod_1 0 65535 /end CHARACTERISTIC
/begin CHARACTERISTIC FaultManager.Inj2Open.Action_1 "Fault manager configuration.  Select up to 4 actions for each fault." VALUE 0x80003125 RecordLayout_4 0 CompuMethod_113 0 65535 /end CHARACTERISTIC
/begin CHARACTERISTIC FaultManager.Inj2Open.Action_1_Condition "Fault manager configuration.  Select up to 4 actions for each fault." VALUE 0x80003127 RecordLayout_4 0 CompuMethod_114 0 65535 /end CHARACTERISTIC
/begin CHARACTERISTIC FaultManager.Inj2Open.Action_2 "Fault manager configuration.  Select up to 4 actions for each fault." VALUE 0x80003129 RecordLayout_4 0 CompuMethod_113 0 65535 /end CHARACTERISTIC
/begin CHARACTERISTIC FaultManager.Inj2Open.Action_2_Condition "Fault manager configuration.  Select up to 4 actions for each fault." VALUE 0x8000312B RecordLayout_4 0 CompuMethod_114 0 65535 /end CHARACTERISTIC
/begin CHARACTERISTIC FaultManager.Inj2Open.Action_3 "Fault manager configuration.  Select up to 4 actions for each fault." VALUE 0x8000312D RecordLayout_4 0 CompuMethod_113 0 65535 /end CHARACTERISTIC
/begin CHARACTERISTIC FaultManager.Inj2Open.Action_3_Condition "Fault manager configuration.  Select up to 4 actions for each fault." VALUE 0x8000312F RecordLayout_4 0 CompuMethod_114 0 65535 /end CHARACTERISTIC
/begin CHARACTERISTIC FaultManager.Inj2Open.Action_4 "Fault manager configuration.  Select up to 4 actions for each fault." VALUE 0x80003131 RecordLayout_4 0 CompuMethod_113 0 65535 /end CHARACTERISTIC
/begin CHARACTERISTIC FaultManager.Inj2Open.Action_4_Condition "Fault manager configuration.  Select up to 4 actions for each fault." VALUE 0x80003133 RecordLayout_4 0 CompuMethod_114 0 65535 /end CHARACTERISTIC
/begin CHARACTERISTIC FaultManager.Inj3Open.Mode "Fault manager configuration.  Select up to 4 actions for each fault." VALUE 0x80003135 RecordLayout_4 0 CompuMethod_111 0 65535 /end CHARACTERISTIC
/begin CHARACTERISTIC FaultManager.Inj3Open.ID "Fault manager configuration.  Select up to 4 actions for each fault." VALUE 0x80003137 RecordLayout_4 0 CompuMethod_1 0 65535 /end CHARACTERISTIC
/begin CHARACTERISTIC FaultManager.Inj3Open.Test "Fault manager configuration.  Select up to 4 actions for each fault." VALUE 0x80003139 RecordLayout_4 0 CompuMethod_112 0 65535 /end CHARACTERISTIC
/begin CHARACTERISTIC FaultManager.Inj3Open.Faulty_Samples__X_ "Fault manager configuration.  Select up to 4 actions for each fault." VALUE 0x8000313B RecordLayout_4 0 CompuMethod_1 0 65535 /end CHARACTERISTIC
/begin CHARACTERISTIC FaultManager.Inj3Open.Total_Samples__Y_ "Fault manager configuration.  Select up to 4 actions for each fault." VALUE 0x8000313D RecordLayout_4 0 CompuMethod_1 0 65535 /end CHARACTERISTIC
/begin CHARACTERISTIC FaultManager.Inj3Open.Action_1 "Fault manager configuration.  Select up to 4 actions for each fault." VALUE 0x8000313F RecordLayout_4 0 CompuMethod_113 0 65535 /end CHARACTERISTIC
/begin CHARACTERISTIC FaultManager.Inj3Open.Action_1_Condition "Fault manager configuration.  Select up to 4 actions for each fault." VALUE 0x80003141 RecordLayout_4 0 CompuMethod_114 0 65535 /end CHARACTERISTIC
/begin CHARACTERISTIC FaultManager.Inj3Open.Action_2 "Fault manager configuration.  Select up to 4 actions for each fault." VALUE 0x80003143 RecordLayout_4 0 CompuMethod_113 0 65535 /end CHARACTERISTIC
/begin CHARACTERISTIC FaultManager.Inj3Open.Action_2_Condition "Fault manager configuration.  Select up to 4 actions for each fault." VALUE 0x80003145 RecordLayout_4 0 CompuMethod_114 0 65535 /end CHARACTERISTIC
/begin CHARACTERISTIC FaultManager.Inj3Open.Action_3 "Fault manager configuration.  Select up to 4 actions for each fault." VALUE 0x80003147 RecordLayout_4 0 CompuMethod_113 0 65535 /end CHARACTERISTIC
/begin CHARACTERISTIC FaultManager.Inj3Open.Action_3_Condition "Fault manager configuration.  Select up to 4 actions for each fault." VALUE 0x80003149 RecordLayout_4 0 CompuMethod_114 0 65535 /end CHARACTERISTIC
/begin CHARACTERISTIC FaultManager.Inj3Open.Action_4 "Fault manager configuration.  Select up to 4 actions for each fault." VALUE 0x8000314B RecordLayout_4 0 CompuMethod_113 0 65535 /end CHARACTERISTIC
/begin CHARACTERISTIC FaultManager.Inj3Open.Action_4_Condition "Fault manager configuration.  Select up to 4 actions for each fault." VALUE 0x8000314D RecordLayout_4 0 CompuMethod_114 0 65535 /end CHARACTERISTIC
/begin CHARACTERISTIC FaultManager.Inj4Open.Mode "Fault manager configuration.  Select up to 4 actions for each fault." VALUE 0x8000314F RecordLayout_4 0 CompuMethod_111 0 65535 /end CHARACTERISTIC
/begin CHARACTERISTIC FaultManager.Inj4Open.ID "Fault manager configuration.  Select up to 4 actions for each fault." VALUE 0x80003151 RecordLayout_4 0 CompuMethod_1 0 65535 /end CHARACTERISTIC
/begin CHARACTERISTIC FaultManager.Inj4Open.Test "Fault manager configuration.  Select up to 4 actions for each fault." VALUE 0x80003153 RecordLayout_4 0 CompuMethod_112 0 65535 /end CHARACTERISTIC
/begin CHARACTERISTIC FaultManager.Inj4Open.Faulty_Samples__X_ "Fault manager configuration.  Select up to 4 actions for each fault." VALUE 0x80003155 RecordLayout_4 0 CompuMethod_1 0 65535 /end CHARACTERISTIC
/begin CHARACTERISTIC FaultManager.Inj4Open.Total_Samples__Y_ "Fault manager configuration.  Select up to 4 actions for each fault." VALUE 0x80003157 RecordLayout_4 0 CompuMethod_1 0 65535 /end CHARACTERISTIC
/begin CHARACTERISTIC FaultManager.Inj4Open.Action_1 "Fault manager configuration.  Select up to 4 actions for each fault." VALUE 0x80003159 RecordLayout_4 0 CompuMethod_113 0 65535 /end CHARACTERISTIC
/begin CHARACTERISTIC FaultManager.Inj4Open.Action_1_Condition "Fault manager configuration.  Select up to 4 actions for each fault." VALUE 0x8000315B RecordLayout_4 0 CompuMethod_114 0 65535 /end CHARACTERISTIC
/begin CHARACTERISTIC FaultManager.Inj4Open.Action_2 "Fault manager configuration.  Select up to 4 actions for each fault." VALUE 0x8000315D RecordLayout_4 0 CompuMethod_113 0 65535 /end CHARACTERISTIC
/begin CHARACTERISTIC FaultManager.Inj4Open.Action_2_Condition "Fault manager configuration.  Select up to 4 actions for each fault." VALUE 0x8000315F RecordLayout_4 0 CompuMethod_114 0 65535 /end CHARACTERISTIC
/begin CHARACTERISTIC FaultManager.Inj4Open.Action_3 "Fault manager configuration.  Select up to 4 actions for each fault." VALUE 0x80003161 RecordLayout_4 0 CompuMethod_113 0 65535 /end CHARACTERISTIC
/begin CHARACTERISTIC FaultManager.Inj4Open.Action_3_Condition "Fault manager configuration.  Select up to 4 actions for each fault." VALUE 0x80003163 RecordLayout_4 0 CompuMethod_114 0 65535 /end CHARACTERISTIC
/begin CHARACTERISTIC FaultManager.Inj4Open.Action_4 "Fault manager configuration.  Select up to 4 actions for each fault." VALUE 0x80003165 RecordLayout_4 0 CompuMethod_113 0 65535 /end CHARACTERISTIC
/begin CHARACTERISTIC FaultManager.Inj4Open.Action_4_Condition "Fault manager configuration.  Select up to 4 actions for each fault." VALUE 0x80003167 RecordLayout_4 0 CompuMethod_114 0 65535 /end CHARACTERISTIC
/begin CHARACTERISTIC FaultManager.Inj5Open.Mode "Fault manager configuration.  Select up to 4 actions for each fault." VALUE 0x80003169 RecordLayout_4 0 CompuMethod_111 0 65535 /end CHARACTERISTIC
/begin CHARACTERISTIC FaultManager.Inj5Open.ID "Fault manager configuration.  Select up to 4 actions for each fault." VALUE 0x8000316B RecordLayout_4 0 CompuMethod_1 0 65535 /end CHARACTERISTIC
/begin CHARACTERISTIC FaultManager.Inj5Open.Test "Fault manager configuration.  Select up to 4 actions for each fault." VALUE 0x8000316D RecordLayout_4 0 CompuMethod_112 0 65535 /end CHARACTERISTIC
/begin CHARACTERISTIC FaultManager.Inj5Open.Faulty_Samples__X_ "Fault manager configuration.  Select up to 4 actions for each fault." VALUE 0x8000316F RecordLayout_4 0 CompuMethod_1 0 65535 /end CHARACTERISTIC
/begin CHARACTERISTIC FaultManager.Inj5Open.Total_Samples__Y_ "Fault manager configuration.  Select up to 4 actions for each fault." VALUE 0x80003171 RecordLayout_4 0 CompuMethod_1 0 65535 /end CHARACTERISTIC
/begin CHARACTERISTIC FaultManager.Inj5Open.Action_1 "Fault manager configuration.  Select up to 4 actions for each fault." VALUE 0x80003173 RecordLayout_4 0 CompuMethod_113 0 65535 /end CHARACTERISTIC
/begin CHARACTERISTIC FaultManager.Inj5Open.Action_1_Condition "Fault manager configuration.  Select up to 4 actions for each fault." VALUE 0x80003175 RecordLayout_4 0 CompuMethod_114 0 65535 /end CHARACTERISTIC
/begin CHARACTERISTIC FaultManager.Inj5Open.Action_2 "Fault manager configuration.  Select up to 4 actions for each fault." VALUE 0x80003177 RecordLayout_4 0 CompuMethod_113 0 65535 /end CHARACTERISTIC
/begin CHARACTERISTIC FaultManager.Inj5Open.Action_2_Condition "Fault manager configuration.  Select up to 4 actions for each fault." VALUE 0x80003179 RecordLayout_4 0 CompuMethod_114 0 65535 /end CHARACTERISTIC
/begin CHARACTERISTIC FaultManager.Inj5Open.Action_3 "Fault manager configuration.  Select up to 4 actions for each fault." VALUE 0x8000317B RecordLayout_4 0 CompuMethod_113 0 65535 /end CHARACTERISTIC
/begin CHARACTERISTIC FaultManager.Inj5Open.Action_3_Condition "Fault manager configuration.  Select up to 4 actions for each fault." VALUE 0x8000317D RecordLayout_4 0 CompuMethod_114 0 65535 /end CHARACTERISTIC
/begin CHARACTERISTIC FaultManager.Inj5Open.Action_4 "Fault manager configuration.  Select up to 4 actions for each fault." VALUE 0x8000317F RecordLayout_4 0 CompuMethod_113 0 65535 /end CHARACTERISTIC
/begin CHARACTERISTIC FaultManager.Inj5Open.Action_4_Condition "Fault manager configuration.  Select up to 4 actions for each fault." VALUE 0x80003181 RecordLayout_4 0 CompuMethod_114 0 65535 /end CHARACTERISTIC
/begin CHARACTERISTIC FaultManager.Inj6Open.Mode "Fault manager configuration.  Select up to 4 actions for each fault." VALUE 0x80003183 RecordLayout_4 0 CompuMethod_111 0 65535 /end CHARACTERISTIC
/begin CHARACTERISTIC FaultManager.Inj6Open.ID "Fault manager configuration.  Select up to 4 actions for each fault." VALUE 0x80003185 RecordLayout_4 0 CompuMethod_1 0 65535 /end CHARACTERISTIC
/begin CHARACTERISTIC FaultManager.Inj6Open.Test "Fault manager configuration.  Select up to 4 actions for each fault." VALUE 0x80003187 RecordLayout_4 0 CompuMethod_112 0 65535 /end CHARACTERISTIC
/begin CHARACTERISTIC FaultManager.Inj6Open.Faulty_Samples__X_ "Fault manager configuration.  Select up to 4 actions for each fault." VALUE 0x80003189 RecordLayout_4 0 CompuMethod_1 0 65535 /end CHARACTERISTIC
/begin CHARACTERISTIC FaultManager.Inj6Open.Total_Samples__Y_ "Fault manager configuration.  Select up to 4 actions for each fault." VALUE 0x8000318B RecordLayout_4 0 CompuMethod_1 0 65535 /end CHARACTERISTIC
/begin CHARACTERISTIC FaultManager.Inj6Open.Action_1 "Fault manager configuration.  Select up to 4 actions for each fault." VALUE 0x8000318D RecordLayout_4 0 CompuMethod_113 0 65535 /end CHARACTERISTIC
/begin CHARACTERISTIC FaultManager.Inj6Open.Action_1_Condition "Fault manager configuration.  Select up to 4 actions for each fault." VALUE 0x8000318F RecordLayout_4 0 CompuMethod_114 0 65535 /end CHARACTERISTIC
/begin CHARACTERISTIC FaultManager.Inj6Open.Action_2 "Fault manager configuration.  Select up to 4 actions for each fault." VALUE 0x80003191 RecordLayout_4 0 CompuMethod_113 0 65535 /end CHARACTERISTIC
/begin CHARACTERISTIC FaultManager.Inj6Open.Action_2_Condition "Fault manager configuration.  Select up to 4 actions for each fault." VALUE 0x80003193 RecordLayout_4 0 CompuMethod_114 0 65535 /end CHARACTERISTIC
/begin CHARACTERISTIC FaultManager.Inj6Open.Action_3 "Fault manager configuration.  Select up to 4 actions for each fault." VALUE 0x80003195 RecordLayout_4 0 CompuMethod_113 0 65535 /end CHARACTERISTIC
/begin CHARACTERISTIC FaultManager.Inj6Open.Action_3_Condition "Fault manager configuration.  Select up to 4 actions for each fault." VALUE 0x80003197 RecordLayout_4 0 CompuMethod_114 0 65535 /end CHARACTERISTIC
/begin CHARACTERISTIC FaultManager.Inj6Open.Action_4 "Fault manager configuration.  Select up to 4 actions for each fault." VALUE 0x80003199 RecordLayout_4 0 CompuMethod_113 0 65535 /end CHARACTERISTIC
/begin CHARACTERISTIC FaultManager.Inj6Open.Action_4_Condition "Fault manager configuration.  Select up to 4 actions for each fault." VALUE 0x8000319B RecordLayout_4 0 CompuMethod_114 0 65535 /end CHARACTERISTIC
/begin CHARACTERISTIC FaultManager.Inj7Open.Mode "Fault manager configuration.  Select up to 4 actions for each fault." VALUE 0x8000319D RecordLayout_4 0 CompuMethod_111 0 65535 /end CHARACTERISTIC
/begin CHARACTERISTIC FaultManager.Inj7Open.ID "Fault manager configuration.  Select up to 4 actions for each fault." VALUE 0x8000319F RecordLayout_4 0 CompuMethod_1 0 65535 /end CHARACTERISTIC
/begin CHARACTERISTIC FaultManager.Inj7Open.Test "Fault manager configuration.  Select up to 4 actions for each fault." VALUE 0x800031A1 RecordLayout_4 0 CompuMethod_112 0 65535 /end CHARACTERISTIC
/begin CHARACTERISTIC FaultManager.Inj7Open.Faulty_Samples__X_ "Fault manager configuration.  Select up to 4 actions for each fault." VALUE 0x800031A3 RecordLayout_4 0 CompuMethod_1 0 65535 /end CHARACTERISTIC
/begin CHARACTERISTIC FaultManager.Inj7Open.Total_Samples__Y_ "Fault manager configuration.  Select up to 4 actions for each fault." VALUE 0x800031A5 RecordLayout_4 0 CompuMethod_1 0 65535 /end CHARACTERISTIC
/begin CHARACTERISTIC FaultManager.Inj7Open.Action_1 "Fault manager configuration.  Select up to 4 actions for each fault." VALUE 0x800031A7 RecordLayout_4 0 CompuMethod_113 0 65535 /end CHARACTERISTIC
/begin CHARACTERISTIC FaultManager.Inj7Open.Action_1_Condition "Fault manager configuration.  Select up to 4 actions for each fault." VALUE 0x800031A9 RecordLayout_4 0 CompuMethod_114 0 65535 /end CHARACTERISTIC
/begin CHARACTERISTIC FaultManager.Inj7Open.Action_2 "Fault manager configuration.  Select up to 4 actions for each fault." VALUE 0x800031AB RecordLayout_4 0 CompuMethod_113 0 65535 /end CHARACTERISTIC
/begin CHARACTERISTIC FaultManager.Inj7Open.Action_2_Condition "Fault manager configuration.  Select up to 4 actions for each fault." VALUE 0x800031AD RecordLayout_4 0 CompuMethod_114 0 65535 /end CHARACTERISTIC
/begin CHARACTERISTIC FaultManager.Inj7Open.Action_3 "Fault manager configuration.  Select up to 4 actions for each fault." VALUE 0x800031AF RecordLayout_4 0 CompuMethod_113 0 65535 /end CHARACTERISTIC
/begin CHARACTERISTIC FaultManager.Inj7Open.Action_3_Condition "Fault manager configuration.  Select up to 4 actions for each fault." VALUE 0x800031B1 RecordLayout_4 0 CompuMethod_114 0 65535 /end CHARACTERISTIC
/begin CHARACTERISTIC FaultManager.Inj7Open.Action_4 "Fault manager configuration.  Select up to 4 actions for each fault." VALUE 0x800031B3 RecordLayout_4 0 CompuMethod_113 0 65535 /end CHARACTERISTIC
/begin CHARACTERISTIC FaultManager.Inj7Open.Action_4_Condition "Fault manager configuration.  Select up to 4 actions for each fault." VALUE 0x800031B5 RecordLayout_4 0 CompuMethod_114 0 65535 /end CHARACTERISTIC
/begin CHARACTERISTIC FaultManager.Inj8Open.Mode "Fault manager configuration.  Select up to 4 actions for each fault." VALUE 0x800031B7 RecordLayout_4 0 CompuMethod_111 0 65535 /end CHARACTERISTIC
/begin CHARACTERISTIC FaultManager.Inj8Open.ID "Fault manager configuration.  Select up to 4 actions for each fault." VALUE 0x800031B9 RecordLayout_4 0 CompuMethod_1 0 65535 /end CHARACTERISTIC
/begin CHARACTERISTIC FaultManager.Inj8Open.Test "Fault manager configuration.  Select up to 4 actions for each fault." VALUE 0x800031BB RecordLayout_4 0 CompuMethod_112 0 65535 /end CHARACTERISTIC
/begin CHARACTERISTIC FaultManager.Inj8Open.Faulty_Samples__X_ "Fault manager configuration.  Select up to 4 actions for each fault." VALUE 0x800031BD RecordLayout_4 0 CompuMethod_1 0 65535 /end CHARACTERISTIC
/begin CHARACTERISTIC FaultManager.Inj8Open.Total_Samples__Y_ "Fault manager configuration.  Select up to 4 actions for each fault." VALUE 0x800031BF RecordLayout_4 0 CompuMethod_1 0 65535 /end CHARACTERISTIC
/begin CHARACTERISTIC FaultManager.Inj8Open.Action_1 "Fault manager configuration.  Select up to 4 actions for each fault." VALUE 0x800031C1 RecordLayout_4 0 CompuMethod_113 0 65535 /end CHARACTERISTIC
/begin CHARACTERISTIC FaultManager.Inj8Open.Action_1_Condition "Fault manager configuration.  Select up to 4 actions for each fault." VALUE 0x800031C3 RecordLayout_4 0 CompuMethod_114 0 65535 /end CHARACTERISTIC
/begin CHARACTERISTIC FaultManager.Inj8Open.Action_2 "Fault manager configuration.  Select up to 4 actions for each fault." VALUE 0x800031C5 RecordLayout_4 0 CompuMethod_113 0 65535 /end CHARACTERISTIC
/begin CHARACTERISTIC FaultManager.Inj8Open.Action_2_Condition "Fault manager configuration.  Select up to 4 actions for each fault." VALUE 0x800031C7 RecordLayout_4 0 CompuMethod_114 0 65535 /end CHARACTERISTIC
/begin CHARACTERISTIC FaultManager.Inj8Open.Action_3 "Fault manager configuration.  Select up to 4 actions for each fault." VALUE 0x800031C9 RecordLayout_4 0 CompuMethod_113 0 65535 /end CHARACTERISTIC
/begin CHARACTERISTIC FaultManager.Inj8Open.Action_3_Condition "Fault manager configuration.  Select up to 4 actions for each fault." VALUE 0x800031CB RecordLayout_4 0 CompuMethod_114 0 65535 /end CHARACTERISTIC
/begin CHARACTERISTIC FaultManager.Inj8Open.Action_4 "Fault manager configuration.  Select up to 4 actions for each fault." VALUE 0x800031CD RecordLayout_4 0 CompuMethod_113 0 65535 /end CHARACTERISTIC
/begin CHARACTERISTIC FaultManager.Inj8Open.Action_4_Condition "Fault manager configuration.  Select up to 4 actions for each fault." VALUE 0x800031CF RecordLayout_4 0 CompuMethod_114 0 65535 /end CHARACTERISTIC
/begin CHARACTERISTIC FaultManager.Lambda_1_NotReady.Mode "Fault manager configuration.  Select up to 4 actions for each fault." VALUE 0x800031D1 RecordLayout_4 0 CompuMethod_111 0 65535 /end CHARACTERISTIC
/begin CHARACTERISTIC FaultManager.Lambda_1_NotReady.ID "Fault manager configuration.  Select up to 4 actions for each fault." VALUE 0x800031D3 RecordLayout_4 0 CompuMethod_1 0 65535 /end CHARACTERISTIC
/begin CHARACTERISTIC FaultManager.Lambda_1_NotReady.Test "Fault manager configuration.  Select up to 4 actions for each fault." VALUE 0x800031D5 RecordLayout_4 0 CompuMethod_112 0 65535 /end CHARACTERISTIC
/begin CHARACTERISTIC FaultManager.Lambda_1_NotReady.Faulty_Samples__X_ "Fault manager configuration.  Select up to 4 actions for each fault." VALUE 0x800031D7 RecordLayout_4 0 CompuMethod_1 0 65535 /end CHARACTERISTIC
/begin CHARACTERISTIC FaultManager.Lambda_1_NotReady.Total_Samples__Y_ "Fault manager configuration.  Select up to 4 actions for each fault." VALUE 0x800031D9 RecordLayout_4 0 CompuMethod_1 0 65535 /end CHARACTERISTIC
/begin CHARACTERISTIC FaultManager.Lambda_1_NotReady.Action_1 "Fault manager configuration.  Select up to 4 actions for each fault." VALUE 0x800031DB RecordLayout_4 0 CompuMethod_113 0 65535 /end CHARACTERISTIC
/begin CHARACTERISTIC FaultManager.Lambda_1_NotReady.Action_1_Condition "Fault manager configuration.  Select up to 4 actions for each fault." VALUE 0x800031DD RecordLayout_4 0 CompuMethod_114 0 65535 /end CHARACTERISTIC
/begin CHARACTERISTIC FaultManager.Lambda_1_NotReady.Action_2 "Fault manager configuration.  Select up to 4 actions for each fault." VALUE 0x800031DF RecordLayout_4 0 CompuMethod_113 0 65535 /end CHARACTERISTIC
/begin CHARACTERISTIC FaultManager.Lambda_1_NotReady.Action_2_Condition "Fault manager configuration.  Select up to 4 actions for each fault." VALUE 0x800031E1 RecordLayout_4 0 CompuMethod_114 0 65535 /end CHARACTERISTIC
/begin CHARACTERISTIC FaultManager.Lambda_1_NotReady.Action_3 "Fault manager configuration.  Select up to 4 actions for each fault." VALUE 0x800031E3 RecordLayout_4 0 CompuMethod_113 0 65535 /end CHARACTERISTIC
/begin CHARACTERISTIC FaultManager.Lambda_1_NotReady.Action_3_Condition "Fault manager configuration.  Select up to 4 actions for each fault." VALUE 0x800031E5 RecordLayout_4 0 CompuMethod_114 0 65535 /end CHARACTERISTIC
/begin CHARACTERISTIC FaultManager.Lambda_1_NotReady.Action_4 "Fault manager configuration.  Select up to 4 actions for each fault." VALUE 0x800031E7 RecordLayout_4 0 CompuMethod_113 0 65535 /end CHARACTERISTIC
/begin CHARACTERISTIC FaultManager.Lambda_1_NotReady.Action_4_Condition "Fault manager configuration.  Select up to 4 actions for each fault." VALUE 0x800031E9 RecordLayout_4 0 CompuMethod_114 0 65535 /end CHARACTERISTIC
/begin CHARACTERISTIC FaultManager.Lambda_1_Timeout.Mode "Fault manager configuration.  Select up to 4 actions for each fault." VALUE 0x800031EB RecordLayout_4 0 CompuMethod_111 0 65535 /end CHARACTERISTIC
/begin CHARACTERISTIC FaultManager.Lambda_1_Timeout.ID "Fault manager configuration.  Select up to 4 actions for each fault." VALUE 0x800031ED RecordLayout_4 0 CompuMethod_1 0 65535 /end CHARACTERISTIC
/begin CHARACTERISTIC FaultManager.Lambda_1_Timeout.Test "Fault manager configuration.  Select up to 4 actions for each fault." VALUE 0x800031EF RecordLayout_4 0 CompuMethod_112 0 65535 /end CHARACTERISTIC
/begin CHARACTERISTIC FaultManager.Lambda_1_Timeout.Faulty_Samples__X_ "Fault manager configuration.  Select up to 4 actions for each fault." VALUE 0x800031F1 RecordLayout_4 0 CompuMethod_1 0 65535 /end CHARACTERISTIC
/begin CHARACTERISTIC FaultManager.Lambda_1_Timeout.Total_Samples__Y_ "Fault manager configuration.  Select up to 4 actions for each fault." VALUE 0x800031F3 RecordLayout_4 0 CompuMethod_1 0 65535 /end CHARACTERISTIC
/begin CHARACTERISTIC FaultManager.Lambda_1_Timeout.Action_1 "Fault manager configuration.  Select up to 4 actions for each fault." VALUE 0x800031F5 RecordLayout_4 0 CompuMethod_113 0 65535 /end CHARACTERISTIC
/begin CHARACTERISTIC FaultManager.Lambda_1_Timeout.Action_1_Condition "Fault manager configuration.  Select up to 4 actions for each fault." VALUE 0x800031F7 RecordLayout_4 0 CompuMethod_114 0 65535 /end CHARACTERISTIC
/begin CHARACTERISTIC FaultManager.Lambda_1_Timeout.Action_2 "Fault manager configuration.  Select up to 4 actions for each fault." VALUE 0x800031F9 RecordLayout_4 0 CompuMethod_113 0 65535 /end CHARACTERISTIC
/begin CHARACTERISTIC FaultManager.Lambda_1_Timeout.Action_2_Condition "Fault manager configuration.  Select up to 4 actions for each fault." VALUE 0x800031FB RecordLayout_4 0 CompuMethod_114 0 65535 /end CHARACTERISTIC
/begin CHARACTERISTIC FaultManager.Lambda_1_Timeout.Action_3 "Fault manager configuration.  Select up to 4 actions for each fault." VALUE 0x800031FD RecordLayout_4 0 CompuMethod_113 0 65535 /end CHARACTERISTIC
/begin CHARACTERISTIC FaultManager.Lambda_1_Timeout.Action_3_Condition "Fault manager configuration.  Select up to 4 actions for each fault." VALUE 0x800031FF RecordLayout_4 0 CompuMethod_114 0 65535 /end CHARACTERISTIC
/begin CHARACTERISTIC FaultManager.Lambda_1_Timeout.Action_4 "Fault manager configuration.  Select up to 4 actions for each fault." VALUE 0x80003201 RecordLayout_4 0 CompuMethod_113 0 65535 /end CHARACTERISTIC
/begin CHARACTERISTIC FaultManager.Lambda_1_Timeout.Action_4_Condition "Fault manager configuration.  Select up to 4 actions for each fault." VALUE 0x80003203 RecordLayout_4 0 CompuMethod_114 0 65535 /end CHARACTERISTIC
/begin CHARACTERISTIC FaultManager.Lambda_2_NotReady.Mode "Fault manager configuration.  Select up to 4 actions for each fault." VALUE 0x80003205 RecordLayout_4 0 CompuMethod_111 0 65535 /end CHARACTERISTIC
/begin CHARACTERISTIC FaultManager.Lambda_2_NotReady.ID "Fault manager configuration.  Select up to 4 actions for each fault." VALUE 0x80003207 RecordLayout_4 0 CompuMethod_1 0 65535 /end CHARACTERISTIC
/begin CHARACTERISTIC FaultManager.Lambda_2_NotReady.Test "Fault manager configuration.  Select up to 4 actions for each fault." VALUE 0x80003209 RecordLayout_4 0 CompuMethod_112 0 65535 /end CHARACTERISTIC
/begin CHARACTERISTIC FaultManager.Lambda_2_NotReady.Faulty_Samples__X_ "Fault manager configuration.  Select up to 4 actions for each fault." VALUE 0x8000320B RecordLayout_4 0 CompuMethod_1 0 65535 /end CHARACTERISTIC
/begin CHARACTERISTIC FaultManager.Lambda_2_NotReady.Total_Samples__Y_ "Fault manager configuration.  Select up to 4 actions for each fault." VALUE 0x8000320D RecordLayout_4 0 CompuMethod_1 0 65535 /end CHARACTERISTIC
/begin CHARACTERISTIC FaultManager.Lambda_2_NotReady.Action_1 "Fault manager configuration.  Select up to 4 actions for each fault." VALUE 0x8000320F RecordLayout_4 0 CompuMethod_113 0 65535 /end CHARACTERISTIC
/begin CHARACTERISTIC FaultManager.Lambda_2_NotReady.Action_1_Condition "Fault manager configuration.  Select up to 4 actions for each fault." VALUE 0x80003211 RecordLayout_4 0 CompuMethod_114 0 65535 /end CHARACTERISTIC
/begin CHARACTERISTIC FaultManager.Lambda_2_NotReady.Action_2 "Fault manager configuration.  Select up to 4 actions for each fault." VALUE 0x80003213 RecordLayout_4 0 CompuMethod_113 0 65535 /end CHARACTERISTIC
/begin CHARACTERISTIC FaultManager.Lambda_2_NotReady.Action_2_Condition "Fault manager configuration.  Select up to 4 actions for each fault." VALUE 0x80003215 RecordLayout_4 0 CompuMethod_114 0 65535 /end CHARACTERISTIC
/begin CHARACTERISTIC FaultManager.Lambda_2_NotReady.Action_3 "Fault manager configuration.  Select up to 4 actions for each fault." VALUE 0x80003217 RecordLayout_4 0 CompuMethod_113 0 65535 /end CHARACTERISTIC
/begin CHARACTERISTIC FaultManager.Lambda_2_NotReady.Action_3_Condition "Fault manager configuration.  Select up to 4 actions for each fault." VALUE 0x80003219 RecordLayout_4 0 CompuMethod_114 0 65535 /end CHARACTERISTIC
/begin CHARACTERISTIC FaultManager.Lambda_2_NotReady.Action_4 "Fault manager configuration.  Select up to 4 actions for each fault." VALUE 0x8000321B RecordLayout_4 0 CompuMethod_113 0 65535 /end CHARACTERISTIC
/begin CHARACTERISTIC FaultManager.Lambda_2_NotReady.Action_4_Condition "Fault manager configuration.  Select up to 4 actions for each fault." VALUE 0x8000321D RecordLayout_4 0 CompuMethod_114 0 65535 /end CHARACTERISTIC
/begin CHARACTERISTIC FaultManager.Lambda_2_Timeout.Mode "Fault manager configuration.  Select up to 4 actions for each fault." VALUE 0x8000321F RecordLayout_4 0 CompuMethod_111 0 65535 /end CHARACTERISTIC
/begin CHARACTERISTIC FaultManager.Lambda_2_Timeout.ID "Fault manager configuration.  Select up to 4 actions for each fault." VALUE 0x80003221 RecordLayout_4 0 CompuMethod_1 0 65535 /end CHARACTERISTIC
/begin CHARACTERISTIC FaultManager.Lambda_2_Timeout.Test "Fault manager configuration.  Select up to 4 actions for each fault." VALUE 0x80003223 RecordLayout_4 0 CompuMethod_112 0 65535 /end CHARACTERISTIC
/begin CHARACTERISTIC FaultManager.Lambda_2_Timeout.Faulty_Samples__X_ "Fault manager configuration.  Select up to 4 actions for each fault." VALUE 0x80003225 RecordLayout_4 0 CompuMethod_1 0 65535 /end CHARACTERISTIC
/begin CHARACTERISTIC FaultManager.Lambda_2_Timeout.Total_Samples__Y_ "Fault manager configuration.  Select up to 4 actions for each fault." VALUE 0x80003227 RecordLayout_4 0 CompuMethod_1 0 65535 /end CHARACTERISTIC
/begin CHARACTERISTIC FaultManager.Lambda_2_Timeout.Action_1 "Fault manager configuration.  Select up to 4 actions for each fault." VALUE 0x80003229 RecordLayout_4 0 CompuMethod_113 0 65535 /end CHARACTERISTIC
/begin CHARACTERISTIC FaultManager.Lambda_2_Timeout.Action_1_Condition "Fault manager configuration.  Select up to 4 actions for each fault." VALUE 0x8000322B RecordLayout_4 0 CompuMethod_114 0 65535 /end CHARACTERISTIC
/begin CHARACTERISTIC FaultManager.Lambda_2_Timeout.Action_2 "Fault manager configuration.  Select up to 4 actions for each fault." VALUE 0x8000322D RecordLayout_4 0 CompuMethod_113 0 65535 /end CHARACTERISTIC
/begin CHARACTERISTIC FaultManager.Lambda_2_Timeout.Action_2_Condition "Fault manager configuration.  Select up to 4 actions for each fault." VALUE 0x8000322F RecordLayout_4 0 CompuMethod_114 0 65535 /end CHARACTERISTIC
/begin CHARACTERISTIC FaultManager.Lambda_2_Timeout.Action_3 "Fault manager configuration.  Select up to 4 actions for each fault." VALUE 0x80003231 RecordLayout_4 0 CompuMethod_113 0 65535 /end CHARACTERISTIC
/begin CHARACTERISTIC FaultManager.Lambda_2_Timeout.Action_3_Condition "Fault manager configuration.  Select up to 4 actions for each fault." VALUE 0x80003233 RecordLayout_4 0 CompuMethod_114 0 65535 /end CHARACTERISTIC
/begin CHARACTERISTIC FaultManager.Lambda_2_Timeout.Action_4 "Fault manager configuration.  Select up to 4 actions for each fault." VALUE 0x80003235 RecordLayout_4 0 CompuMethod_113 0 65535 /end CHARACTERISTIC
/begin CHARACTERISTIC FaultManager.Lambda_2_Timeout.Action_4_Condition "Fault manager configuration.  Select up to 4 actions for each fault." VALUE 0x80003237 RecordLayout_4 0 CompuMethod_114 0 65535 /end CHARACTERISTIC
/begin CHARACTERISTIC FaultManager.LeanProtect_Fault.Mode "Fault manager configuration.  Select up to 4 actions for each fault." VALUE 0x80003239 RecordLayout_4 0 CompuMethod_111 0 65535 /end CHARACTERISTIC
/begin CHARACTERISTIC FaultManager.LeanProtect_Fault.ID "Fault manager configuration.  Select up to 4 actions for each fault." VALUE 0x8000323B RecordLayout_4 0 CompuMethod_1 0 65535 /end CHARACTERISTIC
/begin CHARACTERISTIC FaultManager.LeanProtect_Fault.Test "Fault manager configuration.  Select up to 4 actions for each fault." VALUE 0x8000323D RecordLayout_4 0 CompuMethod_112 0 65535 /end CHARACTERISTIC
/begin CHARACTERISTIC FaultManager.LeanProtect_Fault.Faulty_Samples__X_ "Fault manager configuration.  Select up to 4 actions for each fault." VALUE 0x8000323F RecordLayout_4 0 CompuMethod_1 0 65535 /end CHARACTERISTIC
/begin CHARACTERISTIC FaultManager.LeanProtect_Fault.Total_Samples__Y_ "Fault manager configuration.  Select up to 4 actions for each fault." VALUE 0x80003241 RecordLayout_4 0 CompuMethod_1 0 65535 /end CHARACTERISTIC
/begin CHARACTERISTIC FaultManager.LeanProtect_Fault.Action_1 "Fault manager configuration.  Select up to 4 actions for each fault." VALUE 0x80003243 RecordLayout_4 0 CompuMethod_113 0 65535 /end CHARACTERISTIC
/begin CHARACTERISTIC FaultManager.LeanProtect_Fault.Action_1_Condition "Fault manager configuration.  Select up to 4 actions for each fault." VALUE 0x80003245 RecordLayout_4 0 CompuMethod_114 0 65535 /end CHARACTERISTIC
/begin CHARACTERISTIC FaultManager.LeanProtect_Fault.Action_2 "Fault manager configuration.  Select up to 4 actions for each fault." VALUE 0x80003247 RecordLayout_4 0 CompuMethod_113 0 65535 /end CHARACTERISTIC
/begin CHARACTERISTIC FaultManager.LeanProtect_Fault.Action_2_Condition "Fault manager configuration.  Select up to 4 actions for each fault." VALUE 0x80003249 RecordLayout_4 0 CompuMethod_114 0 65535 /end CHARACTERISTIC
/begin CHARACTERISTIC FaultManager.LeanProtect_Fault.Action_3 "Fault manager configuration.  Select up to 4 actions for each fault." VALUE 0x8000324B RecordLayout_4 0 CompuMethod_113 0 65535 /end CHARACTERISTIC
/begin CHARACTERISTIC FaultManager.LeanProtect_Fault.Action_3_Condition "Fault manager configuration.  Select up to 4 actions for each fault." VALUE 0x8000324D RecordLayout_4 0 CompuMethod_114 0 65535 /end CHARACTERISTIC
/begin CHARACTERISTIC FaultManager.LeanProtect_Fault.Action_4 "Fault manager configuration.  Select up to 4 actions for each fault." VALUE 0x8000324F RecordLayout_4 0 CompuMethod_113 0 65535 /end CHARACTERISTIC
/begin CHARACTERISTIC FaultManager.LeanProtect_Fault.Action_4_Condition "Fault manager configuration.  Select up to 4 actions for each fault." VALUE 0x80003251 RecordLayout_4 0 CompuMethod_114 0 65535 /end CHARACTERISTIC
/begin CHARACTERISTIC FaultManager.MAFRangeHigh.Mode "Fault manager configuration.  Select up to 4 actions for each fault." VALUE 0x80003253 RecordLayout_4 0 CompuMethod_111 0 65535 /end CHARACTERISTIC
/begin CHARACTERISTIC FaultManager.MAFRangeHigh.ID "Fault manager configuration.  Select up to 4 actions for each fault." VALUE 0x80003255 RecordLayout_4 0 CompuMethod_1 0 65535 /end CHARACTERISTIC
/begin CHARACTERISTIC FaultManager.MAFRangeHigh.Test "Fault manager configuration.  Select up to 4 actions for each fault." VALUE 0x80003257 RecordLayout_4 0 CompuMethod_112 0 65535 /end CHARACTERISTIC
/begin CHARACTERISTIC FaultManager.MAFRangeHigh.Faulty_Samples__X_ "Fault manager configuration.  Select up to 4 actions for each fault." VALUE 0x80003259 RecordLayout_4 0 CompuMethod_1 0 65535 /end CHARACTERISTIC
/begin CHARACTERISTIC FaultManager.MAFRangeHigh.Total_Samples__Y_ "Fault manager configuration.  Select up to 4 actions for each fault." VALUE 0x8000325B RecordLayout_4 0 CompuMethod_1 0 65535 /end CHARACTERISTIC
/begin CHARACTERISTIC FaultManager.MAFRangeHigh.Action_1 "Fault manager configuration.  Select up to 4 actions for each fault." VALUE 0x8000325D RecordLayout_4 0 CompuMethod_113 0 65535 /end CHARACTERISTIC
/begin CHARACTERISTIC FaultManager.MAFRangeHigh.Action_1_Condition "Fault manager configuration.  Select up to 4 actions for each fault." VALUE 0x8000325F RecordLayout_4 0 CompuMethod_114 0 65535 /end CHARACTERISTIC
/begin CHARACTERISTIC FaultManager.MAFRangeHigh.Action_2 "Fault manager configuration.  Select up to 4 actions for each fault." VALUE 0x80003261 RecordLayout_4 0 CompuMethod_113 0 65535 /end CHARACTERISTIC
/begin CHARACTERISTIC FaultManager.MAFRangeHigh.Action_2_Condition "Fault manager configuration.  Select up to 4 actions for each fault." VALUE 0x80003263 RecordLayout_4 0 CompuMethod_114 0 65535 /end CHARACTERISTIC
/begin CHARACTERISTIC FaultManager.MAFRangeHigh.Action_3 "Fault manager configuration.  Select up to 4 actions for each fault." VALUE 0x80003265 RecordLayout_4 0 CompuMethod_113 0 65535 /end CHARACTERISTIC
/begin CHARACTERISTIC FaultManager.MAFRangeHigh.Action_3_Condition "Fault manager configuration.  Select up to 4 actions for each fault." VALUE 0x80003267 RecordLayout_4 0 CompuMethod_114 0 65535 /end CHARACTERISTIC
/begin CHARACTERISTIC FaultManager.MAFRangeHigh.Action_4 "Fault manager configuration.  Select up to 4 actions for each fault." VALUE 0x80003269 RecordLayout_4 0 CompuMethod_113 0 65535 /end CHARACTERISTIC
/begin CHARACTERISTIC FaultManager.MAFRangeHigh.Action_4_Condition "Fault manager configuration.  Select up to 4 actions for each fault." VALUE 0x8000326B RecordLayout_4 0 CompuMethod_114 0 65535 /end CHARACTERISTIC
/begin CHARACTERISTIC FaultManager.MAFRangeLow.Mode "Fault manager configuration.  Select up to 4 actions for each fault." VALUE 0x8000326D RecordLayout_4 0 CompuMethod_111 0 65535 /end CHARACTERISTIC
/begin CHARACTERISTIC FaultManager.MAFRangeLow.ID "Fault manager configuration.  Select up to 4 actions for each fault." VALUE 0x8000326F RecordLayout_4 0 CompuMethod_1 0 65535 /end CHARACTERISTIC
/begin CHARACTERISTIC FaultManager.MAFRangeLow.Test "Fault manager configuration.  Select up to 4 actions for each fault." VALUE 0x80003271 RecordLayout_4 0 CompuMethod_112 0 65535 /end CHARACTERISTIC
/begin CHARACTERISTIC FaultManager.MAFRangeLow.Faulty_Samples__X_ "Fault manager configuration.  Select up to 4 actions for each fault." VALUE 0x80003273 RecordLayout_4 0 CompuMethod_1 0 65535 /end CHARACTERISTIC
/begin CHARACTERISTIC FaultManager.MAFRangeLow.Total_Samples__Y_ "Fault manager configuration.  Select up to 4 actions for each fault." VALUE 0x80003275 RecordLayout_4 0 CompuMethod_1 0 65535 /end CHARACTERISTIC
/begin CHARACTERISTIC FaultManager.MAFRangeLow.Action_1 "Fault manager configuration.  Select up to 4 actions for each fault." VALUE 0x80003277 RecordLayout_4 0 CompuMethod_113 0 65535 /end CHARACTERISTIC
/begin CHARACTERISTIC FaultManager.MAFRangeLow.Action_1_Condition "Fault manager configuration.  Select up to 4 actions for each fault." VALUE 0x80003279 RecordLayout_4 0 CompuMethod_114 0 65535 /end CHARACTERISTIC
/begin CHARACTERISTIC FaultManager.MAFRangeLow.Action_2 "Fault manager configuration.  Select up to 4 actions for each fault." VALUE 0x8000327B RecordLayout_4 0 CompuMethod_113 0 65535 /end CHARACTERISTIC
/begin CHARACTERISTIC FaultManager.MAFRangeLow.Action_2_Condition "Fault manager configuration.  Select up to 4 actions for each fault." VALUE 0x8000327D RecordLayout_4 0 CompuMethod_114 0 65535 /end CHARACTERISTIC
/begin CHARACTERISTIC FaultManager.MAFRangeLow.Action_3 "Fault manager configuration.  Select up to 4 actions for each fault." VALUE 0x8000327F RecordLayout_4 0 CompuMethod_113 0 65535 /end CHARACTERISTIC
/begin CHARACTERISTIC FaultManager.MAFRangeLow.Action_3_Condition "Fault manager configuration.  Select up to 4 actions for each fault." VALUE 0x80003281 RecordLayout_4 0 CompuMethod_114 0 65535 /end CHARACTERISTIC
/begin CHARACTERISTIC FaultManager.MAFRangeLow.Action_4 "Fault manager configuration.  Select up to 4 actions for each fault." VALUE 0x80003283 RecordLayout_4 0 CompuMethod_113 0 65535 /end CHARACTERISTIC
/begin CHARACTERISTIC FaultManager.MAFRangeLow.Action_4_Condition "Fault manager configuration.  Select up to 4 actions for each fault." VALUE 0x80003285 RecordLayout_4 0 CompuMethod_114 0 65535 /end CHARACTERISTIC
/begin CHARACTERISTIC FaultManager.MAPRangeHigh.Mode "Fault manager configuration.  Select up to 4 actions for each fault." VALUE 0x80003287 RecordLayout_4 0 CompuMethod_111 0 65535 /end CHARACTERISTIC
/begin CHARACTERISTIC FaultManager.MAPRangeHigh.ID "Fault manager configuration.  Select up to 4 actions for each fault." VALUE 0x80003289 RecordLayout_4 0 CompuMethod_1 0 65535 /end CHARACTERISTIC
/begin CHARACTERISTIC FaultManager.MAPRangeHigh.Test "Fault manager configuration.  Select up to 4 actions for each fault." VALUE 0x8000328B RecordLayout_4 0 CompuMethod_112 0 65535 /end CHARACTERISTIC
/begin CHARACTERISTIC FaultManager.MAPRangeHigh.Faulty_Samples__X_ "Fault manager configuration.  Select up to 4 actions for each fault." VALUE 0x8000328D RecordLayout_4 0 CompuMethod_1 0 65535 /end CHARACTERISTIC
/begin CHARACTERISTIC FaultManager.MAPRangeHigh.Total_Samples__Y_ "Fault manager configuration.  Select up to 4 actions for each fault." VALUE 0x8000328F RecordLayout_4 0 CompuMethod_1 0 65535 /end CHARACTERISTIC
/begin CHARACTERISTIC FaultManager.MAPRangeHigh.Action_1 "Fault manager configuration.  Select up to 4 actions for each fault." VALUE 0x80003291 RecordLayout_4 0 CompuMethod_113 0 65535 /end CHARACTERISTIC
/begin CHARACTERISTIC FaultManager.MAPRangeHigh.Action_1_Condition "Fault manager configuration.  Select up to 4 actions for each fault." VALUE 0x80003293 RecordLayout_4 0 CompuMethod_114 0 65535 /end CHARACTERISTIC
/begin CHARACTERISTIC FaultManager.MAPRangeHigh.Action_2 "Fault manager configuration.  Select up to 4 actions for each fault." VALUE 0x80003295 RecordLayout_4 0 CompuMethod_113 0 65535 /end CHARACTERISTIC
/begin CHARACTERISTIC FaultManager.MAPRangeHigh.Action_2_Condition "Fault manager configuration.  Select up to 4 actions for each fault." VALUE 0x80003297 RecordLayout_4 0 CompuMethod_114 0 65535 /end CHARACTERISTIC
/begin CHARACTERISTIC FaultManager.MAPRangeHigh.Action_3 "Fault manager configuration.  Select up to 4 actions for each fault." VALUE 0x80003299 RecordLayout_4 0 CompuMethod_113 0 65535 /end CHARACTERISTIC
/begin CHARACTERISTIC FaultManager.MAPRangeHigh.Action_3_Condition "Fault manager configuration.  Select up to 4 actions for each fault." VALUE 0x8000329B RecordLayout_4 0 CompuMethod_114 0 65535 /end CHARACTERISTIC
/begin CHARACTERISTIC FaultManager.MAPRangeHigh.Action_4 "Fault manager configuration.  Select up to 4 actions for each fault." VALUE 0x8000329D RecordLayout_4 0 CompuMethod_113 0 65535 /end CHARACTERISTIC
/begin CHARACTERISTIC FaultManager.MAPRangeHigh.Action_4_Condition "Fault manager configuration.  Select up to 4 actions for each fault." VALUE 0x8000329F RecordLayout_4 0 CompuMethod_114 0 65535 /end CHARACTERISTIC
/begin CHARACTERISTIC FaultManager.MAPRangeLow.Mode "Fault manager configuration.  Select up to 4 actions for each fault." VALUE 0x800032A1 RecordLayout_4 0 CompuMethod_111 0 65535 /end CHARACTERISTIC
/begin CHARACTERISTIC FaultManager.MAPRangeLow.ID "Fault manager configuration.  Select up to 4 actions for each fault." VALUE 0x800032A3 RecordLayout_4 0 CompuMethod_1 0 65535 /end CHARACTERISTIC
/begin CHARACTERISTIC FaultManager.MAPRangeLow.Test "Fault manager configuration.  Select up to 4 actions for each fault." VALUE 0x800032A5 RecordLayout_4 0 CompuMethod_112 0 65535 /end CHARACTERISTIC
/begin CHARACTERISTIC FaultManager.MAPRangeLow.Faulty_Samples__X_ "Fault manager configuration.  Select up to 4 actions for each fault." VALUE 0x800032A7 RecordLayout_4 0 CompuMethod_1 0 65535 /end CHARACTERISTIC
/begin CHARACTERISTIC FaultManager.MAPRangeLow.Total_Samples__Y_ "Fault manager configuration.  Select up to 4 actions for each fault." VALUE 0x800032A9 RecordLayout_4 0 CompuMethod_1 0 65535 /end CHARACTERISTIC
/begin CHARACTERISTIC FaultManager.MAPRangeLow.Action_1 "Fault manager configuration.  Select up to 4 actions for each fault." VALUE 0x800032AB RecordLayout_4 0 CompuMethod_113 0 65535 /end CHARACTERISTIC
/begin CHARACTERISTIC FaultManager.MAPRangeLow.Action_1_Condition "Fault manager configuration.  Select up to 4 actions for each fault." VALUE 0x800032AD RecordLayout_4 0 CompuMethod_114 0 65535 /end CHARACTERISTIC
/begin CHARACTERISTIC FaultManager.MAPRangeLow.Action_2 "Fault manager configuration.  Select up to 4 actions for each fault." VALUE 0x800032AF RecordLayout_4 0 CompuMethod_113 0 65535 /end CHARACTERISTIC
/begin CHARACTERISTIC FaultManager.MAPRangeLow.Action_2_Condition "Fault manager configuration.  Select up to 4 actions for each fault." VALUE 0x800032B1 RecordLayout_4 0 CompuMethod_114 0 65535 /end CHARACTERISTIC
/begin CHARACTERISTIC FaultManager.MAPRangeLow.Action_3 "Fault manager configuration.  Select up to 4 actions for each fault." VALUE 0x800032B3 RecordLayout_4 0 CompuMethod_113 0 65535 /end CHARACTERISTIC
/begin CHARACTERISTIC FaultManager.MAPRangeLow.Action_3_Condition "Fault manager configuration.  Select up to 4 actions for each fault." VALUE 0x800032B5 RecordLayout_4 0 CompuMethod_114 0 65535 /end CHARACTERISTIC
/begin CHARACTERISTIC FaultManager.MAPRangeLow.Action_4 "Fault manager configuration.  Select up to 4 actions for each fault." VALUE 0x800032B7 RecordLayout_4 0 CompuMethod_113 0 65535 /end CHARACTERISTIC
/begin CHARACTERISTIC FaultManager.MAPRangeLow.Action_4_Condition "Fault manager configuration.  Select up to 4 actions for each fault." VALUE 0x800032B9 RecordLayout_4 0 CompuMethod_114 0 65535 /end CHARACTERISTIC
/begin CHARACTERISTIC FaultManager.MAPTimeRangeHigh.Mode "Fault manager configuration.  Select up to 4 actions for each fault." VALUE 0x800032BB RecordLayout_4 0 CompuMethod_111 0 65535 /end CHARACTERISTIC
/begin CHARACTERISTIC FaultManager.MAPTimeRangeHigh.ID "Fault manager configuration.  Select up to 4 actions for each fault." VALUE 0x800032BD RecordLayout_4 0 CompuMethod_1 0 65535 /end CHARACTERISTIC
/begin CHARACTERISTIC FaultManager.MAPTimeRangeHigh.Test "Fault manager configuration.  Select up to 4 actions for each fault." VALUE 0x800032BF RecordLayout_4 0 CompuMethod_112 0 65535 /end CHARACTERISTIC
/begin CHARACTERISTIC FaultManager.MAPTimeRangeHigh.Faulty_Samples__X_ "Fault manager configuration.  Select up to 4 actions for each fault." VALUE 0x800032C1 RecordLayout_4 0 CompuMethod_1 0 65535 /end CHARACTERISTIC
/begin CHARACTERISTIC FaultManager.MAPTimeRangeHigh.Total_Samples__Y_ "Fault manager configuration.  Select up to 4 actions for each fault." VALUE 0x800032C3 RecordLayout_4 0 CompuMethod_1 0 65535 /end CHARACTERISTIC
/begin CHARACTERISTIC FaultManager.MAPTimeRangeHigh.Action_1 "Fault manager configuration.  Select up to 4 actions for each fault." VALUE 0x800032C5 RecordLayout_4 0 CompuMethod_113 0 65535 /end CHARACTERISTIC
/begin CHARACTERISTIC FaultManager.MAPTimeRangeHigh.Action_1_Condition "Fault manager configuration.  Select up to 4 actions for each fault." VALUE 0x800032C7 RecordLayout_4 0 CompuMethod_114 0 65535 /end CHARACTERISTIC
/begin CHARACTERISTIC FaultManager.MAPTimeRangeHigh.Action_2 "Fault manager configuration.  Select up to 4 actions for each fault." VALUE 0x800032C9 RecordLayout_4 0 CompuMethod_113 0 65535 /end CHARACTERISTIC
/begin CHARACTERISTIC FaultManager.MAPTimeRangeHigh.Action_2_Condition "Fault manager configuration.  Select up to 4 actions for each fault." VALUE 0x800032CB RecordLayout_4 0 CompuMethod_114 0 65535 /end CHARACTERISTIC
/begin CHARACTERISTIC FaultManager.MAPTimeRangeHigh.Action_3 "Fault manager configuration.  Select up to 4 actions for each fault." VALUE 0x800032CD RecordLayout_4 0 CompuMethod_113 0 65535 /end CHARACTERISTIC
/begin CHARACTERISTIC FaultManager.MAPTimeRangeHigh.Action_3_Condition "Fault manager configuration.  Select up to 4 actions for each fault." VALUE 0x800032CF RecordLayout_4 0 CompuMethod_114 0 65535 /end CHARACTERISTIC
/begin CHARACTERISTIC FaultManager.MAPTimeRangeHigh.Action_4 "Fault manager configuration.  Select up to 4 actions for each fault." VALUE 0x800032D1 RecordLayout_4 0 CompuMethod_113 0 65535 /end CHARACTERISTIC
/begin CHARACTERISTIC FaultManager.MAPTimeRangeHigh.Action_4_Condition "Fault manager configuration.  Select up to 4 actions for each fault." VALUE 0x800032D3 RecordLayout_4 0 CompuMethod_114 0 65535 /end CHARACTERISTIC
/begin CHARACTERISTIC FaultManager.MAPTimeRangeLow.Mode "Fault manager configuration.  Select up to 4 actions for each fault." VALUE 0x800032D5 RecordLayout_4 0 CompuMethod_111 0 65535 /end CHARACTERISTIC
/begin CHARACTERISTIC FaultManager.MAPTimeRangeLow.ID "Fault manager configuration.  Select up to 4 actions for each fault." VALUE 0x800032D7 RecordLayout_4 0 CompuMethod_1 0 65535 /end CHARACTERISTIC
/begin CHARACTERISTIC FaultManager.MAPTimeRangeLow.Test "Fault manager configuration.  Select up to 4 actions for each fault." VALUE 0x800032D9 RecordLayout_4 0 CompuMethod_112 0 65535 /end CHARACTERISTIC
/begin CHARACTERISTIC FaultManager.MAPTimeRangeLow.Faulty_Samples__X_ "Fault manager configuration.  Select up to 4 actions for each fault." VALUE 0x800032DB RecordLayout_4 0 CompuMethod_1 0 65535 /end CHARACTERISTIC
/begin CHARACTERISTIC FaultManager.MAPTimeRangeLow.Total_Samples__Y_ "Fault manager configuration.  Select up to 4 actions for each fault." VALUE 0x800032DD RecordLayout_4 0 CompuMethod_1 0 65535 /end CHARACTERISTIC
/begin CHARACTERISTIC FaultManager.MAPTimeRangeLow.Action_1 "Fault manager configuration.  Select up to 4 actions for each fault." VALUE 0x800032DF RecordLayout_4 0 CompuMethod_113 0 65535 /end CHARACTERISTIC
/begin CHARACTERISTIC FaultManager.MAPTimeRangeLow.Action_1_Condition "Fault manager configuration.  Select up to 4 actions for each fault." VALUE 0x800032E1 RecordLayout_4 0 CompuMethod_114 0 65535 /end CHARACTERISTIC
/begin CHARACTERISTIC FaultManager.MAPTimeRangeLow.Action_2 "Fault manager configuration.  Select up to 4 actions for each fault." VALUE 0x800032E3 RecordLayout_4 0 CompuMethod_113 0 65535 /end CHARACTERISTIC
/begin CHARACTERISTIC FaultManager.MAPTimeRangeLow.Action_2_Condition "Fault manager configuration.  Select up to 4 actions for each fault." VALUE 0x800032E5 RecordLayout_4 0 CompuMethod_114 0 65535 /end CHARACTERISTIC
/begin CHARACTERISTIC FaultManager.MAPTimeRangeLow.Action_3 "Fault manager configuration.  Select up to 4 actions for each fault." VALUE 0x800032E7 RecordLayout_4 0 CompuMethod_113 0 65535 /end CHARACTERISTIC
/begin CHARACTERISTIC FaultManager.MAPTimeRangeLow.Action_3_Condition "Fault manager configuration.  Select up to 4 actions for each fault." VALUE 0x800032E9 RecordLayout_4 0 CompuMethod_114 0 65535 /end CHARACTERISTIC
/begin CHARACTERISTIC FaultManager.MAPTimeRangeLow.Action_4 "Fault manager configuration.  Select up to 4 actions for each fault." VALUE 0x800032EB RecordLayout_4 0 CompuMethod_113 0 65535 /end CHARACTERISTIC
/begin CHARACTERISTIC FaultManager.MAPTimeRangeLow.Action_4_Condition "Fault manager configuration.  Select up to 4 actions for each fault." VALUE 0x800032ED RecordLayout_4 0 CompuMethod_114 0 65535 /end CHARACTERISTIC
/begin CHARACTERISTIC FaultManager.MAP_IR_HI.Mode "Fault manager configuration.  Select up to 4 actions for each fault." VALUE 0x800032EF RecordLayout_4 0 CompuMethod_111 0 65535 /end CHARACTERISTIC
/begin CHARACTERISTIC FaultManager.MAP_IR_HI.ID "Fault manager configuration.  Select up to 4 actions for each fault." VALUE 0x800032F1 RecordLayout_4 0 CompuMethod_1 0 65535 /end CHARACTERISTIC
/begin CHARACTERISTIC FaultManager.MAP_IR_HI.Test "Fault manager configuration.  Select up to 4 actions for each fault." VALUE 0x800032F3 RecordLayout_4 0 CompuMethod_112 0 65535 /end CHARACTERISTIC
/begin CHARACTERISTIC FaultManager.MAP_IR_HI.Faulty_Samples__X_ "Fault manager configuration.  Select up to 4 actions for each fault." VALUE 0x800032F5 RecordLayout_4 0 CompuMethod_1 0 65535 /end CHARACTERISTIC
/begin CHARACTERISTIC FaultManager.MAP_IR_HI.Total_Samples__Y_ "Fault manager configuration.  Select up to 4 actions for each fault." VALUE 0x800032F7 RecordLayout_4 0 CompuMethod_1 0 65535 /end CHARACTERISTIC
/begin CHARACTERISTIC FaultManager.MAP_IR_HI.Action_1 "Fault manager configuration.  Select up to 4 actions for each fault." VALUE 0x800032F9 RecordLayout_4 0 CompuMethod_113 0 65535 /end CHARACTERISTIC
/begin CHARACTERISTIC FaultManager.MAP_IR_HI.Action_1_Condition "Fault manager configuration.  Select up to 4 actions for each fault." VALUE 0x800032FB RecordLayout_4 0 CompuMethod_114 0 65535 /end CHARACTERISTIC
/begin CHARACTERISTIC FaultManager.MAP_IR_HI.Action_2 "Fault manager configuration.  Select up to 4 actions for each fault." VALUE 0x800032FD RecordLayout_4 0 CompuMethod_113 0 65535 /end CHARACTERISTIC
/begin CHARACTERISTIC FaultManager.MAP_IR_HI.Action_2_Condition "Fault manager configuration.  Select up to 4 actions for each fault." VALUE 0x800032FF RecordLayout_4 0 CompuMethod_114 0 65535 /end CHARACTERISTIC
/begin CHARACTERISTIC FaultManager.MAP_IR_HI.Action_3 "Fault manager configuration.  Select up to 4 actions for each fault." VALUE 0x80003301 RecordLayout_4 0 CompuMethod_113 0 65535 /end CHARACTERISTIC
/begin CHARACTERISTIC FaultManager.MAP_IR_HI.Action_3_Condition "Fault manager configuration.  Select up to 4 actions for each fault." VALUE 0x80003303 RecordLayout_4 0 CompuMethod_114 0 65535 /end CHARACTERISTIC
/begin CHARACTERISTIC FaultManager.MAP_IR_HI.Action_4 "Fault manager configuration.  Select up to 4 actions for each fault." VALUE 0x80003305 RecordLayout_4 0 CompuMethod_113 0 65535 /end CHARACTERISTIC
/begin CHARACTERISTIC FaultManager.MAP_IR_HI.Action_4_Condition "Fault manager configuration.  Select up to 4 actions for each fault." VALUE 0x80003307 RecordLayout_4 0 CompuMethod_114 0 65535 /end CHARACTERISTIC
/begin CHARACTERISTIC FaultManager.MAP_IR_LO.Mode "Fault manager configuration.  Select up to 4 actions for each fault." VALUE 0x80003309 RecordLayout_4 0 CompuMethod_111 0 65535 /end CHARACTERISTIC
/begin CHARACTERISTIC FaultManager.MAP_IR_LO.ID "Fault manager configuration.  Select up to 4 actions for each fault." VALUE 0x8000330B RecordLayout_4 0 CompuMethod_1 0 65535 /end CHARACTERISTIC
/begin CHARACTERISTIC FaultManager.MAP_IR_LO.Test "Fault manager configuration.  Select up to 4 actions for each fault." VALUE 0x8000330D RecordLayout_4 0 CompuMethod_112 0 65535 /end CHARACTERISTIC
/begin CHARACTERISTIC FaultManager.MAP_IR_LO.Faulty_Samples__X_ "Fault manager configuration.  Select up to 4 actions for each fault." VALUE 0x8000330F RecordLayout_4 0 CompuMethod_1 0 65535 /end CHARACTERISTIC
/begin CHARACTERISTIC FaultManager.MAP_IR_LO.Total_Samples__Y_ "Fault manager configuration.  Select up to 4 actions for each fault." VALUE 0x80003311 RecordLayout_4 0 CompuMethod_1 0 65535 /end CHARACTERISTIC
/begin CHARACTERISTIC FaultManager.MAP_IR_LO.Action_1 "Fault manager configuration.  Select up to 4 actions for each fault." VALUE 0x80003313 RecordLayout_4 0 CompuMethod_113 0 65535 /end CHARACTERISTIC
/begin CHARACTERISTIC FaultManager.MAP_IR_LO.Action_1_Condition "Fault manager configuration.  Select up to 4 actions for each fault." VALUE 0x80003315 RecordLayout_4 0 CompuMethod_114 0 65535 /end CHARACTERISTIC
/begin CHARACTERISTIC FaultManager.MAP_IR_LO.Action_2 "Fault manager configuration.  Select up to 4 actions for each fault." VALUE 0x80003317 RecordLayout_4 0 CompuMethod_113 0 65535 /end CHARACTERISTIC
/begin CHARACTERISTIC FaultManager.MAP_IR_LO.Action_2_Condition "Fault manager configuration.  Select up to 4 actions for each fault." VALUE 0x80003319 RecordLayout_4 0 CompuMethod_114 0 65535 /end CHARACTERISTIC
/begin CHARACTERISTIC FaultManager.MAP_IR_LO.Action_3 "Fault manager configuration.  Select up to 4 actions for each fault." VALUE 0x8000331B RecordLayout_4 0 CompuMethod_113 0 65535 /end CHARACTERISTIC
/begin CHARACTERISTIC FaultManager.MAP_IR_LO.Action_3_Condition "Fault manager configuration.  Select up to 4 actions for each fault." VALUE 0x8000331D RecordLayout_4 0 CompuMethod_114 0 65535 /end CHARACTERISTIC
/begin CHARACTERISTIC FaultManager.MAP_IR_LO.Action_4 "Fault manager configuration.  Select up to 4 actions for each fault." VALUE 0x8000331F RecordLayout_4 0 CompuMethod_113 0 65535 /end CHARACTERISTIC
/begin CHARACTERISTIC FaultManager.MAP_IR_LO.Action_4_Condition "Fault manager configuration.  Select up to 4 actions for each fault." VALUE 0x80003321 RecordLayout_4 0 CompuMethod_114 0 65535 /end CHARACTERISTIC
/begin CHARACTERISTIC FaultManager.MAP_STICKING.Mode "Fault manager configuration.  Select up to 4 actions for each fault." VALUE 0x80003323 RecordLayout_4 0 CompuMethod_111 0 65535 /end CHARACTERISTIC
/begin CHARACTERISTIC FaultManager.MAP_STICKING.ID "Fault manager configuration.  Select up to 4 actions for each fault." VALUE 0x80003325 RecordLayout_4 0 CompuMethod_1 0 65535 /end CHARACTERISTIC
/begin CHARACTERISTIC FaultManager.MAP_STICKING.Test "Fault manager configuration.  Select up to 4 actions for each fault." VALUE 0x80003327 RecordLayout_4 0 CompuMethod_112 0 65535 /end CHARACTERISTIC
/begin CHARACTERISTIC FaultManager.MAP_STICKING.Faulty_Samples__X_ "Fault manager configuration.  Select up to 4 actions for each fault." VALUE 0x80003329 RecordLayout_4 0 CompuMethod_1 0 65535 /end CHARACTERISTIC
/begin CHARACTERISTIC FaultManager.MAP_STICKING.Total_Samples__Y_ "Fault manager configuration.  Select up to 4 actions for each fault." VALUE 0x8000332B RecordLayout_4 0 CompuMethod_1 0 65535 /end CHARACTERISTIC
/begin CHARACTERISTIC FaultManager.MAP_STICKING.Action_1 "Fault manager configuration.  Select up to 4 actions for each fault." VALUE 0x8000332D RecordLayout_4 0 CompuMethod_113 0 65535 /end CHARACTERISTIC
/begin CHARACTERISTIC FaultManager.MAP_STICKING.Action_1_Condition "Fault manager configuration.  Select up to 4 actions for each fault." VALUE 0x8000332F RecordLayout_4 0 CompuMethod_114 0 65535 /end CHARACTERISTIC
/begin CHARACTERISTIC FaultManager.MAP_STICKING.Action_2 "Fault manager configuration.  Select up to 4 actions for each fault." VALUE 0x80003331 RecordLayout_4 0 CompuMethod_113 0 65535 /end CHARACTERISTIC
/begin CHARACTERISTIC FaultManager.MAP_STICKING.Action_2_Condition "Fault manager configuration.  Select up to 4 actions for each fault." VALUE 0x80003333 RecordLayout_4 0 CompuMethod_114 0 65535 /end CHARACTERISTIC
/begin CHARACTERISTIC FaultManager.MAP_STICKING.Action_3 "Fault manager configuration.  Select up to 4 actions for each fault." VALUE 0x80003335 RecordLayout_4 0 CompuMethod_113 0 65535 /end CHARACTERISTIC
/begin CHARACTERISTIC FaultManager.MAP_STICKING.Action_3_Condition "Fault manager configuration.  Select up to 4 actions for each fault." VALUE 0x80003337 RecordLayout_4 0 CompuMethod_114 0 65535 /end CHARACTERISTIC
/begin CHARACTERISTIC FaultManager.MAP_STICKING.Action_4 "Fault manager configuration.  Select up to 4 actions for each fault." VALUE 0x80003339 RecordLayout_4 0 CompuMethod_113 0 65535 /end CHARACTERISTIC
/begin CHARACTERISTIC FaultManager.MAP_STICKING.Action_4_Condition "Fault manager configuration.  Select up to 4 actions for each fault." VALUE 0x8000333B RecordLayout_4 0 CompuMethod_114 0 65535 /end CHARACTERISTIC
/begin CHARACTERISTIC FaultManager.MediumOverspeed.Mode "Fault manager configuration.  Select up to 4 actions for each fault." VALUE 0x8000333D RecordLayout_4 0 CompuMethod_111 0 65535 /end CHARACTERISTIC
/begin CHARACTERISTIC FaultManager.MediumOverspeed.ID "Fault manager configuration.  Select up to 4 actions for each fault." VALUE 0x8000333F RecordLayout_4 0 CompuMethod_1 0 65535 /end CHARACTERISTIC
/begin CHARACTERISTIC FaultManager.MediumOverspeed.Test "Fault manager configuration.  Select up to 4 actions for each fault." VALUE 0x80003341 RecordLayout_4 0 CompuMethod_112 0 65535 /end CHARACTERISTIC
/begin CHARACTERISTIC FaultManager.MediumOverspeed.Faulty_Samples__X_ "Fault manager configuration.  Select up to 4 actions for each fault." VALUE 0x80003343 RecordLayout_4 0 CompuMethod_1 0 65535 /end CHARACTERISTIC
/begin CHARACTERISTIC FaultManager.MediumOverspeed.Total_Samples__Y_ "Fault manager configuration.  Select up to 4 actions for each fault." VALUE 0x80003345 RecordLayout_4 0 CompuMethod_1 0 65535 /end CHARACTERISTIC
/begin CHARACTERISTIC FaultManager.MediumOverspeed.Action_1 "Fault manager configuration.  Select up to 4 actions for each fault." VALUE 0x80003347 RecordLayout_4 0 CompuMethod_113 0 65535 /end CHARACTERISTIC
/begin CHARACTERISTIC FaultManager.MediumOverspeed.Action_1_Condition "Fault manager configuration.  Select up to 4 actions for each fault." VALUE 0x80003349 RecordLayout_4 0 CompuMethod_114 0 65535 /end CHARACTERISTIC
/begin CHARACTERISTIC FaultManager.MediumOverspeed.Action_2 "Fault manager configuration.  Select up to 4 actions for each fault." VALUE 0x8000334B RecordLayout_4 0 CompuMethod_113 0 65535 /end CHARACTERISTIC
/begin CHARACTERISTIC FaultManager.MediumOverspeed.Action_2_Condition "Fault manager configuration.  Select up to 4 actions for each fault." VALUE 0x8000334D RecordLayout_4 0 CompuMethod_114 0 65535 /end CHARACTERISTIC
/begin CHARACTERISTIC FaultManager.MediumOverspeed.Action_3 "Fault manager configuration.  Select up to 4 actions for each fault." VALUE 0x8000334F RecordLayout_4 0 CompuMethod_113 0 65535 /end CHARACTERISTIC
/begin CHARACTERISTIC FaultManager.MediumOverspeed.Action_3_Condition "Fault manager configuration.  Select up to 4 actions for each fault." VALUE 0x80003351 RecordLayout_4 0 CompuMethod_114 0 65535 /end CHARACTERISTIC
/begin CHARACTERISTIC FaultManager.MediumOverspeed.Action_4 "Fault manager configuration.  Select up to 4 actions for each fault." VALUE 0x80003353 RecordLayout_4 0 CompuMethod_113 0 65535 /end CHARACTERISTIC
/begin CHARACTERISTIC FaultManager.MediumOverspeed.Action_4_Condition "Fault manager configuration.  Select up to 4 actions for each fault." VALUE 0x80003355 RecordLayout_4 0 CompuMethod_114 0 65535 /end CHARACTERISTIC
/begin CHARACTERISTIC FaultManager.NoOil_Fault.Mode "Fault manager configuration.  Select up to 4 actions for each fault." VALUE 0x80003357 RecordLayout_4 0 CompuMethod_111 0 65535 /end CHARACTERISTIC
/begin CHARACTERISTIC FaultManager.NoOil_Fault.ID "Fault manager configuration.  Select up to 4 actions for each fault." VALUE 0x80003359 RecordLayout_4 0 CompuMethod_1 0 65535 /end CHARACTERISTIC
/begin CHARACTERISTIC FaultManager.NoOil_Fault.Test "Fault manager configuration.  Select up to 4 actions for each fault." VALUE 0x8000335B RecordLayout_4 0 CompuMethod_112 0 65535 /end CHARACTERISTIC
/begin CHARACTERISTIC FaultManager.NoOil_Fault.Faulty_Samples__X_ "Fault manager configuration.  Select up to 4 actions for each fault." VALUE 0x8000335D RecordLayout_4 0 CompuMethod_1 0 65535 /end CHARACTERISTIC
/begin CHARACTERISTIC FaultManager.NoOil_Fault.Total_Samples__Y_ "Fault manager configuration.  Select up to 4 actions for each fault." VALUE 0x8000335F RecordLayout_4 0 CompuMethod_1 0 65535 /end CHARACTERISTIC
/begin CHARACTERISTIC FaultManager.NoOil_Fault.Action_1 "Fault manager configuration.  Select up to 4 actions for each fault." VALUE 0x80003361 RecordLayout_4 0 CompuMethod_113 0 65535 /end CHARACTERISTIC
/begin CHARACTERISTIC FaultManager.NoOil_Fault.Action_1_Condition "Fault manager configuration.  Select up to 4 actions for each fault." VALUE 0x80003363 RecordLayout_4 0 CompuMethod_114 0 65535 /end CHARACTERISTIC
/begin CHARACTERISTIC FaultManager.NoOil_Fault.Action_2 "Fault manager configuration.  Select up to 4 actions for each fault." VALUE 0x80003365 RecordLayout_4 0 CompuMethod_113 0 65535 /end CHARACTERISTIC
/begin CHARACTERISTIC FaultManager.NoOil_Fault.Action_2_Condition "Fault manager configuration.  Select up to 4 actions for each fault." VALUE 0x80003367 RecordLayout_4 0 CompuMethod_114 0 65535 /end CHARACTERISTIC
/begin CHARACTERISTIC FaultManager.NoOil_Fault.Action_3 "Fault manager configuration.  Select up to 4 actions for each fault." VALUE 0x80003369 RecordLayout_4 0 CompuMethod_113 0 65535 /end CHARACTERISTIC
/begin CHARACTERISTIC FaultManager.NoOil_Fault.Action_3_Condition "Fault manager configuration.  Select up to 4 actions for each fault." VALUE 0x8000336B RecordLayout_4 0 CompuMethod_114 0 65535 /end CHARACTERISTIC
/begin CHARACTERISTIC FaultManager.NoOil_Fault.Action_4 "Fault manager configuration.  Select up to 4 actions for each fault." VALUE 0x8000336D RecordLayout_4 0 CompuMethod_113 0 65535 /end CHARACTERISTIC
/begin CHARACTERISTIC FaultManager.NoOil_Fault.Action_4_Condition "Fault manager configuration.  Select up to 4 actions for each fault." VALUE 0x8000336F RecordLayout_4 0 CompuMethod_114 0 65535 /end CHARACTERISTIC
/begin CHARACTERISTIC FaultManager.O2FailedLean.Mode "Fault manager configuration.  Select up to 4 actions for each fault." VALUE 0x80003371 RecordLayout_4 0 CompuMethod_111 0 65535 /end CHARACTERISTIC
/begin CHARACTERISTIC FaultManager.O2FailedLean.ID "Fault manager configuration.  Select up to 4 actions for each fault." VALUE 0x80003373 RecordLayout_4 0 CompuMethod_1 0 65535 /end CHARACTERISTIC
/begin CHARACTERISTIC FaultManager.O2FailedLean.Test "Fault manager configuration.  Select up to 4 actions for each fault." VALUE 0x80003375 RecordLayout_4 0 CompuMethod_112 0 65535 /end CHARACTERISTIC
/begin CHARACTERISTIC FaultManager.O2FailedLean.Faulty_Samples__X_ "Fault manager configuration.  Select up to 4 actions for each fault." VALUE 0x80003377 RecordLayout_4 0 CompuMethod_1 0 65535 /end CHARACTERISTIC
/begin CHARACTERISTIC FaultManager.O2FailedLean.Total_Samples__Y_ "Fault manager configuration.  Select up to 4 actions for each fault." VALUE 0x80003379 RecordLayout_4 0 CompuMethod_1 0 65535 /end CHARACTERISTIC
/begin CHARACTERISTIC FaultManager.O2FailedLean.Action_1 "Fault manager configuration.  Select up to 4 actions for each fault." VALUE 0x8000337B RecordLayout_4 0 CompuMethod_113 0 65535 /end CHARACTERISTIC
/begin CHARACTERISTIC FaultManager.O2FailedLean.Action_1_Condition "Fault manager configuration.  Select up to 4 actions for each fault." VALUE 0x8000337D RecordLayout_4 0 CompuMethod_114 0 65535 /end CHARACTERISTIC
/begin CHARACTERISTIC FaultManager.O2FailedLean.Action_2 "Fault manager configuration.  Select up to 4 actions for each fault." VALUE 0x8000337F RecordLayout_4 0 CompuMethod_113 0 65535 /end CHARACTERISTIC
/begin CHARACTERISTIC FaultManager.O2FailedLean.Action_2_Condition "Fault manager configuration.  Select up to 4 actions for each fault." VALUE 0x80003381 RecordLayout_4 0 CompuMethod_114 0 65535 /end CHARACTERISTIC
/begin CHARACTERISTIC FaultManager.O2FailedLean.Action_3 "Fault manager configuration.  Select up to 4 actions for each fault." VALUE 0x80003383 RecordLayout_4 0 CompuMethod_113 0 65535 /end CHARACTERISTIC
/begin CHARACTERISTIC FaultManager.O2FailedLean.Action_3_Condition "Fault manager configuration.  Select up to 4 actions for each fault." VALUE 0x80003385 RecordLayout_4 0 CompuMethod_114 0 65535 /end CHARACTERISTIC
/begin CHARACTERISTIC FaultManager.O2FailedLean.Action_4 "Fault manager configuration.  Select up to 4 actions for each fault." VALUE 0x80003387 RecordLayout_4 0 CompuMethod_113 0 65535 /end CHARACTERISTIC
/begin CHARACTERISTIC FaultManager.O2FailedLean.Action_4_Condition "Fault manager configuration.  Select up to 4 actions for each fault." VALUE 0x80003389 RecordLayout_4 0 CompuMethod_114 0 65535 /end CHARACTERISTIC
/begin CHARACTERISTIC FaultManager.O2FailedRich.Mode "Fault manager configuration.  Select up to 4 actions for each fault." VALUE 0x8000338B RecordLayout_4 0 CompuMethod_111 0 65535 /end CHARACTERISTIC
/begin CHARACTERISTIC FaultManager.O2FailedRich.ID "Fault manager configuration.  Select up to 4 actions for each fault." VALUE 0x8000338D RecordLayout_4 0 CompuMethod_1 0 65535 /end CHARACTERISTIC
/begin CHARACTERISTIC FaultManager.O2FailedRich.Test "Fault manager configuration.  Select up to 4 actions for each fault." VALUE 0x8000338F RecordLayout_4 0 CompuMethod_112 0 65535 /end CHARACTERISTIC
/begin CHARACTERISTIC FaultManager.O2FailedRich.Faulty_Samples__X_ "Fault manager configuration.  Select up to 4 actions for each fault." VALUE 0x80003391 RecordLayout_4 0 CompuMethod_1 0 65535 /end CHARACTERISTIC
/begin CHARACTERISTIC FaultManager.O2FailedRich.Total_Samples__Y_ "Fault manager configuration.  Select up to 4 actions for each fault." VALUE 0x80003393 RecordLayout_4 0 CompuMethod_1 0 65535 /end CHARACTERISTIC
/begin CHARACTERISTIC FaultManager.O2FailedRich.Action_1 "Fault manager configuration.  Select up to 4 actions for each fault." VALUE 0x80003395 RecordLayout_4 0 CompuMethod_113 0 65535 /end CHARACTERISTIC
/begin CHARACTERISTIC FaultManager.O2FailedRich.Action_1_Condition "Fault manager configuration.  Select up to 4 actions for each fault." VALUE 0x80003397 RecordLayout_4 0 CompuMethod_114 0 65535 /end CHARACTERISTIC
/begin CHARACTERISTIC FaultManager.O2FailedRich.Action_2 "Fault manager configuration.  Select up to 4 actions for each fault." VALUE 0x80003399 RecordLayout_4 0 CompuMethod_113 0 65535 /end CHARACTERISTIC
/begin CHARACTERISTIC FaultManager.O2FailedRich.Action_2_Condition "Fault manager configuration.  Select up to 4 actions for each fault." VALUE 0x8000339B RecordLayout_4 0 CompuMethod_114 0 65535 /end CHARACTERISTIC
/begin CHARACTERISTIC FaultManager.O2FailedRich.Action_3 "Fault manager configuration.  Select up to 4 actions for each fault." VALUE 0x8000339D RecordLayout_4 0 CompuMethod_113 0 65535 /end CHARACTERISTIC
/begin CHARACTERISTIC FaultManager.O2FailedRich.Action_3_Condition "Fault manager configuration.  Select up to 4 actions for each fault." VALUE 0x8000339F RecordLayout_4 0 CompuMethod_114 0 65535 /end CHARACTERISTIC
/begin CHARACTERISTIC FaultManager.O2FailedRich.Action_4 "Fault manager configuration.  Select up to 4 actions for each fault." VALUE 0x800033A1 RecordLayout_4 0 CompuMethod_113 0 65535 /end CHARACTERISTIC
/begin CHARACTERISTIC FaultManager.O2FailedRich.Action_4_Condition "Fault manager configuration.  Select up to 4 actions for each fault." VALUE 0x800033A3 RecordLayout_4 0 CompuMethod_114 0 65535 /end CHARACTERISTIC
/begin CHARACTERISTIC FaultManager.O2NotActive.Mode "Fault manager configuration.  Select up to 4 actions for each fault." VALUE 0x800033A5 RecordLayout_4 0 CompuMethod_111 0 65535 /end CHARACTERISTIC
/begin CHARACTERISTIC FaultManager.O2NotActive.ID "Fault manager configuration.  Select up to 4 actions for each fault." VALUE 0x800033A7 RecordLayout_4 0 CompuMethod_1 0 65535 /end CHARACTERISTIC
/begin CHARACTERISTIC FaultManager.O2NotActive.Test "Fault manager configuration.  Select up to 4 actions for each fault." VALUE 0x800033A9 RecordLayout_4 0 CompuMethod_112 0 65535 /end CHARACTERISTIC
/begin CHARACTERISTIC FaultManager.O2NotActive.Faulty_Samples__X_ "Fault manager configuration.  Select up to 4 actions for each fault." VALUE 0x800033AB RecordLayout_4 0 CompuMethod_1 0 65535 /end CHARACTERISTIC
/begin CHARACTERISTIC FaultManager.O2NotActive.Total_Samples__Y_ "Fault manager configuration.  Select up to 4 actions for each fault." VALUE 0x800033AD RecordLayout_4 0 CompuMethod_1 0 65535 /end CHARACTERISTIC
/begin CHARACTERISTIC FaultManager.O2NotActive.Action_1 "Fault manager configuration.  Select up to 4 actions for each fault." VALUE 0x800033AF RecordLayout_4 0 CompuMethod_113 0 65535 /end CHARACTERISTIC
/begin CHARACTERISTIC FaultManager.O2NotActive.Action_1_Condition "Fault manager configuration.  Select up to 4 actions for each fault." VALUE 0x800033B1 RecordLayout_4 0 CompuMethod_114 0 65535 /end CHARACTERISTIC
/begin CHARACTERISTIC FaultManager.O2NotActive.Action_2 "Fault manager configuration.  Select up to 4 actions for each fault." VALUE 0x800033B3 RecordLayout_4 0 CompuMethod_113 0 65535 /end CHARACTERISTIC
/begin CHARACTERISTIC FaultManager.O2NotActive.Action_2_Condition "Fault manager configuration.  Select up to 4 actions for each fault." VALUE 0x800033B5 RecordLayout_4 0 CompuMethod_114 0 65535 /end CHARACTERISTIC
/begin CHARACTERISTIC FaultManager.O2NotActive.Action_3 "Fault manager configuration.  Select up to 4 actions for each fault." VALUE 0x800033B7 RecordLayout_4 0 CompuMethod_113 0 65535 /end CHARACTERISTIC
/begin CHARACTERISTIC FaultManager.O2NotActive.Action_3_Condition "Fault manager configuration.  Select up to 4 actions for each fault." VALUE 0x800033B9 RecordLayout_4 0 CompuMethod_114 0 65535 /end CHARACTERISTIC
/begin CHARACTERISTIC FaultManager.O2NotActive.Action_4 "Fault manager configuration.  Select up to 4 actions for each fault." VALUE 0x800033BB RecordLayout_4 0 CompuMethod_113 0 65535 /end CHARACTERISTIC
/begin CHARACTERISTIC FaultManager.O2NotActive.Action_4_Condition "Fault manager configuration.  Select up to 4 actions for each fault." VALUE 0x800033BD RecordLayout_4 0 CompuMethod_114 0 65535 /end CHARACTERISTIC
/begin CHARACTERISTIC FaultManager.OilPresRangeHigh.Mode "Fault manager configuration.  Select up to 4 actions for each fault." VALUE 0x800033BF RecordLayout_4 0 CompuMethod_111 0 65535 /end CHARACTERISTIC
/begin CHARACTERISTIC FaultManager.OilPresRangeHigh.ID "Fault manager configuration.  Select up to 4 actions for each fault." VALUE 0x800033C1 RecordLayout_4 0 CompuMethod_1 0 65535 /end CHARACTERISTIC
/begin CHARACTERISTIC FaultManager.OilPresRangeHigh.Test "Fault manager configuration.  Select up to 4 actions for each fault." VALUE 0x800033C3 RecordLayout_4 0 CompuMethod_112 0 65535 /end CHARACTERISTIC
/begin CHARACTERISTIC FaultManager.OilPresRangeHigh.Faulty_Samples__X_ "Fault manager configuration.  Select up to 4 actions for each fault." VALUE 0x800033C5 RecordLayout_4 0 CompuMethod_1 0 65535 /end CHARACTERISTIC
/begin CHARACTERISTIC FaultManager.OilPresRangeHigh.Total_Samples__Y_ "Fault manager configuration.  Select up to 4 actions for each fault." VALUE 0x800033C7 RecordLayout_4 0 CompuMethod_1 0 65535 /end CHARACTERISTIC
/begin CHARACTERISTIC FaultManager.OilPresRangeHigh.Action_1 "Fault manager configuration.  Select up to 4 actions for each fault." VALUE 0x800033C9 RecordLayout_4 0 CompuMethod_113 0 65535 /end CHARACTERISTIC
/begin CHARACTERISTIC FaultManager.OilPresRangeHigh.Action_1_Condition "Fault manager configuration.  Select up to 4 actions for each fault." VALUE 0x800033CB RecordLayout_4 0 CompuMethod_114 0 65535 /end CHARACTERISTIC
/begin CHARACTERISTIC FaultManager.OilPresRangeHigh.Action_2 "Fault manager configuration.  Select up to 4 actions for each fault." VALUE 0x800033CD RecordLayout_4 0 CompuMethod_113 0 65535 /end CHARACTERISTIC
/begin CHARACTERISTIC FaultManager.OilPresRangeHigh.Action_2_Condition "Fault manager configuration.  Select up to 4 actions for each fault." VALUE 0x800033CF RecordLayout_4 0 CompuMethod_114 0 65535 /end CHARACTERISTIC
/begin CHARACTERISTIC FaultManager.OilPresRangeHigh.Action_3 "Fault manager configuration.  Select up to 4 actions for each fault." VALUE 0x800033D1 RecordLayout_4 0 CompuMethod_113 0 65535 /end CHARACTERISTIC
/begin RECORD_LAYOUT RecordLayout_4 FNC_VALUES 1 UWORD ROW_DIR DIRECT /end RECORD_LAYOUT
/*~~~~~~~~~ 6.3.31 COMPU_METHODs ~~~~~~~~~*/
/begin COMPU_METHOD CompuMethod_1 "" RAT_FUNC "%3.0" "" COEFFS 0 1 0 0 0 1 /end COMPU_METHOD
/begin COMPU_METHOD CompuMethod_111 "" TAB_VERB "%3.0" "" COMPU_TAB_REF CompuVtab_32 /end COMPU_METHOD
/begin COMPU_METHOD CompuMethod_112 "" TAB_VERB "%3.0" "" COMPU_TAB_REF CompuVtab_33 /end COMPU_METHOD
/begin COMPU_METHOD CompuMethod_113 "" TAB_VERB "%3.0" "" COMPU_TAB_REF CompuVtab_34 /end COMPU_METHOD
/begin COMPU_METHOD CompuMethod_114 "" TAB_VERB "%3.0" "" COMPU_TAB_REF CompuVtab_35 /end COMPU_METHOD
/begin COMPU_VTAB CompuVtab_32 "" TAB_VERB 6 0 "Disabled" 1 "Enabled" 2 "Sticky" 3 "Enabled - Persistent" 4 "Sticky - Persistent" 5 "Save Occurred" /end COMPU_VTAB
/begin COMPU_VTAB CompuVtab_33 "" TAB_VERB 2 0 "-" 1 "Test" /end COMPU_VTAB
/begin COMPU_VTAB CompuVtab_34 "" TAB_VERB 14 0 "CutThrottle" 1 "DFCODisable" 2 "DelayedEngineShutdown" 3 "DisableAC" 4 "DisableO2Ctrl" 5 "DisableVEAdapt" 6 "DisableWastegate" 7 "EngineProtectLED" 8 "EngineShutdown" 9 "HardRevLimit" 10 "MIL_LED" 11 "MediumRevLimit" 12 "SoftRevLimit" 13 "(None)" /end COMPU_VTAB
/begin COMPU_VTAB CompuVtab_35 "" TAB_VERB 8 0 "(None)" 1 "Suspected" 2 "Active" 3 "Suspected or Active" 4 "Occurred" 5 "Suspected or Occurred" 6 "Active or Occurred" 7 "Suspected or Active or Occurred" /end COMPU_VTAB
/begin FUNCTION BaseEngineController_LS ""
 /begin DEF_CHARACTERISTIC FaultManager.EST7_Open.Action_1 FaultManager.EST7_Open.Action_1_Condition FaultManager.EST7_Open.Action_2 FaultManager.EST7_Open.Action_2_Condition FaultManager.EST7_Open.Action_3 FaultManager.EST7_Open.Action_3_Condition FaultManager.EST7_Open.Action_4 FaultManager.EST7_Open.Action_4_Condition FaultManager.EST7_Short.Mode FaultManager.EST7_Short.ID FaultManager.EST7_Short.Test FaultManager.EST7_Short.Faulty_Samples__X_ FaultManager.EST7_Short.Total_Samples__Y_ FaultManager.EST7_Short.Action_1 FaultManager.EST7_Short.Action_1_Condition FaultManager.EST7_Short.Action_2 FaultManager.EST7_Short.Action_2_Condition FaultManager.EST7_Short.Action_3 FaultManager.EST7_Short.Action_3_Condition FaultManager.EST7_Short.Action_4 FaultManager.EST7_Short.Action_4_Condition FaultManager.EST8_Open.Mode FaultManager.EST8_Open.ID FaultManager.EST8_Open.Test FaultManager.EST8_Open.Faulty_Samples__X_ FaultManager.EST8_Open.Total_Samples__Y_ FaultManager.EST8_Open.Action_1 FaultManager.EST8_Open.Action_1_Condition FaultManager.EST8_Open.Action_2 FaultManager.EST8_Open.Action_2_Condition FaultManager.EST8_Open.Action_3 FaultManager.EST8_Open.Action_3_Condition FaultManager.EST8_Open.Action_4 FaultManager.EST8_Open.Action_4_Condition FaultManager.EST8_Short.Mode FaultManager.EST8_Short.ID FaultManager.EST8_Short.Test FaultManager.EST8_Short.Faulty_Samples__X_ FaultManager.EST8_Short.Total_Samples__Y_ FaultManager.EST8_Short.Action_1 FaultManager.EST8_Short.Action_1_Condition FaultManager.EST8_Short.Action_2 FaultManager.EST8_Short.Action_2_Condition FaultManager.EST8_Short.Action_3 FaultManager.EST8_Short.Action_3_Condition FaultManager.EST8_Short.Action_4 FaultManager.EST8_Short.Action_4_Condition FaultManager.ETCSpringTest.Mode FaultManager.ETCSpringTest.ID FaultManager.ETCSpringTest.Test FaultManager.ETCSpringTest.Faulty_Samples__X_ FaultManager.ETCSpringTest.Total_Samples__Y_ FaultManager.ETCSpringTest.Action_1 FaultManager.ETCSpringTest.Action_1_Condition FaultManager.ETCSpringTest.Action_2 FaultManager.ETCSpringTest.Action_2_Condition FaultManager.ETCSpringTest.Action_3 FaultManager.ETCSpringTest.Action_3_Condition FaultManager.ETCSpringTest.Action_4 FaultManager.ETCSpringTest.Action_4_Condition FaultManager.ETC_Open_Fault.Mode FaultManager.ETC_Open_Fault.ID FaultManager.ETC_Open_Fault.Test FaultManager.ETC_Open_Fault.Faulty_Samples__X_ FaultManager.ETC_Open_Fault.Total_Samples__Y_ FaultManager.ETC_Open_Fault.Action_1 FaultManager.ETC_Open_Fault.Action_1_Condition FaultManager.ETC_Open_Fault.Action_2 FaultManager.ETC_Open_Fault.Action_2_Condition FaultManager.ETC_Open_Fault.Action_3 FaultManager.ETC_Open_Fault.Action_3_Condition FaultManager.ETC_Open_Fault.Action_4 FaultManager.ETC_Open_Fault.Action_4_Condition FaultManager.ETC_Sticking.Mode FaultManager.ETC_Sticking.ID FaultManager.ETC_Sticking.Test FaultManager.ETC_Sticking.Faulty_Samples__X_ FaultManager.ETC_Sticking.Total_Samples__Y_ FaultManager.ETC_Sticking.Action_1 FaultManager.ETC_Sticking.Action_1_Condition FaultManager.ETC_Sticking.Action_2 FaultManager.ETC_Sticking.Action_2_Condition FaultManager.ETC_Sticking.Action_3 FaultManager.ETC_Sticking.Action_3_Condition FaultManager.ETC_Sticking.Action_4 FaultManager.ETC_Sticking.Action_4_Condition FaultManager.EVAPRangeHigh.Mode FaultManager.EVAPRangeHigh.ID FaultManager.EVAPRangeHigh.Test FaultManager.EVAPRangeHigh.Faulty_Samples__X_ FaultManager.EVAPRangeHigh.Total_Samples__Y_ FaultManager.EVAPRangeHigh.Action_1 FaultManager.EVAPRangeHigh.Action_1_Condition FaultManager.EVAPRangeHigh.Action_2 FaultManager.EVAPRangeHigh.Action_2_Condition FaultManager.EVAPRangeHigh.Action_3 FaultManager.EVAPRangeHigh.Action_3_Condition FaultManager.EVAPRangeHigh.Action_4 FaultManager.EVAPRangeHigh.Action_4_Condition FaultManager.EVAPRangeLow.Mode FaultManager.EVAPRangeLow.ID FaultManager.EVAPRangeLow.Test FaultManager.EVAPRangeLow.Faulty_Samples__X_ FaultManager.EVAPRangeLow.Total_Samples__Y_ FaultManager.EVAPRangeLow.Action_1 FaultManager.EVAPRangeLow.Action_1_Condition FaultManager.EVAPRangeLow.Action_2 FaultManager.EVAPRangeLow.Action_2_Condition FaultManager.EVAPRangeLow.Action_3 FaultManager.EVAPRangeLow.Action_3_Condition FaultManager.EVAPRangeLow.Action_4 FaultManager.EVAPRangeLow.Action_4_Condition FaultManager.FuelAdaptRangeHi.Mode FaultManager.FuelAdaptRangeHi.ID FaultManager.FuelAdaptRangeHi.Test FaultManager.FuelAdaptRangeHi.Faulty_Samples__X_ FaultManager.FuelAdaptRangeHi.Total_Samples__Y_ FaultManager.FuelAdaptRangeHi.Action_1 FaultManager.FuelAdaptRangeHi.Action_1_Condition FaultManager.FuelAdaptRangeHi.Action_2 FaultManager.FuelAdaptRangeHi.Action_2_Condition FaultManager.FuelAdaptRangeHi.Action_3 FaultManager.FuelAdaptRangeHi.Action_3_Condition FaultManager.FuelAdaptRangeHi.Action_4 FaultManager.FuelAdaptRangeHi.Action_4_Condition FaultManager.FuelAdaptRangeLow.Mode FaultManager.FuelAdaptRangeLow.ID FaultManager.FuelAdaptRangeLow.Test FaultManager.FuelAdaptRangeLow.Faulty_Samples__X_ FaultManager.FuelAdaptRangeLow.Total_Samples__Y_ FaultManager.FuelAdaptRangeLow.Action_1 FaultManager.FuelAdaptRangeLow.Action_1_Condition FaultManager.FuelAdaptRangeLow.Action_2 FaultManager.FuelAdaptRangeLow.Action_2_Condition FaultManager.FuelAdaptRangeLow.Action_3 FaultManager.FuelAdaptRangeLow.Action_3_Condition FaultManager.FuelAdaptRangeLow.Action_4 FaultManager.FuelAdaptRangeLow.Action_4_Condition FaultManager.FuelPresHigh_Fault.Mode FaultManager.FuelPresHigh_Fault.ID FaultManager.FuelPresHigh_Fault.Test FaultManager.FuelPresHigh_Fault.Faulty_Samples__X_ FaultManager.FuelPresHigh_Fault.Total_Samples__Y_ FaultManager.FuelPresHigh_Fault.Action_1 FaultManager.FuelPresHigh_Fault.Action_1_Condition FaultManager.FuelPresHigh_Fault.Action_2 FaultManager.FuelPresHigh_Fault.Action_2_Condition FaultManager.FuelPresHigh_Fault.Action_3 FaultManager.FuelPresHigh_Fault.Action_3_Condition FaultManager.FuelPresHigh_Fault.Action_4 FaultManager.FuelPresHigh_Fault.Action_4_Condition FaultManager.FuelPresLow_Fault.Mode FaultManager.FuelPresLow_Fault.ID FaultManager.FuelPresLow_Fault.Test FaultManager.FuelPresLow_Fault.Faulty_Samples__X_ FaultManager.FuelPresLow_Fault.Total_Samples__Y_ FaultManager.FuelPresLow_Fault.Action_1 FaultManager.FuelPresLow_Fault.Action_1_Condition FaultManager.FuelPresLow_Fault.Action_2 FaultManager.FuelPresLow_Fault.Action_2_Condition FaultManager.FuelPresLow_Fault.Action_3 FaultManager.FuelPresLow_Fault.Action_3_Condition FaultManager.FuelPresLow_Fault.Action_4 FaultManager.FuelPresLow_Fault.Action_4_Condition FaultManager.FuelPresRangeHigh.Mode FaultManager.FuelPresRangeHigh.ID FaultManager.FuelPresRangeHigh.Test FaultManager.FuelPresRangeHigh.Faulty_Samples__X_ FaultManager.FuelPresRangeHigh.Total_Samples__Y_ FaultManager.FuelPresRangeHigh.Action_1 FaultManager.FuelPresRangeHigh.Action_1_Condition FaultManager.FuelPresRangeHigh.Action_2 FaultManager.FuelPresRangeHigh.Action_2_Condition FaultManager.FuelPresRangeHigh.Action_3 FaultManager.FuelPresRangeHigh.Action_3_Condition FaultManager.FuelPresRangeHigh.Action_4 FaultManager.FuelPresRangeHigh.Action_4_Condition FaultManager.FuelPresRangeLow.Mode FaultManager.FuelPresRangeLow.ID FaultManager.FuelPresRangeLow.Test FaultManager.FuelPresRangeLow.Faulty_Samples__X_ FaultManager.FuelPresRangeLow.Total_Samples__Y_ FaultManager.FuelPresRangeLow.Action_1 FaultManager.FuelPresRangeLow.Action_1_Condition FaultManager.FuelPresRangeLow.Action_2 FaultManager.FuelPresRangeLow.Action_2_Condition FaultManager.FuelPresRangeLow.Action_3 FaultManager.FuelPresRangeLow.Action_3_Condition FaultManager.FuelPresRangeLow.Action_4 FaultManager.FuelPresRangeLow.Action_4_Condition FaultManager.FuelSensRangeHigh.Mode FaultManager.FuelSensRangeHigh.ID FaultManager.FuelSensRangeHigh.Test FaultManager.FuelSensRangeHigh.Faulty_Samples__X_ FaultManager.FuelSensRangeHigh.Total_Samples__Y_ FaultManager.FuelSensRangeHigh.Action_1 FaultManager.FuelSensRangeHigh.Action_1_Condition FaultManager.FuelSensRangeHigh.Action_2 FaultManager.FuelSensRangeHigh.Action_2_Condition FaultManager.FuelSensRangeHigh.Action_3 FaultManager.FuelSensRangeHigh.Action_3_Condition FaultManager.FuelSensRangeHigh.Action_4 FaultManager.FuelSensRangeHigh.Action_4_Condition FaultManager.FuelSensRangeLow.Mode FaultManager.FuelSensRangeLow.ID FaultManager.FuelSensRangeLow.Test FaultManager.FuelSensRangeLow.Faulty_Samples__X_ FaultManager.FuelSensRangeLow.Total_Samples__Y_ FaultManager.FuelSensRangeLow.Action_1 FaultManager.FuelSensRangeLow.Action_1_Condition FaultManager.FuelSensRangeLow.Action_2 FaultManager.FuelSensRangeLow.Action_2_Condition FaultManager.FuelSensRangeLow.Action_3 FaultManager.FuelSensRangeLow.Action_3_Condition FaultManager.FuelSensRangeLow.Action_4 FaultManager.FuelSensRangeLow.Action_4_Condition FaultManager.Fuel_LvlRangeHigh.Mode FaultManager.Fuel_LvlRangeHigh.ID FaultManager.Fuel_LvlRangeHigh.Test FaultManager.Fuel_LvlRangeHigh.Faulty_Samples__X_ FaultManager.Fuel_LvlRangeHigh.Total_Samples__Y_ FaultManager.Fuel_LvlRangeHigh.Action_1 FaultManager.Fuel_LvlRangeHigh.Action_1_Condition FaultManager.Fuel_LvlRangeHigh.Action_2 FaultManager.Fuel_LvlRangeHigh.Action_2_Condition FaultManager.Fuel_LvlRangeHigh.Action_3 FaultManager.Fuel_LvlRangeHigh.Action_3_Condition FaultManager.Fuel_LvlRangeHigh.Action_4 FaultManager.Fuel_LvlRangeHigh.Action_4_Condition FaultManager.Fuel_LvlRangeLow.Mode FaultManager.Fuel_LvlRangeLow.ID FaultManager.Fuel_LvlRangeLow.Test FaultManager.Fuel_LvlRangeLow.Faulty_Samples__X_ FaultManager.Fuel_LvlRangeLow.Total_Samples__Y_ FaultManager.Fuel_LvlRangeLow.Action_1 FaultManager.Fuel_LvlRangeLow.Action_1_Condition FaultManager.Fuel_LvlRangeLow.Action_2 FaultManager.Fuel_LvlRangeLow.Action_2_Condition FaultManager.Fuel_LvlRangeLow.Action_3 FaultManager.Fuel_LvlRangeLow.Action_3_Condition FaultManager.Fuel_LvlRangeLow.Action_4 FaultManager.Fuel_LvlRangeLow.Action_4_Condition FaultManager.GPS_DateTime_Timeout.Mode FaultManager.GPS_DateTime_Timeout.ID FaultManager.GPS_DateTime_Timeout.Test FaultManager.GPS_DateTime_Timeout.Faulty_Samples__X_ FaultManager.GPS_DateTime_Timeout.Total_Samples__Y_ FaultManager.GPS_DateTime_Timeout.Action_1 FaultManager.GPS_DateTime_Timeout.Action_1_Condition FaultManager.GPS_DateTime_Timeout.Action_2 FaultManager.GPS_DateTime_Timeout.Action_2_Condition FaultManager.GPS_DateTime_Timeout.Action_3 FaultManager.GPS_DateTime_Timeout.Action_3_Condition FaultManager.GPS_DateTime_Timeout.Action_4 FaultManager.GPS_DateTime_Timeout.Action_4_Condition FaultManager.GPS_LatLong_Timeout.Mode FaultManager.GPS_LatLong_Timeout.ID FaultManager.GPS_LatLong_Timeout.Test FaultManager.GPS_LatLong_Timeout.Faulty_Samples__X_ FaultManager.GPS_LatLong_Timeout.Total_Samples__Y_ FaultManager.GPS_LatLong_Timeout.Action_1 FaultManager.GPS_LatLong_Timeout.Action_1_Condition FaultManager.GPS_LatLong_Timeout.Action_2 FaultManager.GPS_LatLong_Timeout.Action_2_Condition FaultManager.GPS_LatLong_Timeout.Action_3 FaultManager.GPS_LatLong_Timeout.Action_3_Condition FaultManager.GPS_LatLong_Timeout.Action_4 FaultManager.GPS_LatLong_Timeout.Action_4_Condition FaultManager.GPS_NotReady.Mode FaultManager.GPS_NotReady.ID FaultManager.GPS_NotReady.Test FaultManager.GPS_NotReady.Faulty_Samples__X_ FaultManager.GPS_NotReady.Total_Samples__Y_ FaultManager.GPS_NotReady.Action_1 FaultManager.GPS_NotReady.Action_1_Condition FaultManager.GPS_NotReady.Action_2 FaultManager.GPS_NotReady.Action_2_Condition FaultManager.GPS_NotReady.Action_3 FaultManager.GPS_NotReady.Action_3_Condition FaultManager.GPS_NotReady.Action_4 FaultManager.GPS_NotReady.Action_4_Condition FaultManager.GPS_SpeedDir_Timeout.Mode FaultManager.GPS_SpeedDir_Timeout.ID FaultManager.GPS_SpeedDir_Timeout.Test FaultManager.GPS_SpeedDir_Timeout.Faulty_Samples__X_ FaultManager.GPS_SpeedDir_Timeout.Total_Samples__Y_ FaultManager.GPS_SpeedDir_Timeout.Action_1 FaultManager.GPS_SpeedDir_Timeout.Action_1_Condition FaultManager.GPS_SpeedDir_Timeout.Action_2 FaultManager.GPS_SpeedDir_Timeout.Action_2_Condition FaultManager.GPS_SpeedDir_Timeout.Action_3 FaultManager.GPS_SpeedDir_Timeout.Action_3_Condition FaultManager.GPS_SpeedDir_Timeout.Action_4 FaultManager.GPS_SpeedDir_Timeout.Action_4_Condition FaultManager.HardOverBoost_Fault.Mode FaultManager.HardOverBoost_Fault.ID FaultManager.HardOverBoost_Fault.Test FaultManager.HardOverBoost_Fault.Faulty_Samples__X_ FaultManager.HardOverBoost_Fault.Total_Samples__Y_ FaultManager.HardOverBoost_Fault.Action_1 FaultManager.HardOverBoost_Fault.Action_1_Condition FaultManager.HardOverBoost_Fault.Action_2 FaultManager.HardOverBoost_Fault.Action_2_Condition FaultManager.HardOverBoost_Fault.Action_3 FaultManager.HardOverBoost_Fault.Action_3_Condition FaultManager.HardOverBoost_Fault.Action_4 FaultManager.HardOverBoost_Fault.Action_4_Condition FaultManager.HardOverspeed.Mode FaultManager.HardOverspeed.ID FaultManager.HardOverspeed.Test FaultManager.HardOverspeed.Faulty_Samples__X_ FaultManager.HardOverspeed.Total_Samples__Y_ FaultManager.HardOverspeed.Action_1 FaultManager.HardOverspeed.Action_1_Condition FaultManager.HardOverspeed.Action_2 FaultManager.HardOverspeed.Action_2_Condition FaultManager.HardOverspeed.Action_3 FaultManager.HardOverspeed.Action_3_Condition FaultManager.HardOverspeed.Action_4 FaultManager.HardOverspeed.Action_4_Condition FaultManager.IATRangeHigh.Mode FaultManager.IATRangeHigh.ID FaultManager.IATRangeHigh.Test FaultManager.IATRangeHigh.Faulty_Samples__X_ FaultManager.IATRangeHigh.Total_Samples__Y_ FaultManager.IATRangeHigh.Action_1 FaultManager.IATRangeHigh.Action_1_Condition FaultManager.IATRangeHigh.Action_2 FaultManager.IATRangeHigh.Action_2_Condition FaultManager.IATRangeHigh.Action_3 FaultManager.IATRangeHigh.Action_3_Condition FaultManager.IATRangeHigh.Action_4 FaultManager.IATRangeHigh.Action_4_Condition FaultManager.IATRangeLow.Mode FaultManager.IATRangeLow.ID FaultManager.IATRangeLow.Test FaultManager.IATRangeLow.Faulty_Samples__X_ FaultManager.IATRangeLow.Total_Samples__Y_ FaultManager.IATRangeLow.Action_1 FaultManager.IATRangeLow.Action_1_Condition FaultManager.IATRangeLow.Action_2 FaultManager.IATRangeLow.Action_2_Condition FaultManager.IATRangeLow.Action_3 FaultManager.IATRangeLow.Action_3_Condition FaultManager.IATRangeLow.Action_4 FaultManager.IATRangeLow.Action_4_Condition FaultManager.Inj1Open.Mode FaultManager.Inj1Open.ID FaultManager.Inj1Open.Test FaultManager.Inj1Open.Faulty_Samples__X_ FaultManager.Inj1Open.Total_Samples__Y_ FaultManager.Inj1Open.Action_1 FaultManager.Inj1Open.Action_1_Condition FaultManager.Inj1Open.Action_2 FaultManager.Inj1Open.Action_2_Condition FaultManager.Inj1Open.Action_3 FaultManager.Inj1Open.Action_3_Condition FaultManager.Inj1Open.Action_4 FaultManager.Inj1Open.Action_4_Condition FaultManager.Inj2Open.Mode FaultManager.Inj2Open.ID FaultManager.Inj2Open.Test FaultManager.Inj2Open.Faulty_Samples__X_ FaultManager.Inj2Open.Total_Samples__Y_ FaultManager.Inj2Open.Action_1 FaultManager.Inj2Open.Action_1_Condition FaultManager.Inj2Open.Action_2 FaultManager.Inj2Open.Action_2_Condition FaultManager.Inj2Open.Action_3 FaultManager.Inj2Open.Action_3_Condition FaultManager.Inj2Open.Action_4 FaultManager.Inj2Open.Action_4_Condition FaultManager.Inj3Open.Mode FaultManager.Inj3Open.ID FaultManager.Inj3Open.Test FaultManager.Inj3Open.Faulty_Samples__X_ FaultManager.Inj3Open.Total_Samples__Y_ FaultManager.Inj3Open.Action_1 FaultManager.Inj3Open.Action_1_Condition FaultManager.Inj3Open.Action_2 FaultManager.Inj3Open.Action_2_Condition FaultManager.Inj3Open.Action_3 FaultManager.Inj3Open.Action_3_Condition FaultManager.Inj3Open.Action_4 FaultManager.Inj3Open.Action_4_Condition FaultManager.Inj4Open.Mode FaultManager.Inj4Open.ID FaultManager.Inj4Open.Test FaultManager.Inj4Open.Faulty_Samples__X_ FaultManager.Inj4Open.Total_Samples__Y_ FaultManager.Inj4Open.Action_1 FaultManager.Inj4Open.Action_1_Condition FaultManager.Inj4Open.Action_2 FaultManager.Inj4Open.Action_2_Condition FaultManager.Inj4Open.Action_3 FaultManager.Inj4Open.Action_3_Condition FaultManager.Inj4Open.Action_4 FaultManager.Inj4Open.Action_4_Condition FaultManager.Inj5Open.Mode FaultManager.Inj5Open.ID FaultManager.Inj5Open.Test FaultManager.Inj5Open.Faulty_Samples__X_ FaultManager.Inj5Open.Total_Samples__Y_ FaultManager.Inj5Open.Action_1 FaultManager.Inj5Open.Action_1_Condition FaultManager.Inj5Open.Action_2 FaultManager.Inj5Open.Action_2_Condition FaultManager.Inj5Open.Action_3 FaultManager.Inj5Open.Action_3_Condition FaultManager.Inj5Open.Action_4 FaultManager.Inj5Open.Action_4_Condition FaultManager.Inj6Open.Mode FaultManager.Inj6Open.ID FaultManager.Inj6Open.Test FaultManager.Inj6Open.Faulty_Samples__X_ FaultManager.Inj6Open.Total_Samples__Y_ FaultManager.Inj6Open.Action_1 FaultManager.Inj6Open.Action_1_Condition FaultManager.Inj6Open.Action_2 FaultManager.Inj6Open.Action_2_Condition FaultManager.Inj6Open.Action_3 FaultManager.Inj6Open.Action_3_Condition FaultManager.Inj6Open.Action_4 FaultManager.Inj6Open.Action_4_Condition FaultManager.Inj7Open.Mode FaultManager.Inj7Open.ID FaultManager.Inj7Open.Test FaultManager.Inj7Open.Faulty_Samples__X_ FaultManager.Inj7Open.Total_Samples__Y_ FaultManager.Inj7Open.Action_1 FaultManager.Inj7Open.Action_1_Condition FaultManager.Inj7Open.Action_2 FaultManager.Inj7Open.Action_2_Condition FaultManager.Inj7Open.Action_3 FaultManager.Inj7Open.Action_3_Condition FaultManager.Inj7Open.Action_4 FaultManager.Inj7Open.Action_4_Condition FaultManager.Inj8Open.Mode FaultManager.Inj8Open.ID FaultManager.Inj8Open.Test FaultManager.Inj8Open.Faulty_Samples__X_ FaultManager.Inj8Open.Total_Samples__Y_ FaultManager.Inj8Open.Action_1 FaultManager.Inj8Open.Action_1_Condition FaultManager.Inj8Open.Action_2 FaultManager.Inj8Open.Action_2_Condition FaultManager.Inj8Open.Action_3 FaultManager.Inj8Open.Action_3_Condition FaultManager.Inj8Open.Action_4 FaultManager.Inj8Open.Action_4_Condition FaultManager.Lambda_1_NotReady.Mode FaultManager.Lambda_1_NotReady.ID FaultManager.Lambda_1_NotReady.Test FaultManager.Lambda_1_NotReady.Faulty_Samples__X_ FaultManager.Lambda_1_NotReady.Total_Samples__Y_ FaultManager.Lambda_1_NotReady.Action_1 FaultManager.Lambda_1_NotReady.Action_1_Condition FaultManager.Lambda_1_NotReady.Action_2 FaultManager.Lambda_1_NotReady.Action_2_Condition FaultManager.Lambda_1_NotReady.Action_3 FaultManager.Lambda_1_NotReady.Action_3_Condition FaultManager.Lambda_1_NotReady.Action_4 FaultManager.Lambda_1_NotReady.Action_4_Condition FaultManager.Lambda_1_Timeout.Mode FaultManager.Lambda_1_Timeout.ID FaultManager.Lambda_1_Timeout.Test FaultManager.Lambda_1_Timeout.Faulty_Samples__X_ FaultManager.Lambda_1_Timeout.Total_Samples__Y_ FaultManager.Lambda_1_Timeout.Action_1 FaultManager.Lambda_1_Timeout.Action_1_Condition FaultManager.Lambda_1_Timeout.Action_2 FaultManager.Lambda_1_Timeout.Action_2_Condition FaultManager.Lambda_1_Timeout.Action_3 FaultManager.Lambda_1_Timeout.Action_3_Condition FaultManager.Lambda_1_Timeout.Action_4 FaultManager.Lambda_1_Timeout.Action_4_Condition FaultManager.Lambda_2_NotReady.Mode FaultManager.Lambda_2_NotReady.ID FaultManager.Lambda_2_NotReady.Test FaultManager.Lambda_2_NotReady.Faulty_Samples__X_ FaultManager.Lambda_2_NotReady.Total_Samples__Y_ FaultManager.Lambda_2_NotReady.Action_1 FaultManager.Lambda_2_NotReady.Action_1_Condition FaultManager.Lambda_2_NotReady.Action_2 FaultManager.Lambda_2_NotReady.Action_2_Condition FaultManager.Lambda_2_NotReady.Action_3 FaultManager.Lambda_2_NotReady.Action_3_Condition FaultManager.Lambda_2_NotReady.Action_4 FaultManager.Lambda_2_NotReady.Action_4_Condition FaultManager.Lambda_2_Timeout.Mode FaultManager.Lambda_2_Timeout.ID FaultManager.Lambda_2_Timeout.Test FaultManager.Lambda_2_Timeout.Faulty_Samples__X_ FaultManager.Lambda_2_Timeout.Total_Samples__Y_ FaultManager.Lambda_2_Timeout.Action_1 FaultManager.Lambda_2_Timeout.Action_1_Condition FaultManager.Lambda_2_Timeout.Action_2 FaultManager.Lambda_2_Timeout.Action_2_Condition FaultManager.Lambda_2_Timeout.Action_3 FaultManager.Lambda_2_Timeout.Action_3_Condition FaultManager.Lambda_2_Timeout.Action_4 FaultManager.Lambda_2_Timeout.Action_4_Condition FaultManager.LeanProtect_Fault.Mode FaultManager.LeanProtect_Fault.ID FaultManager.LeanProtect_Fault.Test FaultManager.LeanProtect_Fault.Faulty_Samples__X_ FaultManager.LeanProtect_Fault.Total_Samples__Y_ FaultManager.LeanProtect_Fault.Action_1 FaultManager.LeanProtect_Fault.Action_1_Condition FaultManager.LeanProtect_Fault.Action_2 FaultManager.LeanProtect_Fault.Action_2_Condition FaultManager.LeanProtect_Fault.Action_3 FaultManager.LeanProtect_Fault.Action_3_Condition FaultManager.LeanProtect_Fault.Action_4 FaultManager.LeanProtect_Fault.Action_4_Condition FaultManager.MAFRangeHigh.Mode FaultManager.MAFRangeHigh.ID FaultManager.MAFRangeHigh.Test FaultManager.MAFRangeHigh.Faulty_Samples__X_ FaultManager.MAFRangeHigh.Total_Samples__Y_ FaultManager.MAFRangeHigh.Action_1 FaultManager.MAFRangeHigh.Action_1_Condition FaultManager.MAFRangeHigh.Action_2 FaultManager.MAFRangeHigh.Action_2_Condition FaultManager.MAFRangeHigh.Action_3 FaultManager.MAFRangeHigh.Action_3_Condition FaultManager.MAFRangeHigh.Action_4 FaultManager.MAFRangeHigh.Action_4_Condition FaultManager.MAFRangeLow.Mode FaultManager.MAFRangeLow.ID FaultManager.MAFRangeLow.Test FaultManager.MAFRangeLow.Faulty_Samples__X_ FaultManager.MAFRangeLow.Total_Samples__Y_ FaultManager.MAFRangeLow.Action_1 FaultManager.MAFRangeLow.Action_1_Condition FaultManager.MAFRangeLow.Action_2 FaultManager.MAFRangeLow.Action_2_Condition FaultManager.MAFRangeLow.Action_3 FaultManager.MAFRangeLow.Action_3_Condition FaultManager.MAFRangeLow.Action_4 FaultManager.MAFRangeLow.Action_4_Condition FaultManager.MAPRangeHigh.Mode FaultManager.MAPRangeHigh.ID FaultManager.MAPRangeHigh.Test FaultManager.MAPRangeHigh.Faulty_Samples__X_ FaultManager.MAPRangeHigh.Total_Samples__Y_ FaultManager.MAPRangeHigh.Action_1 FaultManager.MAPRangeHigh.Action_1_Condition FaultManager.MAPRangeHigh.Action_2 FaultManager.MAPRangeHigh.Action_2_Condition FaultManager.MAPRangeHigh.Action_3 FaultManager.MAPRangeHigh.Action_3_Condition FaultManager.MAPRangeHigh.Action_4 FaultManager.MAPRangeHigh.Action_4_Condition FaultManager.MAPRangeLow.Mode FaultManager.MAPRangeLow.ID FaultManager.MAPRangeLow.Test FaultManager.MAPRangeLow.Faulty_Samples__X_ FaultManager.MAPRangeLow.Total_Samples__Y_ FaultManager.MAPRangeLow.Action_1 FaultManager.MAPRangeLow.Action_1_Condition FaultManager.MAPRangeLow.Action_2 FaultManager.MAPRangeLow.Action_2_Condition FaultManager.MAPRangeLow.Action_3 FaultManager.MAPRangeLow.Action_3_Condition FaultManager.MAPRangeLow.Action_4 FaultManager.MAPRangeLow.Action_4_Condition FaultManager.MAPTimeRangeHigh.Mode FaultManager.MAPTimeRangeHigh.ID FaultManager.MAPTimeRangeHigh.Test FaultManager.MAPTimeRangeHigh.Faulty_Samples__X_ FaultManager.MAPTimeRangeHigh.Total_Samples__Y_ FaultManager.MAPTimeRangeHigh.Action_1 FaultManager.MAPTimeRangeHigh.Action_1_Condition FaultManager.MAPTimeRangeHigh.Action_2 FaultManager.MAPTimeRangeHigh.Action_2_Condition FaultManager.MAPTimeRangeHigh.Action_3 FaultManager.MAPTimeRangeHigh.Action_3_Condition FaultManager.MAPTimeRangeHigh.Action_4 FaultManager.MAPTimeRangeHigh.Action_4_Condition FaultManager.MAPTimeRangeLow.Mode FaultManager.MAPTimeRangeLow.ID FaultManager.MAPTimeRangeLow.Test FaultManager.MAPTimeRangeLow.Faulty_Samples__X_ FaultManager.MAPTimeRangeLow.Total_Samples__Y_ FaultManager.MAPTimeRangeLow.Action_1 FaultManager.MAPTimeRangeLow.Action_1_Condition FaultManager.MAPTimeRangeLow.Action_2 FaultManager.MAPTimeRangeLow.Action_2_Condition FaultManager.MAPTimeRangeLow.Action_3 FaultManager.MAPTimeRangeLow.Action_3_Condition FaultManager.MAPTimeRangeLow.Action_4 FaultManager.MAPTimeRangeLow.Action_4_Condition FaultManager.MAP_IR_HI.Mode FaultManager.MAP_IR_HI.ID FaultManager.MAP_IR_HI.Test FaultManager.MAP_IR_HI.Faulty_Samples__X_ FaultManager.MAP_IR_HI.Total_Samples__Y_ FaultManager.MAP_IR_HI.Action_1 FaultManager.MAP_IR_HI.Action_1_Condition FaultManager.MAP_IR_HI.Action_2 FaultManager.MAP_IR_HI.Action_2_Condition FaultManager.MAP_IR_HI.Action_3 FaultManager.MAP_IR_HI.Action_3_Condition FaultManager.MAP_IR_HI.Action_4 FaultManager.MAP_IR_HI.Action_4_Condition FaultManager.MAP_IR_LO.Mode FaultManager.MAP_IR_LO.ID FaultManager.MAP_IR_LO.Test FaultManager.MAP_IR_LO.Faulty_Samples__X_ FaultManager.MAP_IR_LO.Total_Samples__Y_ FaultManager.MAP_IR_LO.Action_1 FaultManager.MAP_IR_LO.Action_1_Condition FaultManager.MAP_IR_LO.Action_2 FaultManager.MAP_IR_LO.Action_2_Condition FaultManager.MAP_IR_LO.Action_3 FaultManager.MAP_IR_LO.Action_3_Condition FaultManager.MAP_IR_LO.Action_4 FaultManager.MAP_IR_LO.Action_4_Condition FaultManager.MAP_STICKING.Mode FaultManager.MAP_STICKING.ID FaultManager.MAP_STICKING.Test FaultManager.MAP_STICKING.Faulty_Samples__X_ FaultManager.MAP_STICKING.Total_Samples__Y_ FaultManager.MAP_STICKING.Action_1 FaultManager.MAP_STICKING.Action_1_Condition FaultManager.MAP_STICKING.Action_2 FaultManager.MAP_STICKING.Action_2_Condition FaultManager.MAP_STICKING.Action_3 FaultManager.MAP_STICKING.Action_3_Condition FaultManager.MAP_STICKING.Action_4 FaultManager.MAP_STICKING.Action_4_Condition FaultManager.MediumOverspeed.Mode FaultManager.MediumOverspeed.ID FaultManager.MediumOverspeed.Test FaultManager.MediumOverspeed.Faulty_Samples__X_ FaultManager.MediumOverspeed.Total_Samples__Y_ FaultManager.MediumOverspeed.Action_1 FaultManager.MediumOverspeed.Action_1_Condition FaultManager.MediumOverspeed.Action_2 FaultManager.MediumOverspeed.Action_2_Condition FaultManager.MediumOverspeed.Action_3 FaultManager.MediumOverspeed.Action_3_Condition FaultManager.MediumOverspeed.Action_4 FaultManager.MediumOverspeed.Action_4_Condition FaultManager.NoOil_Fault.Mode FaultManager.NoOil_Fault.ID FaultManager.NoOil_Fault.Test FaultManager.NoOil_Fault.Faulty_Samples__X_ FaultManager.NoOil_Fault.Total_Samples__Y_ FaultManager.NoOil_Fault.Action_1 FaultManager.NoOil_Fault.Action_1_Condition FaultManager.NoOil_Fault.Action_2 FaultManager.NoOil_Fault.Action_2_Condition FaultManager.NoOil_Fault.Action_3 FaultManager.NoOil_Fault.Action_3_Condition FaultManager.NoOil_Fault.Action_4 FaultManager.NoOil_Fault.Action_4_Condition FaultManager.O2FailedLean.Mode FaultManager.O2FailedLean.ID FaultManager.O2FailedLean.Test FaultManager.O2FailedLean.Faulty_Samples__X_ FaultManager.O2FailedLean.Total_Samples__Y_ FaultManager.O2FailedLean.Action_1 FaultManager.O2FailedLean.Action_1_Condition FaultManager.O2FailedLean.Action_2 FaultManager.O2FailedLean.Action_2_Condition FaultManager.O2FailedLean.Action_3 FaultManager.O2FailedLean.Action_3_Condition FaultManager.O2FailedLean.Action_4 FaultManager.O2FailedLean.Action_4_Condition FaultManager.O2FailedRich.Mode FaultManager.O2FailedRich.ID FaultManager.O2FailedRich.Test FaultManager.O2FailedRich.Faulty_Samples__X_ FaultManager.O2FailedRich.Total_Samples__Y_ FaultManager.O2FailedRich.Action_1 FaultManager.O2FailedRich.Action_1_Condition FaultManager.O2FailedRich.Action_2 FaultManager.O2FailedRich.Action_2_Condition FaultManager.O2FailedRich.Action_3 FaultManager.O2FailedRich.Action_3_Condition FaultManager.O2FailedRich.Action_4 FaultManager.O2FailedRich.Action_4_Condition FaultManager.O2NotActive.Mode FaultManager.O2NotActive.ID FaultManager.O2NotActive.Test FaultManager.O2NotActive.Faulty_Samples__X_ FaultManager.O2NotActive.Total_Samples__Y_ FaultManager.O2NotActive.Action_1 FaultManager.O2NotActive.Action_1_Condition FaultManager.O2NotActive.Action_2 FaultManager.O2NotActive.Action_2_Condition FaultManager.O2NotActive.Action_3 FaultManager.O2NotActive.Action_3_Condition FaultManager.O2NotActive.Action_4 FaultManager.O2NotActive.Action_4_Condition FaultManager.OilPresRangeHigh.Mode FaultManager.OilPresRangeHigh.ID FaultManager.OilPresRangeHigh.Test FaultManager.OilPresRangeHigh.Faulty_Samples__X_ FaultManager.OilPresRangeHigh.Total_Samples__Y_ FaultManager.OilPresRangeHigh.Action_1 FaultManager.OilPresRangeHigh.Action_1_Condition FaultManager.OilPresRangeHigh.Action_2 FaultManager.OilPresRangeHigh.Action_2_Condition FaultManager.OilPresRangeHigh.Action_3 /end DEF_CHARACTERISTIC
/end FUNCTION
/end MODULE
/end PROJECT
