ASAP2_VERSION 1 51
/begin PROJECT Project ""
/begin MODULE BaseEngin_034 ""
/begin MOD_COMMON /* MOD_COMMON Comment */ "" BYTE_ORDER MSB_FIRST ALIGNMENT_BYTE 1 ALIGNMENT_FLOAT32_IEEE 1 ALIGNMENT_FLOAT64_IEEE 1 ALIGNMENT_LONG 1 ALIGNMENT_WORD 1 /end MOD_COMMON
/begin MEASUREMENT ACAirFlowOfst "AC air position in based on ECT." FLOAT32_IEEE CompuMethod_9 1 0 -1E+17 1E+17 ECU_ADDRESS 0x40000145 /end MEASUREMENT
/begin MEASUREMENT ACLowChrg "" UBYTE CompuMethod_12 1 0 0 1 ECU_ADDRESS 0x40000149 /end MEASUREMENT
/begin MEASUREMENT ACOutput "" UBYTE CompuMethod_12 1 0 0 1 ECU_ADDRESS 0x4000014A /end MEASUREMENT
/begin MEASUREMENT ACOverPressure "" UBYTE CompuMethod_12 1 0 0 1 ECU_ADDRESS 0x4000014B /end MEASUREMENT
/begin MEASUREMENT ACPres "Final value after Linear Sensor Characterization" FLOAT32_IEEE CompuMethod_13 1 0 -1E+17 1E+17 ECU_ADDRESS 0x4000014C /end MEASUREMENT
/begin MEASUREMENT ACPres05Idx "Index of AC system high side pressure" UWORD CompuMethod_15 1 0 0 127.998 ECU_ADDRESS 0x40000150 /end MEASUREMENT
/begin MEASUREMENT ACPres05In "Index of AC system high side pressure" FLOAT32_IEEE CompuMethod_16 1 0 -1E+17 1E+17 ECU_ADDRESS 0x40000152 /end MEASUREMENT
/begin MEASUREMENT ACPres07Idx "Index of AC system high side pressure" UWORD CompuMethod_15 1 0 0 127.998 ECU_ADDRESS 0x40000156 /end MEASUREMENT
/begin MEASUREMENT ACPres07In "Index of AC system high side pressure" FLOAT32_IEEE CompuMethod_16 1 0 -1E+17 1E+17 ECU_ADDRESS 0x40000158 /end MEASUREMENT
/begin MEASUREMENT ACPresADC "Singal measured directly from sensor" UWORD CompuMethod_17 1 0 0 65535 ECU_ADDRESS 0x4000015C /end MEASUREMENT
/begin MEASUREMENT ACPresFanSpeed "" FLOAT32_IEEE CompuMethod_2 1 0 -1E+17 1E+17 ECU_ADDRESS 0x4000015E /end MEASUREMENT
/begin MEASUREMENT ACPresFanSpeed_Stall "" FLOAT32_IEEE CompuMethod_2 1 0 -1E+17 1E+17 ECU_ADDRESS 0x40000162 /end MEASUREMENT
/begin MEASUREMENT ACPresRaw "After conversion to engineering units, before range checking" FLOAT32_IEEE CompuMethod_13 1 0 -1E+17 1E+17 ECU_ADDRESS 0x40000166 /end MEASUREMENT
/begin MEASUREMENT ACRpmHighEnbl "" UBYTE CompuMethod_12 1 0 0 1 ECU_ADDRESS 0x4000016A /end MEASUREMENT
/begin MEASUREMENT ACRpmLowEnbl "" UBYTE CompuMethod_12 1 0 0 1 ECU_ADDRESS 0x4000016B /end MEASUREMENT
/begin MEASUREMENT ACSw "Display output in engineering units" UBYTE CompuMethod_23 1 0 0 1 ECU_ADDRESS 0x4000016C /end MEASUREMENT
/begin MEASUREMENT ACSw_Raw "Display output in engineering units" FLOAT32_IEEE CompuMethod_21 1 0 -1E+17 1E+17 ECU_ADDRESS 0x4000016D /end MEASUREMENT
/begin MEASUREMENT ACTempEnbl "" UBYTE CompuMethod_12 1 0 0 1 ECU_ADDRESS 0x40000171 /end MEASUREMENT
/begin MEASUREMENT ACTpsEnble "" UBYTE CompuMethod_12 1 0 0 1 ECU_ADDRESS 0x40000172 /end MEASUREMENT
/begin MEASUREMENT AdjustedPerCylFuelRate "Desired fuel per cylinder after application of individual cylinder offsets and multipliers." FLOAT32_IEEE CompuMethod_27 1 0 -1E+17 1E+17 ECU_ADDRESS 0x40000173 MATRIX_DIM 8 1 1 /end MEASUREMENT
/begin MEASUREMENT AirflowMimatchThresh "" SBYTE CompuMethod_1 1 0 -128 127 ECU_ADDRESS 0x40000193 /end MEASUREMENT
/begin MEASUREMENT AirMinGovDGainErrorMult "" FLOAT32_IEEE CompuMethod_29 1 0 -1E+17 1E+17 ECU_ADDRESS 0x40000194 /end MEASUREMENT
/begin MEASUREMENT AirMinGovDTerm "Air min governor D term" FLOAT32_IEEE CompuMethod_2 1 0 -1E+17 1E+17 ECU_ADDRESS 0x40000198 /end MEASUREMENT
/begin MEASUREMENT AirMinGovError "Air min governor P term" FLOAT32_IEEE CompuMethod_2 1 0 -1E+17 1E+17 ECU_ADDRESS 0x4000019C /end MEASUREMENT
/begin MEASUREMENT AirMinGovIGainErrorMult "" FLOAT32_IEEE CompuMethod_29 1 0 -1E+17 1E+17 ECU_ADDRESS 0x400001A0 /end MEASUREMENT
/begin MEASUREMENT AirMinGovITerm "Air min governor I term" FLOAT32_IEEE CompuMethod_2 1 0 -1E+17 1E+17 ECU_ADDRESS 0x400001A4 /end MEASUREMENT
/begin MEASUREMENT AirMinGovOutput "Total output from min. gov. air PID controller." FLOAT32_IEEE CompuMethod_9 1 0 -1E+17 1E+17 ECU_ADDRESS 0x400001A8 /end MEASUREMENT
/begin MEASUREMENT AirMinGovPGainErrorMult "" FLOAT32_IEEE CompuMethod_29 1 0 -1E+17 1E+17 ECU_ADDRESS 0x400001AC /end MEASUREMENT
/begin MEASUREMENT AirMinGovPTerm "Air min governor P term" FLOAT32_IEEE CompuMethod_2 1 0 -1E+17 1E+17 ECU_ADDRESS 0x400001B0 /end MEASUREMENT
/begin MEASUREMENT AirMinGovSpeedErrorIdx "" UWORD CompuMethod_15 1 0 0 127.998 ECU_ADDRESS 0x400001B4 /end MEASUREMENT
/begin MEASUREMENT AirMinGovSpeedErrorIn "" FLOAT32_IEEE CompuMethod_2 1 0 -1E+17 1E+17 ECU_ADDRESS 0x400001B6 /end MEASUREMENT
/begin MEASUREMENT App05Idx "" UWORD CompuMethod_15 1 0 0 127.998 ECU_ADDRESS 0x400001BA /end MEASUREMENT
/begin MEASUREMENT App05In "" FLOAT32_IEEE CompuMethod_2 1 0 -1E+17 1E+17 ECU_ADDRESS 0x400001BC /end MEASUREMENT
/begin MEASUREMENT APP1 "Final value after Linear Sensor Characterization" FLOAT32_IEEE CompuMethod_9 1 0 -1E+17 1E+17 ECU_ADDRESS 0x400001C0 /end MEASUREMENT
/begin MEASUREMENT APP1_AdaptAdapt_Hi "" FLOAT32_IEEE CompuMethod_2 1 0 -1E+17 1E+17 ECU_ADDRESS 0x400001C4 /end MEASUREMENT
/begin MEASUREMENT APP1_AdaptAdapt_Low "" FLOAT32_IEEE CompuMethod_2 1 0 -1E+17 1E+17 ECU_ADDRESS 0x400001C8 /end MEASUREMENT
/begin MEASUREMENT APP1_AdaptADC "" FLOAT32_IEEE CompuMethod_2 1 0 -1E+17 1E+17 ECU_ADDRESS 0x400001CC /end MEASUREMENT
/begin MEASUREMENT APP1_AdaptPercent "" FLOAT32_IEEE CompuMethod_2 1 0 -1E+17 1E+17 ECU_ADDRESS 0x400001D0 /end MEASUREMENT
/begin MEASUREMENT APP1_AdaptPercentRaw "" FLOAT32_IEEE CompuMethod_2 1 0 -1E+17 1E+17 ECU_ADDRESS 0x400001D4 /end MEASUREMENT
/begin MEASUREMENT APP17Idx "Index of APP for driver demand" UWORD CompuMethod_15 1 0 0 127.998 ECU_ADDRESS 0x400001D8 /end MEASUREMENT
/begin MEASUREMENT APP17In "Index of APP for driver demand" FLOAT32_IEEE CompuMethod_9 1 0 -1E+17 1E+17 ECU_ADDRESS 0x400001DA /end MEASUREMENT
/begin MEASUREMENT APP1ADC "Signal measured directly from sensor" UWORD CompuMethod_17 1 0 0 65535 ECU_ADDRESS 0x400001DE /end MEASUREMENT
/begin MEASUREMENT APP1Idx "Look up table to allownon-linear characterization of sensors" UWORD CompuMethod_15 1 0 0 127.998 ECU_ADDRESS 0x400001E0 /end MEASUREMENT
/begin MEASUREMENT APP1Raw "After conversion to engineering units, before range checking" FLOAT32_IEEE CompuMethod_9 1 0 -1E+17 1E+17 ECU_ADDRESS 0x400001E2 /end MEASUREMENT
/begin MEASUREMENT APP2 "Final value after Linear Sensor Characterization" FLOAT32_IEEE CompuMethod_9 1 0 -1E+17 1E+17 ECU_ADDRESS 0x400001E6 /end MEASUREMENT
/begin MEASUREMENT APP2_AdaptAdapt_Hi "" FLOAT32_IEEE CompuMethod_2 1 0 -1E+17 1E+17 ECU_ADDRESS 0x400001EA /end MEASUREMENT
/begin MEASUREMENT APP2_AdaptAdapt_Low "" FLOAT32_IEEE CompuMethod_2 1 0 -1E+17 1E+17 ECU_ADDRESS 0x400001EE /end MEASUREMENT
/begin MEASUREMENT APP2_AdaptADC "" FLOAT32_IEEE CompuMethod_2 1 0 -1E+17 1E+17 ECU_ADDRESS 0x400001F2 /end MEASUREMENT
/begin MEASUREMENT APP2_AdaptPercent "" FLOAT32_IEEE CompuMethod_2 1 0 -1E+17 1E+17 ECU_ADDRESS 0x400001F6 /end MEASUREMENT
/begin MEASUREMENT APP2_AdaptPercentRaw "" FLOAT32_IEEE CompuMethod_2 1 0 -1E+17 1E+17 ECU_ADDRESS 0x400001FA /end MEASUREMENT
/begin MEASUREMENT APP2ADC "Signal measured directly from sensor" UWORD CompuMethod_17 1 0 0 65535 ECU_ADDRESS 0x400001FE /end MEASUREMENT
/begin MEASUREMENT APP2Idx "Look up table to allownon-linear characterization of sensors" UWORD CompuMethod_15 1 0 0 127.998 ECU_ADDRESS 0x40000200 /end MEASUREMENT
/begin MEASUREMENT APP2Raw "After conversion to engineering units, before range checking" FLOAT32_IEEE CompuMethod_9 1 0 -1E+17 1E+17 ECU_ADDRESS 0x40000202 /end MEASUREMENT
/begin MEASUREMENT ApplicationInitStatus "Shows how far the module initialization has progressed" UBYTE CompuMethod_33 1 0 3 5 ECU_ADDRESS 0x40000206 /end MEASUREMENT
/begin MEASUREMENT ApplicationInterruptTaskCPU "Percentage of CPU spent on ApplicationInterruptTask task" UWORD CompuMethod_34 1 0 0 100 ECU_ADDRESS 0x40000207 /end MEASUREMENT
/begin MEASUREMENT ApplicationInterruptTaskStackMinBytesFree "Remaining bytes available on the ApplicationInterruptTask stack" UWORD CompuMethod_36 1 0 0 65535 ECU_ADDRESS 0x40000209 /end MEASUREMENT
/begin MEASUREMENT ApplicationStopReason "Indicates the reason for an application stop" UWORD CompuMethod_39 1 0 0 5 ECU_ADDRESS 0x4000020B /end MEASUREMENT
/begin MEASUREMENT ApplicationStopReasonAppLink "Indicates the reason for a notification-driven application stop" UWORD CompuMethod_40 1 0 0 65535 ECU_ADDRESS 0x4000020D /end MEASUREMENT
/begin MEASUREMENT APPPcnt "APP used in controller (after power curve and CutThrottle limiting" FLOAT32_IEEE CompuMethod_9 1 0 -1E+17 1E+17 ECU_ADDRESS 0x4000020F /end MEASUREMENT
/begin MEASUREMENT Bank1_DataValidState_Prb "" UBYTE CompuMethod_12 1 0 0 1 ECU_ADDRESS 0x40000213 /end MEASUREMENT
/begin MEASUREMENT Bank1_EquivRatio "Final value after Linear Sensor Characterization" FLOAT32_IEEE CompuMethod_41 1 0 -1E+17 1E+17 ECU_ADDRESS 0x40000214 /end MEASUREMENT
/begin MEASUREMENT Bank1_EquivRatioADC "Singal measured directly from sensor" FLOAT32_IEEE CompuMethod_41 1 0 -1E+17 1E+17 ECU_ADDRESS 0x40000218 /end MEASUREMENT
/begin MEASUREMENT Bank1_EquivRatioRaw "After conversion to engineering units, before range checking" FLOAT32_IEEE CompuMethod_41 1 0 -1E+17 1E+17 ECU_ADDRESS 0x4000021C /end MEASUREMENT
/begin MEASUREMENT Bank1_HeaterVolts_Prb "" FLOAT32_IEEE CompuMethod_2 1 0 -1E+17 1E+17 ECU_ADDRESS 0x40000220 /end MEASUREMENT
/begin MEASUREMENT Bank1_Lambda_Prb "" FLOAT32_IEEE CompuMethod_2 1 0 -1E+17 1E+17 ECU_ADDRESS 0x40000224 /end MEASUREMENT
/begin MEASUREMENT Bank1_OxygenConcentration_Prb "" FLOAT32_IEEE CompuMethod_2 1 0 -1E+17 1E+17 ECU_ADDRESS 0x40000228 /end MEASUREMENT
/begin MEASUREMENT Bank1_SensorDetectedStatus_Prb "" UBYTE CompuMethod_12 1 0 0 1 ECU_ADDRESS 0x4000022C /end MEASUREMENT
/begin MEASUREMENT Bank1_SensorFaultState_Prb "" UBYTE CompuMethod_12 1 0 0 1 ECU_ADDRESS 0x4000022D /end MEASUREMENT
/begin MEASUREMENT Bank1_SensorStatus_Prb "" UBYTE CompuMethod_43 1 0 0 255 ECU_ADDRESS 0x4000022E /end MEASUREMENT
/begin MEASUREMENT Bank1_SystemVolts_Prb "" FLOAT32_IEEE CompuMethod_2 1 0 -1E+17 1E+17 ECU_ADDRESS 0x4000022F /end MEASUREMENT
/begin MEASUREMENT Bank1_UsingFreeAreCalState_Prb "" UBYTE CompuMethod_12 1 0 0 1 ECU_ADDRESS 0x40000233 /end MEASUREMENT
/begin MEASUREMENT Bank2_DataValidState_Prb "" UBYTE CompuMethod_12 1 0 0 1 ECU_ADDRESS 0x40000234 /end MEASUREMENT
/begin MEASUREMENT Bank2_EquivRatio "Final value after Linear Sensor Characterization" FLOAT32_IEEE CompuMethod_41 1 0 -1E+17 1E+17 ECU_ADDRESS 0x40000235 /end MEASUREMENT
/begin MEASUREMENT Bank2_EquivRatioADC "Singal measured directly from sensor" FLOAT32_IEEE CompuMethod_41 1 0 -1E+17 1E+17 ECU_ADDRESS 0x40000239 /end MEASUREMENT
/begin MEASUREMENT Bank2_EquivRatioRaw "After conversion to engineering units, before range checking" FLOAT32_IEEE CompuMethod_41 1 0 -1E+17 1E+17 ECU_ADDRESS 0x4000023D /end MEASUREMENT
/begin MEASUREMENT Bank2_HeaterVolts_Prb "" FLOAT32_IEEE CompuMethod_2 1 0 -1E+17 1E+17 ECU_ADDRESS 0x40000241 /end MEASUREMENT
/begin MEASUREMENT Bank2_Lambda_Prb "" FLOAT32_IEEE CompuMethod_2 1 0 -1E+17 1E+17 ECU_ADDRESS 0x40000245 /end MEASUREMENT
/begin MEASUREMENT Bank2_OxygenConcentration_Prb "" FLOAT32_IEEE CompuMethod_2 1 0 -1E+17 1E+17 ECU_ADDRESS 0x40000249 /end MEASUREMENT
/begin MEASUREMENT Bank2_SensorDetectedStatus_Prb "" UBYTE CompuMethod_12 1 0 0 1 ECU_ADDRESS 0x4000024D /end MEASUREMENT
/begin MEASUREMENT Bank2_SensorFaultState_Prb "" UBYTE CompuMethod_12 1 0 0 1 ECU_ADDRESS 0x4000024E /end MEASUREMENT
/begin MEASUREMENT Bank2_SensorStatus_Prb "" UBYTE CompuMethod_43 1 0 0 255 ECU_ADDRESS 0x4000024F /end MEASUREMENT
/begin MEASUREMENT Bank2_SystemVolts_Prb "" FLOAT32_IEEE CompuMethod_2 1 0 -1E+17 1E+17 ECU_ADDRESS 0x40000250 /end MEASUREMENT
/begin MEASUREMENT Bank2_UsingFreeAreCalState_Prb "" UBYTE CompuMethod_12 1 0 0 1 ECU_ADDRESS 0x40000254 /end MEASUREMENT
/begin MEASUREMENT BARO "" FLOAT32_IEEE CompuMethod_16 1 0 -1E+17 1E+17 ECU_ADDRESS 0x40000255 /end MEASUREMENT
/begin MEASUREMENT BARO09Idx "" UWORD CompuMethod_15 1 0 0 127.998 ECU_ADDRESS 0x40000259 /end MEASUREMENT
/begin MEASUREMENT BaroDelayTime "" FLOAT32_IEEE CompuMethod_45 1 0 -1E+17 1E+17 ECU_ADDRESS 0x4000025B /end MEASUREMENT
/begin MEASUREMENT BaseAirflowAdaptEnabled "" UBYTE CompuMethod_46 1 0 0 1 ECU_ADDRESS 0x4000025F /end MEASUREMENT
/begin MEASUREMENT BaseAirflowOfst "Base air position in based on ECT." FLOAT32_IEEE CompuMethod_9 1 0 -1E+17 1E+17 ECU_ADDRESS 0x40000260 /end MEASUREMENT
/begin MEASUREMENT BaseAirOffset "Base air request position, includes ramp into idle manager." FLOAT32_IEEE CompuMethod_49 1 0 -1E+17 1E+17 ECU_ADDRESS 0x40000264 /end MEASUREMENT
/begin MEASUREMENT BaseEquivRatio "Base equivalence ratio for selected fuel system." FLOAT32_IEEE CompuMethod_2 1 0 -1E+17 1E+17 ECU_ADDRESS 0x40000268 /end MEASUREMENT
/begin MEASUREMENT BaseSparkEnergy "Spark energy - Run state" FLOAT32_IEEE CompuMethod_50 1 0 -1E+17 1E+17 ECU_ADDRESS 0x4000026C /end MEASUREMENT
/begin MEASUREMENT BGNDTaskCPU "Percentage of CPU spent on BGNDTask task" UWORD CompuMethod_34 1 0 0 100 ECU_ADDRESS 0x40000270 /end MEASUREMENT
/begin MEASUREMENT BGNDTaskStackMinBytesFree "Remaining bytes available on the BGNDTask stack" UWORD CompuMethod_36 1 0 0 65535 ECU_ADDRESS 0x40000272 /end MEASUREMENT
/begin MEASUREMENT BoostControlAdaptEnabled "" UBYTE CompuMethod_46 1 0 0 1 ECU_ADDRESS 0x40000274 /end MEASUREMENT
/begin MEASUREMENT BoostControlBase "Base boost duty cycle table for feed forward" UBYTE CompuMethod_52 1 0 0 255 ECU_ADDRESS 0x40000275 /end MEASUREMENT
/begin MEASUREMENT BoostControlBase_Adapt "Base boost duty cycle table for feed forward" FLOAT32_IEEE CompuMethod_53 1 0 -1E+17 1E+17 ECU_ADDRESS 0x40000276 /end MEASUREMENT
/begin MEASUREMENT BoostControlDutyCycleFF "" UBYTE CompuMethod_1 1 0 0 255 ECU_ADDRESS 0x4000027A /end MEASUREMENT
/begin MEASUREMENT BoostControlDutyCycleOut "Boost controller final duty cycle out" FLOAT32_IEEE CompuMethod_53 1 0 -1E+17 1E+17 ECU_ADDRESS 0x4000027B /end MEASUREMENT
/begin MEASUREMENT BoostControlPID "Boost controller PID output" FLOAT32_IEEE CompuMethod_53 1 0 -1E+17 1E+17 ECU_ADDRESS 0x4000027F /end MEASUREMENT
/begin MEASUREMENT BoostControlPID_ITerm "Boost controller PID I term" FLOAT32_IEEE CompuMethod_2 1 0 -1E+17 1E+17 ECU_ADDRESS 0x40000283 /end MEASUREMENT
/begin MEASUREMENT BoostControlTarget "Final boost target" FLOAT32_IEEE CompuMethod_51 1 0 -1E+17 1E+17 ECU_ADDRESS 0x40000287 /end MEASUREMENT
/begin MEASUREMENT BoostCtlDGainErrorMult "" FLOAT32_IEEE CompuMethod_29 1 0 -1E+17 1E+17 ECU_ADDRESS 0x4000028B /end MEASUREMENT
/begin MEASUREMENT BoostCtlDTerm "Air min governor D term" FLOAT32_IEEE CompuMethod_2 1 0 -1E+17 1E+17 ECU_ADDRESS 0x4000028F /end MEASUREMENT
/begin MEASUREMENT BoostCtlError "Air min governor P term" FLOAT32_IEEE CompuMethod_2 1 0 -1E+17 1E+17 ECU_ADDRESS 0x40000293 /end MEASUREMENT
/begin MEASUREMENT BoostCtlIGainErrorMult "" FLOAT32_IEEE CompuMethod_29 1 0 -1E+17 1E+17 ECU_ADDRESS 0x40000297 /end MEASUREMENT
/begin MEASUREMENT BoostCtlITerm "Air min governor I term" FLOAT32_IEEE CompuMethod_2 1 0 -1E+17 1E+17 ECU_ADDRESS 0x4000029B /end MEASUREMENT
/begin MEASUREMENT BoostCtlPGainErrorMult "" FLOAT32_IEEE CompuMethod_29 1 0 -1E+17 1E+17 ECU_ADDRESS 0x4000029F /end MEASUREMENT
/begin MEASUREMENT BoostCtlPTerm "Air min governor P term" FLOAT32_IEEE CompuMethod_2 1 0 -1E+17 1E+17 ECU_ADDRESS 0x400002A3 /end MEASUREMENT
/begin MEASUREMENT BoostCtlSpeedErrorIdx "" UWORD CompuMethod_15 1 0 0 127.998 ECU_ADDRESS 0x400002A7 /end MEASUREMENT
/begin MEASUREMENT BoostCtlSpeedErrorIn "" FLOAT32_IEEE CompuMethod_2 1 0 -1E+17 1E+17 ECU_ADDRESS 0x400002A9 /end MEASUREMENT
/begin MEASUREMENT BoostECTLimit "Boost limit as a function of ECT" SBYTE CompuMethod_54 1 0 -128 127 ECU_ADDRESS 0x400002AD /end MEASUREMENT
/begin MEASUREMENT BoostIATLimit "Boost limit as a function of IAT" SBYTE CompuMethod_54 1 0 -128 127 ECU_ADDRESS 0x400002AE /end MEASUREMENT
/begin MEASUREMENT BoostTarget "Target boost as a function of RPM and VSPD" SBYTE CompuMethod_54 1 0 -128 127 ECU_ADDRESS 0x400002AF /end MEASUREMENT
/begin MEASUREMENT BoostTargetIdx "" UWORD CompuMethod_15 1 0 0 127.998 ECU_ADDRESS 0x400002B0 /end MEASUREMENT
/begin MEASUREMENT BoostTargetIn "" FLOAT32_IEEE CompuMethod_2 1 0 -1E+17 1E+17 ECU_ADDRESS 0x400002B2 /end MEASUREMENT
/begin MEASUREMENT CAT "Final value after Linear Sensor Characterization" FLOAT32_IEEE CompuMethod_59 1 0 -1E+17 1E+17 ECU_ADDRESS 0x400002B7 /end MEASUREMENT
/begin MEASUREMENT CAT_SpkOfst "CAT spark offset" FLOAT32_IEEE CompuMethod_2 1 0 -1E+17 1E+17 ECU_ADDRESS 0x400002BB /end MEASUREMENT
/begin MEASUREMENT CAT_SpkOfstMult "Multiplier on IAT2 spark offset table." FLOAT32_IEEE CompuMethod_29 1 0 -1E+17 1E+17 ECU_ADDRESS 0x400002BF /end MEASUREMENT
/begin MEASUREMENT CAT05Idx "Index of charge air temperature" UWORD CompuMethod_15 1 0 0 127.998 ECU_ADDRESS 0x400002C3 /end MEASUREMENT
/begin MEASUREMENT CAT05In "Index of charge air temperature" FLOAT32_IEEE CompuMethod_60 1 0 -1E+17 1E+17 ECU_ADDRESS 0x400002C5 /end MEASUREMENT
/begin MEASUREMENT CATADC "Signal measured directly from sensor" UWORD CompuMethod_17 1 0 0 65535 ECU_ADDRESS 0x400002C9 /end MEASUREMENT
/begin MEASUREMENT CATIdx "Look up table to allownon-linear characterization of sensors" UWORD CompuMethod_15 1 0 0 127.998 ECU_ADDRESS 0x400002CB /end MEASUREMENT
/begin MEASUREMENT CATRaw "After conversion to engineering units, before range checking" FLOAT32_IEEE CompuMethod_59 1 0 -1E+17 1E+17 ECU_ADDRESS 0x400002CD /end MEASUREMENT
/begin MEASUREMENT CCP_CCP1_Access.CCP_CCP1_CAL "Calibration Authentication Status for CCP Handler CCP1" UBYTE CompuMethod_61 1 0 0 1 ECU_ADDRESS 0x400002D1 BIT_MASK 0x00000001 /end MEASUREMENT
/begin MEASUREMENT CCP_CCP1_Access.CCP_CCP1_DAQ "Data Acquisition Authentication Status for CCP Handler CCP1" UBYTE CompuMethod_62 1 0 0 1 ECU_ADDRESS 0x400002D1 BIT_MASK 0x00000002 /end MEASUREMENT
/begin MEASUREMENT CCP_CCP1_Access.CCP_CCP1_PGM "Programming Authentication Status for CCP Handler CCP1" UBYTE CompuMethod_63 1 0 0 1 ECU_ADDRESS 0x400002D1 BIT_MASK 0x00000040 /end MEASUREMENT
/begin MEASUREMENT CCP_CCP1_Access "Current Access Code for CCP Handler CCP1" UBYTE CompuMethod_2 1 0 0 255 ECU_ADDRESS 0x400002D1 /end MEASUREMENT
/begin MEASUREMENT CCP_CCP1_ConnectionStatus "CCP Handler CCP1 connection status" UBYTE CompuMethod_64 1 0 0 255 ECU_ADDRESS 0x400002D2 /end MEASUREMENT
/begin MEASUREMENT ChargeAirTempEnrichment "Requsted base eq. ratio as a function of CAT and MAP" FLOAT32_IEEE CompuMethod_66 1 0 -1E+17 1E+17 ECU_ADDRESS 0x400002D3 /end MEASUREMENT
/begin MEASUREMENT ClutchSw "Display output in engineering units" UBYTE CompuMethod_23 1 0 0 1 ECU_ADDRESS 0x400002D7 /end MEASUREMENT
/begin MEASUREMENT ClutchSw_Raw "Display output in engineering units" FLOAT32_IEEE CompuMethod_21 1 0 -1E+17 1E+17 ECU_ADDRESS 0x400002D8 /end MEASUREMENT
/begin MEASUREMENT CoilDwell "Required spark dwell to give the desired spark energy." FLOAT32_IEEE CompuMethod_69 1 0 -1E+17 1E+17 ECU_ADDRESS 0x400002DC /end MEASUREMENT
/begin MEASUREMENT CoilEnabled "Enable sate for coils." UBYTE CompuMethod_6 1 0 0 1 ECU_ADDRESS 0x400002E0 MATRIX_DIM 8 1 1 /end MEASUREMENT
/begin MEASUREMENT CoilStartAngle "StartAngle for coils to establish dwell." FLOAT32_IEEE CompuMethod_70 1 0 -1E+17 1E+17 ECU_ADDRESS 0x400002E8 /end MEASUREMENT
/begin MEASUREMENT CoilStopAngle "Stop angle for coils to establish dwell." FLOAT32_IEEE CompuMethod_70 1 0 -1E+17 1E+17 ECU_ADDRESS 0x400002EC /end MEASUREMENT
/begin MEASUREMENT CPUIdlePcnt "Percentage of CPU spent executing idle activity" UWORD CompuMethod_34 1 0 0 100 ECU_ADDRESS 0x40000340 /end MEASUREMENT
/begin MEASUREMENT CrankAirflowSetPt "ETC setpoint during cranking." FLOAT32_IEEE CompuMethod_9 1 0 -1E+17 1E+17 ECU_ADDRESS 0x40000342 /end MEASUREMENT
/begin MEASUREMENT CrankECT05Idx "ECT pre-lookup for crank maps." UWORD CompuMethod_15 1 0 0 127.998 ECU_ADDRESS 0x40000346 /end MEASUREMENT
/begin MEASUREMENT CrankFPC "Liquid fuel supplied during crank." FLOAT32_IEEE CompuMethod_71 1 0 -1E+17 1E+17 ECU_ADDRESS 0x40000348 /end MEASUREMENT
/begin MEASUREMENT CrankFPC_IATMult "Crank fuel IAT ultiplier" FLOAT32_IEEE CompuMethod_2 1 0 -1E+17 1E+17 ECU_ADDRESS 0x4000034C /end MEASUREMENT
/begin MEASUREMENT CrankFPC_OXYMult "Crank fuel oxygentation multiplier" FLOAT32_IEEE CompuMethod_2 1 0 -1E+17 1E+17 ECU_ADDRESS 0x40000350 /end MEASUREMENT
/begin MEASUREMENT CrankIAC "Base IAC % While Cranking" FLOAT32_IEEE CompuMethod_9 1 0 -1E+17 1E+17 ECU_ADDRESS 0x40000354 /end MEASUREMENT
/begin MEASUREMENT CrankIAC_IATMult "" FLOAT32_IEEE CompuMethod_2 1 0 -1E+17 1E+17 ECU_ADDRESS 0x40000358 /end MEASUREMENT
/begin MEASUREMENT CrankIAC_OXYMult "" FLOAT32_IEEE CompuMethod_2 1 0 -1E+17 1E+17 ECU_ADDRESS 0x4000035C /end MEASUREMENT
/begin MEASUREMENT CrankIAT05Idx "IAT pre-lookup for crank maps." UWORD CompuMethod_15 1 0 0 127.998 ECU_ADDRESS 0x40000360 /end MEASUREMENT
/begin MEASUREMENT CrankMakeUpEOI "Start of injection during cranking." FLOAT32_IEEE CompuMethod_70 1 0 -1E+17 1E+17 ECU_ADDRESS 0x40000362 /end MEASUREMENT
/begin MEASUREMENT CrankOXY05Idx "OXY pre-lookup for crank maps." UWORD CompuMethod_15 1 0 0 127.998 ECU_ADDRESS 0x40000366 /end MEASUREMENT
/begin MEASUREMENT CrankOXY05In "OXY pre-lookup for crank maps." FLOAT32_IEEE CompuMethod_9 1 0 -1E+17 1E+17 ECU_ADDRESS 0x40000368 /end MEASUREMENT
/begin MEASUREMENT CrankRPM05Idx "RPM pre-lookup for crank maps" UWORD CompuMethod_15 1 0 0 127.998 ECU_ADDRESS 0x4000036C /end MEASUREMENT
/begin MEASUREMENT CrankRPM05In "RPM pre-lookup for crank maps" FLOAT32_IEEE CompuMethod_72 1 0 -1E+17 1E+17 ECU_ADDRESS 0x4000036E /end MEASUREMENT
/begin MEASUREMENT CrankSOI "Start of injection during cranking." FLOAT32_IEEE CompuMethod_70 1 0 -1E+17 1E+17 ECU_ADDRESS 0x40000372 /end MEASUREMENT
/begin MEASUREMENT CrankSpark "Spark adv during cranking." FLOAT32_IEEE CompuMethod_70 1 0 -1E+17 1E+17 ECU_ADDRESS 0x40000376 /end MEASUREMENT
/begin MEASUREMENT CrankSpkEnergy "Spark energy during cranking." FLOAT32_IEEE CompuMethod_73 1 0 -1E+17 1E+17 ECU_ADDRESS 0x4000037A /end MEASUREMENT
/begin MEASUREMENT CrankTDCs "" UBYTE CompuMethod_1 1 0 0 255 ECU_ADDRESS 0x4000037E /end MEASUREMENT
/begin MEASUREMENT CrankTrans "" UBYTE CompuMethod_12 1 0 0 1 ECU_ADDRESS 0x4000037F /end MEASUREMENT
/begin MEASUREMENT DeltaMAP "" FLOAT32_IEEE CompuMethod_2 1 0 -1E+17 1E+17 ECU_ADDRESS 0x40000380 /end MEASUREMENT
/begin MEASUREMENT DeltaMAP_Mult "Transient Fueling Multiplier for adjustment based on delta MAP" FLOAT32_IEEE CompuMethod_29 1 0 -1E+17 1E+17 ECU_ADDRESS 0x40000384 /end MEASUREMENT
/begin MEASUREMENT DeltaMAP17Idx "" UWORD CompuMethod_15 1 0 0 127.998 ECU_ADDRESS 0x40000388 /end MEASUREMENT
/begin MEASUREMENT DeltaMAP17In "" FLOAT32_IEEE CompuMethod_2 1 0 -1E+17 1E+17 ECU_ADDRESS 0x4000038A /end MEASUREMENT
/begin MEASUREMENT DeltaTPS "" FLOAT32_IEEE CompuMethod_2 1 0 -1E+17 1E+17 ECU_ADDRESS 0x4000038E /end MEASUREMENT
/begin MEASUREMENT DeltaTPS_Mult "Transient Fueling Multiplier for adjustment based on delta TPS" FLOAT32_IEEE CompuMethod_29 1 0 -1E+17 1E+17 ECU_ADDRESS 0x40000392 /end MEASUREMENT
/begin MEASUREMENT DeltaTPS17Idx "" UWORD CompuMethod_15 1 0 0 127.998 ECU_ADDRESS 0x40000396 /end MEASUREMENT
/begin MEASUREMENT DeltaTPS17In "" FLOAT32_IEEE CompuMethod_2 1 0 -1E+17 1E+17 ECU_ADDRESS 0x40000398 /end MEASUREMENT
/begin MEASUREMENT DesAFRatio "" FLOAT32_IEEE CompuMethod_75 1 0 -1E+17 1E+17 ECU_ADDRESS 0x4000039C /end MEASUREMENT
/begin MEASUREMENT DesAFRatioIdx "" UWORD CompuMethod_15 1 0 0 127.998 ECU_ADDRESS 0x400003A0 /end MEASUREMENT
/begin MEASUREMENT DesAFRatioIn "" FLOAT32_IEEE CompuMethod_76 1 0 -1E+17 1E+17 ECU_ADDRESS 0x400003A2 /end MEASUREMENT
/begin MEASUREMENT DesEqRatio09Idx "Desired Equivalence Ratio breakpoints" UWORD CompuMethod_15 1 0 0 127.998 ECU_ADDRESS 0x400003A6 /end MEASUREMENT
/begin MEASUREMENT DesEqRatio09In "Desired Equivalence Ratio breakpoints" FLOAT32_IEEE CompuMethod_77 1 0 -1E+17 1E+17 ECU_ADDRESS 0x400003A8 /end MEASUREMENT
/begin MEASUREMENT DesEquivInRange "" UBYTE CompuMethod_10 1 0 0 1 ECU_ADDRESS 0x400003AC /end MEASUREMENT
/begin MEASUREMENT DesEquivRatio "Desired liquid equivalence ratio." FLOAT32_IEEE CompuMethod_2 1 0 -1E+17 1E+17 ECU_ADDRESS 0x400003AD /end MEASUREMENT
/begin MEASUREMENT Desired_AF_Ratio "Desired Air to Fuel Ratio based on Ethanol Percentage" FLOAT32_IEEE CompuMethod_78 1 0 -1E+17 1E+17 ECU_ADDRESS 0x400003B1 /end MEASUREMENT
/begin MEASUREMENT DFCOActive "DFCO state" UBYTE CompuMethod_12 1 0 0 1 ECU_ADDRESS 0x400003B5 /end MEASUREMENT
/begin MEASUREMENT DFCODesEquivRatio "DFCO commanded equiv ratio" FLOAT32_IEEE CompuMethod_2 1 0 -1E+17 1E+17 ECU_ADDRESS 0x400003B6 /end MEASUREMENT
/begin MEASUREMENT DFCODesSparkOutOfst "DFCO spark output" FLOAT32_IEEE CompuMethod_70 1 0 -1E+17 1E+17 ECU_ADDRESS 0x400003BA /end MEASUREMENT
/begin MEASUREMENT DFCOEnterCond "Conditions are correct for DFCO" UBYTE CompuMethod_12 1 0 0 1 ECU_ADDRESS 0x400003BE /end MEASUREMENT
/begin MEASUREMENT DFCOEntryRPM "" FLOAT32_IEEE CompuMethod_2 1 0 -1E+17 1E+17 ECU_ADDRESS 0x400003BF /end MEASUREMENT
/begin MEASUREMENT DFCOExitRPM "" FLOAT32_IEEE CompuMethod_2 1 0 -1E+17 1E+17 ECU_ADDRESS 0x400003C3 /end MEASUREMENT
/begin MEASUREMENT ECT "Final value after Linear Sensor Characterization" FLOAT32_IEEE CompuMethod_59 1 0 -1E+17 1E+17 ECU_ADDRESS 0x400003C7 /end MEASUREMENT
/begin MEASUREMENT ECT_KeyUp "" FLOAT32_IEEE CompuMethod_59 1 0 -1E+17 1E+17 ECU_ADDRESS 0x400003CB /end MEASUREMENT
/begin MEASUREMENT ECT_KeyUp09Idx "Index of ECT captured at key-up." UWORD CompuMethod_15 1 0 0 127.998 ECU_ADDRESS 0x400003CF /end MEASUREMENT
/begin MEASUREMENT ECT_KeyUp09In "Index of ECT captured at key-up." FLOAT32_IEEE CompuMethod_60 1 0 -1E+17 1E+17 ECU_ADDRESS 0x400003D1 /end MEASUREMENT
/begin MEASUREMENT ECT_SpkOfst "ECT spark offset" FLOAT32_IEEE CompuMethod_70 1 0 -1E+17 1E+17 ECU_ADDRESS 0x400003D5 /end MEASUREMENT
/begin MEASUREMENT ECT_SpkOfstMult "Multiplier on ECT spark offset table." FLOAT32_IEEE CompuMethod_2 1 0 -1E+17 1E+17 ECU_ADDRESS 0x400003D9 /end MEASUREMENT
/begin MEASUREMENT ECT05Idx "Idex of ECT" UWORD CompuMethod_15 1 0 0 127.998 ECU_ADDRESS 0x400003DD /end MEASUREMENT
/begin MEASUREMENT ECT05In "Idex of ECT" FLOAT32_IEEE CompuMethod_60 1 0 -1E+17 1E+17 ECU_ADDRESS 0x400003DF /end MEASUREMENT
/begin MEASUREMENT ECT07Idx "Index of ECT" UWORD CompuMethod_15 1 0 0 127.998 ECU_ADDRESS 0x400003E3 /end MEASUREMENT
/begin MEASUREMENT ECT07In "Index of ECT" FLOAT32_IEEE CompuMethod_60 1 0 -1E+17 1E+17 ECU_ADDRESS 0x400003E5 /end MEASUREMENT
/begin MEASUREMENT ECT09Idx "Index of ECT" UWORD CompuMethod_15 1 0 0 127.998 ECU_ADDRESS 0x400003E9 /end MEASUREMENT
/begin MEASUREMENT ECT09In "Index of ECT" FLOAT32_IEEE CompuMethod_60 1 0 -1E+17 1E+17 ECU_ADDRESS 0x400003EB /end MEASUREMENT
/begin MEASUREMENT ECTADC "Signal measured directly from sensor" UWORD CompuMethod_17 1 0 0 65535 ECU_ADDRESS 0x400003EF /end MEASUREMENT
/begin MEASUREMENT ECTFanSpeed "" FLOAT32_IEEE CompuMethod_2 1 0 -1E+17 1E+17 ECU_ADDRESS 0x400003F1 /end MEASUREMENT
/begin MEASUREMENT ECTFanSpeed_Stall "" FLOAT32_IEEE CompuMethod_2 1 0 -1E+17 1E+17 ECU_ADDRESS 0x400003F5 /end MEASUREMENT
/begin MEASUREMENT ECTIdx "Look up table to allownon-linear characterization of sensors" UWORD CompuMethod_15 1 0 0 127.998 ECU_ADDRESS 0x400003F9 /end MEASUREMENT
/begin MEASUREMENT ECTRaw "After conversion to engineering units, before range checking" FLOAT32_IEEE CompuMethod_59 1 0 -1E+17 1E+17 ECU_ADDRESS 0x400003FB /end MEASUREMENT
/begin MEASUREMENT ECTTransFuelMult "Transient fuel multiplier based on ECT.  Only engaged during transient fueling" FLOAT32_IEEE CompuMethod_2 1 0 -1E+17 1E+17 ECU_ADDRESS 0x400003FF /end MEASUREMENT
/begin MEASUREMENT ECUP_Enabled "" UBYTE CompuMethod_10 1 0 0 1 ECU_ADDRESS 0x40000403 /end MEASUREMENT
/begin MEASUREMENT EncoderFault "" UBYTE CompuMethod_83 1 0 0 255 ECU_ADDRESS 0x40000404 /end MEASUREMENT
/begin MEASUREMENT EncoderFaultCount "" ULONG CompuMethod_65 1 0 0 4294970000 ECU_ADDRESS 0x40000405 /end MEASUREMENT
/begin MEASUREMENT EncoderState "" UBYTE CompuMethod_84 1 0 0 255 ECU_ADDRESS 0x40000409 /end MEASUREMENT
/begin MEASUREMENT EncoderTDCOrder "Order of TDC angles (0 means unused)" SBYTE CompuMethod_86 1 0 -1 127 ECU_ADDRESS 0x4000040A MATRIX_DIM 8 1 1 /end MEASUREMENT
/begin MEASUREMENT EngineAccel "Acceleration rate of engine" FLOAT32_IEEE CompuMethod_87 1 0 -1E+17 1E+17 ECU_ADDRESS 0x40000412 /end MEASUREMENT
/begin MEASUREMENT EngineStateRaw "" UBYTE CompuMethod_1 1 0 0 255 ECU_ADDRESS 0x40000416 /end MEASUREMENT
/begin MEASUREMENT EnginSteadyState "" UBYTE CompuMethod_10 1 0 0 1 ECU_ADDRESS 0x40000417 /end MEASUREMENT
/begin MEASUREMENT EqRatio_SpkOfsMult "Speed and Load Multiplier to the Equivalence Ratio Spark Offset table." FLOAT32_IEEE CompuMethod_29 1 0 -1E+17 1E+17 ECU_ADDRESS 0x40000418 /end MEASUREMENT
/begin MEASUREMENT EqRatio_SpkOfst "Spark offset based on desired equivalence ratio (also muliplied by a speed load factor)" FLOAT32_IEEE CompuMethod_88 1 0 -1E+17 1E+17 ECU_ADDRESS 0x4000041C /end MEASUREMENT
/begin MEASUREMENT EST_DiagDwell "Dwell time used to diagnose ESTs during run-state." UWORD CompuMethod_90 1 0 0 65535 ECU_ADDRESS 0x40000420 MATRIX_DIM 8 1 1 /end MEASUREMENT
/begin MEASUREMENT EST_TDCEnabled "" SBYTE CompuMethod_91 1 0 -128 127 ECU_ADDRESS 0x40000430 /end MEASUREMENT
/begin MEASUREMENT ESTOP "Display output in engineering units" UBYTE CompuMethod_23 1 0 0 1 ECU_ADDRESS 0x40000431 /end MEASUREMENT
/begin MEASUREMENT ESTOP_Raw "Display output in engineering units" UBYTE CompuMethod_23 1 0 0 1 ECU_ADDRESS 0x40000432 /end MEASUREMENT
/begin MEASUREMENT ESTOpenADC "ADC counts of measured voltage feedback for diagnosing the ESTs during stall state." UWORD CompuMethod_5 1 0 0 65535 ECU_ADDRESS 0x40000433 MATRIX_DIM 8 1 1 /end MEASUREMENT
/begin MEASUREMENT ETB_Curr_Flt "" UBYTE CompuMethod_12 1 0 0 1 ECU_ADDRESS 0x40000443 /end MEASUREMENT
/begin MEASUREMENT ETC_Current "Current output of ETC duty cycle." SWORD CompuMethod_92 1 0 -32768 32767 ECU_ADDRESS 0x40000444 /end MEASUREMENT
/begin MEASUREMENT ETC_DutyCycle "Actual duty cycle of actuator" FLOAT32_IEEE CompuMethod_9 1 0 -1E+17 1E+17 ECU_ADDRESS 0x40000446 /end MEASUREMENT
/begin MEASUREMENT ETC_ECUPState "" UBYTE CompuMethod_12 1 0 0 1 ECU_ADDRESS 0x4000044A /end MEASUREMENT
/begin MEASUREMENT ETC_ErrorIdx "" UWORD CompuMethod_15 1 0 0 127.998 ECU_ADDRESS 0x4000044B /end MEASUREMENT
/begin MEASUREMENT ETC_ErrorIn "" FLOAT32_IEEE CompuMethod_2 1 0 -1E+17 1E+17 ECU_ADDRESS 0x4000044D /end MEASUREMENT
/begin MEASUREMENT ETC_Setpoint "Commanded electronic throttle position" FLOAT32_IEEE CompuMethod_9 1 0 -1E+17 1E+17 ECU_ADDRESS 0x40000459 /end MEASUREMENT
/begin MEASUREMENT ETC_SetpointIdx "" UWORD CompuMethod_15 1 0 0 127.998 ECU_ADDRESS 0x4000045D /end MEASUREMENT
/begin MEASUREMENT ETC_SetpointIn "" FLOAT32_IEEE CompuMethod_2 1 0 -1E+17 1E+17 ECU_ADDRESS 0x4000045F /end MEASUREMENT
/begin MEASUREMENT ETC_ShutDownTimer "" FLOAT32_IEEE CompuMethod_2 1 0 -1E+17 1E+17 ECU_ADDRESS 0x40000464 /end MEASUREMENT
/begin MEASUREMENT ETC_VoltageComp "Gain on ETC duty cycle based on DRVP" FLOAT32_IEEE CompuMethod_2 1 0 -1E+17 1E+17 ECU_ADDRESS 0x40000468 /end MEASUREMENT
/begin MEASUREMENT ETCDampTerm "PID Damper Term" FLOAT32_IEEE CompuMethod_9 1 0 -1E+17 1E+17 ECU_ADDRESS 0x40000475 /end MEASUREMENT
/begin MEASUREMENT ETCDCOffset "Duty cycle offset based on desired ETC position." FLOAT32_IEEE CompuMethod_9 1 0 -1E+17 1E+17 ECU_ADDRESS 0x40000479 /end MEASUREMENT
/begin MEASUREMENT ETCDTerm "PID Derivative Term" FLOAT32_IEEE CompuMethod_9 1 0 -1E+17 1E+17 ECU_ADDRESS 0x4000047D /end MEASUREMENT
/begin MEASUREMENT ETCError "PID Error Term" FLOAT32_IEEE CompuMethod_9 1 0 -1E+17 1E+17 ECU_ADDRESS 0x40000481 /end MEASUREMENT
/begin MEASUREMENT ETCITerm "PID Integrator Term" FLOAT32_IEEE CompuMethod_9 1 0 -1E+17 1E+17 ECU_ADDRESS 0x40000485 /end MEASUREMENT
/begin MEASUREMENT ETCOut "PID Final Output" FLOAT32_IEEE CompuMethod_9 1 0 -1E+17 1E+17 ECU_ADDRESS 0x40000489 /end MEASUREMENT
/begin MEASUREMENT ETCPTerm "PID Proportional Term" FLOAT32_IEEE CompuMethod_9 1 0 -1E+17 1E+17 ECU_ADDRESS 0x4000048D /end MEASUREMENT
/begin MEASUREMENT ETCReqFallRate "Limits fall rate of ETCRequestFiltered." FLOAT32_IEEE CompuMethod_99 1 0 -1E+17 1E+17 ECU_ADDRESS 0x40000491 /end MEASUREMENT
/begin MEASUREMENT ETCReqFilterConst "" FLOAT32_IEEE CompuMethod_2 1 0 -1E+17 1E+17 ECU_ADDRESS 0x40000495 /end MEASUREMENT
/begin MEASUREMENT ETCReqRiseRate "Limits rise rate of ETCRequestFiltered." FLOAT32_IEEE CompuMethod_99 1 0 -1E+17 1E+17 ECU_ADDRESS 0x40000499 /end MEASUREMENT
/begin MEASUREMENT ETCRequest "Driver demand table" FLOAT32_IEEE CompuMethod_9 1 0 -1E+17 1E+17 ECU_ADDRESS 0x4000049D /end MEASUREMENT
/begin MEASUREMENT ETCRequestDirection "" UBYTE CompuMethod_100 1 0 0 1 ECU_ADDRESS 0x400004A1 /end MEASUREMENT
/begin MEASUREMENT ETCRequestFinal "Final ETC request sent to ETC controller from Run state." FLOAT32_IEEE CompuMethod_49 1 0 -1E+17 1E+17 ECU_ADDRESS 0x400004A2 /end MEASUREMENT
/begin MEASUREMENT Fan1Cmd "FAN 1 final request" FLOAT32_IEEE CompuMethod_9 1 0 -1E+17 1E+17 ECU_ADDRESS 0x400004CF /end MEASUREMENT
/begin MEASUREMENT Fan2Cmd "Fan 2 final command" FLOAT32_IEEE CompuMethod_9 1 0 -1E+17 1E+17 ECU_ADDRESS 0x400004D7 /end MEASUREMENT
/begin MEASUREMENT FGNDTaskCPU "Percentage of CPU spent on FGNDTask task" UWORD CompuMethod_34 1 0 0 100 ECU_ADDRESS 0x400004ED /end MEASUREMENT
/begin MEASUREMENT FGNDTaskStackMinBytesFree "Remaining bytes available on the FGNDTask stack" UWORD CompuMethod_36 1 0 0 65535 ECU_ADDRESS 0x400004EF /end MEASUREMENT
/begin MEASUREMENT FilteredETCRequest "Final ETC request" FLOAT32_IEEE CompuMethod_9 1 0 -1E+17 1E+17 ECU_ADDRESS 0x400004F1 /end MEASUREMENT
/begin MEASUREMENT ForcedShutDownTimer "" FLOAT32_IEEE CompuMethod_2 1 0 -1E+17 1E+17 ECU_ADDRESS 0x400004F5 /end MEASUREMENT
/begin MEASUREMENT FuelAdapt_Error_BankA "Error in fuel flow at the current operating point, as compared to O2 sensor" FLOAT32_IEEE CompuMethod_2 1 0 -1E+17 1E+17 ECU_ADDRESS 0x40000545 /end MEASUREMENT
/begin MEASUREMENT FuelAdapt_Error_BankB "Error in fuel flow at the current operating point, as compared to O2 sensor" FLOAT32_IEEE CompuMethod_2 1 0 -1E+17 1E+17 ECU_ADDRESS 0x40000549 /end MEASUREMENT
/begin MEASUREMENT FuelAdaptEnabled "Indicates whether FuelFlowComp map adapting is enabled" UBYTE CompuMethod_46 1 0 0 1 ECU_ADDRESS 0x4000054D /end MEASUREMENT
/begin MEASUREMENT FuelAdaptGain_BankA "Gain for updating FuelFlowComp map.  This fraction of the error is added to the map every 5ms." FLOAT32_IEEE CompuMethod_47 1 0 -1E+17 1E+17 ECU_ADDRESS 0x4000054E /end MEASUREMENT
/begin MEASUREMENT FuelAdaptGain_BankB "Gain for updating FuelFlowComp map.  This fraction of the error is added to the map every 5ms." FLOAT32_IEEE CompuMethod_47 1 0 -1E+17 1E+17 ECU_ADDRESS 0x40000552 /end MEASUREMENT
/begin MEASUREMENT FuelFlowComp "Fuel Flow Compensation Multiplier - gain to adjust modelling errors in mechanical fuel system." FLOAT32_IEEE CompuMethod_29 1 0 -1E+17 1E+17 ECU_ADDRESS 0x4000055E /end MEASUREMENT
/begin MEASUREMENT FuelFlowCompAdapt_BankA "Adapt map based on O2 ITerm that is multiplied into FuelFlowComp." FLOAT32_IEEE CompuMethod_29 1 0 -1E+17 1E+17 ECU_ADDRESS 0x40000562 /end MEASUREMENT
/begin MEASUREMENT FuelFlowCompAdapt_BankB "Adapt map based on O2 ITerm that is multiplied into FuelFlowComp." FLOAT32_IEEE CompuMethod_29 1 0 -1E+17 1E+17 ECU_ADDRESS 0x40000566 /end MEASUREMENT
/begin MEASUREMENT FuelPumpTSE "" FLOAT32_IEEE CompuMethod_2 1 0 -1E+17 1E+17 ECU_ADDRESS 0x4000058E /end MEASUREMENT
/begin MEASUREMENT GlobalBaseFuelRate "Liquid fuel rate based on airflow and target equivalence ratio" FLOAT32_IEEE CompuMethod_27 1 0 -1E+17 1E+17 ECU_ADDRESS 0x400005A2 /end MEASUREMENT
/begin MEASUREMENT IAT_SpkOfst "IAT spark offset" FLOAT32_IEEE CompuMethod_70 1 0 -1E+17 1E+17 ECU_ADDRESS 0x400005D8 /end MEASUREMENT
/begin MEASUREMENT IAT_SpkOfstMult "Multiplier on IAT spark offset table." FLOAT32_IEEE CompuMethod_2 1 0 -1E+17 1E+17 ECU_ADDRESS 0x400005DC /end MEASUREMENT
/begin MEASUREMENT IATFanSpeed "" FLOAT32_IEEE CompuMethod_2 1 0 -1E+17 1E+17 ECU_ADDRESS 0x400005F4 /end MEASUREMENT
/begin MEASUREMENT IATFanSpeed_Stall "" FLOAT32_IEEE CompuMethod_2 1 0 -1E+17 1E+17 ECU_ADDRESS 0x400005F8 /end MEASUREMENT
/begin MEASUREMENT IdleHandOffMult "" FLOAT32_IEEE CompuMethod_2 1 0 -1E+17 1E+17 ECU_ADDRESS 0x40000602 /end MEASUREMENT
/begin MEASUREMENT IdleStackMinBytesFree "Remaining bytes available on the Idle stack" UWORD CompuMethod_35 1 0 0 65535 ECU_ADDRESS 0x40000606 /end MEASUREMENT
/begin MEASUREMENT IdleState "The idle governor may be one of: Flaring, OnIdle, OffIdle" UBYTE CompuMethod_119 1 0 0 255 ECU_ADDRESS 0x40000608 /end MEASUREMENT
/begin MEASUREMENT InjectorsEnabled "Enable state for injectors." UBYTE CompuMethod_6 1 0 0 1 ECU_ADDRESS 0x40000633 MATRIX_DIM 8 1 1 /end MEASUREMENT
/begin MEASUREMENT InjTransitionCount "" UBYTE CompuMethod_1 1 0 0 255 ECU_ADDRESS 0x4000065F MATRIX_DIM 8 1 1 /end MEASUREMENT
/begin MEASUREMENT IntakeAirTempEnrichment "Requested on base eq. ratio as a function of IAT and MAP" FLOAT32_IEEE CompuMethod_66 1 0 -1E+17 1E+17 ECU_ADDRESS 0x4000066F /end MEASUREMENT
/begin MEASUREMENT InterruptStackMinBytesFree "Remaining bytes available on the interrupt stack" UWORD CompuMethod_35 1 0 0 65535 ECU_ADDRESS 0x40000673 /end MEASUREMENT
/begin MEASUREMENT KernelStackMinBytesFree "Remaining bytes available on the Kernel stack" UWORD CompuMethod_35 1 0 0 65535 ECU_ADDRESS 0x40000683 /end MEASUREMENT
/begin MEASUREMENT MAF09Idx "" UWORD CompuMethod_15 1 0 0 127.998 ECU_ADDRESS 0x400006B1 /end MEASUREMENT
/begin MEASUREMENT MAF09In "" FLOAT32_IEEE CompuMethod_2 1 0 -1E+17 1E+17 ECU_ADDRESS 0x400006B3 /end MEASUREMENT
/begin MEASUREMENT MAFFinal "Air mass flow rate at the intake manifold - Used by the fueling algorithm" FLOAT32_IEEE CompuMethod_27 1 0 -1E+17 1E+17 ECU_ADDRESS 0x400006BB /end MEASUREMENT
/begin MEASUREMENT MakeUpEOI "End of injection timing for transient makeup fuel pulse" FLOAT32_IEEE CompuMethod_70 1 0 -1E+17 1E+17 ECU_ADDRESS 0x400006CB /end MEASUREMENT
/begin MEASUREMENT MaxETCSetPtLimit "Maximum allowable ETC position." FLOAT32_IEEE CompuMethod_9 1 0 -1E+17 1E+17 ECU_ADDRESS 0x4000074B /end MEASUREMENT
/begin MEASUREMENT MinETCSetPtLimit "Min allowable ETC position." FLOAT32_IEEE CompuMethod_9 1 0 -1E+17 1E+17 ECU_ADDRESS 0x40000789 /end MEASUREMENT
/begin MEASUREMENT MinGovReset "" UBYTE CompuMethod_12 1 0 0 1 ECU_ADDRESS 0x4000078F /end MEASUREMENT
/begin MEASUREMENT O2_BankA_EquivRatio_Out "" FLOAT32_IEEE CompuMethod_2 1 0 -1E+17 1E+17 ECU_ADDRESS 0x4000092F /end MEASUREMENT
/begin MEASUREMENT O2Calibration "" UBYTE CompuMethod_10 1 0 0 1 ECU_ADDRESS 0x4000093B /end MEASUREMENT
/begin MEASUREMENT O2CtrlMode "" UBYTE CompuMethod_137 1 0 0 1 ECU_ADDRESS 0x4000093C /end MEASUREMENT
/begin MEASUREMENT O2FaultDisable "" UBYTE CompuMethod_12 1 0 0 1 ECU_ADDRESS 0x40000941 /end MEASUREMENT
/begin MEASUREMENT O2ITerm_BankAIdx "Index for O2 ITerm." UWORD CompuMethod_15 1 0 0 127.998 ECU_ADDRESS 0x40000962 /end MEASUREMENT
/begin MEASUREMENT O2ITerm_BankAIn "Index for O2 ITerm." FLOAT32_IEEE CompuMethod_29 1 0 -1E+17 1E+17 ECU_ADDRESS 0x40000964 /end MEASUREMENT
/begin MEASUREMENT O2ITerm_BankBIdx "Index for O2 ITerm." UWORD CompuMethod_15 1 0 0 127.998 ECU_ADDRESS 0x40000968 /end MEASUREMENT
/begin MEASUREMENT O2ITerm_BankBIn "Index for O2 ITerm." FLOAT32_IEEE CompuMethod_29 1 0 -1E+17 1E+17 ECU_ADDRESS 0x4000096A /end MEASUREMENT
/begin MEASUREMENT O2SensorFaults "" UBYTE CompuMethod_10 1 0 0 1 ECU_ADDRESS 0x4000098E /end MEASUREMENT
/begin MEASUREMENT O2StartUpDelay "Delay O2 enable until TimeSinceRun is greater than this time." FLOAT32_IEEE CompuMethod_45 1 0 -1E+17 1E+17 ECU_ADDRESS 0x4000098F /end MEASUREMENT
/begin MEASUREMENT O2TimeDelay "" UBYTE CompuMethod_10 1 0 0 1 ECU_ADDRESS 0x4000099B /end MEASUREMENT
/begin MEASUREMENT PeakHeapBytesUsed "Maximum number of bytes used on the heap since startup" ULONG CompuMethod_142 1 0 0 4294970000 ECU_ADDRESS 0x400009D8 /end MEASUREMENT
/begin MEASUREMENT PerCylBaseFuelRate "Liquid fuel mass flow rate based on airflow and target equivalence ratio per cylinder." FLOAT32_IEEE CompuMethod_27 1 0 -1E+17 1E+17 ECU_ADDRESS 0x400009DC /end MEASUREMENT
/begin MEASUREMENT PrimarySOI "Injection timing for primary fuel pulse - SOI or EOI depending on Inj Config" FLOAT32_IEEE CompuMethod_70 1 0 -1E+17 1E+17 ECU_ADDRESS 0x400009E9 /end MEASUREMENT
/begin MEASUREMENT RPM "" FLOAT32_IEEE CompuMethod_2 1 0 -1E+17 1E+17 ECU_ADDRESS 0x400009F6 /end MEASUREMENT
/begin MEASUREMENT RPMAccel17Idx "" UWORD CompuMethod_15 1 0 0 127.998 ECU_ADDRESS 0x40000A0C /end MEASUREMENT
/begin MEASUREMENT RPMAccel17In "" FLOAT32_IEEE CompuMethod_2 1 0 -1E+17 1E+17 ECU_ADDRESS 0x40000A0E /end MEASUREMENT
/begin MEASUREMENT RPMCtrlMode "" UBYTE CompuMethod_12 1 0 0 1 ECU_ADDRESS 0x40000A12 /end MEASUREMENT
/begin MEASUREMENT RPMInst "" FLOAT32_IEEE CompuMethod_2 1 0 -1E+17 1E+17 ECU_ADDRESS 0x40000A1C /end MEASUREMENT
/begin MEASUREMENT SHUTDOWNTaskCPU "Percentage of CPU spent on SHUTDOWNTask task" UWORD CompuMethod_34 1 0 0 100 ECU_ADDRESS 0x40000A2F /end MEASUREMENT
/begin MEASUREMENT SHUTDOWNTaskStackMinBytesFree "Remaining bytes available on the SHUTDOWNTask stack" UWORD CompuMethod_36 1 0 0 65535 ECU_ADDRESS 0x40000A31 /end MEASUREMENT
/begin MEASUREMENT Spark_Adv_Prb "" FLOAT32_IEEE CompuMethod_2 1 0 -1E+17 1E+17 ECU_ADDRESS 0x40000A33 /end MEASUREMENT
/begin MEASUREMENT SparkAdv "Base spark advance map." FLOAT32_IEEE CompuMethod_70 1 0 -1E+17 1E+17 ECU_ADDRESS 0x40000A37 /end MEASUREMENT
/begin MEASUREMENT SparkDwell "Total electrical spark dwell time" FLOAT32_IEEE CompuMethod_69 1 0 -1E+17 1E+17 ECU_ADDRESS 0x40000A3B /end MEASUREMENT
/begin MEASUREMENT SparkEnabled "Enabled when spark energy is greater than zero" UBYTE CompuMethod_31 1 0 0 1 ECU_ADDRESS 0x40000A3F /end MEASUREMENT
/begin MEASUREMENT SparkEnergyMonitor "Commanded spark energy, before conversion to dwell time" FLOAT32_IEEE CompuMethod_50 1 0 -1E+17 1E+17 ECU_ADDRESS 0x40000A40 /end MEASUREMENT
/begin MEASUREMENT SpkEnergy09Idx "" UWORD CompuMethod_15 1 0 0 127.998 ECU_ADDRESS 0x40000A44 /end MEASUREMENT
/begin MEASUREMENT SpkEnergy09In "" FLOAT32_IEEE CompuMethod_2 1 0 -1E+17 1E+17 ECU_ADDRESS 0x40000A46 /end MEASUREMENT
/begin MEASUREMENT SpkMinGovOutput "" FLOAT32_IEEE CompuMethod_2 1 0 -1E+17 1E+17 ECU_ADDRESS 0x40000A56 /end MEASUREMENT
/begin MEASUREMENT SpkOfstTempFnl "Total Spark Offset based on ECT, IAT, CAT, engine speed and load" FLOAT32_IEEE CompuMethod_70 1 0 -1E+17 1E+17 ECU_ADDRESS 0x40000A68 /end MEASUREMENT
/begin MEASUREMENT TDCCount "Number of TDC events counted after stall.  This will reset once in Crank and Run." UBYTE CompuMethod_1 1 0 0 255 ECU_ADDRESS 0x40000A90 /end MEASUREMENT
/begin MEASUREMENT TDCCountThreshEnabled "" UBYTE CompuMethod_10 1 0 0 1 ECU_ADDRESS 0x40000A91 /end MEASUREMENT
/begin MEASUREMENT TimeSinceRun09Idx "" UWORD CompuMethod_15 1 0 0 127.998 ECU_ADDRESS 0x40000A9A /end MEASUREMENT
/begin MEASUREMENT TimeSinceRun09In "" FLOAT32_IEEE CompuMethod_2 1 0 -1E+17 1E+17 ECU_ADDRESS 0x40000A9C /end MEASUREMENT
/begin MEASUREMENT Tot_EqRatio_SpkOfst "Total Spark Offset based on Desired Equivalence Ratio, engine speed and load" FLOAT32_IEEE CompuMethod_88 1 0 -1E+17 1E+17 ECU_ADDRESS 0x40000AA4 /end MEASUREMENT
/begin MEASUREMENT TransFuel_MAPFilt "" FLOAT32_IEEE CompuMethod_2 1 0 -1E+17 1E+17 ECU_ADDRESS 0x40000B02 /end MEASUREMENT
/begin MEASUREMENT TransFuel_TPSFilt "" FLOAT32_IEEE CompuMethod_2 1 0 -1E+17 1E+17 ECU_ADDRESS 0x40000B06 /end MEASUREMENT
/begin MEASUREMENT VEAdaptAmnt "Volumetric efficiency adapt amount at the given speed and load" FLOAT32_IEEE CompuMethod_9 1 0 -1E+17 1E+17 ECU_ADDRESS 0x40000B10 /end MEASUREMENT
/begin MEASUREMENT VEAdapting "Indicates whether the volumetric efficiency map is currently being adjusted" UBYTE CompuMethod_162 1 0 0 1 ECU_ADDRESS 0x40000B18 /end MEASUREMENT
/begin MEASUREMENT VEBaroCorr "Vol Eff compensation based on BARO." FLOAT32_IEEE CompuMethod_2 1 0 -1E+17 1E+17 ECU_ADDRESS 0x40000B19 /end MEASUREMENT
/begin MEASUREMENT VEFin "Final volumentric efficiency after adapt table" FLOAT32_IEEE CompuMethod_27 1 0 -1E+17 1E+17 ECU_ADDRESS 0x40000B1D /end MEASUREMENT
/begin MEASUREMENT VEIdealMAF "Air Mass Flow Rate - ideal" FLOAT32_IEEE CompuMethod_27 1 0 -1E+17 1E+17 ECU_ADDRESS 0x40000B21 /end MEASUREMENT
/begin MEASUREMENT VEMapIdx "Index of MAP for VE calculations" UWORD CompuMethod_15 1 0 0 127.998 ECU_ADDRESS 0x40000B25 /end MEASUREMENT
/begin MEASUREMENT VEMapIn "Index of MAP for VE calculations" FLOAT32_IEEE CompuMethod_16 1 0 -1E+17 1E+17 ECU_ADDRESS 0x40000B27 /end MEASUREMENT
/begin MEASUREMENT VEModelMAF "Air Mass Flow Rate - Port Total" FLOAT32_IEEE CompuMethod_27 1 0 -1E+17 1E+17 ECU_ADDRESS 0x40000B2B /end MEASUREMENT
/begin MEASUREMENT VETempCorr "" FLOAT32_IEEE CompuMethod_9 1 0 -1E+17 1E+17 ECU_ADDRESS 0x40000B2F /end MEASUREMENT
/begin MEASUREMENT VolEff "Volumetric efficiency table for speed density mode" FLOAT32_IEEE CompuMethod_9 1 0 -1E+17 1E+17 ECU_ADDRESS 0x40000B33 /end MEASUREMENT
/begin MEASUREMENT VolEffAdapt "Volumetric efficiency adapt table" FLOAT32_IEEE CompuMethod_9 1 0 -1E+17 1E+17 ECU_ADDRESS 0x40000B37 /end MEASUREMENT
/begin MEASUREMENT WarmUpEqRatio "Requested eq. ratio as a function of ECT and MAP." FLOAT32_IEEE CompuMethod_66 1 0 -1E+17 1E+17 ECU_ADDRESS 0x40000B69 /end MEASUREMENT
/begin MEASUREMENT WarmUpTimeRatio "Requested eq. ratio as a function of TimeSinceRun and ECT. Use for cold temps" FLOAT32_IEEE CompuMethod_66 1 0 -1E+17 1E+17 ECU_ADDRESS 0x40000B6E /end MEASUREMENT
/begin MEASUREMENT WGDeadTime "Wastegate turn on time" FLOAT32_IEEE CompuMethod_68 1 0 -1E+17 1E+17 ECU_ADDRESS 0x40000B76 /end MEASUREMENT
/begin CHARACTERISTIC AC_TPSOff "Throttle position at which AC gets disengaged" VALUE 0x80000026 RecordLayout_3 0 CompuMethod_8 0 65535 /end CHARACTERISTIC
/begin CHARACTERISTIC AC_TPSOn "Throttle position at which AC gets engaged" VALUE 0x80000028 RecordLayout_3 0 CompuMethod_8 0 65535 /end CHARACTERISTIC
/begin CHARACTERISTIC ACAirFlowOfst_Enab "Enables AC airflow adder" VALUE 0x8000002A RecordLayout_2 0 CompuMethod_10 0 1 /end CHARACTERISTIC
/begin CHARACTERISTIC ACAirFlowOfstTbl "AC air position in based on ECT." CURVE 0x8000002B RecordLayout_4 0 CompuMethod_9 -1E+17 1E+17
 /begin AXIS_DESCR COM_AXIS ACPres05In CompuMethod_16 5 -150 10000 AXIS_PTS_REF ACPres05IdxArr /end AXIS_DESCR
/end CHARACTERISTIC
/begin CHARACTERISTIC ACHighPresOff "" VALUE 0x8000003F RecordLayout_3 0 CompuMethod_5 0 65535 /end CHARACTERISTIC
/begin CHARACTERISTIC ACHighPresOn "" VALUE 0x80000041 RecordLayout_3 0 CompuMethod_5 0 65535 /end CHARACTERISTIC
/begin CHARACTERISTIC ACHighPressureDisable "Pressure when ac gets disabled" VALUE 0x80000043 RecordLayout_3 0 CompuMethod_11 0 65535 /end CHARACTERISTIC
/begin CHARACTERISTIC ACLowPresOff "" VALUE 0x80000045 RecordLayout_3 0 CompuMethod_5 0 65535 /end CHARACTERISTIC
/begin CHARACTERISTIC ACLowPresOn "" VALUE 0x80000047 RecordLayout_3 0 CompuMethod_5 0 65535 /end CHARACTERISTIC
/begin CHARACTERISTIC ACLowPressureDisable "Pressure when ac gets disabled" VALUE 0x80000049 RecordLayout_3 0 CompuMethod_11 0 65535 /end CHARACTERISTIC
/begin CHARACTERISTIC ACPres_new "Override result of linear sensor characterization, in engineering units" VALUE 0x8000004B RecordLayout_4 0 CompuMethod_14 -1E+17 1E+17 /end CHARACTERISTIC
/begin CHARACTERISTIC ACPres_ovr "" VALUE 0x8000004F RecordLayout_2 0 CompuMethod_7 0 1 /end CHARACTERISTIC
/begin CHARACTERISTIC ACPresDfltValue "This is the initial default value should the sensor be in fault on key-up.  Otherwise the sensors outputs the last value prior to faulting" VALUE 0x80000080 RecordLayout_4 0 CompuMethod_14 -1E+17 1E+17 /end CHARACTERISTIC
/begin CHARACTERISTIC ACPresFanOff "AC pressure when the fan turns off" VALUE 0x80000084 RecordLayout_4 0 CompuMethod_18 -1E+17 1E+17 /end CHARACTERISTIC
/begin CHARACTERISTIC ACPresFanOn "AC pressure when the fan turns on" VALUE 0x80000088 RecordLayout_4 0 CompuMethod_18 -1E+17 1E+17 /end CHARACTERISTIC
/begin CHARACTERISTIC ACPresFanSpeed_StallTbl "" CURVE 0x8000008C RecordLayout_4 0 CompuMethod_2 -1E+17 1E+17
 /begin AXIS_DESCR COM_AXIS ACPres05In CompuMethod_16 5 -150 10000 AXIS_PTS_REF ACPres05IdxArr /end AXIS_DESCR
/end CHARACTERISTIC
/begin CHARACTERISTIC ACPresFanSpeedMap "" MAP 0x800000A0 RecordLayout_4 0 CompuMethod_2 -1E+17 1E+17
 /begin AXIS_DESCR COM_AXIS VSPD07In CompuMethod_165 7 -100 200 AXIS_PTS_REF VSPD07IdxArr /end AXIS_DESCR
 /begin AXIS_DESCR COM_AXIS ACPres07In CompuMethod_16 7 -150 10000 AXIS_PTS_REF ACPres07IdxArr /end AXIS_DESCR
/end CHARACTERISTIC
/begin CHARACTERISTIC ACPresFilterConst "Filter time constant" VALUE 0x80000164 RecordLayout_4 0 CompuMethod_19 -1E+17 1E+17 /end CHARACTERISTIC
/begin CHARACTERISTIC ACPresGain "Scaling from A/D counts to engineering units" VALUE 0x80000168 RecordLayout_4 0 CompuMethod_20 -1E+17 1E+17 /end CHARACTERISTIC
/begin CHARACTERISTIC ACPresInputHiFltPos "Maximum allowable input, indicating short or open circuit" VALUE 0x8000016C RecordLayout_4 0 CompuMethod_21 -1E+17 1E+17 /end CHARACTERISTIC
/begin CHARACTERISTIC ACPresInputLoFltPos "Minimum allowable input, indicating short or open circuit" VALUE 0x80000170 RecordLayout_4 0 CompuMethod_21 -1E+17 1E+17 /end CHARACTERISTIC
/begin CHARACTERISTIC ACPresOfst "Offset after gain in engineering units" VALUE 0x80000174 RecordLayout_4 0 CompuMethod_14 -1E+17 1E+17 /end CHARACTERISTIC
/begin CHARACTERISTIC ACSpdFastOff "Engine speed at which the compressor turns off at high side" VALUE 0x80000178 RecordLayout_3 0 CompuMethod_22 0 65535 /end CHARACTERISTIC
/begin CHARACTERISTIC ACSpdFastOn "Engine speed at which the compressor turns on at high side" VALUE 0x8000017A RecordLayout_3 0 CompuMethod_22 0 65535 /end CHARACTERISTIC
/begin CHARACTERISTIC ACSpdSlowOff "Engine speed at which the compressor turns off at low side" VALUE 0x8000017C RecordLayout_3 0 CompuMethod_22 0 65535 /end CHARACTERISTIC
/begin CHARACTERISTIC ACSpdSlowOn "Engine speed at which the compressor turns on at low side" VALUE 0x8000017E RecordLayout_3 0 CompuMethod_22 0 65535 /end CHARACTERISTIC
/begin CHARACTERISTIC ACSw_new "Override actuator, in engineering units" VALUE 0x80000180 RecordLayout_2 0 CompuMethod_23 0 1 /end CHARACTERISTIC
/begin CHARACTERISTIC ACSw_ovr "" VALUE 0x80000181 RecordLayout_2 0 CompuMethod_7 0 1 /end CHARACTERISTIC
/begin CHARACTERISTIC ACSwFanSpeed "Fan speed % req for AC Sw 0 to disable" VALUE 0x80000182 RecordLayout_2 0 CompuMethod_24 0 100 /end CHARACTERISTIC
/begin CHARACTERISTIC ACSwFanSpeed_Stall "Fan speed % req for AC Sw 0 to disable" VALUE 0x80000183 RecordLayout_4 0 CompuMethod_9 0 100 /end CHARACTERISTIC
/begin CHARACTERISTIC ACSwPolarity "0 = High True    1 = Low True" VALUE 0x80000187 RecordLayout_2 0 CompuMethod_6 0 1 /end CHARACTERISTIC
/begin CHARACTERISTIC ACSwSwitchPt "Defines switch point in ADC units boolean conversion" VALUE 0x80000188 RecordLayout_4 0 CompuMethod_21 -1E+17 1E+17 /end CHARACTERISTIC
/begin CHARACTERISTIC ACTempOff "" VALUE 0x8000018C RecordLayout_4 0 CompuMethod_2 -1E+17 1E+17 /end CHARACTERISTIC
/begin CHARACTERISTIC ACTempOn "" VALUE 0x80000190 RecordLayout_4 0 CompuMethod_2 -1E+17 1E+17 /end CHARACTERISTIC
/begin CHARACTERISTIC ACTimeFromStartDelay "Time from start AC enable delay" VALUE 0x80000194 RecordLayout_4 0 CompuMethod_25 0 1E+17 /end CHARACTERISTIC
/begin CHARACTERISTIC AdaptEnable "Determines whether the FuelFlowComp map will be adapted using the MAF sensor" VALUE 0x80000198 RecordLayout_2 0 CompuMethod_26 0 1 /end CHARACTERISTIC
/begin CHARACTERISTIC AirControlSource "Selects source of idle air control" VALUE 0x80000199 RecordLayout_2 0 CompuMethod_28 0 1 /end CHARACTERISTIC
/begin CHARACTERISTIC AirflowDiag_MAPIRDiagEnable "" VALUE 0x8000019A RecordLayout_2 0 CompuMethod_10 0 1 /end CHARACTERISTIC
/begin CHARACTERISTIC AirflowMimatchThreshMap "" MAP 0x8000019B RecordLayout_6 0 CompuMethod_1 -128 127
 /begin AXIS_DESCR COM_AXIS MAP09In CompuMethod_16 9 0 1000 AXIS_PTS_REF MAP09IdxArr /end AXIS_DESCR
 /begin AXIS_DESCR COM_AXIS RPM09In CompuMethod_72 9 0 14000 AXIS_PTS_REF RPM09IdxArr /end AXIS_DESCR
/end CHARACTERISTIC
/begin CHARACTERISTIC AirMinGovDGain "Base D-gain for the min. governor controller." VALUE 0x800001EC RecordLayout_4 0 CompuMethod_29 -1E+17 1E+17 /end CHARACTERISTIC
/begin CHARACTERISTIC AirMinGovDGainErrorMultTbl "" CURVE 0x800001F0 RecordLayout_4 0 CompuMethod_29 -1E+17 1E+17
 /begin AXIS_DESCR COM_AXIS AirMinGovSpeedErrorIn CompuMethod_2 9 -1E+17 1E+17 AXIS_PTS_REF AirMinGovSpeedErrorIdxArr /end AXIS_DESCR
/end CHARACTERISTIC
/begin CHARACTERISTIC AirMinGovErrorGain "Error gain for the min governor controller. This gain is applied to the RPM error term before it is used to calculate the P, I and D terms." VALUE 0x80000214 RecordLayout_4 0 CompuMethod_29 -1E+17 1E+17 /end CHARACTERISTIC
/begin CHARACTERISTIC AirMinGovIGain "Base I-gain for the min. governor controller." VALUE 0x80000218 RecordLayout_4 0 CompuMethod_29 -1E+17 1E+17 /end CHARACTERISTIC
/begin CHARACTERISTIC AirMinGovIGainErrorMultTbl "" CURVE 0x8000021C RecordLayout_4 0 CompuMethod_29 -1E+17 1E+17
 /begin AXIS_DESCR COM_AXIS AirMinGovSpeedErrorIn CompuMethod_2 9 -1E+17 1E+17 AXIS_PTS_REF AirMinGovSpeedErrorIdxArr /end AXIS_DESCR
/end CHARACTERISTIC
/begin CHARACTERISTIC AirMinGovITermLowerLimit "Lower limit on Air Min Governor I-term value." VALUE 0x80000240 RecordLayout_4 0 CompuMethod_9 -1E+17 1E+17 /end CHARACTERISTIC
/begin CHARACTERISTIC AirMinGovITermUpperLimit "Upper limit on Air Min Governor I-term value." VALUE 0x80000244 RecordLayout_4 0 CompuMethod_9 -1E+17 1E+17 /end CHARACTERISTIC
/begin CHARACTERISTIC AirMinGovPGain "Base P-gain for the min. governor controller." VALUE 0x80000248 RecordLayout_4 0 CompuMethod_29 -1E+17 1E+17 /end CHARACTERISTIC
/begin CHARACTERISTIC AirMinGovPGainErrorMultTbl "" CURVE 0x8000024C RecordLayout_4 0 CompuMethod_29 -1E+17 1E+17
 /begin AXIS_DESCR COM_AXIS AirMinGovSpeedErrorIn CompuMethod_2 9 -1E+17 1E+17 AXIS_PTS_REF AirMinGovSpeedErrorIdxArr /end AXIS_DESCR
/end CHARACTERISTIC
/begin CHARACTERISTIC AirMinGovPIDOutLowerLimit "Lower limit on air min governor PID Output." VALUE 0x80000270 RecordLayout_4 0 CompuMethod_9 -1E+17 1E+17 /end CHARACTERISTIC
/begin CHARACTERISTIC AirMinGovPIDOutUpperLimit "Upper limit on air min governor PID Output." VALUE 0x80000274 RecordLayout_4 0 CompuMethod_9 -1E+17 1E+17 /end CHARACTERISTIC
/begin CHARACTERISTIC APP_AdaptMode "" VALUE 0x8000029C RecordLayout_2 0 CompuMethod_10 0 1 /end CHARACTERISTIC
/begin CHARACTERISTIC APP_Filt "Filter time constant" VALUE 0x8000029D RecordLayout_4 0 CompuMethod_19 -1E+17 1E+17 /end CHARACTERISTIC
/begin CHARACTERISTIC APP1_Adapt_new "Override result of linear sensor characterization, in engineering units" VALUE 0x800002B5 RecordLayout_4 0 CompuMethod_9 -1E+17 1E+17 /end CHARACTERISTIC
/begin CHARACTERISTIC APP1_Adapt_ovr "" VALUE 0x800002B9 RecordLayout_2 0 CompuMethod_7 0 1 /end CHARACTERISTIC
/begin CHARACTERISTIC APP1_AdaptAdapt_Delta "Specifies the minimum deviation amount to react to." VALUE 0x800002BA RecordLayout_4 0 CompuMethod_21 -1E+17 1E+17 /end CHARACTERISTIC
/begin CHARACTERISTIC APP1_AdaptAdapt_Hi_Max "Specifies for the maximum value of the upper adapt range." VALUE 0x800002BE RecordLayout_4 0 CompuMethod_30 -1E+17 1E+17 /end CHARACTERISTIC
/begin CHARACTERISTIC APP1_AdaptAdapt_Hi_Min "Specifies for the minimum value of the upper adapt range." VALUE 0x800002C2 RecordLayout_4 0 CompuMethod_30 -1E+17 1E+17 /end CHARACTERISTIC
/begin CHARACTERISTIC APP1_AdaptAdapt_Low_Max "Specifies for the maximum value of the lower adapt range." VALUE 0x800002C6 RecordLayout_4 0 CompuMethod_30 -1E+17 1E+17 /end CHARACTERISTIC
/begin CHARACTERISTIC APP1_AdaptAdapt_Low_Min "Specifies for the minimum value of the lower adapt range." VALUE 0x800002CA RecordLayout_4 0 CompuMethod_30 -1E+17 1E+17 /end CHARACTERISTIC
/begin CHARACTERISTIC APP1_AdaptAdaptHiEnable "Enables or disables this adapt." VALUE 0x800002CE RecordLayout_2 0 CompuMethod_10 0 1 /end CHARACTERISTIC
/begin CHARACTERISTIC APP1_AdaptAdaptLoEnable "Enables or disables this adapt." VALUE 0x800002CF RecordLayout_2 0 CompuMethod_10 0 1 /end CHARACTERISTIC
/begin CHARACTERISTIC APP1_AdaptDfltValue "This is the initial default value should the sensor be in fault on key-up.  Otherwise the sensors outputs the last value prior to faulting" VALUE 0x800002D0 RecordLayout_4 0 CompuMethod_9 -1E+17 1E+17 /end CHARACTERISTIC
/begin CHARACTERISTIC APP1_AdaptFilterConst "Filter time constant" VALUE 0x800002D4 RecordLayout_4 0 CompuMethod_19 -1E+17 1E+17 /end CHARACTERISTIC
/begin CHARACTERISTIC APP1_AdaptInputHiFltPos "Hi limit of input signal which sets fault" VALUE 0x800002D8 RecordLayout_4 0 CompuMethod_21 -1E+17 1E+17 /end CHARACTERISTIC
/begin CHARACTERISTIC APP1_AdaptInputLoFltPos "Low limit of input signal which sets fault" VALUE 0x800002DC RecordLayout_4 0 CompuMethod_21 -1E+17 1E+17 /end CHARACTERISTIC
/begin CHARACTERISTIC APP1_AdaptMaxLimit "Sets the upper limit on the potentiometer range." VALUE 0x800002E0 RecordLayout_4 0 CompuMethod_9 -1E+17 1E+17 /end CHARACTERISTIC
/begin CHARACTERISTIC APP1_AdaptRev_Polarity "1 = Reverse Polarity (Smaller voltage values indicate larger % travel)" VALUE 0x800002E4 RecordLayout_2 0 CompuMethod_31 0 1 /end CHARACTERISTIC
/begin CHARACTERISTIC APP1_AlwaysAdapt "" VALUE 0x800002E5 RecordLayout_2 0 CompuMethod_10 0 1 /end CHARACTERISTIC
/begin CHARACTERISTIC APP1_APP2_Max_Deviation "Specifies the maximum allowable deviation between the two sensors" VALUE 0x800002E6 RecordLayout_4 0 CompuMethod_32 -1E+17 1E+17 /end CHARACTERISTIC
/begin CHARACTERISTIC APP1_new "Override result of linear sensor characterization, in engineering units" VALUE 0x800002EA RecordLayout_4 0 CompuMethod_9 -1E+17 1E+17 /end CHARACTERISTIC
/begin CHARACTERISTIC APP1_ovr "" VALUE 0x800002EE RecordLayout_2 0 CompuMethod_7 0 1 /end CHARACTERISTIC
/begin CHARACTERISTIC APP1Default "This is the initial default value should the sensor be in fault on key-up.  Otherwise the sensors outputs the last value prior to faulting" VALUE 0x80000333 RecordLayout_4 0 CompuMethod_9 -1E+17 1E+17 /end CHARACTERISTIC
/begin CHARACTERISTIC APP1FiltConst "Filter time constant" VALUE 0x80000337 RecordLayout_4 0 CompuMethod_19 -1E+17 1E+17 /end CHARACTERISTIC
/begin CHARACTERISTIC APP1HiAdaptADCThresh "Sets the ADC limit above which a high-side adapt will be captured on key-up." VALUE 0x8000033B RecordLayout_4 0 CompuMethod_21 -1E+17 1E+17 /end CHARACTERISTIC
/begin CHARACTERISTIC APP1LowAdaptADCThresh "Sets the ADC limit below which a low-side adapt will be captured on key-up." VALUE 0x80000363 RecordLayout_4 0 CompuMethod_21 -1E+17 1E+17 /end CHARACTERISTIC
/begin CHARACTERISTIC APP1Max "Maximum allowable input, indicating short or open circuit" VALUE 0x80000367 RecordLayout_4 0 CompuMethod_21 -1E+17 1E+17 /end CHARACTERISTIC
/begin CHARACTERISTIC APP1MaxLimit "Sets the upper limit on the potentiometer range." VALUE 0x8000036B RecordLayout_4 0 CompuMethod_9 -1E+17 1E+17 /end CHARACTERISTIC
/begin CHARACTERISTIC APP1Min "Minimum allowable input, indicating short or open circuit" VALUE 0x8000036F RecordLayout_4 0 CompuMethod_21 -1E+17 1E+17 /end CHARACTERISTIC
/begin CHARACTERISTIC APP1Tbl "Look up table to allownon-linear characterization of sensors" CURVE 0x80000373 RecordLayout_4 0 CompuMethod_9 -1E+17 1E+17
 /begin AXIS_DESCR COM_AXIS APP1ADC CompuMethod_21 9 -1E+17 1E+17 AXIS_PTS_REF APP1IdxArr /end AXIS_DESCR
/end CHARACTERISTIC
/begin CHARACTERISTIC APP2_Adapt_new "Override result of linear sensor characterization, in engineering units" VALUE 0x80000397 RecordLayout_4 0 CompuMethod_9 -1E+17 1E+17 /end CHARACTERISTIC
/begin CHARACTERISTIC APP2_Adapt_ovr "" VALUE 0x8000039B RecordLayout_2 0 CompuMethod_7 0 1 /end CHARACTERISTIC
/begin CHARACTERISTIC APP2_AdaptAdapt_Delta "Specifies the minimum deviation amount to react to." VALUE 0x8000039C RecordLayout_4 0 CompuMethod_21 -1E+17 1E+17 /end CHARACTERISTIC
/begin CHARACTERISTIC APP2_AdaptAdapt_Hi_Max "Specifies for the maximum value of the upper adapt range." VALUE 0x800003A0 RecordLayout_4 0 CompuMethod_30 -1E+17 1E+17 /end CHARACTERISTIC
/begin CHARACTERISTIC APP2_AdaptAdapt_Hi_Min "Specifies for the minimum value of the upper adapt range." VALUE 0x800003A4 RecordLayout_4 0 CompuMethod_30 -1E+17 1E+17 /end CHARACTERISTIC
/begin CHARACTERISTIC APP2_AdaptAdapt_Low_Max "Specifies for the maximum value of the lower adapt range." VALUE 0x800003A8 RecordLayout_4 0 CompuMethod_30 -1E+17 1E+17 /end CHARACTERISTIC
/begin CHARACTERISTIC APP2_AdaptAdapt_Low_Min "Specifies for the minimum value of the lower adapt range." VALUE 0x800003AC RecordLayout_4 0 CompuMethod_30 -1E+17 1E+17 /end CHARACTERISTIC
/begin CHARACTERISTIC APP2_AdaptAdaptHiEnable "Enables or disables this adapt." VALUE 0x800003B0 RecordLayout_2 0 CompuMethod_10 0 1 /end CHARACTERISTIC
/begin CHARACTERISTIC APP2_AdaptAdaptLoEnable "Enables or disables this adapt." VALUE 0x800003B1 RecordLayout_2 0 CompuMethod_10 0 1 /end CHARACTERISTIC
/begin CHARACTERISTIC APP2_AdaptDfltValue "This is the initial default value should the sensor be in fault on key-up.  Otherwise the sensors outputs the last value prior to faulting" VALUE 0x800003B2 RecordLayout_4 0 CompuMethod_9 -1E+17 1E+17 /end CHARACTERISTIC
/begin CHARACTERISTIC APP2_AdaptFilterConst "Filter time constant" VALUE 0x800003B6 RecordLayout_4 0 CompuMethod_19 -1E+17 1E+17 /end CHARACTERISTIC
/begin CHARACTERISTIC APP2_AdaptInputHiFltPos "Hi limit of input signal which sets fault" VALUE 0x800003BA RecordLayout_4 0 CompuMethod_21 -1E+17 1E+17 /end CHARACTERISTIC
/begin CHARACTERISTIC APP2_AdaptInputLoFltPos "Low limit of input signal which sets fault" VALUE 0x800003BE RecordLayout_4 0 CompuMethod_21 -1E+17 1E+17 /end CHARACTERISTIC
/begin CHARACTERISTIC APP2_AdaptMaxLimit "Sets the upper limit on the potentiometer range." VALUE 0x800003C2 RecordLayout_4 0 CompuMethod_9 -1E+17 1E+17 /end CHARACTERISTIC
/begin CHARACTERISTIC APP2_AdaptRev_Polarity "1 = Reverse Polarity (Smaller voltage values indicate larger % travel)" VALUE 0x800003C6 RecordLayout_2 0 CompuMethod_31 0 1 /end CHARACTERISTIC
/begin CHARACTERISTIC APP2_AlwaysAdapt "" VALUE 0x800003C7 RecordLayout_2 0 CompuMethod_10 0 1 /end CHARACTERISTIC
/begin CHARACTERISTIC APP2_new "Override result of linear sensor characterization, in engineering units" VALUE 0x800003C8 RecordLayout_4 0 CompuMethod_9 -1E+17 1E+17 /end CHARACTERISTIC
/begin CHARACTERISTIC APP2_ovr "" VALUE 0x800003CC RecordLayout_2 0 CompuMethod_7 0 1 /end CHARACTERISTIC
/begin CHARACTERISTIC APP2Default "This is the initial default value should the sensor be in fault on key-up.  Otherwise the sensors outputs the last value prior to faulting" VALUE 0x800003CD RecordLayout_4 0 CompuMethod_9 -1E+17 1E+17 /end CHARACTERISTIC
/begin CHARACTERISTIC APP2FiltConst "Filter time constant" VALUE 0x800003D1 RecordLayout_4 0 CompuMethod_19 -1E+17 1E+17 /end CHARACTERISTIC
/begin CHARACTERISTIC APP2HiAdaptADCThresh "Sets the ADC limit above which a high-side adapt will be captured on key-up." VALUE 0x800003D5 RecordLayout_4 0 CompuMethod_21 -1E+17 1E+17 /end CHARACTERISTIC
/begin CHARACTERISTIC APP2LowAdaptADCThresh "Sets the ADC limit below which a low-side adapt will be captured on key-up." VALUE 0x800003FD RecordLayout_4 0 CompuMethod_21 -1E+17 1E+17 /end CHARACTERISTIC
/begin CHARACTERISTIC APP2Max "Maximum allowable input, indicating short or open circuit" VALUE 0x80000401 RecordLayout_4 0 CompuMethod_21 -1E+17 1E+17 /end CHARACTERISTIC
/begin CHARACTERISTIC APP2MaxLimit "Sets the upper limit on the potentiometer range." VALUE 0x80000405 RecordLayout_4 0 CompuMethod_9 -1E+17 1E+17 /end CHARACTERISTIC
/begin CHARACTERISTIC APP2Min "Minimum allowable input, indicating short or open circuit" VALUE 0x80000409 RecordLayout_4 0 CompuMethod_21 -1E+17 1E+17 /end CHARACTERISTIC
/begin CHARACTERISTIC APP2Tbl "Look up table to allownon-linear characterization of sensors" CURVE 0x8000040D RecordLayout_4 0 CompuMethod_9 -1E+17 1E+17
 /begin AXIS_DESCR COM_AXIS APP2ADC CompuMethod_21 9 -1E+17 1E+17 AXIS_PTS_REF APP2IdxArr /end AXIS_DESCR
/end CHARACTERISTIC
/begin CHARACTERISTIC ApplicationInterruptTaskStackMargin "When the available ApplicationInterruptTask stack space drops below this threshold, the application performs a safety stop" VALUE 0x80000431 RecordLayout_3 0 CompuMethod_35 0 1024 /end CHARACTERISTIC
/begin CHARACTERISTIC ApplicationMonitorEnable "Enables runtime checking of stack, heap, CPU, and OS errors.  Stops the application on error." VALUE 0x80000433 RecordLayout_2 0 CompuMethod_10 0 1 /end CHARACTERISTIC
/begin CHARACTERISTIC ApplicationPausePoint "Selects the startup pause point, for debugging.  Can be moved forward to step through the initialization" VALUE 0x80000434 RecordLayout_2 0 CompuMethod_37 0 255 /end CHARACTERISTIC
/begin CHARACTERISTIC ApplicationStatus "View and set the application runtime status" VALUE 0x80000435 RecordLayout_2 0 CompuMethod_38 1 4 /end CHARACTERISTIC
/begin CHARACTERISTIC Bank1_EquivRatio_new "Override result of linear sensor characterization, in engineering units" VALUE 0x80000436 RecordLayout_4 0 CompuMethod_41 -1E+17 1E+17 /end CHARACTERISTIC
/begin CHARACTERISTIC Bank1_EquivRatio_ovr "" VALUE 0x8000043A RecordLayout_2 0 CompuMethod_7 0 1 /end CHARACTERISTIC
/begin CHARACTERISTIC Bank1_EquivRatioDfltValue "This is the initial default value should the sensor be in fault on key-up.  Otherwise the sensors outputs the last value prior to faulting" VALUE 0x8000043B RecordLayout_4 0 CompuMethod_41 -1E+17 1E+17 /end CHARACTERISTIC
/begin CHARACTERISTIC Bank1_EquivRatioFilterConst "Filter time constant" VALUE 0x8000043F RecordLayout_4 0 CompuMethod_19 -1E+17 1E+17 /end CHARACTERISTIC
/begin CHARACTERISTIC Bank1_EquivRatioGain "Scaling from A/D counts to engineering units" VALUE 0x80000443 RecordLayout_4 0 CompuMethod_42 -1E+17 1E+17 /end CHARACTERISTIC
/begin CHARACTERISTIC Bank1_EquivRatioInputHiFltPos "Maximum allowable input, indicating short or open circuit" VALUE 0x80000447 RecordLayout_4 0 CompuMethod_41 -1E+17 1E+17 /end CHARACTERISTIC
/begin CHARACTERISTIC Bank1_EquivRatioInputLoFltPos "Minimum allowable input, indicating short or open circuit" VALUE 0x8000044B RecordLayout_4 0 CompuMethod_41 -1E+17 1E+17 /end CHARACTERISTIC
/begin CHARACTERISTIC Bank1_EquivRatioOfst "Offset after gain in engineering units" VALUE 0x8000044F RecordLayout_4 0 CompuMethod_41 -1E+17 1E+17 /end CHARACTERISTIC
/begin CHARACTERISTIC Bank2_EquivRatio_new "Override result of linear sensor characterization, in engineering units" VALUE 0x80000453 RecordLayout_4 0 CompuMethod_41 -1E+17 1E+17 /end CHARACTERISTIC
/begin CHARACTERISTIC Bank2_EquivRatio_ovr "" VALUE 0x80000457 RecordLayout_2 0 CompuMethod_7 0 1 /end CHARACTERISTIC
/begin CHARACTERISTIC Bank2_EquivRatioDfltValue "This is the initial default value should the sensor be in fault on key-up.  Otherwise the sensors outputs the last value prior to faulting" VALUE 0x80000458 RecordLayout_4 0 CompuMethod_41 -1E+17 1E+17 /end CHARACTERISTIC
/begin CHARACTERISTIC Bank2_EquivRatioFilterConst "Filter time constant" VALUE 0x8000045C RecordLayout_4 0 CompuMethod_19 -1E+17 1E+17 /end CHARACTERISTIC
/begin CHARACTERISTIC Bank2_EquivRatioGain "Scaling from A/D counts to engineering units" VALUE 0x80000460 RecordLayout_4 0 CompuMethod_42 -1E+17 1E+17 /end CHARACTERISTIC
/begin CHARACTERISTIC Bank2_EquivRatioInputHiFltPos "Maximum allowable input, indicating short or open circuit" VALUE 0x80000464 RecordLayout_4 0 CompuMethod_41 -1E+17 1E+17 /end CHARACTERISTIC
/begin CHARACTERISTIC Bank2_EquivRatioInputLoFltPos "Minimum allowable input, indicating short or open circuit" VALUE 0x80000468 RecordLayout_4 0 CompuMethod_41 -1E+17 1E+17 /end CHARACTERISTIC
/begin CHARACTERISTIC Bank2_EquivRatioOfst "Offset after gain in engineering units" VALUE 0x8000046C RecordLayout_4 0 CompuMethod_41 -1E+17 1E+17 /end CHARACTERISTIC
/begin CHARACTERISTIC BankB_Avg_Enable "" VALUE 0x80000470 RecordLayout_2 0 CompuMethod_10 0 1 /end CHARACTERISTIC
/begin CHARACTERISTIC BankB_Enbl "" VALUE 0x80000471 RecordLayout_2 0 CompuMethod_10 0 1 /end CHARACTERISTIC
/begin CHARACTERISTIC BARO_Count "Number of samples to average at key-up to produce signal value" VALUE 0x80000472 RecordLayout_6 0 CompuMethod_1 -128 127 /end CHARACTERISTIC
/begin CHARACTERISTIC BARO_offset "Provides an override to the input by adding this amount to either the locked or running value" VALUE 0x80000473 RecordLayout_4 0 CompuMethod_16 -1E+17 1E+17 /end CHARACTERISTIC
/begin CHARACTERISTIC BARO_ovr "Provides an override to the input by adding this amount to either the locked or running value" VALUE 0x80000477 RecordLayout_2 0 CompuMethod_44 0 1 /end CHARACTERISTIC
/begin CHARACTERISTIC BaroLearn_MAP "" VALUE 0x8000049C RecordLayout_4 0 CompuMethod_16 0 100 /end CHARACTERISTIC
/begin CHARACTERISTIC BaroLearn_Tm "" VALUE 0x800004A0 RecordLayout_4 0 CompuMethod_19 0 100 /end CHARACTERISTIC
/begin CHARACTERISTIC BaroLearn_TPSPos "" VALUE 0x800004A4 RecordLayout_4 0 CompuMethod_9 0 100 /end CHARACTERISTIC
/begin CHARACTERISTIC BaroRunStallDelay "Delay time after transitioning from Run to Stall before resampling baro." VALUE 0x800004A8 RecordLayout_4 0 CompuMethod_45 -1E+17 1E+17 /end CHARACTERISTIC
/begin CHARACTERISTIC BaseAirflowAdaptDelayTime "Idle Control must be enabled for this amount of time before fuel adaption is enabled" VALUE 0x800004AC RecordLayout_4 0 CompuMethod_45 0 1E+17 /end CHARACTERISTIC
/begin CHARACTERISTIC BaseAirflowAdaptDelta "Air PID Iterm must be less than this delta to adapt the BaseAirflow table." VALUE 0x800004B0 RecordLayout_4 0 CompuMethod_29 -1E+17 1E+17 /end CHARACTERISTIC
/begin CHARACTERISTIC BaseAirflowAdaptEnable "Determines whether the BaseAirflow table will be adapted using the air PID Iterm." VALUE 0x800004B4 RecordLayout_2 0 CompuMethod_26 0 1 /end CHARACTERISTIC
/begin CHARACTERISTIC BaseAirflowAdaptErrorLwrLim "Lower Limit Value" VALUE 0x800004B5 RecordLayout_4 0 CompuMethod_47 -1E+17 1E+17 /end CHARACTERISTIC
/begin CHARACTERISTIC BaseAirflowAdaptErrorUprLim "Upper Limit Value" VALUE 0x800004B9 RecordLayout_4 0 CompuMethod_47 -1E+17 1E+17 /end CHARACTERISTIC
/begin CHARACTERISTIC BaseAirflowAdaptGain "Gain for updating BaseAirflow table.  This fraction of the error is added to the map every 5ms." VALUE 0x800004BD RecordLayout_4 0 CompuMethod_48 -1E+17 1E+17 /end CHARACTERISTIC
/begin CHARACTERISTIC BaseAirflowOfstMaxValue "Maximum value that can be adapted into the BaseAirflowOfst table." VALUE 0x800004C1 RecordLayout_4 0 CompuMethod_9 -1E+17 1E+17 /end CHARACTERISTIC
/begin CHARACTERISTIC BaseAirflowOfstMinValue "Minimum value that can be adapted into the BaseAirflowOfst table." VALUE 0x800004C5 RecordLayout_4 0 CompuMethod_9 -1E+17 1E+17 /end CHARACTERISTIC
/begin CHARACTERISTIC BaseAirflowOfstTbl "Base air position in based on ECT." CURVE 0x800004C9 RecordLayout_4 0 CompuMethod_9 -1E+17 1E+17
 /begin AXIS_DESCR COM_AXIS ECT05In CompuMethod_60 5 -40 200 AXIS_PTS_REF ECT05IdxArr /end AXIS_DESCR
/end CHARACTERISTIC
/begin CHARACTERISTIC BaseRevLimit "Maximum RPM allowed, before any action is taken" VALUE 0x800004DD RecordLayout_7 0 CompuMethod_22 0 32767 /end CHARACTERISTIC
/begin CHARACTERISTIC BaseSparkEnergyMap "Spark energy - Run state" MAP 0x800004DF RecordLayout_4 0 CompuMethod_50 -1E+17 1E+17
 /begin AXIS_DESCR COM_AXIS RPM09In CompuMethod_72 9 0 14000 AXIS_PTS_REF RPM09IdxArr /end AXIS_DESCR
 /begin AXIS_DESCR COM_AXIS MAP09In CompuMethod_16 9 0 1000 AXIS_PTS_REF MAP09IdxArr /end AXIS_DESCR
/end CHARACTERISTIC
/begin CHARACTERISTIC BGNDTaskStackMargin "When the available BGNDTask stack space drops below this threshold, the application performs a safety stop" VALUE 0x80000623 RecordLayout_3 0 CompuMethod_35 0 1024 /end CHARACTERISTIC
/begin CHARACTERISTIC BoostActivationThreshold "Minimum boost pressure before controller is activated, usually set to wastegate spring pressure" VALUE 0x80000625 RecordLayout_4 0 CompuMethod_51 -1E+17 1E+17 /end CHARACTERISTIC
/begin CHARACTERISTIC BoostAdaptDelayTime "Idle Control must be enabled for this amount of time before fuel adaption is enabled" VALUE 0x80000629 RecordLayout_4 0 CompuMethod_45 0 1E+17 /end CHARACTERISTIC
/begin CHARACTERISTIC BoostAdaptErrorLwrLim "Lower Limit Value" VALUE 0x8000062D RecordLayout_4 0 CompuMethod_47 -1E+17 1E+17 /end CHARACTERISTIC
/begin CHARACTERISTIC BoostAdaptErrorUprLim "Upper Limit Value" VALUE 0x80000631 RecordLayout_4 0 CompuMethod_47 -1E+17 1E+17 /end CHARACTERISTIC
/begin CHARACTERISTIC BoostControlAdaptDelta "Air PID Iterm must be less than this delta to adapt the BaseAirflow table." VALUE 0x80000635 RecordLayout_4 0 CompuMethod_29 -1E+17 1E+17 /end CHARACTERISTIC
/begin CHARACTERISTIC BoostControlAdaptEnable "Determines whether the BaseAirflow table will be adapted using the air PID Iterm." VALUE 0x80000639 RecordLayout_2 0 CompuMethod_26 0 1 /end CHARACTERISTIC
/begin CHARACTERISTIC BoostControlAdaptGain "Gain for updating BaseAirflow table.  This fraction of the error is added to the map every 5ms." VALUE 0x8000063A RecordLayout_4 0 CompuMethod_48 -1E+17 1E+17 /end CHARACTERISTIC
/begin CHARACTERISTIC BoostControlBase_AdaptMap "Base boost duty cycle table for feed forward" MAP 0x8000063E RecordLayout_4 0 CompuMethod_53 0 100
 /begin AXIS_DESCR COM_AXIS RPM09In CompuMethod_72 9 0 14000 AXIS_PTS_REF RPM09IdxArr /end AXIS_DESCR
 /begin AXIS_DESCR COM_AXIS BoostTargetIn CompuMethod_2 9 0 1E+17 AXIS_PTS_REF BoostTargetIdxArr /end AXIS_DESCR
/end CHARACTERISTIC
/begin CHARACTERISTIC BoostControlBaseMap "Base boost duty cycle table for feed forward" MAP 0x80000782 RecordLayout_2 0 CompuMethod_52 0 100
 /begin AXIS_DESCR COM_AXIS RPM09In CompuMethod_72 9 0 14000 AXIS_PTS_REF RPM09IdxArr /end AXIS_DESCR
 /begin AXIS_DESCR COM_AXIS BoostTargetIn CompuMethod_2 9 0 1E+17 AXIS_PTS_REF BoostTargetIdxArr /end AXIS_DESCR
/end CHARACTERISTIC
/begin CHARACTERISTIC BoostControlOfstMaxValue "Maximum value that can be adapted into the BaseAirflowOfst table." VALUE 0x800007D3 RecordLayout_4 0 CompuMethod_9 -1E+17 1E+17 /end CHARACTERISTIC
/begin CHARACTERISTIC BoostControlOfstMinValue "Minimum value that can be adapted into the BaseAirflowOfst table." VALUE 0x800007D7 RecordLayout_4 0 CompuMethod_9 -1E+17 1E+17 /end CHARACTERISTIC
/begin CHARACTERISTIC BoostCtlDGain "Base D-gain for the min. governor controller." VALUE 0x800007DB RecordLayout_4 0 CompuMethod_29 -1E+17 1E+17 /end CHARACTERISTIC
/begin CHARACTERISTIC BoostCtlDGainErrorMultTbl "" CURVE 0x800007DF RecordLayout_4 0 CompuMethod_29 -1E+17 1E+17
 /begin AXIS_DESCR COM_AXIS BoostCtlSpeedErrorIn CompuMethod_2 9 -1E+17 1E+17 AXIS_PTS_REF BoostCtlSpeedErrorIdxArr /end AXIS_DESCR
/end CHARACTERISTIC
/begin CHARACTERISTIC BoostCtlErrorGain "Error gain for the min governor controller. This gain is applied to the RPM error term before it is used to calculate the P, I and D terms." VALUE 0x80000803 RecordLayout_4 0 CompuMethod_29 -1E+17 1E+17 /end CHARACTERISTIC
/begin CHARACTERISTIC BoostCtlIGain "Base I-gain for the min. governor controller." VALUE 0x80000807 RecordLayout_4 0 CompuMethod_29 -1E+17 1E+17 /end CHARACTERISTIC
/begin CHARACTERISTIC BoostCtlIGainErrorMultTbl "" CURVE 0x8000080B RecordLayout_4 0 CompuMethod_29 -1E+17 1E+17
 /begin AXIS_DESCR COM_AXIS BoostCtlSpeedErrorIn CompuMethod_2 9 -1E+17 1E+17 AXIS_PTS_REF BoostCtlSpeedErrorIdxArr /end AXIS_DESCR
/end CHARACTERISTIC
/begin CHARACTERISTIC BoostCtlITermLowerLimit "Lower limit on Air Min Governor I-term value." VALUE 0x8000082F RecordLayout_4 0 CompuMethod_53 -1E+17 1E+17 /end CHARACTERISTIC
/begin CHARACTERISTIC BoostCtlITermUpperLimit "Upper limit on Air Min Governor I-term value." VALUE 0x80000833 RecordLayout_4 0 CompuMethod_53 -1E+17 1E+17 /end CHARACTERISTIC
/begin CHARACTERISTIC BoostCtlPGain "Base P-gain for the min. governor controller." VALUE 0x80000837 RecordLayout_4 0 CompuMethod_29 -1E+17 1E+17 /end CHARACTERISTIC
/begin CHARACTERISTIC BoostCtlPGainErrorMultTbl "" CURVE 0x8000083B RecordLayout_4 0 CompuMethod_29 -1E+17 1E+17
 /begin AXIS_DESCR COM_AXIS BoostCtlSpeedErrorIn CompuMethod_2 9 -1E+17 1E+17 AXIS_PTS_REF BoostCtlSpeedErrorIdxArr /end AXIS_DESCR
/end CHARACTERISTIC
/begin CHARACTERISTIC BoostCtlPIDOutLowerLimit "Lower limit on air min governor PID Output." VALUE 0x8000085F RecordLayout_4 0 CompuMethod_53 -1E+17 1E+17 /end CHARACTERISTIC
/begin CHARACTERISTIC BoostCtlPIDOutUpperLimit "Upper limit on air min governor PID Output." VALUE 0x80000863 RecordLayout_4 0 CompuMethod_53 -1E+17 1E+17 /end CHARACTERISTIC
/begin CHARACTERISTIC BoostDiag_MAPIRDiagEnable "" VALUE 0x8000088B RecordLayout_2 0 CompuMethod_10 0 1 /end CHARACTERISTIC
/begin CHARACTERISTIC BoostECTLimitTbl "Boost limit as a function of ECT" CURVE 0x8000088C RecordLayout_6 0 CompuMethod_54 0 100
 /begin AXIS_DESCR COM_AXIS ECT05In CompuMethod_60 5 -40 200 AXIS_PTS_REF ECT05IdxArr /end AXIS_DESCR
/end CHARACTERISTIC
/begin CHARACTERISTIC BoostFallRate "Maximum rate boost falls at" VALUE 0x80000891 RecordLayout_4 0 CompuMethod_55 -10000 0 /end CHARACTERISTIC
/begin CHARACTERISTIC BoostIATLimitTbl "Boost limit as a function of IAT" CURVE 0x80000895 RecordLayout_6 0 CompuMethod_54 0 100
 /begin AXIS_DESCR COM_AXIS IAT05In CompuMethod_60 5 -40 300 AXIS_PTS_REF IAT05IdxArr /end AXIS_DESCR
/end CHARACTERISTIC
/begin CHARACTERISTIC BoostRiseRate "Maximum rate boost builds at" VALUE 0x8000089A RecordLayout_4 0 CompuMethod_55 0 10000 /end CHARACTERISTIC
/begin CHARACTERISTIC BoostScrambleAdder "Amount of pressure to increase target by when scramble button is activated" VALUE 0x8000089E RecordLayout_4 0 CompuMethod_51 -100 100 /end CHARACTERISTIC
/begin CHARACTERISTIC BoostTargetMap "Target boost as a function of RPM and VSPD" MAP 0x800008C6 RecordLayout_6 0 CompuMethod_54 0 100
 /begin AXIS_DESCR COM_AXIS RPM09In CompuMethod_72 9 0 14000 AXIS_PTS_REF RPM09IdxArr /end AXIS_DESCR
 /begin AXIS_DESCR COM_AXIS VSPD09In CompuMethod_165 9 -100 200 AXIS_PTS_REF VSPD09IdxArr /end AXIS_DESCR
/end CHARACTERISTIC
/begin CHARACTERISTIC CAMDelay "Delay between the rising edge of the actual CAM signal and the rising edge of the ideal CAM.  If it leads the ideal CAM by one tooth (60-6 system) then the delay would be 6 degCA and 714 degCA if it lagged.  Applicable if crank encoder has >1 sync pts." VALUE 0x80000917 RecordLayout_3 0 CompuMethod_56 0 720 /end CHARACTERISTIC
/begin CHARACTERISTIC CAN_1_TransmitOverrun "Debug value for CAN_1_TransmitOverrun" VALUE 0x80000919 RecordLayout_3 0 CompuMethod_57 0 65535 /end CHARACTERISTIC
/begin CHARACTERISTIC CAN_2_TransmitOverrun "Debug value for CAN_2_TransmitOverrun" VALUE 0x8000091B RecordLayout_3 0 CompuMethod_57 0 65535 /end CHARACTERISTIC
/begin CHARACTERISTIC CAT_new "Override result of linear sensor characterization, in engineering units" VALUE 0x8000091D RecordLayout_4 0 CompuMethod_59 -1E+17 1E+17 /end CHARACTERISTIC
/begin CHARACTERISTIC CAT_ovr "" VALUE 0x80000921 RecordLayout_2 0 CompuMethod_7 0 1 /end CHARACTERISTIC
/begin CHARACTERISTIC CAT_SpkOfstMultMap "Multiplier on IAT2 spark offset table." MAP 0x80000922 RecordLayout_4 0 CompuMethod_29 -1E+17 1E+17
 /begin AXIS_DESCR COM_AXIS RPM09In CompuMethod_72 9 0 14000 AXIS_PTS_REF RPM09IdxArr /end AXIS_DESCR
 /begin AXIS_DESCR COM_AXIS MAP09In CompuMethod_16 9 0 1000 AXIS_PTS_REF MAP09IdxArr /end AXIS_DESCR
/end CHARACTERISTIC
/begin CHARACTERISTIC CAT_SpkOfstTbl "CAT spark offset" CURVE 0x80000A66 RecordLayout_4 0 CompuMethod_2 -50 50
 /begin AXIS_DESCR COM_AXIS CAT05In CompuMethod_60 5 -40 300 AXIS_PTS_REF CAT05IdxArr /end AXIS_DESCR
/end CHARACTERISTIC
/begin CHARACTERISTIC CATDefault "This is the initial default value should the sensor be in fault on key-up.  Otherwise the sensors outputs the last value prior to faulting" VALUE 0x80000A8E RecordLayout_4 0 CompuMethod_59 -1E+17 1E+17 /end CHARACTERISTIC
/begin CHARACTERISTIC CATFiltConst "Filter time constant" VALUE 0x80000A92 RecordLayout_4 0 CompuMethod_19 -1E+17 1E+17 /end CHARACTERISTIC
/begin CHARACTERISTIC CATMax "Maximum allowable input, indicating short or open circuit" VALUE 0x80000ACA RecordLayout_4 0 CompuMethod_21 -1E+17 1E+17 /end CHARACTERISTIC
/begin CHARACTERISTIC CATMin "Minimum allowable input, indicating short or open circuit" VALUE 0x80000ACE RecordLayout_4 0 CompuMethod_21 -1E+17 1E+17 /end CHARACTERISTIC
/begin CHARACTERISTIC CATTbl "Look up table to allownon-linear characterization of sensors" CURVE 0x80000AD2 RecordLayout_4 0 CompuMethod_59 -1E+17 1E+17
 /begin AXIS_DESCR COM_AXIS CATADC CompuMethod_21 13 -1E+17 1E+17 AXIS_PTS_REF CATIdxArr /end AXIS_DESCR
/end CHARACTERISTIC
/begin CHARACTERISTIC CCP1_StationAddr "Station ID for CCP handler: CCP1" VALUE 0x80000B06 RecordLayout_3 0 CompuMethod_5 0 65535 /end CHARACTERISTIC
/begin CHARACTERISTIC CCP1RxID "Receive CAN ID for CCP handler: CCP1" VALUE 0x80000B08 RecordLayout_8 0 CompuMethod_65 0 4294970000 /end CHARACTERISTIC
/begin CHARACTERISTIC CCP1RxIDMask "Receive CAN ID Mask for CCP handler: CCP1" VALUE 0x80000B0C RecordLayout_8 0 CompuMethod_65 0 4294970000 /end CHARACTERISTIC
/begin CHARACTERISTIC CCP1TxID "Transmit CAN ID for CCP handler: CCP1" VALUE 0x80000B10 RecordLayout_8 0 CompuMethod_65 0 4294970000 /end CHARACTERISTIC
/begin CHARACTERISTIC ChargeAirTempEnrichmentMap "Requsted base eq. ratio as a function of CAT and MAP" MAP 0x80000B14 RecordLayout_4 0 CompuMethod_66 0 1E+17
 /begin AXIS_DESCR COM_AXIS CAT05In CompuMethod_60 5 -40 300 AXIS_PTS_REF CAT05IdxArr /end AXIS_DESCR
 /begin AXIS_DESCR COM_AXIS MAP05In CompuMethod_16 5 0 1000 AXIS_PTS_REF MAP05IdxArr /end AXIS_DESCR
/end CHARACTERISTIC
/begin CHARACTERISTIC CityID_CAN_1 "City ID for CAN bus CAN_1" VALUE 0x80000B78 RecordLayout_2 0 CompuMethod_1 0 255 /end CHARACTERISTIC
/begin CHARACTERISTIC CityID_CAN_2 "City ID for CAN bus CAN_2" VALUE 0x80000B79 RecordLayout_2 0 CompuMethod_1 0 255 /end CHARACTERISTIC
/begin CHARACTERISTIC ClearFloodThreshold "In crank mode, throttle commands greater than this threshold will disable crank fueling." VALUE 0x80000B7A RecordLayout_4 0 CompuMethod_67 -1E+17 1E+17 /end CHARACTERISTIC
/begin CHARACTERISTIC ClutchSw_new "Override actuator, in engineering units" VALUE 0x80000B7E RecordLayout_2 0 CompuMethod_23 0 1 /end CHARACTERISTIC
/begin CHARACTERISTIC ClutchSw_ovr "" VALUE 0x80000B7F RecordLayout_2 0 CompuMethod_7 0 1 /end CHARACTERISTIC
/begin CHARACTERISTIC ClutchSwPolarity "0 = High True    1 = Low True" VALUE 0x80000B80 RecordLayout_2 0 CompuMethod_6 0 1 /end CHARACTERISTIC
/begin CHARACTERISTIC ClutchSwSwitchPt "Defines switch point in ADC units boolean conversion" VALUE 0x80000B81 RecordLayout_4 0 CompuMethod_21 -1E+17 1E+17 /end CHARACTERISTIC
/begin CHARACTERISTIC CoilDrvrDlyTime "Coil driver delay time between receipt of EST signal and initiation of coil dwell." VALUE 0x80000B85 RecordLayout_4 0 CompuMethod_68 -1E+17 1E+17 /end CHARACTERISTIC
/begin CHARACTERISTIC CoilDwellMap "Required spark dwell to give the desired spark energy." MAP 0x80000B89 RecordLayout_4 0 CompuMethod_69 -1E+17 1E+17
 /begin AXIS_DESCR COM_AXIS SysVolt09In CompuMethod_152 9 0 32 AXIS_PTS_REF SysVolt09IdxArr /end AXIS_DESCR
 /begin AXIS_DESCR COM_AXIS SpkEnergy09In CompuMethod_2 9 -1E+17 1E+17 AXIS_PTS_REF SpkEnergy09IdxArr /end AXIS_DESCR
/end CHARACTERISTIC
/begin CHARACTERISTIC CombEventsPerRev "Number of conbustion events per engine revolution. For example, for a four-stroke, eight cylinder engine the value would be 4." VALUE 0x80000CCD RecordLayout_2 0 CompuMethod_1 0.5 255 /end CHARACTERISTIC
/begin CHARACTERISTIC Constant_Fuel_Pump "" VALUE 0x80000CCE RecordLayout_2 0 CompuMethod_12 0 1 /end CHARACTERISTIC
/begin CHARACTERISTIC CrankAirflowSetPtTbl "ETC setpoint during cranking." CURVE 0x80000CCF RecordLayout_4 0 CompuMethod_9 -1E+17 1E+17
 /begin AXIS_DESCR COM_AXIS ECT CompuMethod_60 5 -1E+17 1E+17 AXIS_PTS_REF CrankECT05IdxArr /end AXIS_DESCR
/end CHARACTERISTIC
/begin CHARACTERISTIC CrankFPC_IATMultTbl "Crank fuel IAT ultiplier" CURVE 0x80000CF7 RecordLayout_4 0 CompuMethod_2 0 100
 /begin AXIS_DESCR COM_AXIS IAT CompuMethod_60 5 -1E+17 1E+17 AXIS_PTS_REF CrankIAT05IdxArr /end AXIS_DESCR
/end CHARACTERISTIC
/begin CHARACTERISTIC CrankFPC_OXYMultTbl "Crank fuel oxygentation multiplier" CURVE 0x80000D0B RecordLayout_4 0 CompuMethod_2 0 100
 /begin AXIS_DESCR COM_AXIS CrankOXY05In CompuMethod_9 5 -1E+17 1E+17 AXIS_PTS_REF CrankOXY05IdxArr /end AXIS_DESCR
/end CHARACTERISTIC
/begin CHARACTERISTIC CrankFPCMap "Liquid fuel supplied during crank." MAP 0x80000D1F RecordLayout_4 0 CompuMethod_71 0 1E+17
 /begin AXIS_DESCR COM_AXIS CrankRPM05In CompuMethod_72 5 -1E+17 1E+17 AXIS_PTS_REF CrankRPM05IdxArr /end AXIS_DESCR
 /begin AXIS_DESCR COM_AXIS ECT CompuMethod_60 5 -1E+17 1E+17 AXIS_PTS_REF CrankECT05IdxArr /end AXIS_DESCR
/end CHARACTERISTIC
/begin CHARACTERISTIC CrankIAC_IATMultTbl "" CURVE 0x80000D83 RecordLayout_4 0 CompuMethod_2 0 100
 /begin AXIS_DESCR COM_AXIS IAT CompuMethod_60 5 -1E+17 1E+17 AXIS_PTS_REF CrankIAT05IdxArr /end AXIS_DESCR
/end CHARACTERISTIC
/begin CHARACTERISTIC CrankIAC_OXYMultTbl "" CURVE 0x80000D97 RecordLayout_4 0 CompuMethod_2 0 100
 /begin AXIS_DESCR COM_AXIS CrankOXY05In CompuMethod_9 5 -1E+17 1E+17 AXIS_PTS_REF CrankOXY05IdxArr /end AXIS_DESCR
/end CHARACTERISTIC
/begin CHARACTERISTIC CrankIACMap "Base IAC % While Cranking" MAP 0x80000DAB RecordLayout_4 0 CompuMethod_9 0 100
 /begin AXIS_DESCR COM_AXIS CrankRPM05In CompuMethod_72 5 -1E+17 1E+17 AXIS_PTS_REF CrankRPM05IdxArr /end AXIS_DESCR
 /begin AXIS_DESCR COM_AXIS ECT CompuMethod_60 5 -1E+17 1E+17 AXIS_PTS_REF CrankECT05IdxArr /end AXIS_DESCR
/end CHARACTERISTIC
/begin CHARACTERISTIC CrankMakeUpEOITbl "Start of injection during cranking." CURVE 0x80000E23 RecordLayout_4 0 CompuMethod_70 -920 920
 /begin AXIS_DESCR COM_AXIS CrankRPM05In CompuMethod_72 5 -1E+17 1E+17 AXIS_PTS_REF CrankRPM05IdxArr /end AXIS_DESCR
/end CHARACTERISTIC
/begin CHARACTERISTIC CrankSOITbl "Start of injection during cranking." CURVE 0x80000E5F RecordLayout_4 0 CompuMethod_70 -920 920
 /begin AXIS_DESCR COM_AXIS CrankRPM05In CompuMethod_72 5 -1E+17 1E+17 AXIS_PTS_REF CrankRPM05IdxArr /end AXIS_DESCR
/end CHARACTERISTIC
/begin CHARACTERISTIC CrankSparkMap "Spark adv during cranking." MAP 0x80000E73 RecordLayout_4 0 CompuMethod_70 -100 100
 /begin AXIS_DESCR COM_AXIS CrankRPM05In CompuMethod_72 5 -1E+17 1E+17 AXIS_PTS_REF CrankRPM05IdxArr /end AXIS_DESCR
 /begin AXIS_DESCR COM_AXIS ECT CompuMethod_60 5 -1E+17 1E+17 AXIS_PTS_REF CrankECT05IdxArr /end AXIS_DESCR
/end CHARACTERISTIC
/begin CHARACTERISTIC CrankSpkEnergyMap "Spark energy during cranking." MAP 0x80000ED7 RecordLayout_4 0 CompuMethod_73 0 1E+17
 /begin AXIS_DESCR COM_AXIS CrankRPM05In CompuMethod_72 5 -1E+17 1E+17 AXIS_PTS_REF CrankRPM05IdxArr /end AXIS_DESCR
 /begin AXIS_DESCR COM_AXIS ECT CompuMethod_60 5 -1E+17 1E+17 AXIS_PTS_REF CrankECT05IdxArr /end AXIS_DESCR
/end CHARACTERISTIC
/begin CHARACTERISTIC CrankToRunRPMThresh "RPM above which RUN mode can be entered from CRANK mode." VALUE 0x80000F3B RecordLayout_3 0 CompuMethod_22 0 65535 /end CHARACTERISTIC
/begin CHARACTERISTIC CylSweptVol "Cylinder swept volume for a single cylinder." VALUE 0x80000F3D RecordLayout_4 0 CompuMethod_74 0 1E+17 /end CHARACTERISTIC
/begin CHARACTERISTIC DeltaMAP_FiltConst "Filter time constant" VALUE 0x80000F41 RecordLayout_4 0 CompuMethod_19 -1E+17 1E+17 /end CHARACTERISTIC
/begin CHARACTERISTIC DeltaMAP_MultMap "Transient Fueling Multiplier for adjustment based on delta MAP" MAP 0x80000F45 RecordLayout_4 0 CompuMethod_29 -1E+17 1E+17
 /begin AXIS_DESCR COM_AXIS DeltaMAP17In CompuMethod_2 17 -1E+17 1E+17 AXIS_PTS_REF DeltaMAP17IdxArr /end AXIS_DESCR
 /begin AXIS_DESCR COM_AXIS MAF09In CompuMethod_2 9 -1E+17 1E+17 AXIS_PTS_REF MAF09IdxArr /end AXIS_DESCR
/end CHARACTERISTIC
/begin CHARACTERISTIC DeltaTPS_FiltConst "Filter time constant" VALUE 0x800011ED RecordLayout_4 0 CompuMethod_19 -1E+17 1E+17 /end CHARACTERISTIC
/begin CHARACTERISTIC DeltaTPS_MultMap "Transient Fueling Multiplier for adjustment based on delta TPS" MAP 0x800011F1 RecordLayout_4 0 CompuMethod_29 -1E+17 1E+17
 /begin AXIS_DESCR COM_AXIS DeltaTPS17In CompuMethod_2 17 -1E+17 1E+17 AXIS_PTS_REF DeltaTPS17IdxArr /end AXIS_DESCR
 /begin AXIS_DESCR COM_AXIS MAF09In CompuMethod_2 9 -1E+17 1E+17 AXIS_PTS_REF MAF09IdxArr /end AXIS_DESCR
/end CHARACTERISTIC
/begin CHARACTERISTIC DeltaTPSFuelingEnable "Enable Delta TPS transient fuel algorithm" VALUE 0x80001499 RecordLayout_2 0 CompuMethod_10 0 1 /end CHARACTERISTIC
/begin CHARACTERISTIC DesAFRatioTbl "" CURVE 0x800014C6 RecordLayout_4 0 CompuMethod_75 0 20
 /begin AXIS_DESCR COM_AXIS DesAFRatioIn CompuMethod_76 11 0 100 AXIS_PTS_REF DesAFRatioIdxArr /end AXIS_DESCR
/end CHARACTERISTIC
/begin CHARACTERISTIC DesEquivRatioMap "Desired liquid equivalence ratio." MAP 0x80001516 RecordLayout_4 0 CompuMethod_2 0 1E+17
 /begin AXIS_DESCR COM_AXIS RPM17In CompuMethod_72 17 0 14000 AXIS_PTS_REF RPM17IdxArr /end AXIS_DESCR
 /begin AXIS_DESCR COM_AXIS MAP17In CompuMethod_16 17 0 1000 AXIS_PTS_REF MAP17IdxArr /end AXIS_DESCR
/end CHARACTERISTIC
/begin CHARACTERISTIC DFCODelayTime "DFCO delay enter time" VALUE 0x8000199A RecordLayout_4 0 CompuMethod_19 0 1000000 /end CHARACTERISTIC
/begin CHARACTERISTIC DFCOEnable "" VALUE 0x8000199E RecordLayout_2 0 CompuMethod_10 0 1 /end CHARACTERISTIC
/begin CHARACTERISTIC DFCOEnterIdleSpeed "DFCO entry above idle speed setpoint" VALUE 0x8000199F RecordLayout_7 0 CompuMethod_22 0 7000 /end CHARACTERISTIC
/begin CHARACTERISTIC DFCOEnterRampTime "DFCO enter ramp time" VALUE 0x800019A1 RecordLayout_4 0 CompuMethod_19 -1E+17 1E+17 /end CHARACTERISTIC
/begin CHARACTERISTIC DFCOEntryAPP "DFCO APP entry threshold" VALUE 0x800019A5 RecordLayout_4 0 CompuMethod_9 0 100 /end CHARACTERISTIC
/begin CHARACTERISTIC DFCOEntryMAP "DFCO MAP entry threshold" VALUE 0x800019A9 RecordLayout_2 0 CompuMethod_79 0 255 /end CHARACTERISTIC
/begin CHARACTERISTIC DFCOEntryRPMTbl "" CURVE 0x800019AA RecordLayout_4 0 CompuMethod_2 -1E+17 1E+17
 /begin AXIS_DESCR COM_AXIS ECT05In CompuMethod_60 5 -40 200 AXIS_PTS_REF ECT05IdxArr /end AXIS_DESCR
/end CHARACTERISTIC
/begin CHARACTERISTIC DFCOExitAPP "DFCO exit APP threshold" VALUE 0x800019BE RecordLayout_4 0 CompuMethod_9 0 100 /end CHARACTERISTIC
/begin CHARACTERISTIC DFCOExitIdleSpeed "DFCO exit offset from desired idle speed" VALUE 0x800019C2 RecordLayout_7 0 CompuMethod_22 0 7000 /end CHARACTERISTIC
/begin CHARACTERISTIC DFCOExitMAP "DFCO exit MAP threhsold" VALUE 0x800019C4 RecordLayout_2 0 CompuMethod_79 0 255 /end CHARACTERISTIC
/begin CHARACTERISTIC DFCOExitRampTime "DFCO exit ramp time" VALUE 0x800019C5 RecordLayout_4 0 CompuMethod_19 -1E+17 1E+17 /end CHARACTERISTIC
/begin CHARACTERISTIC DFCOExitRPMTbl "" CURVE 0x800019C9 RecordLayout_4 0 CompuMethod_2 -1E+17 1E+17
 /begin AXIS_DESCR COM_AXIS ECT05In CompuMethod_60 5 -40 200 AXIS_PTS_REF ECT05IdxArr /end AXIS_DESCR
/end CHARACTERISTIC
/begin CHARACTERISTIC DFCOExitSparkRet "DFCO exit spark retard" VALUE 0x800019DD RecordLayout_7 0 CompuMethod_80 -100 100 /end CHARACTERISTIC
/begin CHARACTERISTIC DigDiag_ClutchStuckTime "" VALUE 0x800019DF RecordLayout_4 0 CompuMethod_2 -1E+17 1E+17 /end CHARACTERISTIC
/begin CHARACTERISTIC DigDiag_ScrambleStuckTime "" VALUE 0x800019E3 RecordLayout_4 0 CompuMethod_2 -1E+17 1E+17 /end CHARACTERISTIC
/begin CHARACTERISTIC ECT_KeyUp_Count "Number of samples to average at key-up to produce signal value" VALUE 0x800019E7 RecordLayout_6 0 CompuMethod_1 -128 127 /end CHARACTERISTIC
/begin CHARACTERISTIC ECT_new "Override result of linear sensor characterization, in engineering units" VALUE 0x80001A0C RecordLayout_4 0 CompuMethod_59 -1E+17 1E+17 /end CHARACTERISTIC
/begin CHARACTERISTIC ECT_ovr "" VALUE 0x80001A10 RecordLayout_2 0 CompuMethod_7 0 1 /end CHARACTERISTIC
/begin CHARACTERISTIC ECT_SpkOfstMultMap "Multiplier on ECT spark offset table." MAP 0x80001A11 RecordLayout_4 0 CompuMethod_2 -100 100
 /begin AXIS_DESCR COM_AXIS RPM09In CompuMethod_72 9 0 14000 AXIS_PTS_REF RPM09IdxArr /end AXIS_DESCR
 /begin AXIS_DESCR COM_AXIS MAP09In CompuMethod_16 9 0 1000 AXIS_PTS_REF MAP09IdxArr /end AXIS_DESCR
/end CHARACTERISTIC
/begin CHARACTERISTIC ECT_SpkOfstTbl "ECT spark offset" CURVE 0x80001B55 RecordLayout_4 0 CompuMethod_70 -50 50
 /begin AXIS_DESCR COM_AXIS ECT05In CompuMethod_60 5 -40 200 AXIS_PTS_REF ECT05IdxArr /end AXIS_DESCR
/end CHARACTERISTIC
/begin CHARACTERISTIC ECTDefault "This is the initial default value should the sensor be in fault on key-up.  Otherwise the sensors outputs the last value prior to faulting" VALUE 0x80001BBD RecordLayout_4 0 CompuMethod_59 -1E+17 1E+17 /end CHARACTERISTIC
/begin CHARACTERISTIC ECTFanOff "ECT temp when the fan turns off" VALUE 0x80001BC1 RecordLayout_4 0 CompuMethod_60 -1E+17 1E+17 /end CHARACTERISTIC
/begin CHARACTERISTIC ECTFanOn "ECT temp when the fan turns on" VALUE 0x80001BC5 RecordLayout_4 0 CompuMethod_60 -1E+17 1E+17 /end CHARACTERISTIC
/begin CHARACTERISTIC ECTFanSpeed_StallTbl "" CURVE 0x80001BC9 RecordLayout_4 0 CompuMethod_2 -1E+17 1E+17
 /begin AXIS_DESCR COM_AXIS ECT05In CompuMethod_60 5 -40 200 AXIS_PTS_REF ECT05IdxArr /end AXIS_DESCR
/end CHARACTERISTIC
/begin CHARACTERISTIC ECTFanSpeedMap "" MAP 0x80001BDD RecordLayout_4 0 CompuMethod_2 -1E+17 1E+17
 /begin AXIS_DESCR COM_AXIS VSPD07In CompuMethod_165 7 -100 200 AXIS_PTS_REF VSPD07IdxArr /end AXIS_DESCR
 /begin AXIS_DESCR COM_AXIS ECT07In CompuMethod_60 7 -40 200 AXIS_PTS_REF ECT07IdxArr /end AXIS_DESCR
/end CHARACTERISTIC
/begin CHARACTERISTIC ECTFiltConst "Filter time constant" VALUE 0x80001CA1 RecordLayout_4 0 CompuMethod_19 -1E+17 1E+17 /end CHARACTERISTIC
/begin CHARACTERISTIC ECTMax "Maximum allowable input, indicating short or open circuit" VALUE 0x80001CD9 RecordLayout_4 0 CompuMethod_21 -1E+17 1E+17 /end CHARACTERISTIC
/begin CHARACTERISTIC ECTMin "Minimum allowable input, indicating short or open circuit" VALUE 0x80001CDD RecordLayout_4 0 CompuMethod_21 -1E+17 1E+17 /end CHARACTERISTIC
/begin CHARACTERISTIC ECTTbl "Look up table to allownon-linear characterization of sensors" CURVE 0x80001CE1 RecordLayout_4 0 CompuMethod_59 -1E+17 1E+17
 /begin AXIS_DESCR COM_AXIS ECTADC CompuMethod_21 13 -1E+17 1E+17 AXIS_PTS_REF ECTIdxArr /end AXIS_DESCR
/end CHARACTERISTIC
/begin CHARACTERISTIC ECTTransFuelMultTbl "Transient fuel multiplier based on ECT.  Only engaged during transient fueling" CURVE 0x80001D15 RecordLayout_4 0 CompuMethod_2 -1E+17 1E+17
 /begin AXIS_DESCR COM_AXIS ECT05In CompuMethod_60 5 -40 200 AXIS_PTS_REF ECT05IdxArr /end AXIS_DESCR
/end CHARACTERISTIC
/begin CHARACTERISTIC ECUP_Threshold "ADC voltage threshold above which ECU is considered powered" VALUE 0x80001D29 RecordLayout_3 0 CompuMethod_81 0 1023 /end CHARACTERISTIC
/begin CHARACTERISTIC ECUVolt_Filt "Filter time constant" VALUE 0x80001D2B RecordLayout_4 0 CompuMethod_19 -1E+17 1E+17 /end CHARACTERISTIC
/begin CHARACTERISTIC Elec_PW_new "" VALUE 0x80001D2F RecordLayout_4 0 CompuMethod_2 -1E+17 1E+17 /end CHARACTERISTIC
/begin CHARACTERISTIC Elec_PW_ovr "" VALUE 0x80001D33 RecordLayout_2 0 CompuMethod_7 0 1 /end CHARACTERISTIC
/begin CHARACTERISTIC EnableRPMFalling "If disabled, Min Gov will enable immediately after cranking without waiting for falling RPM." VALUE 0x80001D34 RecordLayout_2 0 CompuMethod_6 0 1 /end CHARACTERISTIC
/begin CHARACTERISTIC EncoderCrankTeethAfterCam "The number of crank teeth between the synchronizing edge of the cam and the first tooth in the crank pattern. May be -1 to disable explicit tooth counting." VALUE 0x80001D35 RecordLayout_7 0 CompuMethod_82 -1 255 /end CHARACTERISTIC
/begin CHARACTERISTIC EncoderNumCylinders "Number of cylinders" VALUE 0x80001D37 RecordLayout_2 0 CompuMethod_1 1 8 /end CHARACTERISTIC
/begin CHARACTERISTIC EncoderTDCAngles "TDC angle of each cylinder in degrees after TDC1" VAL_BLK 0x80001D38 RecordLayout_7 0 CompuMethod_85 0 720 MATRIX_DIM 8 1 1 /end CHARACTERISTIC
/begin CHARACTERISTIC EngineAccelFiltConst "Filter time constant" VALUE 0x80001D48 RecordLayout_4 0 CompuMethod_19 -1E+17 1E+17 /end CHARACTERISTIC
/begin CHARACTERISTIC EngineShutdownDelayTime "Delays the engine shutdown when DelayedEngineShutdown fault-action is active." VALUE 0x80001D4C RecordLayout_4 0 CompuMethod_45 0 1E+17 /end CHARACTERISTIC
/begin CHARACTERISTIC EngineToEncoderOffset "" VALUE 0x80001D50 RecordLayout_4 0 CompuMethod_2 -1E+17 1E+17 /end CHARACTERISTIC
/begin CHARACTERISTIC EqRatio_SpkOfsMultMap "Speed and Load Multiplier to the Equivalence Ratio Spark Offset table." MAP 0x80001D54 RecordLayout_4 0 CompuMethod_29 -1E+17 1E+17
 /begin AXIS_DESCR COM_AXIS RPM09In CompuMethod_72 9 0 14000 AXIS_PTS_REF RPM09IdxArr /end AXIS_DESCR
 /begin AXIS_DESCR COM_AXIS MAP09In CompuMethod_16 9 0 1000 AXIS_PTS_REF MAP09IdxArr /end AXIS_DESCR
/end CHARACTERISTIC
/begin CHARACTERISTIC EqRatio_SpkOfstTbl "Spark offset based on desired equivalence ratio (also muliplied by a speed load factor)" CURVE 0x80001E98 RecordLayout_4 0 CompuMethod_88 -1E+17 1E+17
 /begin AXIS_DESCR COM_AXIS DesEqRatio09In CompuMethod_77 9 0 1E+17 AXIS_PTS_REF DesEqRatio09IdxArr /end AXIS_DESCR
/end CHARACTERISTIC
/begin CHARACTERISTIC EquivRatio_new "" VALUE 0x80001EBC RecordLayout_4 0 CompuMethod_2 -1E+17 1E+17 /end CHARACTERISTIC
/begin CHARACTERISTIC EquivRatio_ovr "" VALUE 0x80001EC0 RecordLayout_2 0 CompuMethod_7 0 1 /end CHARACTERISTIC
/begin CHARACTERISTIC EquivRatioDelta "Equivalence ratio has to be with this band of 1 to achieve close loop." VALUE 0x80001EC1 RecordLayout_4 0 CompuMethod_89 -1E+17 1E+17 /end CHARACTERISTIC
/begin CHARACTERISTIC ESTOP_FuelInj_Ovr_new "" VALUE 0x80001EC5 RecordLayout_2 0 CompuMethod_12 0 1 /end CHARACTERISTIC
/begin CHARACTERISTIC ESTOP_FuelInj_Ovr_ovr "" VALUE 0x80001EC6 RecordLayout_2 0 CompuMethod_7 0 1 /end CHARACTERISTIC
/begin CHARACTERISTIC ESTOP_new "Override actuator, in engineering units" VALUE 0x80001EC7 RecordLayout_2 0 CompuMethod_23 0 1 /end CHARACTERISTIC
/begin CHARACTERISTIC ESTOP_ovr "" VALUE 0x80001EC8 RecordLayout_2 0 CompuMethod_7 0 1 /end CHARACTERISTIC
/begin CHARACTERISTIC ESTOPPolarity "0 = High True    1 = Low True" VALUE 0x80001EC9 RecordLayout_2 0 CompuMethod_6 0 1 /end CHARACTERISTIC
/begin CHARACTERISTIC ETC_CutPower_ETC "Cut power to ETC if ETC request is less than this" VALUE 0x80001ECA RecordLayout_4 0 CompuMethod_93 0 100 /end CHARACTERISTIC
/begin CHARACTERISTIC ETC_CutPower_Permitted "Cut power to ETC after ESTOP or long stalled period" VALUE 0x80001ECE RecordLayout_2 0 CompuMethod_94 0 1 /end CHARACTERISTIC
/begin CHARACTERISTIC ETC_CutPower_StallTime "Cut power to ETC after stalled this long" VALUE 0x80001ECF RecordLayout_4 0 CompuMethod_95 0 100 /end CHARACTERISTIC
/begin CHARACTERISTIC ETC_Frequency "Frequency of PWM output" VALUE 0x80001EFB RecordLayout_4 0 CompuMethod_96 7.63 1E+17 /end CHARACTERISTIC
/begin CHARACTERISTIC ETC_I_MIN "H-bridge open circuit fault:  ETC current must exceed this when ETC duty cycle is > ETC_OC_MIN, otherwise an open circuit fault may exist." VALUE 0x80001EFF RecordLayout_4 0 CompuMethod_97 0 1E+17 /end CHARACTERISTIC
/begin CHARACTERISTIC ETC_OC_MIN "H-bridge open circuit fault:  ETC duty cycle must exceed this to enable open circuit fault detection." VALUE 0x80001F3F RecordLayout_4 0 CompuMethod_9 0 1E+17 /end CHARACTERISTIC
/begin CHARACTERISTIC ETC_Offset "Offset from engineering units to PWM duty cycle" VALUE 0x80001F43 RecordLayout_4 0 CompuMethod_9 -1E+17 1E+17 /end CHARACTERISTIC
/begin CHARACTERISTIC ETC_ShutdownLoAdaptError "Drive ETC closed until this error has been achieved in order to catch lo side adapt point." VALUE 0x80001FC0 RecordLayout_4 0 CompuMethod_9 -1E+17 1E+17 /end CHARACTERISTIC
/begin CHARACTERISTIC ETC_SpringTestHiThresh "Before initiating spring test during shutdown, open the ETC to this setpoint. When achieved, the ETC controller will release the ETC to have the spring close the valve." VALUE 0x80001FC4 RecordLayout_4 0 CompuMethod_9 -1E+17 1E+17 /end CHARACTERISTIC
/begin CHARACTERISTIC ETC_SpringTestLoThresh "Spring test timer will measure time of travel between ETC_SpringTestHiThresh and ETC_SpringTestLoThresh." VALUE 0x80001FC8 RecordLayout_4 0 CompuMethod_9 -1E+17 1E+17 /end CHARACTERISTIC
/begin CHARACTERISTIC ETC_SpringTestTimerThresh "During spring test at shutdown, TPS must fall to 0% within this time to prevent fault." VALUE 0x80001FCC RecordLayout_4 0 CompuMethod_45 -1E+17 1E+17 /end CHARACTERISTIC
/begin CHARACTERISTIC ETC_VoltageCompTbl "Gain on ETC duty cycle based on DRVP" CURVE 0x80001FDC RecordLayout_4 0 CompuMethod_2 -1E+17 1E+17
 /begin AXIS_DESCR COM_AXIS SysVolt09In CompuMethod_152 9 0 32 AXIS_PTS_REF SysVolt09IdxArr /end AXIS_DESCR
/end CHARACTERISTIC
/begin CHARACTERISTIC ETCDampGainDown "PID Damper Gain - Down Direction" VALUE 0x8000200C RecordLayout_4 0 CompuMethod_29 -1E+17 1E+17 /end CHARACTERISTIC
/begin CHARACTERISTIC ETCDampGainUp "PID Damper Gain - Up Direction" VALUE 0x80002010 RecordLayout_4 0 CompuMethod_29 -1E+17 1E+17 /end CHARACTERISTIC
/begin CHARACTERISTIC ETCDCOffsetTbl "Duty cycle offset based on desired ETC position." CURVE 0x80002014 RecordLayout_4 0 CompuMethod_9 -1E+17 1E+17
 /begin AXIS_DESCR COM_AXIS ETC_SetpointIn CompuMethod_2 20 -1E+17 1E+17 AXIS_PTS_REF ETC_SetpointIdxArr /end AXIS_DESCR
/end CHARACTERISTIC
/begin CHARACTERISTIC ETCDGain "PID Derivative Gain" VALUE 0x80002064 RecordLayout_4 0 CompuMethod_29 -1E+17 1E+17 /end CHARACTERISTIC
/begin CHARACTERISTIC ETCErrorGain "PID Error Gain" VALUE 0x80002068 RecordLayout_4 0 CompuMethod_29 -1E+17 1E+17 /end CHARACTERISTIC
/begin CHARACTERISTIC ETCIMax "PID Integrator Upper Limit" VALUE 0x80002070 RecordLayout_4 0 CompuMethod_9 -1E+17 1E+17 /end CHARACTERISTIC
/begin CHARACTERISTIC ETCIMin "PID Integrator Lower Limit" VALUE 0x80002074 RecordLayout_4 0 CompuMethod_9 -1E+17 1E+17 /end CHARACTERISTIC
/begin CHARACTERISTIC ETCReq_Filt "Filter time constant" VALUE 0x80002080 RecordLayout_4 0 CompuMethod_19 -1E+17 1E+17 /end CHARACTERISTIC
/begin CHARACTERISTIC ETCReqDecFiltC "Filter time constant for a decreasing ETC Request signal." VALUE 0x80002089 RecordLayout_4 0 CompuMethod_19 -1E+17 1E+17 /end CHARACTERISTIC
/begin CHARACTERISTIC ETCReqFallRateTbl "Limits fall rate of ETCRequestFiltered." CURVE 0x8000208D RecordLayout_4 0 CompuMethod_99 -10000 0
 /begin AXIS_DESCR COM_AXIS TPS09In CompuMethod_9 9 0 100 AXIS_PTS_REF TPS09IdxArr /end AXIS_DESCR
/end CHARACTERISTIC
/begin CHARACTERISTIC ETCReqIncFiltC "Filter time constant for a decreasing ETC Request signal." VALUE 0x800020B1 RecordLayout_4 0 CompuMethod_19 -1E+17 1E+17 /end CHARACTERISTIC
/begin CHARACTERISTIC ETCReqRiseRateTbl "Limits rise rate of ETCRequestFiltered." CURVE 0x800020B5 RecordLayout_4 0 CompuMethod_99 0 10000
 /begin AXIS_DESCR COM_AXIS TPS09In CompuMethod_9 9 0 100 AXIS_PTS_REF TPS09IdxArr /end AXIS_DESCR
/end CHARACTERISTIC
/begin CHARACTERISTIC ETCRequestMap "Driver demand table" MAP 0x800020D9 RecordLayout_4 0 CompuMethod_9 0 100
 /begin AXIS_DESCR COM_AXIS APP17In CompuMethod_9 17 0 100 AXIS_PTS_REF APP17IdxArr /end AXIS_DESCR
 /begin AXIS_DESCR COM_AXIS VSPD17In CompuMethod_165 17 -100 200 AXIS_PTS_REF VSPD17IdxArr /end AXIS_DESCR
/end CHARACTERISTIC
/begin CHARACTERISTIC FAN_Mode "" VALUE 0x8000274B RecordLayout_2 0 CompuMethod_101 0 1 /end CHARACTERISTIC
/begin CHARACTERISTIC Fan1ACPres "Fan Enabler" VALUE 0x80002765 RecordLayout_2 0 CompuMethod_10 0 1 /end CHARACTERISTIC
/begin CHARACTERISTIC Fan1ACSw "Fan Enabler" VALUE 0x80002766 RecordLayout_2 0 CompuMethod_10 0 1 /end CHARACTERISTIC
/begin CHARACTERISTIC Fan1ECT "Fan Enabler" VALUE 0x80002767 RecordLayout_2 0 CompuMethod_10 0 1 /end CHARACTERISTIC
/begin CHARACTERISTIC Fan1IAT "Fan Enabler" VALUE 0x80002768 RecordLayout_2 0 CompuMethod_10 0 1 /end CHARACTERISTIC
/begin CHARACTERISTIC Fan2ACPres "Fan Enabler" VALUE 0x80002782 RecordLayout_2 0 CompuMethod_10 0 1 /end CHARACTERISTIC
/begin CHARACTERISTIC Fan2ACSw "Fan Enabler" VALUE 0x80002783 RecordLayout_2 0 CompuMethod_10 0 1 /end CHARACTERISTIC
/begin CHARACTERISTIC Fan2ECT "Fan Enabler" VALUE 0x80002784 RecordLayout_2 0 CompuMethod_10 0 1 /end CHARACTERISTIC
/begin CHARACTERISTIC Fan2IAT "Fan Enabler" VALUE 0x80002785 RecordLayout_2 0 CompuMethod_10 0 1 /end CHARACTERISTIC
/begin CHARACTERISTIC FGNDTaskStackMargin "When the available FGNDTask stack space drops below this threshold, the application performs a safety stop" VALUE 0x800037FF RecordLayout_3 0 CompuMethod_35 0 4096 /end CHARACTERISTIC
/begin CHARACTERISTIC ForcedShutDownTimerThresh "If ECUP is off for this time and application has not turned off, then force a shutdown routine." VALUE 0x8000380A RecordLayout_4 0 CompuMethod_19 0 1023 /end CHARACTERISTIC
/begin CHARACTERISTIC FuelAdaptDelta "O2_Error must be less than this delta to adapt the FuelFlowComp map" VALUE 0x8000384B RecordLayout_4 0 CompuMethod_29 0 2 /end CHARACTERISTIC
/begin CHARACTERISTIC FuelAdaptEnable "Determines whether the FuelFlowComp map will be adapted using the MAF sensor" VALUE 0x8000384F RecordLayout_2 0 CompuMethod_26 0 1 /end CHARACTERISTIC
/begin CHARACTERISTIC FuelAdaptGain_BankATbl "Gain for updating FuelFlowComp map.  This fraction of the error is added to the map every 5ms." CURVE 0x80003860 RecordLayout_4 0 CompuMethod_47 -1E+17 1E+17
 /begin AXIS_DESCR COM_AXIS O2ITerm_BankAIn CompuMethod_29 5 -1E+17 1E+17 AXIS_PTS_REF O2ITerm_BankAIdxArr /end AXIS_DESCR
/end CHARACTERISTIC
/begin CHARACTERISTIC FuelAdaptGain_BankBTbl "Gain for updating FuelFlowComp map.  This fraction of the error is added to the map every 5ms." CURVE 0x80003874 RecordLayout_4 0 CompuMethod_47 -1E+17 1E+17
 /begin AXIS_DESCR COM_AXIS O2ITerm_BankBIn CompuMethod_29 5 -1E+17 1E+17 AXIS_PTS_REF O2ITerm_BankBIdxArr /end AXIS_DESCR
/end CHARACTERISTIC
/begin CHARACTERISTIC FuelFlowCompAdapt_BankAMap "Adapt map based on O2 ITerm that is multiplied into FuelFlowComp." MAP 0x8000388C RecordLayout_4 0 CompuMethod_29 -1E+17 1E+17
 /begin AXIS_DESCR COM_AXIS RPM09In CompuMethod_72 9 0 14000 AXIS_PTS_REF RPM09IdxArr /end AXIS_DESCR
 /begin AXIS_DESCR COM_AXIS MAP09In CompuMethod_16 9 0 1000 AXIS_PTS_REF MAP09IdxArr /end AXIS_DESCR
/end CHARACTERISTIC
/begin CHARACTERISTIC FuelFlowCompAdapt_BankBMap "Adapt map based on O2 ITerm that is multiplied into FuelFlowComp." MAP 0x800039D0 RecordLayout_4 0 CompuMethod_29 -1E+17 1E+17
 /begin AXIS_DESCR COM_AXIS RPM09In CompuMethod_72 9 0 14000 AXIS_PTS_REF RPM09IdxArr /end AXIS_DESCR
 /begin AXIS_DESCR COM_AXIS MAP09In CompuMethod_16 9 0 1000 AXIS_PTS_REF MAP09IdxArr /end AXIS_DESCR
/end CHARACTERISTIC
/begin CHARACTERISTIC FuelFlowCompMap "Fuel Flow Compensation Multiplier - gain to adjust modelling errors in mechanical fuel system." MAP 0x80003B14 RecordLayout_4 0 CompuMethod_29 -1E+17 1E+17
 /begin AXIS_DESCR COM_AXIS RPM09In CompuMethod_72 9 0 14000 AXIS_PTS_REF RPM09IdxArr /end AXIS_DESCR
 /begin AXIS_DESCR COM_AXIS MAP09In CompuMethod_16 9 0 1000 AXIS_PTS_REF MAP09IdxArr /end AXIS_DESCR
/end CHARACTERISTIC
/begin CHARACTERISTIC FuelPumpStartTime "The length of time for the Fuel Pump relay to be enabled at startup" VALUE 0x80003D9C RecordLayout_4 0 CompuMethod_19 0 100 /end CHARACTERISTIC
/begin CHARACTERISTIC HardOverBoostLimit "Hard overboost limit" VALUE 0x80003E0B RecordLayout_4 0 CompuMethod_51 -1E+17 1E+17 /end CHARACTERISTIC
/begin CHARACTERISTIC HardRevOffset "RPM rev limit for hard action to be taken" VALUE 0x80003E0F RecordLayout_7 0 CompuMethod_22 0 32767 /end CHARACTERISTIC
/begin CHARACTERISTIC HeapMargin "When the available heap drops below this threshold, the application performs a safety stop" VALUE 0x80003E11 RecordLayout_3 0 CompuMethod_35 0 2048 /end CHARACTERISTIC
/begin CHARACTERISTIC IACTypeCal "" VALUE 0x80003E45 RecordLayout_2 0 CompuMethod_117 0 255 /end CHARACTERISTIC
/begin CHARACTERISTIC IAT_SpkOfstMultMap "Multiplier on IAT spark offset table." MAP 0x80003E70 RecordLayout_4 0 CompuMethod_2 -100 100
 /begin AXIS_DESCR COM_AXIS RPM09In CompuMethod_72 9 0 14000 AXIS_PTS_REF RPM09IdxArr /end AXIS_DESCR
 /begin AXIS_DESCR COM_AXIS MAP09In CompuMethod_16 9 0 1000 AXIS_PTS_REF MAP09IdxArr /end AXIS_DESCR
/end CHARACTERISTIC
/begin CHARACTERISTIC IAT_SpkOfstTbl "IAT spark offset" CURVE 0x80003FB4 RecordLayout_4 0 CompuMethod_70 -50 50
 /begin AXIS_DESCR COM_AXIS IAT05In CompuMethod_60 5 -40 300 AXIS_PTS_REF IAT05IdxArr /end AXIS_DESCR
/end CHARACTERISTIC
/begin CHARACTERISTIC IATFanOff "IAT temp when the fan turns off" VALUE 0x80004040 RecordLayout_4 0 CompuMethod_60 -1E+17 1E+17 /end CHARACTERISTIC
/begin CHARACTERISTIC IATFanOn "IAT temp when the fan turns on" VALUE 0x80004044 RecordLayout_4 0 CompuMethod_60 -1E+17 1E+17 /end CHARACTERISTIC
/begin CHARACTERISTIC IATFanSpeed_StallTbl "" CURVE 0x80004048 RecordLayout_4 0 CompuMethod_2 -1E+17 1E+17
 /begin AXIS_DESCR COM_AXIS IAT05In CompuMethod_60 5 -40 300 AXIS_PTS_REF IAT05IdxArr /end AXIS_DESCR
/end CHARACTERISTIC
/begin CHARACTERISTIC IATFanSpeedMap "" MAP 0x8000405C RecordLayout_4 0 CompuMethod_2 -1E+17 1E+17
 /begin AXIS_DESCR COM_AXIS VSPD07In CompuMethod_165 7 -100 200 AXIS_PTS_REF VSPD07IdxArr /end AXIS_DESCR
 /begin AXIS_DESCR COM_AXIS IAT07In CompuMethod_60 7 -40 300 AXIS_PTS_REF IAT07IdxArr /end AXIS_DESCR
/end CHARACTERISTIC
/begin CHARACTERISTIC IdleExitTimeConst "Time constant for idle air and spark ramp out" VALUE 0x80004198 RecordLayout_4 0 CompuMethod_118 0 100 /end CHARACTERISTIC
/begin CHARACTERISTIC InGearMinGovEntryRPMDelta "RPM above setpoint where Min Gov will enable when RPM is falling into idle." VALUE 0x8000419C RecordLayout_7 0 CompuMethod_22 -32768 32767 /end CHARACTERISTIC
/begin CHARACTERISTIC InjectiorMinDuration "Fuel injector min pulsewidth" VALUE 0x800041EA RecordLayout_4 0 CompuMethod_69 -1E+17 1E+17 /end CHARACTERISTIC
/begin CHARACTERISTIC Injector1Enable "" VALUE 0x800041EE RecordLayout_2 0 CompuMethod_10 0 1 /end CHARACTERISTIC
/begin CHARACTERISTIC Injector2Enable "" VALUE 0x800041EF RecordLayout_2 0 CompuMethod_10 0 1 /end CHARACTERISTIC
/begin CHARACTERISTIC Injector3Enable "" VALUE 0x800041F0 RecordLayout_2 0 CompuMethod_10 0 1 /end CHARACTERISTIC
/begin CHARACTERISTIC Injector4Enable "" VALUE 0x800041F1 RecordLayout_2 0 CompuMethod_10 0 1 /end CHARACTERISTIC
/begin CHARACTERISTIC Injector5Enable "" VALUE 0x800041F2 RecordLayout_2 0 CompuMethod_10 0 1 /end CHARACTERISTIC
/begin CHARACTERISTIC Injector6Enable "" VALUE 0x800041F3 RecordLayout_2 0 CompuMethod_10 0 1 /end CHARACTERISTIC
/begin CHARACTERISTIC Injector7Enable "" VALUE 0x800041F4 RecordLayout_2 0 CompuMethod_10 0 1 /end CHARACTERISTIC
/begin CHARACTERISTIC Injector8Enable "" VALUE 0x800041F5 RecordLayout_2 0 CompuMethod_10 0 1 /end CHARACTERISTIC
/begin CHARACTERISTIC InjectorMaxDuration "Maximum duration for an injector pulse.  Must be a multiple of 5ms" VALUE 0x800041F6 RecordLayout_4 0 CompuMethod_69 -1E+17 1E+17 /end CHARACTERISTIC
/begin CHARACTERISTIC IntakeAirTempEnrichmentMap "Requested on base eq. ratio as a function of IAT and MAP" MAP 0x80004253 RecordLayout_4 0 CompuMethod_66 0 10
 /begin AXIS_DESCR COM_AXIS IAT05In CompuMethod_60 5 -40 300 AXIS_PTS_REF IAT05IdxArr /end AXIS_DESCR
 /begin AXIS_DESCR COM_AXIS MAP05In CompuMethod_16 5 0 1000 AXIS_PTS_REF MAP05IdxArr /end AXIS_DESCR
/end CHARACTERISTIC
/begin CHARACTERISTIC InterruptTaskStackMargin "When the available InterruptTask stack space drops below this threshold, the application performs a safety stop" VALUE 0x800042B7 RecordLayout_3 0 CompuMethod_35 0 1280 /end CHARACTERISTIC
/begin CHARACTERISTIC Lambda_1_Timeout "" VALUE 0x800042B9 RecordLayout_3 0 CompuMethod_115 0 65535 /end CHARACTERISTIC
/begin CHARACTERISTIC Lambda_2_Timeout "" VALUE 0x800042BB RecordLayout_3 0 CompuMethod_115 0 65535 /end CHARACTERISTIC
/begin CHARACTERISTIC MAF_Source "Selects the source for the fueling algorithm" VALUE 0x8000456C RecordLayout_2 0 CompuMethod_124 0 255 /end CHARACTERISTIC
/begin CHARACTERISTIC MainAppTaskStackMargin "When the available MainAppTask stack space drops below this threshold, the application performs a safety stop" VALUE 0x8000461D RecordLayout_3 0 CompuMethod_35 0 1024 /end CHARACTERISTIC
/begin CHARACTERISTIC MakeUpEOIMap "End of injection timing for transient makeup fuel pulse" MAP 0x80004624 RecordLayout_4 0 CompuMethod_70 -1000 1000
 /begin AXIS_DESCR COM_AXIS RPM09In CompuMethod_72 9 0 14000 AXIS_PTS_REF RPM09IdxArr /end AXIS_DESCR
 /begin AXIS_DESCR COM_AXIS MAP09In CompuMethod_16 9 0 1000 AXIS_PTS_REF MAP09IdxArr /end AXIS_DESCR
/end CHARACTERISTIC
/begin CHARACTERISTIC MaxETCSetPtLimitTbl "Maximum allowable ETC position." CURVE 0x8000483A RecordLayout_4 0 CompuMethod_9 0 100
 /begin AXIS_DESCR COM_AXIS RPM09In CompuMethod_72 9 0 14000 AXIS_PTS_REF RPM09IdxArr /end AXIS_DESCR
/end CHARACTERISTIC
/begin CHARACTERISTIC MediumRevOffset "RPM rev limit for medium action to be taken" VALUE 0x800049D4 RecordLayout_7 0 CompuMethod_22 0 32767 /end CHARACTERISTIC
/begin CHARACTERISTIC MinETCSetPtLimitTbl "Min allowable ETC position." CURVE 0x800049D6 RecordLayout_4 0 CompuMethod_9 0 100
 /begin AXIS_DESCR COM_AXIS RPM09In CompuMethod_72 9 0 14000 AXIS_PTS_REF RPM09IdxArr /end AXIS_DESCR
/end CHARACTERISTIC
/begin CHARACTERISTIC MinGovAirPcntHyst "Hysteresis around MinGovEntryAirPcnt where Min Gov will disable." VALUE 0x800049FA RecordLayout_4 0 CompuMethod_9 -1E+17 1E+17 /end CHARACTERISTIC
/begin CHARACTERISTIC MinGovEntryAirPcnt "Percent air (TPS or APP) position where below which Min Gov will enable." VALUE 0x80004A08 RecordLayout_4 0 CompuMethod_9 -1E+17 1E+17 /end CHARACTERISTIC
/begin CHARACTERISTIC MinGovEntryAirTimeThresh "If entry AirPcnt condition is satisfied, but RPM is high, Min Gov will enable if this time is exceeded." VALUE 0x80004A0C RecordLayout_4 0 CompuMethod_45 -1E+17 1E+17 /end CHARACTERISTIC
/begin CHARACTERISTIC MinMakeUpPW "Minimum change in injector pulse width that will trigger a make-up pulse." VALUE 0x80004A10 RecordLayout_4 0 CompuMethod_69 -1E+17 1E+17 /end CHARACTERISTIC
/begin CHARACTERISTIC O2ControlEnable "Enables O2 control" VALUE 0x80004AB3 RecordLayout_2 0 CompuMethod_135 0 1 /end CHARACTERISTIC
/begin CHARACTERISTIC O2StartUpDelayTbl "Delay O2 enable until TimeSinceRun is greater than this time." CURVE 0x80004CAE RecordLayout_4 0 CompuMethod_45 -1E+17 1E+17
 /begin AXIS_DESCR COM_AXIS ECT_KeyUp09In CompuMethod_60 9 -1E+17 1E+17 AXIS_PTS_REF ECT_KeyUp09IdxArr /end AXIS_DESCR
/end CHARACTERISTIC
/begin CHARACTERISTIC OpenThrottleFPCScalar "Crank FPC is scaled up with throttle opening for mechanical throttle systems, this parameter sets the gain for this relationship.  CrankFPC=CrankFPC*(1+TPS/100*FPCScalar)." VALUE 0x80004CF3 RecordLayout_4 0 CompuMethod_67 -1E+17 1E+17 /end CHARACTERISTIC
/begin CHARACTERISTIC PrimarySOIMap "Injection timing for primary fuel pulse - SOI or EOI depending on Inj Config" MAP 0x80004D3C RecordLayout_4 0 CompuMethod_70 -1000 1000
 /begin AXIS_DESCR COM_AXIS RPM09In CompuMethod_72 9 0 14000 AXIS_PTS_REF RPM09IdxArr /end AXIS_DESCR
 /begin AXIS_DESCR COM_AXIS MAP09In CompuMethod_16 9 0 1000 AXIS_PTS_REF MAP09IdxArr /end AXIS_DESCR
/end CHARACTERISTIC
/begin CHARACTERISTIC ProcessorReboot "Reboots the processor when set." VALUE 0x80004E80 RecordLayout_2 0 CompuMethod_144 0 1 /end CHARACTERISTIC
/begin CHARACTERISTIC PseudoRPM "" VALUE 0x80004E81 RecordLayout_3 0 CompuMethod_5 0 65535 /end CHARACTERISTIC
/begin CHARACTERISTIC RevLimitHyst "Hysteresis applied to MaxRPM once rev limit threshold is satisfied" VALUE 0x80004E84 RecordLayout_7 0 CompuMethod_22 0 12000 /end CHARACTERISTIC
/begin CHARACTERISTIC RPMFiltConst "Filter time constant" VALUE 0x800051E2 RecordLayout_4 0 CompuMethod_19 -1E+17 1E+17 /end CHARACTERISTIC
/begin CHARACTERISTIC RunLatchTDCs "Number of TDCs required to be above CrankToRunRPMThresh before the RUN mode is invoked." VALUE 0x800051E6 RecordLayout_2 0 CompuMethod_150 0 255 /end CHARACTERISTIC
/begin CHARACTERISTIC Shutdown_Delay "ECU calibrateable shutdown delay" VALUE 0x80005211 RecordLayout_4 0 CompuMethod_25 0 1E+17 /end CHARACTERISTIC
/begin CHARACTERISTIC SHUTDOWNTaskStackMargin "When the available SHUTDOWNTask stack space drops below this threshold, the application performs a safety stop" VALUE 0x80005215 RecordLayout_3 0 CompuMethod_35 0 1024 /end CHARACTERISTIC
/begin CHARACTERISTIC SoftOverBoostLimit "Soft overboost limit" VALUE 0x80005237 RecordLayout_4 0 CompuMethod_51 -1E+17 1E+17 /end CHARACTERISTIC
/begin CHARACTERISTIC SparkAdv_Filt "Filter time constant" VALUE 0x80005248 RecordLayout_4 0 CompuMethod_19 -1E+17 1E+17 /end CHARACTERISTIC
/begin CHARACTERISTIC SparkAdvMap "Base spark advance map." MAP 0x8000524C RecordLayout_4 0 CompuMethod_70 -1E+17 1E+17
 /begin AXIS_DESCR COM_AXIS RPM17In CompuMethod_72 17 0 14000 AXIS_PTS_REF RPM17IdxArr /end AXIS_DESCR
 /begin AXIS_DESCR COM_AXIS MAP17In CompuMethod_16 17 0 1000 AXIS_PTS_REF MAP17IdxArr /end AXIS_DESCR
/end CHARACTERISTIC
/begin CHARACTERISTIC SparkEnableCyl1 "Disable spark to particular cylinder." VALUE 0x800056D5 RecordLayout_2 0 CompuMethod_155 0 1 /end CHARACTERISTIC
/begin CHARACTERISTIC SparkEnableCyl2 "Disable spark to particular cylinder." VALUE 0x800056D6 RecordLayout_2 0 CompuMethod_155 0 1 /end CHARACTERISTIC
/begin CHARACTERISTIC SparkEnableCyl3 "Disable spark to particular cylinder." VALUE 0x800056D7 RecordLayout_2 0 CompuMethod_155 0 1 /end CHARACTERISTIC
/begin CHARACTERISTIC SparkEnableCyl4 "Disable spark to particular cylinder." VALUE 0x800056D8 RecordLayout_2 0 CompuMethod_155 0 1 /end CHARACTERISTIC
/begin CHARACTERISTIC SparkEnableCyl5 "Disable spark to particular cylinder." VALUE 0x800056D9 RecordLayout_2 0 CompuMethod_155 0 1 /end CHARACTERISTIC
/begin CHARACTERISTIC SparkEnableCyl6 "Disable spark to particular cylinder." VALUE 0x800056DA RecordLayout_2 0 CompuMethod_155 0 1 /end CHARACTERISTIC
/begin CHARACTERISTIC SparkEnableCyl7 "Disable spark to particular cylinder." VALUE 0x800056DB RecordLayout_2 0 CompuMethod_155 0 1 /end CHARACTERISTIC
/begin CHARACTERISTIC SparkEnableCyl8 "Disable spark to particular cylinder." VALUE 0x800056DC RecordLayout_2 0 CompuMethod_155 0 1 /end CHARACTERISTIC
/begin CHARACTERISTIC SparkEnableTDCCounts "Do not enable spark until this many TDCs have occurred in order to guarantee cam synchronization. This number should typically be 2." VALUE 0x800056DD RecordLayout_2 0 CompuMethod_1 0 255 /end CHARACTERISTIC
/begin CHARACTERISTIC SparkMaxDuration "Maximum duration for a spark pulse.  Must be a multiple of 5ms" VALUE 0x800056DE RecordLayout_4 0 CompuMethod_69 -1E+17 1E+17 /end CHARACTERISTIC
/begin CHARACTERISTIC StallRPMMinThreshold "Min. RPM Threshold below which engine state transition to STALL." VALUE 0x800057A8 RecordLayout_3 0 CompuMethod_22 0 65535 /end CHARACTERISTIC
/begin CHARACTERISTIC StallRPMThresholdHyst "Hysteresis used in conjunction with Min. RPM Threshold to determine when engine state transition to STALL. " VALUE 0x800057AA RecordLayout_3 0 CompuMethod_22 0 65535 /end CHARACTERISTIC
/begin CHARACTERISTIC StallSaverDeltaRPM "RPM delta below setpoint where Min Gov will enable to prevent engine stalls." VALUE 0x800057AC RecordLayout_7 0 CompuMethod_22 -32768 32767 /end CHARACTERISTIC
/begin CHARACTERISTIC StarvationTimerMargin "When the available Starvation Time drops below this threshold, the application performs a safety stop" VALUE 0x800057AE RecordLayout_8 0 CompuMethod_158 0 4294970 /end CHARACTERISTIC
/begin CHARACTERISTIC TeethBeforeSyncAllowed "The number of teeth that must be observed before the encoder will allow synchronization to occur. Ignored unless TimeBeforeSyncAllowed is zero." VALUE 0x800057F4 RecordLayout_2 0 CompuMethod_82 0 255 /end CHARACTERISTIC
/begin CHARACTERISTIC ThrottleSource "Selects source of throttle command" VALUE 0x80005801 RecordLayout_2 0 CompuMethod_160 0 1 /end CHARACTERISTIC
/begin CHARACTERISTIC TimeBeforeSyncAllowed "The amount of time that must be observed after initial encoder activity before the encoder will allow synchronization to occur." VALUE 0x80005802 RecordLayout_3 0 CompuMethod_115 0 65535 /end CHARACTERISTIC
/begin CHARACTERISTIC VEAdaptEnable "Determines whether the Volumetric Efficiency map will be adapted using the MAF sensor" VALUE 0x800058E0 RecordLayout_2 0 CompuMethod_26 0 1 /end CHARACTERISTIC
/begin CHARACTERISTIC VEAdaptTemp "Engine Coolant Temp Must be higher than this to Adapt VE" VALUE 0x80005911 RecordLayout_4 0 CompuMethod_60 -40 200 /end CHARACTERISTIC
/begin CHARACTERISTIC VEAdaptTime "Engine Run Time must be greater than this to Adapt VE" VALUE 0x80005915 RecordLayout_4 0 CompuMethod_19 0 200 /end CHARACTERISTIC
/begin CHARACTERISTIC VEBaroCorrTbl "Vol Eff compensation based on BARO." CURVE 0x80005919 RecordLayout_4 0 CompuMethod_2 -1E+17 1E+17
 /begin AXIS_DESCR COM_AXIS BARO CompuMethod_2 9 -1E+17 1E+17 AXIS_PTS_REF BARO09IdxArr /end AXIS_DESCR
/end CHARACTERISTIC
/begin CHARACTERISTIC VETempCorrMap "" MAP 0x80005981 RecordLayout_4 0 CompuMethod_9 -1E+17 1E+17
 /begin AXIS_DESCR COM_AXIS ECT09In CompuMethod_60 9 -40 200 AXIS_PTS_REF ECT09IdxArr /end AXIS_DESCR
 /begin AXIS_DESCR COM_AXIS IAT17In CompuMethod_60 17 -40 300 AXIS_PTS_REF IAT17IdxArr /end AXIS_DESCR
/end CHARACTERISTIC
/begin CHARACTERISTIC VolEffAdaptMap "Volumetric efficiency adapt table" MAP 0x80005BE5 RecordLayout_4 0 CompuMethod_9 -1000 1000
 /begin AXIS_DESCR COM_AXIS RPM17In CompuMethod_72 17 0 14000 AXIS_PTS_REF RPM17IdxArr /end AXIS_DESCR
 /begin AXIS_DESCR COM_AXIS VEMapIn CompuMethod_16 17 -1E+17 1E+17 AXIS_PTS_REF VEMapIdxArr /end AXIS_DESCR
/end CHARACTERISTIC
/begin CHARACTERISTIC VolEffMap "Volumetric efficiency table for speed density mode" MAP 0x80006069 RecordLayout_4 0 CompuMethod_9 0 1000
 /begin AXIS_DESCR COM_AXIS RPM17In CompuMethod_72 17 0 14000 AXIS_PTS_REF RPM17IdxArr /end AXIS_DESCR
 /begin AXIS_DESCR COM_AXIS VEMapIn CompuMethod_16 17 -1E+17 1E+17 AXIS_PTS_REF VEMapIdxArr /end AXIS_DESCR
/end CHARACTERISTIC
/begin CHARACTERISTIC VSPD_Filt "Filter time constant" VALUE 0x800064F3 RecordLayout_4 0 CompuMethod_19 -1E+17 1E+17 /end CHARACTERISTIC
/begin CHARACTERISTIC WarmUpEqRatioMap "Requested eq. ratio as a function of ECT and MAP." MAP 0x800065D7 RecordLayout_4 0 CompuMethod_66 0 10
 /begin AXIS_DESCR COM_AXIS ECT09In CompuMethod_60 9 -40 200 AXIS_PTS_REF ECT09IdxArr /end AXIS_DESCR
 /begin AXIS_DESCR COM_AXIS MAP05In CompuMethod_16 5 0 1000 AXIS_PTS_REF MAP05IdxArr /end AXIS_DESCR
/end CHARACTERISTIC
/begin CHARACTERISTIC WarmUpTimeRatioMap "Requested eq. ratio as a function of TimeSinceRun and ECT. Use for cold temps" MAP 0x8000668B RecordLayout_4 0 CompuMethod_66 0 10
 /begin AXIS_DESCR COM_AXIS ECT05In CompuMethod_60 5 -40 200 AXIS_PTS_REF ECT05IdxArr /end AXIS_DESCR
 /begin AXIS_DESCR COM_AXIS TimeSinceRun09In CompuMethod_2 9 -1E+17 1E+17 AXIS_PTS_REF TimeSinceRun09IdxArr /end AXIS_DESCR
/end CHARACTERISTIC
/begin CHARACTERISTIC WastegateLossOfControl "Wastegate duty cycle having insufficient control of boost" VALUE 0x8000674C RecordLayout_4 0 CompuMethod_9 -1E+17 1E+17 /end CHARACTERISTIC
/begin CHARACTERISTIC WGDeadTimeTbl "Wastegate turn on time" CURVE 0x8000675C RecordLayout_4 0 CompuMethod_68 0 1000
 /begin AXIS_DESCR COM_AXIS SysVolt09In CompuMethod_152 9 0 32 AXIS_PTS_REF SysVolt09IdxArr /end AXIS_DESCR
/end CHARACTERISTIC
/*~~~~~~~~~ 6.3.17 AXIS_PTS ~~~~~~~~~*/
/begin AXIS_PTS ACPres05IdxArr "Index of AC system high side pressure" 0x80000050 ACPres05In RecordLayout_5 0 CompuMethod_16 5 -150 10000 DEPOSIT ABSOLUTE /end AXIS_PTS
/begin AXIS_PTS ACPres07IdxArr "Index of AC system high side pressure" 0x80000064 ACPres07In RecordLayout_5 0 CompuMethod_16 7 -150 10000 DEPOSIT ABSOLUTE /end AXIS_PTS
/begin AXIS_PTS AirMinGovSpeedErrorIdxArr "" 0x80000278 AirMinGovSpeedErrorIn RecordLayout_5 0 CompuMethod_2 9 -1E+17 1E+17 DEPOSIT ABSOLUTE /end AXIS_PTS
/begin AXIS_PTS APP17IdxArr "Index of APP for driver demand" 0x800002EF APP17In RecordLayout_5 0 CompuMethod_9 17 0 100 DEPOSIT ABSOLUTE /end AXIS_PTS
/begin AXIS_PTS APP1IdxArr "Look up table to allownon-linear characterization of sensors" 0x8000033F APP1ADC RecordLayout_5 0 CompuMethod_21 9 -1E+17 1E+17 DEPOSIT ABSOLUTE /end AXIS_PTS
/begin AXIS_PTS APP2IdxArr "Look up table to allownon-linear characterization of sensors" 0x800003D9 APP2ADC RecordLayout_5 0 CompuMethod_21 9 -1E+17 1E+17 DEPOSIT ABSOLUTE /end AXIS_PTS
/begin AXIS_PTS BARO09IdxArr "" 0x80000478 BARO RecordLayout_5 0 CompuMethod_2 9 -1E+17 1E+17 DEPOSIT ABSOLUTE /end AXIS_PTS
/begin AXIS_PTS BoostCtlSpeedErrorIdxArr "" 0x80000867 BoostCtlSpeedErrorIn RecordLayout_5 0 CompuMethod_2 9 -1E+17 1E+17 DEPOSIT ABSOLUTE /end AXIS_PTS
/begin AXIS_PTS BoostTargetIdxArr "" 0x800008A2 BoostTargetIn RecordLayout_5 0 CompuMethod_2 9 0 1E+17 DEPOSIT ABSOLUTE /end AXIS_PTS
/begin AXIS_PTS CAT05IdxArr "Index of charge air temperature" 0x80000A7A CAT05In RecordLayout_5 0 CompuMethod_60 5 -40 300 DEPOSIT ABSOLUTE /end AXIS_PTS
/begin AXIS_PTS CATIdxArr "Look up table to allownon-linear characterization of sensors" 0x80000A96 CATADC RecordLayout_5 0 CompuMethod_21 13 -1E+17 1E+17 DEPOSIT ABSOLUTE /end AXIS_PTS
/begin AXIS_PTS CrankECT05IdxArr "ECT pre-lookup for crank maps." 0x80000CE3 ECT RecordLayout_5 0 CompuMethod_60 5 -1E+17 1E+17 DEPOSIT ABSOLUTE /end AXIS_PTS
/begin AXIS_PTS CrankIAT05IdxArr "IAT pre-lookup for crank maps." 0x80000E0F IAT RecordLayout_5 0 CompuMethod_60 5 -1E+17 1E+17 DEPOSIT ABSOLUTE /end AXIS_PTS
/begin AXIS_PTS CrankOXY05IdxArr "OXY pre-lookup for crank maps." 0x80000E37 CrankOXY05In RecordLayout_5 0 CompuMethod_9 5 -1E+17 1E+17 DEPOSIT ABSOLUTE /end AXIS_PTS
/begin AXIS_PTS CrankRPM05IdxArr "RPM pre-lookup for crank maps" 0x80000E4B CrankRPM05In RecordLayout_5 0 CompuMethod_72 5 -1E+17 1E+17 DEPOSIT ABSOLUTE /end AXIS_PTS
/begin AXIS_PTS DeltaMAP17IdxArr "" 0x800011A9 DeltaMAP17In RecordLayout_5 0 CompuMethod_2 17 -1E+17 1E+17 DEPOSIT ABSOLUTE /end AXIS_PTS
/begin AXIS_PTS DeltaTPS17IdxArr "" 0x80001455 DeltaTPS17In RecordLayout_5 0 CompuMethod_2 17 -1E+17 1E+17 DEPOSIT ABSOLUTE /end AXIS_PTS
/begin AXIS_PTS DesAFRatioIdxArr "" 0x8000149A DesAFRatioIn RecordLayout_5 0 CompuMethod_76 11 0 100 DEPOSIT ABSOLUTE /end AXIS_PTS
/begin AXIS_PTS DesEqRatio09IdxArr "Desired Equivalence Ratio breakpoints" 0x800014F2 DesEqRatio09In RecordLayout_5 0 CompuMethod_77 9 0 1E+17 DEPOSIT ABSOLUTE /end AXIS_PTS
/begin AXIS_PTS ECT_KeyUp09IdxArr "Index of ECT captured at key-up." 0x800019E8 ECT_KeyUp09In RecordLayout_5 0 CompuMethod_60 9 -1E+17 1E+17 DEPOSIT ABSOLUTE /end AXIS_PTS
/begin AXIS_PTS ECT05IdxArr "Idex of ECT" 0x80001B69 ECT05In RecordLayout_5 0 CompuMethod_60 5 -40 200 DEPOSIT ABSOLUTE /end AXIS_PTS
/begin AXIS_PTS ECT07IdxArr "Index of ECT" 0x80001B7D ECT07In RecordLayout_5 0 CompuMethod_60 7 -40 200 DEPOSIT ABSOLUTE /end AXIS_PTS
/begin AXIS_PTS ECT09IdxArr "Index of ECT" 0x80001B99 ECT09In RecordLayout_5 0 CompuMethod_60 9 -40 200 DEPOSIT ABSOLUTE /end AXIS_PTS
/begin AXIS_PTS ECTIdxArr "Look up table to allownon-linear characterization of sensors" 0x80001CA5 ECTADC RecordLayout_5 0 CompuMethod_21 13 -1E+17 1E+17 DEPOSIT ABSOLUTE /end AXIS_PTS
/begin AXIS_PTS ETC_SetpointIdxArr "" 0x80001F70 ETC_SetpointIn RecordLayout_5 0 CompuMethod_2 20 -1E+17 1E+17 DEPOSIT ABSOLUTE /end AXIS_PTS
/begin AXIS_PTS IAT05IdxArr "Index of IAT" 0x80003FC8 IAT05In RecordLayout_5 0 CompuMethod_60 5 -40 300 DEPOSIT ABSOLUTE /end AXIS_PTS
/begin AXIS_PTS IAT07IdxArr "Index of IAT" 0x80003FDC IAT07In RecordLayout_5 0 CompuMethod_60 7 -40 300 DEPOSIT ABSOLUTE /end AXIS_PTS
/begin AXIS_PTS IAT17IdxArr "Index of IAT" 0x80003FF8 IAT17In RecordLayout_5 0 CompuMethod_60 17 -40 300 DEPOSIT ABSOLUTE /end AXIS_PTS
/begin AXIS_PTS MAF09IdxArr "" 0x8000456D MAF09In RecordLayout_5 0 CompuMethod_2 9 -1E+17 1E+17 DEPOSIT ABSOLUTE /end AXIS_PTS
/begin AXIS_PTS MAP05IdxArr "Index of MAP" 0x80004789 MAP05In RecordLayout_5 0 CompuMethod_16 5 0 1000 DEPOSIT ABSOLUTE /end AXIS_PTS
/begin AXIS_PTS MAP09IdxArr "Index of MAP" 0x8000479D MAP09In RecordLayout_5 0 CompuMethod_16 9 0 1000 DEPOSIT ABSOLUTE /end AXIS_PTS
/begin AXIS_PTS MAP17IdxArr "Index of MAP" 0x800047C1 MAP17In RecordLayout_5 0 CompuMethod_16 17 0 1000 DEPOSIT ABSOLUTE /end AXIS_PTS
/begin AXIS_PTS O2ITerm_BankAIdxArr "Index for O2 ITerm." 0x80004C36 O2ITerm_BankAIn RecordLayout_5 0 CompuMethod_29 5 -1E+17 1E+17 DEPOSIT ABSOLUTE /end AXIS_PTS
/begin AXIS_PTS O2ITerm_BankBIdxArr "Index for O2 ITerm." 0x80004C4A O2ITerm_BankBIn RecordLayout_5 0 CompuMethod_29 5 -1E+17 1E+17 DEPOSIT ABSOLUTE /end AXIS_PTS
/begin AXIS_PTS RPM09IdxArr "Index of RPM" 0x80005127 RPM09In RecordLayout_5 0 CompuMethod_72 9 0 14000 DEPOSIT ABSOLUTE /end AXIS_PTS
/begin AXIS_PTS RPM17IdxArr "Index of RPM" 0x8000514B RPM17In RecordLayout_5 0 CompuMethod_72 17 0 14000 DEPOSIT ABSOLUTE /end AXIS_PTS
/begin AXIS_PTS SpkEnergy09IdxArr "" 0x800056EC SpkEnergy09In RecordLayout_5 0 CompuMethod_2 9 -1E+17 1E+17 DEPOSIT ABSOLUTE /end AXIS_PTS
/begin AXIS_PTS SysVolt09IdxArr "Index of system voltage" 0x800057B8 SysVolt09In RecordLayout_5 0 CompuMethod_152 9 0 32 DEPOSIT ABSOLUTE /end AXIS_PTS
/begin AXIS_PTS TimeSinceRun09IdxArr "" 0x80005804 TimeSinceRun09In RecordLayout_5 0 CompuMethod_2 9 -1E+17 1E+17 DEPOSIT ABSOLUTE /end AXIS_PTS
/begin AXIS_PTS TPS09IdxArr "Index of TPS" 0x80005830 TPS09In RecordLayout_5 0 CompuMethod_9 9 0 100 DEPOSIT ABSOLUTE /end AXIS_PTS
/begin AXIS_PTS VEMapIdxArr "Index of MAP for VE calculations" 0x8000593D VEMapIn RecordLayout_5 0 CompuMethod_16 17 -1E+17 1E+17 DEPOSIT ABSOLUTE /end AXIS_PTS
/begin AXIS_PTS VSPD07IdxArr "Index of VSPD" 0x80006507 VSPD07In RecordLayout_5 0 CompuMethod_165 7 -100 200 DEPOSIT ABSOLUTE /end AXIS_PTS
/begin AXIS_PTS VSPD09IdxArr "Index of VSPD" 0x80006523 VSPD09In RecordLayout_5 0 CompuMethod_165 9 -100 200 DEPOSIT ABSOLUTE /end AXIS_PTS
/begin AXIS_PTS VSPD17IdxArr "Index of VSPD" 0x80006547 VSPD17In RecordLayout_5 0 CompuMethod_165 17 -100 200 DEPOSIT ABSOLUTE /end AXIS_PTS
/begin RECORD_LAYOUT RecordLayout_2 FNC_VALUES 1 UBYTE ROW_DIR DIRECT /end RECORD_LAYOUT
/begin RECORD_LAYOUT RecordLayout_3 FNC_VALUES 1 UWORD ROW_DIR DIRECT /end RECORD_LAYOUT
/begin RECORD_LAYOUT RecordLayout_4 FNC_VALUES 1 FLOAT32_IEEE ROW_DIR DIRECT /end RECORD_LAYOUT
/begin RECORD_LAYOUT RecordLayout_5 AXIS_PTS_X 1 FLOAT32_IEEE /* IndexIncr */ INDEX_INCR /* Addressing */ DIRECT /end RECORD_LAYOUT
/begin RECORD_LAYOUT RecordLayout_6 FNC_VALUES 1 SBYTE ROW_DIR DIRECT /end RECORD_LAYOUT
/begin RECORD_LAYOUT RecordLayout_7 FNC_VALUES 1 SWORD ROW_DIR DIRECT /end RECORD_LAYOUT
/begin RECORD_LAYOUT RecordLayout_8 FNC_VALUES 1 ULONG ROW_DIR DIRECT /end RECORD_LAYOUT
/*~~~~~~~~~ 6.3.31 COMPU_METHODs ~~~~~~~~~*/
/begin COMPU_METHOD CompuMethod_1 "" RAT_FUNC "%3.0" "" COEFFS 0 1 0 0 0 1 /end COMPU_METHOD
/begin COMPU_METHOD CompuMethod_2 "" RAT_FUNC "%6.2" "" COEFFS 0 1 0 0 0 1 /end COMPU_METHOD
/begin COMPU_METHOD CompuMethod_5 "" RAT_FUNC "%5.0" "" COEFFS 0 1 0 0 0 1 /end COMPU_METHOD
/begin COMPU_METHOD CompuMethod_6 "" RAT_FUNC "%1.0" "bool" COEFFS 0 1 0 0 0 1 /end COMPU_METHOD
/begin COMPU_METHOD CompuMethod_7 "" TAB_VERB "%1.0" "" COMPU_TAB_REF CompuVtab_2 /end COMPU_METHOD
/begin COMPU_METHOD CompuMethod_8 "" RAT_FUNC "%5.0" "%" COEFFS 0 1 0 0 0 1 /end COMPU_METHOD
/begin COMPU_METHOD CompuMethod_9 "" RAT_FUNC "%6.2" "%" COEFFS 0 1 0 0 0 1 /end COMPU_METHOD
/begin COMPU_METHOD CompuMethod_10 "" TAB_VERB "%1.0" "" COMPU_TAB_REF CompuVtab_3 /end COMPU_METHOD
/begin COMPU_METHOD CompuMethod_11 "" RAT_FUNC "%5.0" "kpa" COEFFS 0 1 0 0 0 1 /end COMPU_METHOD
/begin COMPU_METHOD CompuMethod_12 "" RAT_FUNC "%1.0" "" COEFFS 0 1 0 0 0 1 /end COMPU_METHOD
/begin COMPU_METHOD CompuMethod_13 "" RAT_FUNC "%6.2" "kPaGauge" COEFFS 0 1 0 0 0 1 /end COMPU_METHOD
/begin COMPU_METHOD CompuMethod_14 "" RAT_FUNC "%6.2" "kPa Gauge" COEFFS 0 1 0 0 0 1 /end COMPU_METHOD
/begin COMPU_METHOD CompuMethod_15 "" RAT_FUNC "%6.2" "idx.frac" COEFFS 0 1 0 0 0 0.00195313 /end COMPU_METHOD
/begin COMPU_METHOD CompuMethod_16 "" RAT_FUNC "%6.2" "kPa" COEFFS 0 1 0 0 0 1 /end COMPU_METHOD
/begin COMPU_METHOD CompuMethod_17 "" RAT_FUNC "%5.0" "ADC" COEFFS 0 1 0 0 0 1 /end COMPU_METHOD
/begin COMPU_METHOD CompuMethod_18 "" RAT_FUNC "%6.2" "kpa" COEFFS 0 1 0 0 0 1 /end COMPU_METHOD
/begin COMPU_METHOD CompuMethod_19 "" RAT_FUNC "%6.2" "sec" COEFFS 0 1 0 0 0 1 /end COMPU_METHOD
/begin COMPU_METHOD CompuMethod_20 "" RAT_FUNC "%9.4" "kPa Gauge/ADC" COEFFS 0 1 0 0 0 1 /end COMPU_METHOD
/begin COMPU_METHOD CompuMethod_21 "" RAT_FUNC "%6.2" "ADC" COEFFS 0 1 0 0 0 1 /end COMPU_METHOD
/begin COMPU_METHOD CompuMethod_22 "" RAT_FUNC "%5.0" "RPM" COEFFS 0 1 0 0 0 1 /end COMPU_METHOD
/begin COMPU_METHOD CompuMethod_23 "" RAT_FUNC "%1.0" "Boolean" COEFFS 0 1 0 0 0 1 /end COMPU_METHOD
/begin COMPU_METHOD CompuMethod_24 "" RAT_FUNC "%3.0" "%" COEFFS 0 1 0 0 0 1 /end COMPU_METHOD
/begin COMPU_METHOD CompuMethod_25 "" RAT_FUNC "%6.2" "Seconds" COEFFS 0 1 0 0 0 1 /end COMPU_METHOD
/begin COMPU_METHOD CompuMethod_26 "" TAB_VERB "%1.0" "bool" COMPU_TAB_REF CompuVtab_3 /end COMPU_METHOD
/begin COMPU_METHOD CompuMethod_27 "" RAT_FUNC "%6.2" "g/s" COEFFS 0 1 0 0 0 1 /end COMPU_METHOD
/begin COMPU_METHOD CompuMethod_28 "" TAB_VERB "%1.0" "" COMPU_TAB_REF CompuVtab_4 /end COMPU_METHOD
/begin COMPU_METHOD CompuMethod_29 "" RAT_FUNC "%6.2" "mult" COEFFS 0 1 0 0 0 1 /end COMPU_METHOD
/begin COMPU_METHOD CompuMethod_30 "" RAT_FUNC "%6.2" "ADC Counts" COEFFS 0 1 0 0 0 1 /end COMPU_METHOD
/begin COMPU_METHOD CompuMethod_31 "" RAT_FUNC "%1.0" "boolean" COEFFS 0 1 0 0 0 1 /end COMPU_METHOD
/begin COMPU_METHOD CompuMethod_32 "" RAT_FUNC "%6.2" "Percent" COEFFS 0 1 0 0 0 1 /end COMPU_METHOD
/begin COMPU_METHOD CompuMethod_33 "" TAB_VERB "%3.0" "" COMPU_TAB_REF CompuVtab_5 /end COMPU_METHOD
/begin COMPU_METHOD CompuMethod_34 "" RAT_FUNC "%6.2" "%" COEFFS 0 1 0 0 0 0.0015259 /end COMPU_METHOD
/begin COMPU_METHOD CompuMethod_35 "" RAT_FUNC "%5.0" "bytes" COEFFS 0 1 0 0 0 1 /end COMPU_METHOD
/begin COMPU_METHOD CompuMethod_36 "" RAT_FUNC "%8.0" "bytes" COEFFS 0 1 0 0 0 1 /end COMPU_METHOD
/begin COMPU_METHOD CompuMethod_37 "" TAB_VERB "%3.0" "" COMPU_TAB_REF CompuVtab_6 /end COMPU_METHOD
/begin COMPU_METHOD CompuMethod_38 "" TAB_VERB "%3.0" "" COMPU_TAB_REF CompuVtab_7 /end COMPU_METHOD
/begin COMPU_METHOD CompuMethod_39 "" TAB_VERB "%5.0" "" COMPU_TAB_REF CompuVtab_8 /end COMPU_METHOD
/begin COMPU_METHOD CompuMethod_40 "" TAB_VERB "%5.0" "" COMPU_TAB_REF CompuVtab_9 /end COMPU_METHOD
/begin COMPU_METHOD CompuMethod_41 "" RAT_FUNC "%6.2" "EquivRatio" COEFFS 0 1 0 0 0 1 /end COMPU_METHOD
/begin COMPU_METHOD CompuMethod_42 "" RAT_FUNC "%9.4" "EquivRatio/ADC" COEFFS 0 1 0 0 0 1 /end COMPU_METHOD
/begin COMPU_METHOD CompuMethod_43 "" TAB_VERB "%3.0" "" COMPU_TAB_REF CompuVtab_10 /end COMPU_METHOD
/begin COMPU_METHOD CompuMethod_44 "" TAB_VERB "%1.0" "kPa" COMPU_TAB_REF CompuVtab_11 /end COMPU_METHOD
/begin COMPU_METHOD CompuMethod_45 "" RAT_FUNC "%6.2" "s" COEFFS 0 1 0 0 0 1 /end COMPU_METHOD
/begin COMPU_METHOD CompuMethod_46 "" TAB_VERB "%1.0" "" COMPU_TAB_REF CompuVtab_12 /end COMPU_METHOD
/begin COMPU_METHOD CompuMethod_47 "" RAT_FUNC "%5.4" "" COEFFS 0 1 0 0 0 1 /end COMPU_METHOD
/begin COMPU_METHOD CompuMethod_48 "" RAT_FUNC "%5.4" "mult" COEFFS 0 1 0 0 0 1 /end COMPU_METHOD
/begin COMPU_METHOD CompuMethod_49 "" RAT_FUNC "%7.2" "%" COEFFS 0 1 0 0 0 1 /end COMPU_METHOD
/begin COMPU_METHOD CompuMethod_50 "" RAT_FUNC "%6.2" "mJ" COEFFS 0 1 0 0 0 1 /end COMPU_METHOD
/begin COMPU_METHOD CompuMethod_51 "" RAT_FUNC "%6.2" "PSI" COEFFS 0 1 0 0 0 1 /end COMPU_METHOD
/begin COMPU_METHOD CompuMethod_52 "" RAT_FUNC "%3.0" "dutyCycle" COEFFS 0 1 0 0 0 1 /end COMPU_METHOD
/begin COMPU_METHOD CompuMethod_53 "" RAT_FUNC "%6.2" "dutyCycle" COEFFS 0 1 0 0 0 1 /end COMPU_METHOD
/begin COMPU_METHOD CompuMethod_54 "" RAT_FUNC "%3.0" "PSI" COEFFS 0 1 0 0 0 1 /end COMPU_METHOD
/begin COMPU_METHOD CompuMethod_55 "" RAT_FUNC "%6.2" "PSI/sec" COEFFS 0 1 0 0 0 1 /end COMPU_METHOD
/begin COMPU_METHOD CompuMethod_56 "" RAT_FUNC "%7.2" "degCA" COEFFS 0 1 0 0 0 0.0625 /end COMPU_METHOD
/begin COMPU_METHOD CompuMethod_57 "" TAB_VERB "%5.0" "" COMPU_TAB_REF CompuVtab_13 /end COMPU_METHOD
/begin COMPU_METHOD CompuMethod_59 "" RAT_FUNC "%6.2" "C" COEFFS 0 1 0 0 0 1 /end COMPU_METHOD
/begin COMPU_METHOD CompuMethod_60 "" RAT_FUNC "%6.2" "degC" COEFFS 0 1 0 0 0 1 /end COMPU_METHOD
/begin COMPU_METHOD CompuMethod_61 "" TAB_VERB "%1.0" "" COMPU_TAB_REF CompuVtab_15 /end COMPU_METHOD
/begin COMPU_METHOD CompuMethod_62 "" TAB_VERB "%1.0" "" COMPU_TAB_REF CompuVtab_16 /end COMPU_METHOD
/begin COMPU_METHOD CompuMethod_63 "" TAB_VERB "%1.0" "" COMPU_TAB_REF CompuVtab_17 /end COMPU_METHOD
/begin COMPU_METHOD CompuMethod_64 "" TAB_VERB "%1.0" "" COMPU_TAB_REF CompuVtab_18 /end COMPU_METHOD
/begin COMPU_METHOD CompuMethod_65 "" RAT_FUNC "%8.0" "" COEFFS 0 1 0 0 0 1 /end COMPU_METHOD
/begin COMPU_METHOD CompuMethod_66 "" RAT_FUNC "%6.2" "phi" COEFFS 0 1 0 0 0 1 /end COMPU_METHOD
/begin COMPU_METHOD CompuMethod_67 "" RAT_FUNC "%6.2" "Mult" COEFFS 0 1 0 0 0 1 /end COMPU_METHOD
/begin COMPU_METHOD CompuMethod_68 "" RAT_FUNC "%5.3" "ms" COEFFS 0 1 0 0 0 1 /end COMPU_METHOD
/begin COMPU_METHOD CompuMethod_69 "" RAT_FUNC "%6.2" "ms" COEFFS 0 1 0 0 0 1 /end COMPU_METHOD
/begin COMPU_METHOD CompuMethod_70 "" RAT_FUNC "%6.2" "degBTDC" COEFFS 0 1 0 0 0 1 /end COMPU_METHOD
/begin COMPU_METHOD CompuMethod_71 "" RAT_FUNC "%6.2" "mg/cyl" COEFFS 0 1 0 0 0 1 /end COMPU_METHOD
/begin COMPU_METHOD CompuMethod_72 "" RAT_FUNC "%6.2" "RPM" COEFFS 0 1 0 0 0 1 /end COMPU_METHOD
/begin COMPU_METHOD CompuMethod_73 "" RAT_FUNC "%6.2" "MJ" COEFFS 0 1 0 0 0 1 /end COMPU_METHOD
/begin COMPU_METHOD CompuMethod_74 "" RAT_FUNC "%6.2" "cm3" COEFFS 0 1 0 0 0 1 /end COMPU_METHOD
/begin COMPU_METHOD CompuMethod_75 "" RAT_FUNC "%6.2" "AFRatio" COEFFS 0 1 0 0 0 1 /end COMPU_METHOD
/begin COMPU_METHOD CompuMethod_76 "" RAT_FUNC "%6.2" "Ethanol%" COEFFS 0 1 0 0 0 1 /end COMPU_METHOD
/begin COMPU_METHOD CompuMethod_77 "" RAT_FUNC "%6.2" "F/A" COEFFS 0 1 0 0 0 1 /end COMPU_METHOD
/begin COMPU_METHOD CompuMethod_78 "" RAT_FUNC "%7.2" "ratio" COEFFS 0 1 0 0 0 1 /end COMPU_METHOD
/begin COMPU_METHOD CompuMethod_79 "" RAT_FUNC "%3.0" "kPa" COEFFS 0 1 0 0 0 1 /end COMPU_METHOD
/begin COMPU_METHOD CompuMethod_80 "" RAT_FUNC "%5.0" "degBTDC" COEFFS 0 1 0 0 0 1 /end COMPU_METHOD
/begin COMPU_METHOD CompuMethod_81 "" RAT_FUNC "%5.0" "ADC_counts" COEFFS 0 1 0 0 0 1 /end COMPU_METHOD
/begin COMPU_METHOD CompuMethod_82 "" RAT_FUNC "%3.0" "Teeth" COEFFS 0 1 0 0 0 1 /end COMPU_METHOD
/begin COMPU_METHOD CompuMethod_83 "" TAB_VERB "%3.0" "" COMPU_TAB_REF CompuVtab_19 /end COMPU_METHOD
/begin COMPU_METHOD CompuMethod_84 "" TAB_VERB "%3.0" "" COMPU_TAB_REF CompuVtab_20 /end COMPU_METHOD
/begin COMPU_METHOD CompuMethod_85 "" RAT_FUNC "%5.0" "degCA" COEFFS 0 1 0 0 0 0.0625 /end COMPU_METHOD
/begin COMPU_METHOD CompuMethod_86 "" RAT_FUNC "%3.0" "cyl#" COEFFS 0 1 -1 0 0 1 /end COMPU_METHOD
/begin COMPU_METHOD CompuMethod_87 "" RAT_FUNC "%6.2" "RPM/s" COEFFS 0 1 0 0 0 1 /end COMPU_METHOD
/begin COMPU_METHOD CompuMethod_88 "" RAT_FUNC "%6.2" "degCA" COEFFS 0 1 0 0 0 1 /end COMPU_METHOD
/begin COMPU_METHOD CompuMethod_89 "" RAT_FUNC "%8.3" "EquivRatio" COEFFS 0 1 0 0 0 1 /end COMPU_METHOD
/begin COMPU_METHOD CompuMethod_90 "" RAT_FUNC "%5.0" "us" COEFFS 0 1 0 0 0 1 /end COMPU_METHOD
/begin COMPU_METHOD CompuMethod_91 "" TAB_VERB "%3.0" "" COMPU_TAB_REF CompuVtab_3 /end COMPU_METHOD
/begin COMPU_METHOD CompuMethod_92 "" RAT_FUNC "%5.0" "mA" COEFFS 0 1 0 0 0 1 /end COMPU_METHOD
/begin COMPU_METHOD CompuMethod_93 "" RAT_FUNC "%5.3" "%" COEFFS 0 1 0 0 0 1 /end COMPU_METHOD
/begin COMPU_METHOD CompuMethod_94 "" RAT_FUNC "%5.3" "flag" COEFFS 0 1 0 0 0 1 /end COMPU_METHOD
/begin COMPU_METHOD CompuMethod_95 "" RAT_FUNC "%5.3" "s" COEFFS 0 1 0 0 0 1 /end COMPU_METHOD
/begin COMPU_METHOD CompuMethod_96 "" RAT_FUNC "%6.2" "Hz" COEFFS 0 1 0 0 0 1 /end COMPU_METHOD
/begin COMPU_METHOD CompuMethod_97 "" RAT_FUNC "%6.2" "mA" COEFFS 0 1 0 0 0 1 /end COMPU_METHOD
/begin COMPU_METHOD CompuMethod_99 "" RAT_FUNC "%6.2" "%/sec" COEFFS 0 1 0 0 0 1 /end COMPU_METHOD
/begin COMPU_METHOD CompuMethod_100 "" TAB_VERB "%1.0" "" COMPU_TAB_REF CompuVtab_21 /end COMPU_METHOD
/begin COMPU_METHOD CompuMethod_101 "" TAB_VERB "%1.0" "" COMPU_TAB_REF CompuVtab_22 /end COMPU_METHOD
/begin COMPU_METHOD CompuMethod_115 "" RAT_FUNC "%5.0" "ms" COEFFS 0 1 0 0 0 1 /end COMPU_METHOD
/begin COMPU_METHOD CompuMethod_117 "" TAB_VERB "%3.0" "" COMPU_TAB_REF CompuVtab_31 /end COMPU_METHOD
/begin COMPU_METHOD CompuMethod_118 "" RAT_FUNC "%5.3" "sec" COEFFS 0 1 0 0 0 1 /end COMPU_METHOD
/begin COMPU_METHOD CompuMethod_119 "" TAB_VERB "%3.0" "" COMPU_TAB_REF CompuVtab_32 /end COMPU_METHOD
/begin COMPU_METHOD CompuMethod_124 "" TAB_VERB "%3.0" "" COMPU_TAB_REF CompuVtab_33 /end COMPU_METHOD
/begin COMPU_METHOD CompuMethod_135 "" TAB_VERB "%8.3" "bool" COMPU_TAB_REF CompuVtab_3 /end COMPU_METHOD
/begin COMPU_METHOD CompuMethod_137 "" TAB_VERB "%1.0" "" COMPU_TAB_REF CompuVtab_41 /end COMPU_METHOD
/begin COMPU_METHOD CompuMethod_142 "" RAT_FUNC "%9.0" "bytes" COEFFS 0 1 0 0 0 1 /end COMPU_METHOD
/begin COMPU_METHOD CompuMethod_144 "" TAB_VERB "%1.0" "" COMPU_TAB_REF CompuVtab_44 /end COMPU_METHOD
/begin COMPU_METHOD CompuMethod_150 "" RAT_FUNC "%3.0" "TDCs" COEFFS 0 1 0 0 0 1 /end COMPU_METHOD
/begin COMPU_METHOD CompuMethod_152 "" RAT_FUNC "%6.2" "Volts" COEFFS 0 1 0 0 0 1 /end COMPU_METHOD
/begin COMPU_METHOD CompuMethod_155 "" TAB_VERB "%1.0" "boolean" COMPU_TAB_REF CompuVtab_3 /end COMPU_METHOD
/begin COMPU_METHOD CompuMethod_158 "" RAT_FUNC "%8.0" "ms" COEFFS 0 1 0 0 0 0.001 /end COMPU_METHOD
/begin COMPU_METHOD CompuMethod_160 "" TAB_VERB "%1.0" "" COMPU_TAB_REF CompuVtab_51 /end COMPU_METHOD
/begin COMPU_METHOD CompuMethod_162 "" TAB_VERB "%1.0" "" COMPU_TAB_REF CompuVtab_52 /end COMPU_METHOD
/begin COMPU_METHOD CompuMethod_165 "" RAT_FUNC "%6.2" "MPH" COEFFS 0 1 0 0 0 1 /end COMPU_METHOD
/begin COMPU_VTAB CompuVtab_2 "" TAB_VERB 2 0 "Pass-Through" 1 "Override" /end COMPU_VTAB
/begin COMPU_VTAB CompuVtab_3 "" TAB_VERB 2 0 "Disabled" 1 "Enabled" /end COMPU_VTAB
/begin COMPU_VTAB CompuVtab_4 "" TAB_VERB 2 0 "ETC" 1 "IAC" /end COMPU_VTAB
/begin COMPU_VTAB CompuVtab_5 "" TAB_VERB 7 0 "Paused Before Application Initialization (Step 1)" 1 "Paused Before OpenApplication (Step 2)" 2 "Paused Before Trigger_STARTUP_EVENT_11965p0004 (Step 3)" 3 "Paused Before Trigger_STARTUP_EVENT_9720p0004 (Step 4)" 4 "Paused After Application Initialization" 5 "Run" 6 "-" /end COMPU_VTAB
/begin COMPU_VTAB CompuVtab_6 "" TAB_VERB 6 0 "Pause Before Application Initialization (Step 1)" 1 "Paused Before OpenApplication (Step 2)" 2 "Paused Before Trigger_STARTUP_EVENT_11965p0004 (Step 3)" 3 "Paused Before Trigger_STARTUP_EVENT_9720p0004 (Step 4)" 4 "Pause After Application Initialization" 5 "Do Not Pause On Startup" /end COMPU_VTAB
/begin COMPU_VTAB CompuVtab_7 "" TAB_VERB 5 0 "Initializing" 1 "Running Normally" 2 "Stopped" 3 "Paused" 4 "Save Cals, Shutdown Power, and Reset" /end COMPU_VTAB
/begin COMPU_VTAB CompuVtab_8 "" TAB_VERB 11 0 "-" 1 "App Monitor Notification Stop" 2 "Application Stopped (User Command)" 3 "Starvation timer margin violation" 4 "Heap margin violation" 5 "Idle stack margin violation" 6 "Interrupt stack margin violation" 8 "ApplicationInterruptTask stack margin violation" 9 "BGNDTask stack margin violation" 10 "SHUTDOWNTask stack margin violation" 11 "FGNDTask stack margin violation" /end COMPU_VTAB
/begin COMPU_VTAB CompuVtab_9 "" TAB_VERB 1 0 "-" /end COMPU_VTAB
/begin COMPU_VTAB CompuVtab_10 "" TAB_VERB 21 0 "Reset" 1 "WarmingUp" 2 " Stabilizing" 3 "ReadingNerstPumpImpedance" 4 "Equalizing" 5 "ReadingRcalValue" 6 "Run" 7 "Overheat" 8 "Overcool" 9 "HeaterShortCircuit" 10 "HeaterOpenCircuit" 11 "StartFreeAirCal" 12 "PerformingFreeAirCal" 13 "DetectingSensor" 14 "ReadingJunctionImpedance" 15 "EvapStartup" 16 "DeterminingSensorType" 17 "PreparingToRun" 18 "SaveSensor" 19 "NeedsNewFreeAirCal" 20 "Error" /end COMPU_VTAB
/begin COMPU_VTAB CompuVtab_11 "" TAB_VERB 2 0 "Unlocked" 1 "Locked" /end COMPU_VTAB
/begin COMPU_VTAB CompuVtab_12 "" TAB_VERB 2 0 "Not Enabled" 1 "Enabled" /end COMPU_VTAB
/begin COMPU_VTAB CompuVtab_13 "" TAB_VERB 41 0 "Normal Operation" 1 "Task Kernel API Usage" 2 "Bad Attribute Data" 3 "Operation timed out" 4 "Operation aborted" 5 "Access from an ISR" 6 "Illegal Handle" 7 "Out of free store memory" 8 "The supplied task information is not valid." 9 "Missing Attribute" 10 "Insufficient FW resource" 11 "TPU Mask incompatible with the eTPU" 12 "Resource Busy" 13 "Data Unavailable" 14 "Function Not Supported" 15 "Flash is not blank" 16 "Flash Prog Voltage Unavailable" 17 "Memory verify" 18 "Uncreated Resource access" 19 "Illegal address" 20 "Hardware overrun" 21 "Alignment" 22 "Hardware timeout" 23 "TPU Function not in mask" 24 "TPU coprocessor not succesfully opened" 25 "Required dependants were not located" 26 "SPI Bus Integrity check failed." 27 "Insufficient param ram for TPU primitive" 28 "Dependent ASIC not created" 29 "Resource Not Capable." 30 "Software overrun" 31 "A Write attempted failed but OK to continue" 32 "Heap free-list distroyed; found while allocating" 33 "Heap freeing already freed or distroyed block" 34 "Heap freeing block outside of pool" 35 "Heap free list crashed; found while reallocating" 36 "An operation to the host operating system failed" 37 "Data Alignment" 38 "Attempt to create resource that is already created" 39 "Attempt to attach an ISR handler that is in use" 40 "Attempt to attach an ISR IRQ that is out of range" /end COMPU_VTAB
/begin COMPU_VTAB CompuVtab_15 "" TAB_VERB 2 0 "Calibration Locked" 1 "Calibration Unlocked" /end COMPU_VTAB
/begin COMPU_VTAB CompuVtab_16 "" TAB_VERB 2 0 "Data Acquisition Locked" 1 "Data Acquisition Unlocked" /end COMPU_VTAB
/begin COMPU_VTAB CompuVtab_17 "" TAB_VERB 2 0 "Programming Locked" 1 "Programming Unlocked" /end COMPU_VTAB
/begin COMPU_VTAB CompuVtab_18 "" TAB_VERB 2 0 "Not Connected" 1 "Connected" /end COMPU_VTAB
/begin COMPU_VTAB CompuVtab_19 "" TAB_VERB 6 0 "No Fault" 1 "Crank Sync Fault" 2 "Reverse Rotation Fault" 3 "No Crank Edges Fault" 4 "No CAM edges fault" 5 "Cam Sync Fault" /end COMPU_VTAB
/begin COMPU_VTAB CompuVtab_20 "" TAB_VERB 5 0 "zero" 1 "ZERO_SPEED" 2 "POSN_UNKNOWN" 3 "ENC_SYNC_CAM_UNKNOWN" 4 "ENC_SYNC_CAM_SYNC" /end COMPU_VTAB
/begin COMPU_VTAB CompuVtab_21 "" TAB_VERB 2 0 "Decreasing" 1 "Increasing" /end COMPU_VTAB
/begin COMPU_VTAB CompuVtab_22 "" TAB_VERB 2 0 "PWM" 1 "OnOff" /end COMPU_VTAB
/begin COMPU_VTAB CompuVtab_31 "" TAB_VERB 2 0 "2-Wire" 1 "3-Wire" /end COMPU_VTAB
/begin COMPU_VTAB CompuVtab_32 "" TAB_VERB 4 0 "Unknown" 1 "Flaring" 2 "OnIdle" 3 "OffIdle" /end COMPU_VTAB
/begin COMPU_VTAB CompuVtab_33 "" TAB_VERB 2 0 "Model from MAP" 1 "Use MAF sensor directly" /end COMPU_VTAB
/begin COMPU_VTAB CompuVtab_41 "" TAB_VERB 2 0 "Open-Loop" 1 "Closed-Loop" /end COMPU_VTAB
/begin COMPU_VTAB CompuVtab_44 "" TAB_VERB 2 0 "Run" 1 "Reboot" /end COMPU_VTAB
/begin COMPU_VTAB CompuVtab_51 "" TAB_VERB 2 0 "APP1" 1 "NORMAL" /end COMPU_VTAB
/begin COMPU_VTAB CompuVtab_52 "" TAB_VERB 2 0 "Not adapting" 1 "Adapting" /end COMPU_VTAB
/begin FUNCTION AC_Control_1 ""
 /begin DEF_CHARACTERISTIC AC_TPSOff AC_TPSOn ACHighPresOff ACHighPresOn ACLowPresOff ACLowPresOn ACSpdFastOff ACSpdFastOn ACSpdSlowOff ACSpdSlowOn ACTempOff ACTempOn ACTimeFromStartDelay /end DEF_CHARACTERISTIC
 /begin OUT_MEASUREMENT ACLowChrg ACOutput ACOverPressure ACRpmHighEnbl ACRpmLowEnbl ACTempEnbl ACTpsEnble /end OUT_MEASUREMENT
/end FUNCTION
/begin FUNCTION Run ""
 /begin SUB_FUNCTION AC_Control_1 MinGovernor FAN_Control_1 Fuel_System_Manager AirFlow_Manager O2_Control Base_Equiv_Ratio Spark_Manager Boost_Control DFCO MaxGovernor /end SUB_FUNCTION
/end FUNCTION
/begin FUNCTION Controller "" /begin SUB_FUNCTION Run Stall Crank /end SUB_FUNCTION /end FUNCTION
/begin FUNCTION Control ""
 /begin SUB_FUNCTION Controller Diagnostics VirtualSensors ActuatorCharacterization /end SUB_FUNCTION
/end FUNCTION
/begin FUNCTION AiflowOffset "" /begin DEF_CHARACTERISTIC ACAirFlowOfst_Enab ACAirFlowOfstTbl BaseAirflowOfstTbl /end DEF_CHARACTERISTIC /begin OUT_MEASUREMENT ACAirFlowOfst BaseAirflowOfst BaseAirOffset /end OUT_MEASUREMENT /begin SUB_FUNCTION Ramp_Air_Into_Idle_State /end SUB_FUNCTION /end FUNCTION
/begin FUNCTION MinGovernor "" /begin DEF_CHARACTERISTIC IdleExitTimeConst /end DEF_CHARACTERISTIC
 /begin OUT_MEASUREMENT AirMinGovOutput IdleHandOffMult MinGovReset SpkMinGovOutput /end OUT_MEASUREMENT
 /begin SUB_FUNCTION AiflowOffset Universal_PID__Tunable___Scheduled_ Air_PID_Config Base_Airflow_Table_Adapt Idle_State_Determination Ramp_RPM Base_RPM_Set_Pt MotoringDetection Universal_PD__Tunable___Scheduled_ /end SUB_FUNCTION
/end FUNCTION
/begin FUNCTION AC_Fault "" /begin DEF_CHARACTERISTIC ACHighPressureDisable ACLowPressureDisable /end DEF_CHARACTERISTIC /end FUNCTION
/begin FUNCTION Diagnostics ""
 /begin SUB_FUNCTION AC_Fault AirFlow Overspeed_Protection Boost_Fault Digital_Sensors Fuel_Economy Wrong_Fuel_Pressure_Fault_Logic O2_Smart_Sensor Lean_Protect Low_Voltage MAP_Fault_Logic Low_Oil_Pressure_Fault_Logic MISFIRE Engine_Overheat_Fault_Logic /end SUB_FUNCTION
/end FUNCTION
/begin FUNCTION ACPres "" /begin OUT_MEASUREMENT ACPres ACPresADC ACPresRaw /end OUT_MEASUREMENT /begin SUB_FUNCTION ACPres_Override ACPres_Config /end SUB_FUNCTION /end FUNCTION
/begin FUNCTION LinearSensors ""
 /begin SUB_FUNCTION ACPres FuelOxygenationSensor FuelPres FuelSens _MAP MAPTime OilPres SensVolt SysVolt /end SUB_FUNCTION
/end FUNCTION
/begin FUNCTION Inputs ""
 /begin SUB_FUNCTION LinearSensors Digital PotentiometerSensors CAN EngineSpeed NonLinearSensors /end SUB_FUNCTION
/end FUNCTION
/begin FUNCTION ACPres_Override "" /begin DEF_CHARACTERISTIC ACPres_new ACPres_ovr /end DEF_CHARACTERISTIC /end FUNCTION
/begin FUNCTION ACPres_Index "" /begin OUT_MEASUREMENT ACPres05Idx ACPres05In ACPres07Idx ACPres07In /end OUT_MEASUREMENT /end FUNCTION
/begin FUNCTION Raw_Indexes ""
 /begin SUB_FUNCTION ACPres_Index CAT_Index ECT_Index IAT_Indexes MAP_Indexes OXY_Index RPM_Indexes SysVolt_Index TPS_Indexes VSPD_Index /end SUB_FUNCTION
/end FUNCTION
/begin FUNCTION VirtualSensors ""
 /begin SUB_FUNCTION Raw_Indexes Virtual_Indexes RawProcessed AirCalcs FuelLevel LoadBasedCalcs /end SUB_FUNCTION
/end FUNCTION
/begin FUNCTION ACPres_Config ""
 /begin DEF_CHARACTERISTIC ACPresDfltValue ACPresFilterConst ACPresGain ACPresInputHiFltPos ACPresInputLoFltPos ACPresOfst /end DEF_CHARACTERISTIC
/end FUNCTION
/begin FUNCTION FAN_Control ""
 /begin DEF_CHARACTERISTIC ACPresFanOff ACPresFanOn ACPresFanSpeed_StallTbl ACSwFanSpeed_Stall ECTFanOff ECTFanOn ECTFanSpeed_StallTbl FAN_Mode Fan1ACPres Fan1ACSw Fan1ECT Fan1IAT Fan2ACPres Fan2ACSw Fan2ECT Fan2IAT IATFanOff IATFanOn IATFanSpeed_StallTbl /end DEF_CHARACTERISTIC
 /begin OUT_MEASUREMENT ACPresFanSpeed_Stall ECTFanSpeed_Stall IATFanSpeed_Stall /end OUT_MEASUREMENT
/end FUNCTION
/begin FUNCTION Stall "" /begin SUB_FUNCTION FAN_Control Fuel_Pump_at_Startup Stall_Throttle /end SUB_FUNCTION /end FUNCTION
/begin FUNCTION FAN_Control_1 ""
 /begin DEF_CHARACTERISTIC ACPresFanSpeedMap ACSwFanSpeed ECTFanSpeedMap IATFanSpeedMap /end DEF_CHARACTERISTIC
 /begin OUT_MEASUREMENT ACPresFanSpeed ECTFanSpeed Fan1Cmd Fan2Cmd IATFanSpeed /end OUT_MEASUREMENT
/end FUNCTION
/begin FUNCTION ACSw "" /begin OUT_MEASUREMENT ACSw ACSw_Raw /end OUT_MEASUREMENT /begin SUB_FUNCTION ACSw_Override ACSw_Config /end SUB_FUNCTION /end FUNCTION
/begin FUNCTION Digital "" /begin SUB_FUNCTION ACSw ClutchSw ESTOP MAF Scramble VSPD_Filt VSPD /end SUB_FUNCTION /end FUNCTION
/begin FUNCTION ACSw_Override "" /begin DEF_CHARACTERISTIC ACSw_new ACSw_ovr /end DEF_CHARACTERISTIC /end FUNCTION
/begin FUNCTION ACSw_Config "" /begin DEF_CHARACTERISTIC ACSwPolarity ACSwSwitchPt /end DEF_CHARACTERISTIC /end FUNCTION
/begin FUNCTION O2_Fuel_Adapt ""
 /begin DEF_CHARACTERISTIC AdaptEnable FuelAdaptDelta FuelAdaptEnable FuelAdaptGain_BankATbl FuelAdaptGain_BankBTbl FuelFlowCompAdapt_BankAMap FuelFlowCompAdapt_BankBMap FuelFlowCompMap /end DEF_CHARACTERISTIC
 /begin OUT_MEASUREMENT FuelAdapt_Error_BankA FuelAdapt_Error_BankB FuelAdaptEnabled FuelAdaptGain_BankA FuelAdaptGain_BankB FuelFlowComp FuelFlowCompAdapt_BankA FuelFlowCompAdapt_BankB O2ITerm_BankAIdx O2ITerm_BankAIn O2ITerm_BankBIdx O2ITerm_BankBIn /end OUT_MEASUREMENT
 /begin SUB_FUNCTION Saturation__Tunable__2 Saturation__Tunable_1 Adapt_FuelFlowComp_Map_Bank_B Adapt_FuelFlowComp_Map_Bank_A O2_Control_Enable_Delay WarmUp_Disable /end SUB_FUNCTION
/end FUNCTION
/begin FUNCTION Fuel_System_Manager "" /begin SUB_FUNCTION O2_Fuel_Adapt Fuel_Calculation Injector_Manager /end SUB_FUNCTION /end FUNCTION
/begin FUNCTION Fuel_Calculation ""
 /begin OUT_MEASUREMENT AdjustedPerCylFuelRate GlobalBaseFuelRate PerCylBaseFuelRate /end OUT_MEASUREMENT
 /begin SUB_FUNCTION Calculate_Fuel_Flow /end SUB_FUNCTION
/end FUNCTION
/begin FUNCTION AirFlow_Manager ""
 /begin DEF_CHARACTERISTIC AirControlSource IACTypeCal MaxETCSetPtLimitTbl MinETCSetPtLimitTbl ThrottleSource /end DEF_CHARACTERISTIC
 /begin OUT_MEASUREMENT ETCRequestFinal MaxETCSetPtLimit MinETCSetPtLimit /end OUT_MEASUREMENT
/end FUNCTION
/begin FUNCTION AirFlow "" /begin DEF_CHARACTERISTIC AirflowDiag_MAPIRDiagEnable AirflowMimatchThreshMap /end DEF_CHARACTERISTIC /begin OUT_MEASUREMENT AirflowMimatchThresh /end OUT_MEASUREMENT /end FUNCTION
/begin FUNCTION PID_Gain_Select1 ""
 /begin DEF_CHARACTERISTIC AirMinGovDGain AirMinGovDGainErrorMultTbl AirMinGovIGain AirMinGovIGainErrorMultTbl AirMinGovPGain AirMinGovPGainErrorMultTbl /end DEF_CHARACTERISTIC
 /begin OUT_MEASUREMENT AirMinGovDGainErrorMult AirMinGovIGainErrorMult AirMinGovPGainErrorMult /end OUT_MEASUREMENT
/end FUNCTION
/begin FUNCTION Universal_PID__Tunable___Scheduled_ ""
 /begin OUT_MEASUREMENT AirMinGovDTerm AirMinGovError AirMinGovITerm AirMinGovPTerm AirMinGovSpeedErrorIdx AirMinGovSpeedErrorIn /end OUT_MEASUREMENT
 /begin SUB_FUNCTION PID_Gain_Select1 /end SUB_FUNCTION
/end FUNCTION
/begin FUNCTION Air_PID_Config ""
 /begin DEF_CHARACTERISTIC AirMinGovErrorGain AirMinGovITermLowerLimit AirMinGovITermUpperLimit AirMinGovPIDOutLowerLimit AirMinGovPIDOutUpperLimit /end DEF_CHARACTERISTIC
/end FUNCTION
/begin FUNCTION PotentiometerSensors "" /begin DEF_CHARACTERISTIC APP_AdaptMode /end DEF_CHARACTERISTIC
 /begin SUB_FUNCTION APP1 APP1_Adapt APP1ForcedAdapt APP2 APP2_Adapt APP2ForcedAdapt TPS1 TPS2 /end SUB_FUNCTION
/end FUNCTION
/begin FUNCTION Dash_Message_DBW "" /begin DEF_CHARACTERISTIC APP_Filt ETCReq_Filt /end DEF_CHARACTERISTIC /end FUNCTION
/begin FUNCTION AEM_Infinity_Dash ""
 /begin SUB_FUNCTION Dash_Message_DBW Dash_Message_2 Dash_Message_6 Dash_Message_3 Dash_Message_1 /end SUB_FUNCTION
/end FUNCTION
/begin FUNCTION Virtual_Indexes ""
 /begin OUT_MEASUREMENT App05Idx App05In RPMAccel17Idx RPMAccel17In TimeSinceRun09Idx TimeSinceRun09In /end OUT_MEASUREMENT
 /begin SUB_FUNCTION ECT_KeyUp IAT_KeyUp MAFPortIndex /end SUB_FUNCTION
/end FUNCTION
/begin FUNCTION APP1 "" /begin DEF_CHARACTERISTIC APP1Tbl /end DEF_CHARACTERISTIC /begin OUT_MEASUREMENT APP1 APP1ADC APP1Idx APP1Raw /end OUT_MEASUREMENT /begin SUB_FUNCTION APP1_Override APP1_Config /end SUB_FUNCTION /end FUNCTION
/begin FUNCTION APP1_Adapt_Override "" /begin DEF_CHARACTERISTIC APP1_Adapt_new APP1_Adapt_ovr /end DEF_CHARACTERISTIC /end FUNCTION
/begin FUNCTION APP1_Adapt ""
 /begin OUT_MEASUREMENT APP1_AdaptAdapt_Hi APP1_AdaptAdapt_Low APP1_AdaptADC APP1_AdaptPercent APP1_AdaptPercentRaw /end OUT_MEASUREMENT
 /begin SUB_FUNCTION APP1_Adapt_Override APP1_Adapt_Config /end SUB_FUNCTION
/end FUNCTION
/begin FUNCTION APP1_Adapt_Config ""
 /begin DEF_CHARACTERISTIC APP1_AdaptAdapt_Delta APP1_AdaptAdapt_Hi_Max APP1_AdaptAdapt_Hi_Min APP1_AdaptAdapt_Low_Max APP1_AdaptAdapt_Low_Min APP1_AdaptAdaptHiEnable APP1_AdaptAdaptLoEnable APP1_AdaptDfltValue APP1_AdaptFilterConst APP1_AdaptInputHiFltPos APP1_AdaptInputLoFltPos APP1_AdaptMaxLimit APP1_AdaptRev_Polarity /end DEF_CHARACTERISTIC
/end FUNCTION
/begin FUNCTION Function_Call_Subsystem "" /begin DEF_CHARACTERISTIC APP1_AlwaysAdapt /end DEF_CHARACTERISTIC /end FUNCTION
/begin FUNCTION APP1ForcedAdapt "" /begin DEF_CHARACTERISTIC APP1HiAdaptADCThresh APP1LowAdaptADCThresh /end DEF_CHARACTERISTIC /begin SUB_FUNCTION Function_Call_Subsystem /end SUB_FUNCTION /end FUNCTION
/begin FUNCTION APP__Sensor_Arbitration1 "" /begin DEF_CHARACTERISTIC APP1_APP2_Max_Deviation /end DEF_CHARACTERISTIC /end FUNCTION
/begin FUNCTION RawProcessed "" /begin OUT_MEASUREMENT APPPcnt ECT_KeyUp /end OUT_MEASUREMENT
 /begin SUB_FUNCTION APP__Sensor_Arbitration1 Base_TPS_Request EngineState Capture_ECT_At_Startup Engine_Accel Gear_Estimator Fuel_Delta_Pressure_Calculation Capture_IAT_At_Startup O2_De_lag CutThrottle_APP_Limiting Time_Since_Key_On Time_Since_Run Time_Since_Stall TPS__Sensor_Arbitration VSPD_Selector /end SUB_FUNCTION
/end FUNCTION
/begin FUNCTION APP1_Override "" /begin DEF_CHARACTERISTIC APP1_new APP1_ovr /end DEF_CHARACTERISTIC /end FUNCTION
/begin FUNCTION Base_TPS_Request ""
 /begin DEF_CHARACTERISTIC ETCReqDecFiltC ETCReqFallRateTbl ETCReqIncFiltC ETCReqRiseRateTbl ETCRequestMap /end DEF_CHARACTERISTIC
 /begin OUT_MEASUREMENT APP17Idx APP17In ETCReqFallRate ETCReqFilterConst ETCReqRiseRate ETCRequest ETCRequestDirection FilteredETCRequest /end OUT_MEASUREMENT
/end FUNCTION
/begin FUNCTION APP1_Config "" /begin DEF_CHARACTERISTIC APP1Default APP1FiltConst APP1Max APP1MaxLimit APP1Min /end DEF_CHARACTERISTIC /end FUNCTION
/begin FUNCTION APP2 "" /begin DEF_CHARACTERISTIC APP2Tbl /end DEF_CHARACTERISTIC /begin OUT_MEASUREMENT APP2 APP2ADC APP2Idx APP2Raw /end OUT_MEASUREMENT /begin SUB_FUNCTION APP2_Override APP2_Config /end SUB_FUNCTION /end FUNCTION
/begin FUNCTION APP2_Adapt_Override "" /begin DEF_CHARACTERISTIC APP2_Adapt_new APP2_Adapt_ovr /end DEF_CHARACTERISTIC /end FUNCTION
/begin FUNCTION APP2_Adapt ""
 /begin OUT_MEASUREMENT APP2_AdaptAdapt_Hi APP2_AdaptAdapt_Low APP2_AdaptADC APP2_AdaptPercent APP2_AdaptPercentRaw /end OUT_MEASUREMENT
 /begin SUB_FUNCTION APP2_Adapt_Override APP2_Adapt_Config /end SUB_FUNCTION
/end FUNCTION
/begin FUNCTION APP2_Adapt_Config ""
 /begin DEF_CHARACTERISTIC APP2_AdaptAdapt_Delta APP2_AdaptAdapt_Hi_Max APP2_AdaptAdapt_Hi_Min APP2_AdaptAdapt_Low_Max APP2_AdaptAdapt_Low_Min APP2_AdaptAdaptHiEnable APP2_AdaptAdaptLoEnable APP2_AdaptDfltValue APP2_AdaptFilterConst APP2_AdaptInputHiFltPos APP2_AdaptInputLoFltPos APP2_AdaptMaxLimit APP2_AdaptRev_Polarity /end DEF_CHARACTERISTIC
/end FUNCTION
/begin FUNCTION Function_Call_Subsystem_1 "" /begin DEF_CHARACTERISTIC APP2_AlwaysAdapt /end DEF_CHARACTERISTIC /end FUNCTION
/begin FUNCTION APP2ForcedAdapt "" /begin DEF_CHARACTERISTIC APP2HiAdaptADCThresh APP2LowAdaptADCThresh /end DEF_CHARACTERISTIC /begin SUB_FUNCTION Function_Call_Subsystem_1 /end SUB_FUNCTION /end FUNCTION
/begin FUNCTION APP2_Override "" /begin DEF_CHARACTERISTIC APP2_new APP2_ovr /end DEF_CHARACTERISTIC /end FUNCTION
/begin FUNCTION APP2_Config "" /begin DEF_CHARACTERISTIC APP2Default APP2FiltConst APP2Max APP2MaxLimit APP2Min /end DEF_CHARACTERISTIC /end FUNCTION
/begin FUNCTION Application_Monitor "" /begin DEF_CHARACTERISTIC ApplicationStatus /end DEF_CHARACTERISTIC
 /begin OUT_MEASUREMENT ApplicationInitStatus ApplicationStopReason ApplicationStopReasonAppLink /end OUT_MEASUREMENT
/end FUNCTION
/begin FUNCTION Debug ""
 /begin SUB_FUNCTION Application_Monitor Application_Monitor_Config CAN_1 Memory_1 /end SUB_FUNCTION
/end FUNCTION
/begin FUNCTION Performance ""
 /begin OUT_MEASUREMENT ApplicationInterruptTaskCPU BGNDTaskCPU CPUIdlePcnt FGNDTaskCPU SHUTDOWNTaskCPU /end OUT_MEASUREMENT
 /begin SUB_FUNCTION ISR /end SUB_FUNCTION
/end FUNCTION
/begin FUNCTION Application_Monitor_Config ""
 /begin DEF_CHARACTERISTIC ApplicationInterruptTaskStackMargin ApplicationMonitorEnable ApplicationPausePoint BGNDTaskStackMargin FGNDTaskStackMargin HeapMargin InterruptTaskStackMargin MainAppTaskStackMargin SHUTDOWNTaskStackMargin StarvationTimerMargin /end DEF_CHARACTERISTIC
/end FUNCTION
/begin FUNCTION Memory ""
 /begin OUT_MEASUREMENT ApplicationInterruptTaskStackMinBytesFree BGNDTaskStackMinBytesFree FGNDTaskStackMinBytesFree IdleStackMinBytesFree InterruptStackMinBytesFree KernelStackMinBytesFree PeakHeapBytesUsed SHUTDOWNTaskStackMinBytesFree /end OUT_MEASUREMENT
/end FUNCTION
/begin FUNCTION AEM_X_Lambda "" /begin DEF_CHARACTERISTIC BankB_Avg_Enable Lambda_1_Timeout Lambda_2_Timeout /end DEF_CHARACTERISTIC
 /begin OUT_MEASUREMENT Bank1_DataValidState_Prb Bank1_HeaterVolts_Prb Bank1_Lambda_Prb Bank1_OxygenConcentration_Prb Bank1_SensorDetectedStatus_Prb Bank1_SensorFaultState_Prb Bank1_SensorStatus_Prb Bank1_SystemVolts_Prb Bank1_UsingFreeAreCalState_Prb Bank2_DataValidState_Prb Bank2_HeaterVolts_Prb Bank2_Lambda_Prb Bank2_OxygenConcentration_Prb Bank2_SensorDetectedStatus_Prb Bank2_SensorFaultState_Prb Bank2_SensorStatus_Prb Bank2_SystemVolts_Prb Bank2_UsingFreeAreCalState_Prb O2_BankA_EquivRatio_Out /end OUT_MEASUREMENT
 /begin SUB_FUNCTION Bank1_EquivRatio Bank2_EquivRatio /end SUB_FUNCTION
/end FUNCTION
/begin FUNCTION CAN "" /begin SUB_FUNCTION AEM_X_Lambda AEM_GPS /end SUB_FUNCTION /end FUNCTION
/begin FUNCTION Bank1_EquivRatio "" /begin OUT_MEASUREMENT Bank1_EquivRatio Bank1_EquivRatioADC Bank1_EquivRatioRaw /end OUT_MEASUREMENT /begin SUB_FUNCTION Bank1_EquivRatio_Override Bank1_EquivRatio_Config /end SUB_FUNCTION /end FUNCTION
/begin FUNCTION Bank1_EquivRatio_Override "" /begin DEF_CHARACTERISTIC Bank1_EquivRatio_new Bank1_EquivRatio_ovr /end DEF_CHARACTERISTIC /end FUNCTION
/begin FUNCTION Bank1_EquivRatio_Config ""
 /begin DEF_CHARACTERISTIC Bank1_EquivRatioDfltValue Bank1_EquivRatioFilterConst Bank1_EquivRatioGain Bank1_EquivRatioInputHiFltPos Bank1_EquivRatioInputLoFltPos Bank1_EquivRatioOfst /end DEF_CHARACTERISTIC
/end FUNCTION
/begin FUNCTION Bank2_EquivRatio "" /begin OUT_MEASUREMENT Bank2_EquivRatio Bank2_EquivRatioADC Bank2_EquivRatioRaw /end OUT_MEASUREMENT /begin SUB_FUNCTION Bank2_EquivRatio_Override Bank2_EquivRatio_Config /end SUB_FUNCTION /end FUNCTION
/begin FUNCTION Bank2_EquivRatio_Override "" /begin DEF_CHARACTERISTIC Bank2_EquivRatio_new Bank2_EquivRatio_ovr /end DEF_CHARACTERISTIC /end FUNCTION
/begin FUNCTION Bank2_EquivRatio_Config ""
 /begin DEF_CHARACTERISTIC Bank2_EquivRatioDfltValue Bank2_EquivRatioFilterConst Bank2_EquivRatioGain Bank2_EquivRatioInputHiFltPos Bank2_EquivRatioInputLoFltPos Bank2_EquivRatioOfst /end DEF_CHARACTERISTIC
/end FUNCTION
/begin FUNCTION O2Disable "" /begin DEF_CHARACTERISTIC BankB_Enbl /end DEF_CHARACTERISTIC /begin OUT_MEASUREMENT O2FaultDisable /end OUT_MEASUREMENT /end FUNCTION
/begin FUNCTION O2_Control ""
 /begin SUB_FUNCTION O2Disable O2_Control_State_Determination O2_PID_Calibrations O2_PID_Controller_Bank_A O2_PID_Controller_Bank_B Map_O2_Sensors_to_V8_Cylinders O2Arb /end SUB_FUNCTION
/end FUNCTION
/begin FUNCTION AirCalcs "" /begin DEF_CHARACTERISTIC BaroRunStallDelay /end DEF_CHARACTERISTIC /begin OUT_MEASUREMENT BARO BaroDelayTime /end OUT_MEASUREMENT
 /begin SUB_FUNCTION Capture_Signal_At_Startup BARO_Override Speed_Density___MAP_Referenced___Adaptive Running_Baro_Learn /end SUB_FUNCTION
/end FUNCTION
/begin FUNCTION Capture_Signal_At_Startup "" /begin DEF_CHARACTERISTIC BARO_Count /end DEF_CHARACTERISTIC /end FUNCTION
/begin FUNCTION BARO_Override "" /begin DEF_CHARACTERISTIC BARO_offset BARO_ovr /end DEF_CHARACTERISTIC /end FUNCTION
/begin FUNCTION Speed_Density___MAP_Referenced___Adaptive ""
 /begin DEF_CHARACTERISTIC CombEventsPerRev CylSweptVol MAF_Source VEAdaptEnable VEAdaptTemp VEAdaptTime VEBaroCorrTbl VETempCorrMap VolEffAdaptMap VolEffMap /end DEF_CHARACTERISTIC
 /begin OUT_MEASUREMENT BARO09Idx MAFFinal VEAdaptAmnt VEAdapting VEBaroCorr VEFin VEIdealMAF VEMapIdx VEMapIn VEModelMAF VETempCorr VolEff VolEffAdapt /end OUT_MEASUREMENT
 /begin SUB_FUNCTION Adapt_VolEff_Map /end SUB_FUNCTION
/end FUNCTION
/begin FUNCTION Running_Baro_Learn "" /begin DEF_CHARACTERISTIC BaroLearn_MAP BaroLearn_Tm BaroLearn_TPSPos /end DEF_CHARACTERISTIC /end FUNCTION
/begin FUNCTION Idle_Control_Enable_Delay "" /begin DEF_CHARACTERISTIC BaseAirflowAdaptDelayTime /end DEF_CHARACTERISTIC /end FUNCTION
/begin FUNCTION Base_Airflow_Table_Adapt ""
 /begin DEF_CHARACTERISTIC BaseAirflowAdaptDelta BaseAirflowAdaptEnable BaseAirflowAdaptGain /end DEF_CHARACTERISTIC
 /begin OUT_MEASUREMENT BaseAirflowAdaptEnabled /end OUT_MEASUREMENT
 /begin SUB_FUNCTION Idle_Control_Enable_Delay Saturation__Tunable_ Adapt_Base_Airflow_Table /end SUB_FUNCTION
/end FUNCTION
/begin FUNCTION Saturation__Tunable_ "" /begin DEF_CHARACTERISTIC BaseAirflowAdaptErrorLwrLim BaseAirflowAdaptErrorUprLim /end DEF_CHARACTERISTIC /end FUNCTION
/begin FUNCTION Adapt_Base_Airflow_Table "" /begin DEF_CHARACTERISTIC BaseAirflowOfstMaxValue BaseAirflowOfstMinValue /end DEF_CHARACTERISTIC /end FUNCTION
/begin FUNCTION Base_Equiv_Ratio ""
 /begin DEF_CHARACTERISTIC ChargeAirTempEnrichmentMap DesEquivRatioMap IntakeAirTempEnrichmentMap WarmUpEqRatioMap WarmUpTimeRatioMap /end DEF_CHARACTERISTIC
 /begin OUT_MEASUREMENT BaseEquivRatio ChargeAirTempEnrichment DesEquivRatio IntakeAirTempEnrichment WarmUpEqRatio WarmUpTimeRatio /end OUT_MEASUREMENT
 /begin SUB_FUNCTION EquivRatio_Override Warm_Up_Fuel_Holdoff /end SUB_FUNCTION
/end FUNCTION
/begin FUNCTION BaseRevLimit "" /begin DEF_CHARACTERISTIC BaseRevLimit HardRevOffset MediumRevOffset RevLimitHyst /end DEF_CHARACTERISTIC /end FUNCTION
/begin FUNCTION Overspeed_Protection "" /begin SUB_FUNCTION BaseRevLimit /end SUB_FUNCTION /end FUNCTION
/begin FUNCTION Spark_Manager "" /begin DEF_CHARACTERISTIC BaseSparkEnergyMap SparkAdvMap /end DEF_CHARACTERISTIC /begin OUT_MEASUREMENT BaseSparkEnergy Spark_Adv_Prb SparkAdv /end OUT_MEASUREMENT
 /begin SUB_FUNCTION Temp_Comp_Offset Desired_Eq_Ratio_Offset Ethanol_Spark_Offset SparkAdvanceLimiter Spark_Advance_Rate_Limiter /end SUB_FUNCTION
/end FUNCTION
/begin FUNCTION Boost_Control ""
 /begin DEF_CHARACTERISTIC BoostActivationThreshold BoostControlBase_AdaptMap BoostControlBaseMap BoostECTLimitTbl BoostFallRate BoostIATLimitTbl BoostRiseRate BoostScrambleAdder BoostTargetMap WGDeadTimeTbl /end DEF_CHARACTERISTIC
 /begin OUT_MEASUREMENT BoostControlBase BoostControlBase_Adapt BoostControlDutyCycleFF BoostControlDutyCycleOut BoostControlPID BoostControlPID_ITerm BoostControlTarget BoostECTLimit BoostIATLimit BoostTarget BoostTargetIdx BoostTargetIn WGDeadTime /end OUT_MEASUREMENT
 /begin SUB_FUNCTION BoostControl_Adapt Universal_PID__Tunable___Scheduled__1 Air_PID_Config_1 /end SUB_FUNCTION
/end FUNCTION
/begin FUNCTION BoostControl_Enable_Delay "" /begin DEF_CHARACTERISTIC BoostAdaptDelayTime /end DEF_CHARACTERISTIC /end FUNCTION
/begin FUNCTION BoostControl_Adapt ""
 /begin DEF_CHARACTERISTIC BoostControlAdaptDelta BoostControlAdaptEnable BoostControlAdaptGain /end DEF_CHARACTERISTIC
 /begin OUT_MEASUREMENT BoostControlAdaptEnabled /end OUT_MEASUREMENT
 /begin SUB_FUNCTION BoostControl_Enable_Delay Saturation__Tunable__1 Adapt_Boost_Table /end SUB_FUNCTION
/end FUNCTION
/begin FUNCTION Saturation__Tunable__1 "" /begin DEF_CHARACTERISTIC BoostAdaptErrorLwrLim BoostAdaptErrorUprLim /end DEF_CHARACTERISTIC /end FUNCTION
/begin FUNCTION Adapt_Boost_Table "" /begin DEF_CHARACTERISTIC BoostControlOfstMaxValue BoostControlOfstMinValue /end DEF_CHARACTERISTIC /end FUNCTION
/begin FUNCTION PID_Gain_Select1_1 ""
 /begin DEF_CHARACTERISTIC BoostCtlDGain BoostCtlDGainErrorMultTbl BoostCtlIGain BoostCtlIGainErrorMultTbl BoostCtlPGain BoostCtlPGainErrorMultTbl /end DEF_CHARACTERISTIC
 /begin OUT_MEASUREMENT BoostCtlDGainErrorMult BoostCtlIGainErrorMult BoostCtlPGainErrorMult /end OUT_MEASUREMENT
/end FUNCTION
/begin FUNCTION Universal_PID__Tunable___Scheduled__1 ""
 /begin OUT_MEASUREMENT BoostCtlDTerm BoostCtlError BoostCtlITerm BoostCtlPTerm BoostCtlSpeedErrorIdx BoostCtlSpeedErrorIn /end OUT_MEASUREMENT
 /begin SUB_FUNCTION PID_Gain_Select1_1 /end SUB_FUNCTION
/end FUNCTION
/begin FUNCTION Air_PID_Config_1 ""
 /begin DEF_CHARACTERISTIC BoostCtlErrorGain BoostCtlITermLowerLimit BoostCtlITermUpperLimit BoostCtlPIDOutLowerLimit BoostCtlPIDOutUpperLimit /end DEF_CHARACTERISTIC
/end FUNCTION
/begin FUNCTION Boost_Fault ""
 /begin DEF_CHARACTERISTIC BoostDiag_MAPIRDiagEnable HardOverBoostLimit SoftOverBoostLimit WastegateLossOfControl /end DEF_CHARACTERISTIC
/end FUNCTION
/begin FUNCTION Encoder_Config ""
 /begin DEF_CHARACTERISTIC CAMDelay EncoderCrankTeethAfterCam EncoderNumCylinders EncoderTDCAngles TeethBeforeSyncAllowed TimeBeforeSyncAllowed /end DEF_CHARACTERISTIC
/end FUNCTION
/begin FUNCTION EngineSpeed "" /begin DEF_CHARACTERISTIC EngineToEncoderOffset PseudoRPM RPMFiltConst /end DEF_CHARACTERISTIC /begin OUT_MEASUREMENT EncoderState EncoderTDCOrder RPM RPMInst /end OUT_MEASUREMENT /begin SUB_FUNCTION Encoder_Config Encoder_Diagnostics /end SUB_FUNCTION /end FUNCTION
/begin FUNCTION CAN_1 "" /begin DEF_CHARACTERISTIC CAN_1_TransmitOverrun CAN_2_TransmitOverrun /end DEF_CHARACTERISTIC /end FUNCTION
/begin FUNCTION CAT "" /begin DEF_CHARACTERISTIC CATTbl /end DEF_CHARACTERISTIC /begin OUT_MEASUREMENT CAT CATADC CATIdx CATRaw /end OUT_MEASUREMENT /begin SUB_FUNCTION CAT_Override CAT_Config /end SUB_FUNCTION /end FUNCTION
/begin FUNCTION Temp_Sensors "" /begin SUB_FUNCTION CAT ECT EVAP IAT /end SUB_FUNCTION /end FUNCTION
/begin FUNCTION NonLinearSensors "" /begin SUB_FUNCTION Temp_Sensors Fuel_Level /end SUB_FUNCTION /end FUNCTION
/begin FUNCTION CAT_Override "" /begin DEF_CHARACTERISTIC CAT_new CAT_ovr /end DEF_CHARACTERISTIC /end FUNCTION
/begin FUNCTION Temp_Comp_Offset ""
 /begin DEF_CHARACTERISTIC CAT_SpkOfstMultMap CAT_SpkOfstTbl ECT_SpkOfstMultMap ECT_SpkOfstTbl IAT_SpkOfstMultMap IAT_SpkOfstTbl /end DEF_CHARACTERISTIC
 /begin OUT_MEASUREMENT CAT_SpkOfst CAT_SpkOfstMult ECT_SpkOfst ECT_SpkOfstMult IAT_SpkOfst IAT_SpkOfstMult SpkOfstTempFnl /end OUT_MEASUREMENT
/end FUNCTION
/begin FUNCTION CAT_Index "" /begin OUT_MEASUREMENT CAT05Idx CAT05In /end OUT_MEASUREMENT /end FUNCTION
/begin FUNCTION CAT_Config "" /begin DEF_CHARACTERISTIC CATDefault CATFiltConst CATMax CATMin /end DEF_CHARACTERISTIC /end FUNCTION
/begin FUNCTION CCP1 "" /begin DEF_CHARACTERISTIC CCP1_StationAddr CCP1RxID CCP1RxIDMask CCP1TxID /end DEF_CHARACTERISTIC
 /begin OUT_MEASUREMENT CCP_CCP1_Access CCP_CCP1_Access.CCP_CCP1_CAL CCP_CCP1_Access.CCP_CCP1_DAQ CCP_CCP1_Access.CCP_CCP1_PGM CCP_CCP1_ConnectionStatus /end OUT_MEASUREMENT
/end FUNCTION
/begin FUNCTION CCP "" /begin SUB_FUNCTION CCP1 /end SUB_FUNCTION /end FUNCTION
/begin FUNCTION Communication_Config "" /begin DEF_CHARACTERISTIC CityID_CAN_1 CityID_CAN_2 /end DEF_CHARACTERISTIC /end FUNCTION
/begin FUNCTION System_Config "" /begin SUB_FUNCTION Communication_Config /end SUB_FUNCTION /end FUNCTION
/begin FUNCTION CrankFueling ""
 /begin DEF_CHARACTERISTIC ClearFloodThreshold CrankFPC_IATMultTbl CrankFPC_OXYMultTbl CrankFPCMap OpenThrottleFPCScalar /end DEF_CHARACTERISTIC
 /begin OUT_MEASUREMENT CrankFPC CrankFPC_IATMult CrankFPC_OXYMult /end OUT_MEASUREMENT
/end FUNCTION
/begin FUNCTION Crank ""
 /begin DEF_CHARACTERISTIC CrankAirflowSetPtTbl CrankMakeUpEOITbl CrankSOITbl CrankSparkMap CrankSpkEnergyMap /end DEF_CHARACTERISTIC
 /begin OUT_MEASUREMENT CrankAirflowSetPt CrankECT05Idx CrankIAT05Idx CrankMakeUpEOI CrankOXY05Idx CrankOXY05In CrankRPM05Idx CrankRPM05In CrankSOI CrankSpark CrankSpkEnergy /end OUT_MEASUREMENT
 /begin SUB_FUNCTION CrankFueling CrankIAC /end SUB_FUNCTION
/end FUNCTION
/begin FUNCTION ClutchSw "" /begin OUT_MEASUREMENT ClutchSw ClutchSw_Raw /end OUT_MEASUREMENT /begin SUB_FUNCTION ClutchSw_Override ClutchSw_Config /end SUB_FUNCTION /end FUNCTION
/begin FUNCTION ClutchSw_Override "" /begin DEF_CHARACTERISTIC ClutchSw_new ClutchSw_ovr /end DEF_CHARACTERISTIC /end FUNCTION
/begin FUNCTION ClutchSw_Config "" /begin DEF_CHARACTERISTIC ClutchSwPolarity ClutchSwSwitchPt /end DEF_CHARACTERISTIC /end FUNCTION
/begin FUNCTION Spark_Coil_Characterization "" /begin DEF_CHARACTERISTIC CoilDrvrDlyTime CoilDwellMap /end DEF_CHARACTERISTIC
 /begin OUT_MEASUREMENT CoilDwell SparkDwell SparkEnabled SparkEnergyMonitor SpkEnergy09Idx SpkEnergy09In /end OUT_MEASUREMENT
 /begin SUB_FUNCTION SparkDwell_Override /end SUB_FUNCTION
/end FUNCTION
/begin FUNCTION ActuatorCharacterization ""
 /begin SUB_FUNCTION Spark_Coil_Characterization Electronic_Throttle_Controller Injector_Characterization SequenceCutPattern /end SUB_FUNCTION
/end FUNCTION
/begin FUNCTION Coil_Control "" /begin DEF_CHARACTERISTIC SparkMaxDuration /end DEF_CHARACTERISTIC /begin OUT_MEASUREMENT CoilEnabled CoilStartAngle CoilStopAngle /end OUT_MEASUREMENT
 /begin SUB_FUNCTION EST_Fault_Management Coil_Enable_Manager SparkStartAngle_Override SparkStopAngle_Override /end SUB_FUNCTION
/end FUNCTION
/begin FUNCTION Fuel_Pump_at_Startup "" /begin DEF_CHARACTERISTIC Constant_Fuel_Pump FuelPumpStartTime /end DEF_CHARACTERISTIC /begin OUT_MEASUREMENT FuelPumpTSE /end OUT_MEASUREMENT /end FUNCTION
/begin FUNCTION CrankIAC "" /begin DEF_CHARACTERISTIC CrankIAC_IATMultTbl CrankIAC_OXYMultTbl CrankIACMap /end DEF_CHARACTERISTIC /begin OUT_MEASUREMENT CrankIAC CrankIAC_IATMult CrankIAC_OXYMult /end OUT_MEASUREMENT /end FUNCTION
/begin FUNCTION TDC_Counter "" /begin OUT_MEASUREMENT CrankTDCs /end OUT_MEASUREMENT /end FUNCTION
/begin FUNCTION EngineState ""
 /begin DEF_CHARACTERISTIC CrankToRunRPMThresh RunLatchTDCs StallRPMMinThreshold StallRPMThresholdHyst /end DEF_CHARACTERISTIC
 /begin OUT_MEASUREMENT CrankTrans EngineStateRaw /end OUT_MEASUREMENT
 /begin SUB_FUNCTION TDC_Counter /end SUB_FUNCTION
/end FUNCTION
/begin FUNCTION Delta_TPS_Transient_Fueling ""
 /begin DEF_CHARACTERISTIC DeltaMAP_FiltConst DeltaMAP_MultMap DeltaTPS_FiltConst DeltaTPS_MultMap /end DEF_CHARACTERISTIC
 /begin OUT_MEASUREMENT DeltaMAP DeltaMAP_Mult DeltaMAP17Idx DeltaMAP17In DeltaTPS DeltaTPS_Mult DeltaTPS17Idx DeltaTPS17In MAF09Idx MAF09In TransFuel_MAPFilt TransFuel_TPSFilt /end OUT_MEASUREMENT
 /begin SUB_FUNCTION ECT_Transient_Fueling OXY_Transient_Fueling /end SUB_FUNCTION
/end FUNCTION
/begin FUNCTION Injector_Manager "" /begin DEF_CHARACTERISTIC DeltaTPSFuelingEnable MakeUpEOIMap PrimarySOIMap /end DEF_CHARACTERISTIC /begin OUT_MEASUREMENT MakeUpEOI PrimarySOI /end OUT_MEASUREMENT /begin SUB_FUNCTION Delta_TPS_Transient_Fueling /end SUB_FUNCTION /end FUNCTION
/begin FUNCTION Calculate_A_F_Ratio "" /begin DEF_CHARACTERISTIC DesAFRatioTbl /end DEF_CHARACTERISTIC /begin OUT_MEASUREMENT DesAFRatio DesAFRatioIdx DesAFRatioIn /end OUT_MEASUREMENT /end FUNCTION
/begin FUNCTION Calculate_Fuel_Flow "" /begin OUT_MEASUREMENT Desired_AF_Ratio /end OUT_MEASUREMENT /begin SUB_FUNCTION Calculate_A_F_Ratio /end SUB_FUNCTION /end FUNCTION
/begin FUNCTION Desired_Eq_Ratio_Offset "" /begin DEF_CHARACTERISTIC EqRatio_SpkOfsMultMap EqRatio_SpkOfstTbl /end DEF_CHARACTERISTIC
 /begin OUT_MEASUREMENT DesEqRatio09Idx DesEqRatio09In EqRatio_SpkOfsMult EqRatio_SpkOfst Tot_EqRatio_SpkOfst /end OUT_MEASUREMENT
/end FUNCTION
/begin FUNCTION O2_Control_State_Determination "" /begin DEF_CHARACTERISTIC EquivRatioDelta O2ControlEnable O2StartUpDelayTbl /end DEF_CHARACTERISTIC
 /begin OUT_MEASUREMENT DesEquivInRange EnginSteadyState O2Calibration O2CtrlMode O2SensorFaults O2StartUpDelay O2TimeDelay /end OUT_MEASUREMENT
/end FUNCTION
/begin FUNCTION DesEquivRatioMod ""
 /begin DEF_CHARACTERISTIC DFCODelayTime DFCOEnable DFCOEnterIdleSpeed DFCOEnterRampTime DFCOEntryAPP DFCOEntryMAP DFCOEntryRPMTbl DFCOExitAPP DFCOExitIdleSpeed DFCOExitMAP DFCOExitRampTime DFCOExitRPMTbl DFCOExitSparkRet /end DEF_CHARACTERISTIC
 /begin OUT_MEASUREMENT DFCOActive DFCODesEquivRatio DFCODesSparkOutOfst DFCOEnterCond DFCOEntryRPM DFCOExitRPM /end OUT_MEASUREMENT
/end FUNCTION
/begin FUNCTION DFCO "" /begin SUB_FUNCTION DesEquivRatioMod /end SUB_FUNCTION /end FUNCTION
/begin FUNCTION Digital_Sensors "" /begin DEF_CHARACTERISTIC DigDiag_ClutchStuckTime DigDiag_ScrambleStuckTime /end DEF_CHARACTERISTIC /end FUNCTION
/begin FUNCTION ECT "" /begin DEF_CHARACTERISTIC ECTTbl /end DEF_CHARACTERISTIC /begin OUT_MEASUREMENT ECT ECTADC ECTIdx ECTRaw /end OUT_MEASUREMENT /begin SUB_FUNCTION ECT_Override ECT_Config /end SUB_FUNCTION /end FUNCTION
/begin FUNCTION Capture_ECT_At_Startup "" /begin DEF_CHARACTERISTIC ECT_KeyUp_Count /end DEF_CHARACTERISTIC /end FUNCTION
/begin FUNCTION ECT_KeyUp "" /begin OUT_MEASUREMENT ECT_KeyUp09Idx ECT_KeyUp09In /end OUT_MEASUREMENT /end FUNCTION
/begin FUNCTION ECT_Override "" /begin DEF_CHARACTERISTIC ECT_new ECT_ovr /end DEF_CHARACTERISTIC /end FUNCTION
/begin FUNCTION ECT_Index "" /begin OUT_MEASUREMENT ECT05Idx ECT05In ECT07Idx ECT07In ECT09Idx ECT09In /end OUT_MEASUREMENT /end FUNCTION
/begin FUNCTION ECT_Config "" /begin DEF_CHARACTERISTIC ECTDefault ECTFiltConst ECTMax ECTMin /end DEF_CHARACTERISTIC /end FUNCTION
/begin FUNCTION ECT_Transient_Fueling "" /begin DEF_CHARACTERISTIC ECTTransFuelMultTbl /end DEF_CHARACTERISTIC /begin OUT_MEASUREMENT ECTTransFuelMult /end OUT_MEASUREMENT /end FUNCTION
/begin FUNCTION Main_Power_Relay "" /begin DEF_CHARACTERISTIC ProcessorReboot /end DEF_CHARACTERISTIC /begin OUT_MEASUREMENT ECUP_Enabled ForcedShutDownTimer /end OUT_MEASUREMENT /begin SUB_FUNCTION Main_Power_Relay_Config MPRD_Override /end SUB_FUNCTION /end FUNCTION
/begin FUNCTION Main_Power_Relay_Config "" /begin DEF_CHARACTERISTIC ECUP_Threshold ForcedShutDownTimerThresh Shutdown_Delay /end DEF_CHARACTERISTIC /end FUNCTION
/begin FUNCTION Dash_Message_2 "" /begin DEF_CHARACTERISTIC ECUVolt_Filt SparkAdv_Filt VSPD_Filt /end DEF_CHARACTERISTIC /begin SUB_FUNCTION PHI_Filt PHI_Filt1 /end SUB_FUNCTION /end FUNCTION
/begin FUNCTION Elec_PW_Override "" /begin DEF_CHARACTERISTIC Elec_PW_new Elec_PW_ovr /end DEF_CHARACTERISTIC /end FUNCTION
/begin FUNCTION Injector_Control "" /begin DEF_CHARACTERISTIC InjectiorMinDuration InjectorMaxDuration MinMakeUpPW /end DEF_CHARACTERISTIC /begin OUT_MEASUREMENT InjectorsEnabled InjTransitionCount /end OUT_MEASUREMENT
 /begin SUB_FUNCTION Elec_PW_Override Injector_Enable_Manager ESTOP_FuelInj_Ovr_Override InjEnable_Override MakeUp_EOI_Override Mech_PW_Override SOI_Override /end SUB_FUNCTION
/end FUNCTION
/begin FUNCTION Idle_State_Determination ""
 /begin DEF_CHARACTERISTIC EnableRPMFalling InGearMinGovEntryRPMDelta MinGovAirPcntHyst MinGovEntryAirPcnt MinGovEntryAirTimeThresh StallSaverDeltaRPM /end DEF_CHARACTERISTIC
 /begin OUT_MEASUREMENT IdleState RPMCtrlMode /end OUT_MEASUREMENT
 /begin SUB_FUNCTION Determine_if_RPM_is_Falling /end SUB_FUNCTION
/end FUNCTION
/begin FUNCTION Encoder_Diagnostics "" /begin OUT_MEASUREMENT EncoderFault EncoderFaultCount /end OUT_MEASUREMENT /end FUNCTION
/begin FUNCTION Engine_Accel "" /begin DEF_CHARACTERISTIC EngineAccelFiltConst /end DEF_CHARACTERISTIC /begin OUT_MEASUREMENT EngineAccel /end OUT_MEASUREMENT /end FUNCTION
/begin FUNCTION Injector_Enable_Manager ""
 /begin DEF_CHARACTERISTIC EngineShutdownDelayTime Injector1Enable Injector2Enable Injector3Enable Injector4Enable Injector5Enable Injector6Enable Injector7Enable Injector8Enable /end DEF_CHARACTERISTIC
/end FUNCTION
/begin FUNCTION EquivRatio_Override "" /begin DEF_CHARACTERISTIC EquivRatio_new EquivRatio_ovr /end DEF_CHARACTERISTIC /end FUNCTION
/begin FUNCTION EST_Fault_Management "" /begin OUT_MEASUREMENT EST_DiagDwell ESTOpenADC /end OUT_MEASUREMENT /end FUNCTION
/begin FUNCTION EST_Enable_TDC_Counter "" /begin DEF_CHARACTERISTIC SparkEnableTDCCounts /end DEF_CHARACTERISTIC /begin OUT_MEASUREMENT EST_TDCEnabled TDCCount TDCCountThreshEnabled /end OUT_MEASUREMENT /end FUNCTION
/begin FUNCTION Coil_Enable_Manager ""
 /begin DEF_CHARACTERISTIC SparkEnableCyl1 SparkEnableCyl2 SparkEnableCyl3 SparkEnableCyl4 SparkEnableCyl5 SparkEnableCyl6 SparkEnableCyl7 SparkEnableCyl8 /end DEF_CHARACTERISTIC
 /begin SUB_FUNCTION EST_Enable_TDC_Counter /end SUB_FUNCTION
/end FUNCTION
/begin FUNCTION ESTOP "" /begin OUT_MEASUREMENT ESTOP ESTOP_Raw /end OUT_MEASUREMENT /begin SUB_FUNCTION ESTOP_Override ESTOP_Config /end SUB_FUNCTION /end FUNCTION
/begin FUNCTION ESTOP_FuelInj_Ovr_Override "" /begin DEF_CHARACTERISTIC ESTOP_FuelInj_Ovr_new ESTOP_FuelInj_Ovr_ovr /end DEF_CHARACTERISTIC /end FUNCTION
/begin FUNCTION ESTOP_Override "" /begin DEF_CHARACTERISTIC ESTOP_new ESTOP_ovr /end DEF_CHARACTERISTIC /end FUNCTION
/begin FUNCTION ESTOP_Config "" /begin DEF_CHARACTERISTIC ESTOPPolarity /end DEF_CHARACTERISTIC /end FUNCTION
/begin FUNCTION HBridge ""
 /begin DEF_CHARACTERISTIC ETC_CutPower_Permitted ETC_Frequency ETC_I_MIN ETC_OC_MIN ETC_Offset ETC_VoltageCompTbl /end DEF_CHARACTERISTIC
 /begin OUT_MEASUREMENT ETB_Curr_Flt ETC_Current ETC_DutyCycle ETC_VoltageComp /end OUT_MEASUREMENT
 /begin SUB_FUNCTION ETC_Override /end SUB_FUNCTION
/end FUNCTION
/begin FUNCTION ETC_CutPower "" /begin DEF_CHARACTERISTIC ETC_CutPower_ETC ETC_CutPower_StallTime /end DEF_CHARACTERISTIC /end FUNCTION
/begin FUNCTION State__Manager "" /begin OUT_MEASUREMENT ETC_ECUPState ETC_ShutDownTimer /end OUT_MEASUREMENT /end FUNCTION
/begin FUNCTION Electronic_Throttle_Controller ""
 /begin DEF_CHARACTERISTIC ETC_ShutdownLoAdaptError ETC_SpringTestHiThresh ETC_SpringTestLoThresh ETC_SpringTestTimerThresh /end DEF_CHARACTERISTIC
 /begin SUB_FUNCTION State__Manager PID_With_Damper_Terms__Tunable_ Setpoint_Manager ETC_Adapt_Request ETC_Sticking_Fault ETC_PID_Config ETCStallShutDown /end SUB_FUNCTION
/end FUNCTION
/begin FUNCTION PID_With_Damper_Terms__Tunable_ ""
 /begin DEF_CHARACTERISTIC ETCDampGainDown ETCDampGainUp ETCDCOffsetTbl ETCDGain ETCErrorGain ETCIMax ETCIMin /end DEF_CHARACTERISTIC
 /begin OUT_MEASUREMENT ETC_ErrorIdx ETC_ErrorIn ETC_Setpoint ETC_SetpointIdx ETC_SetpointIn ETCDampTerm ETCDCOffset ETCDTerm ETCError ETCITerm ETCOut ETCPTerm /end OUT_MEASUREMENT
 /begin SUB_FUNCTION IGain PGain DamperSwitch /end SUB_FUNCTION
/end FUNCTION
/end MODULE
/end PROJECT
