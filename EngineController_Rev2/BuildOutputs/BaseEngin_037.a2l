ASAP2_VERSION 1 51
/begin PROJECT Project ""
/begin MODULE BaseEngin_037 ""
/begin MOD_COMMON /* MOD_COMMON Comment */ "" BYTE_ORDER MSB_FIRST ALIGNMENT_BYTE 1 ALIGNMENT_FLOAT32_IEEE 1 ALIGNMENT_FLOAT64_IEEE 1 ALIGNMENT_LONG 1 ALIGNMENT_WORD 1 /end MOD_COMMON
/begin CHARACTERISTIC FaultManager.EST5_Open.Faulty_Samples__X_ "Fault manager configuration.  Select up to 4 actions for each fault." VALUE 0x8000281D RecordLayout_4 0 CompuMethod_1 0 65535 /end CHARACTERISTIC
/begin CHARACTERISTIC FaultManager.EST5_Open.Total_Samples__Y_ "Fault manager configuration.  Select up to 4 actions for each fault." VALUE 0x8000281F RecordLayout_4 0 CompuMethod_1 0 65535 /end CHARACTERISTIC
/begin CHARACTERISTIC FaultManager.EST5_Open.Action_1 "Fault manager configuration.  Select up to 4 actions for each fault." VALUE 0x80002821 RecordLayout_4 0 CompuMethod_110 0 65535 /end CHARACTERISTIC
/begin CHARACTERISTIC FaultManager.EST5_Open.Action_1_Condition "Fault manager configuration.  Select up to 4 actions for each fault." VALUE 0x80002823 RecordLayout_4 0 CompuMethod_111 0 65535 /end CHARACTERISTIC
/begin CHARACTERISTIC FaultManager.EST5_Open.Action_2 "Fault manager configuration.  Select up to 4 actions for each fault." VALUE 0x80002825 RecordLayout_4 0 CompuMethod_110 0 65535 /end CHARACTERISTIC
/begin CHARACTERISTIC FaultManager.EST5_Open.Action_2_Condition "Fault manager configuration.  Select up to 4 actions for each fault." VALUE 0x80002827 RecordLayout_4 0 CompuMethod_111 0 65535 /end CHARACTERISTIC
/begin CHARACTERISTIC FaultManager.EST5_Open.Action_3 "Fault manager configuration.  Select up to 4 actions for each fault." VALUE 0x80002829 RecordLayout_4 0 CompuMethod_110 0 65535 /end CHARACTERISTIC
/begin CHARACTERISTIC FaultManager.EST5_Open.Action_3_Condition "Fault manager configuration.  Select up to 4 actions for each fault." VALUE 0x8000282B RecordLayout_4 0 CompuMethod_111 0 65535 /end CHARACTERISTIC
/begin CHARACTERISTIC FaultManager.EST5_Open.Action_4 "Fault manager configuration.  Select up to 4 actions for each fault." VALUE 0x8000282D RecordLayout_4 0 CompuMethod_110 0 65535 /end CHARACTERISTIC
/begin CHARACTERISTIC FaultManager.EST5_Open.Action_4_Condition "Fault manager configuration.  Select up to 4 actions for each fault." VALUE 0x8000282F RecordLayout_4 0 CompuMethod_111 0 65535 /end CHARACTERISTIC
/begin CHARACTERISTIC FaultManager.EST5_Short.Mode "Fault manager configuration.  Select up to 4 actions for each fault." VALUE 0x80002831 RecordLayout_4 0 CompuMethod_108 0 65535 /end CHARACTERISTIC
/begin CHARACTERISTIC FaultManager.EST5_Short.ID "Fault manager configuration.  Select up to 4 actions for each fault." VALUE 0x80002833 RecordLayout_4 0 CompuMethod_1 0 65535 /end CHARACTERISTIC
/begin CHARACTERISTIC FaultManager.EST5_Short.Test "Fault manager configuration.  Select up to 4 actions for each fault." VALUE 0x80002835 RecordLayout_4 0 CompuMethod_109 0 65535 /end CHARACTERISTIC
/begin CHARACTERISTIC FaultManager.EST5_Short.Faulty_Samples__X_ "Fault manager configuration.  Select up to 4 actions for each fault." VALUE 0x80002837 RecordLayout_4 0 CompuMethod_1 0 65535 /end CHARACTERISTIC
/begin CHARACTERISTIC FaultManager.EST5_Short.Total_Samples__Y_ "Fault manager configuration.  Select up to 4 actions for each fault." VALUE 0x80002839 RecordLayout_4 0 CompuMethod_1 0 65535 /end CHARACTERISTIC
/begin CHARACTERISTIC FaultManager.EST5_Short.Action_1 "Fault manager configuration.  Select up to 4 actions for each fault." VALUE 0x8000283B RecordLayout_4 0 CompuMethod_110 0 65535 /end CHARACTERISTIC
/begin CHARACTERISTIC FaultManager.EST5_Short.Action_1_Condition "Fault manager configuration.  Select up to 4 actions for each fault." VALUE 0x8000283D RecordLayout_4 0 CompuMethod_111 0 65535 /end CHARACTERISTIC
/begin CHARACTERISTIC FaultManager.EST5_Short.Action_2 "Fault manager configuration.  Select up to 4 actions for each fault." VALUE 0x8000283F RecordLayout_4 0 CompuMethod_110 0 65535 /end CHARACTERISTIC
/begin CHARACTERISTIC FaultManager.EST5_Short.Action_2_Condition "Fault manager configuration.  Select up to 4 actions for each fault." VALUE 0x80002841 RecordLayout_4 0 CompuMethod_111 0 65535 /end CHARACTERISTIC
/begin CHARACTERISTIC FaultManager.EST5_Short.Action_3 "Fault manager configuration.  Select up to 4 actions for each fault." VALUE 0x80002843 RecordLayout_4 0 CompuMethod_110 0 65535 /end CHARACTERISTIC
/begin CHARACTERISTIC FaultManager.EST5_Short.Action_3_Condition "Fault manager configuration.  Select up to 4 actions for each fault." VALUE 0x80002845 RecordLayout_4 0 CompuMethod_111 0 65535 /end CHARACTERISTIC
/begin CHARACTERISTIC FaultManager.EST5_Short.Action_4 "Fault manager configuration.  Select up to 4 actions for each fault." VALUE 0x80002847 RecordLayout_4 0 CompuMethod_110 0 65535 /end CHARACTERISTIC
/begin CHARACTERISTIC FaultManager.EST5_Short.Action_4_Condition "Fault manager configuration.  Select up to 4 actions for each fault." VALUE 0x80002849 RecordLayout_4 0 CompuMethod_111 0 65535 /end CHARACTERISTIC
/begin CHARACTERISTIC FaultManager.EST6_Open.Mode "Fault manager configuration.  Select up to 4 actions for each fault." VALUE 0x8000284B RecordLayout_4 0 CompuMethod_108 0 65535 /end CHARACTERISTIC
/begin CHARACTERISTIC FaultManager.EST6_Open.ID "Fault manager configuration.  Select up to 4 actions for each fault." VALUE 0x8000284D RecordLayout_4 0 CompuMethod_1 0 65535 /end CHARACTERISTIC
/begin CHARACTERISTIC FaultManager.EST6_Open.Test "Fault manager configuration.  Select up to 4 actions for each fault." VALUE 0x8000284F RecordLayout_4 0 CompuMethod_109 0 65535 /end CHARACTERISTIC
/begin CHARACTERISTIC FaultManager.EST6_Open.Faulty_Samples__X_ "Fault manager configuration.  Select up to 4 actions for each fault." VALUE 0x80002851 RecordLayout_4 0 CompuMethod_1 0 65535 /end CHARACTERISTIC
/begin CHARACTERISTIC FaultManager.EST6_Open.Total_Samples__Y_ "Fault manager configuration.  Select up to 4 actions for each fault." VALUE 0x80002853 RecordLayout_4 0 CompuMethod_1 0 65535 /end CHARACTERISTIC
/begin CHARACTERISTIC FaultManager.EST6_Open.Action_1 "Fault manager configuration.  Select up to 4 actions for each fault." VALUE 0x80002855 RecordLayout_4 0 CompuMethod_110 0 65535 /end CHARACTERISTIC
/begin CHARACTERISTIC FaultManager.EST6_Open.Action_1_Condition "Fault manager configuration.  Select up to 4 actions for each fault." VALUE 0x80002857 RecordLayout_4 0 CompuMethod_111 0 65535 /end CHARACTERISTIC
/begin CHARACTERISTIC FaultManager.EST6_Open.Action_2 "Fault manager configuration.  Select up to 4 actions for each fault." VALUE 0x80002859 RecordLayout_4 0 CompuMethod_110 0 65535 /end CHARACTERISTIC
/begin CHARACTERISTIC FaultManager.EST6_Open.Action_2_Condition "Fault manager configuration.  Select up to 4 actions for each fault." VALUE 0x8000285B RecordLayout_4 0 CompuMethod_111 0 65535 /end CHARACTERISTIC
/begin CHARACTERISTIC FaultManager.EST6_Open.Action_3 "Fault manager configuration.  Select up to 4 actions for each fault." VALUE 0x8000285D RecordLayout_4 0 CompuMethod_110 0 65535 /end CHARACTERISTIC
/begin CHARACTERISTIC FaultManager.EST6_Open.Action_3_Condition "Fault manager configuration.  Select up to 4 actions for each fault." VALUE 0x8000285F RecordLayout_4 0 CompuMethod_111 0 65535 /end CHARACTERISTIC
/begin CHARACTERISTIC FaultManager.EST6_Open.Action_4 "Fault manager configuration.  Select up to 4 actions for each fault." VALUE 0x80002861 RecordLayout_4 0 CompuMethod_110 0 65535 /end CHARACTERISTIC
/begin CHARACTERISTIC FaultManager.EST6_Open.Action_4_Condition "Fault manager configuration.  Select up to 4 actions for each fault." VALUE 0x80002863 RecordLayout_4 0 CompuMethod_111 0 65535 /end CHARACTERISTIC
/begin CHARACTERISTIC FaultManager.EST6_Short.Mode "Fault manager configuration.  Select up to 4 actions for each fault." VALUE 0x80002865 RecordLayout_4 0 CompuMethod_108 0 65535 /end CHARACTERISTIC
/begin CHARACTERISTIC FaultManager.EST6_Short.ID "Fault manager configuration.  Select up to 4 actions for each fault." VALUE 0x80002867 RecordLayout_4 0 CompuMethod_1 0 65535 /end CHARACTERISTIC
/begin CHARACTERISTIC FaultManager.EST6_Short.Test "Fault manager configuration.  Select up to 4 actions for each fault." VALUE 0x80002869 RecordLayout_4 0 CompuMethod_109 0 65535 /end CHARACTERISTIC
/begin CHARACTERISTIC FaultManager.EST6_Short.Faulty_Samples__X_ "Fault manager configuration.  Select up to 4 actions for each fault." VALUE 0x8000286B RecordLayout_4 0 CompuMethod_1 0 65535 /end CHARACTERISTIC
/begin CHARACTERISTIC FaultManager.EST6_Short.Total_Samples__Y_ "Fault manager configuration.  Select up to 4 actions for each fault." VALUE 0x8000286D RecordLayout_4 0 CompuMethod_1 0 65535 /end CHARACTERISTIC
/begin CHARACTERISTIC FaultManager.EST6_Short.Action_1 "Fault manager configuration.  Select up to 4 actions for each fault." VALUE 0x8000286F RecordLayout_4 0 CompuMethod_110 0 65535 /end CHARACTERISTIC
/begin CHARACTERISTIC FaultManager.EST6_Short.Action_1_Condition "Fault manager configuration.  Select up to 4 actions for each fault." VALUE 0x80002871 RecordLayout_4 0 CompuMethod_111 0 65535 /end CHARACTERISTIC
/begin CHARACTERISTIC FaultManager.EST6_Short.Action_2 "Fault manager configuration.  Select up to 4 actions for each fault." VALUE 0x80002873 RecordLayout_4 0 CompuMethod_110 0 65535 /end CHARACTERISTIC
/begin CHARACTERISTIC FaultManager.EST6_Short.Action_2_Condition "Fault manager configuration.  Select up to 4 actions for each fault." VALUE 0x80002875 RecordLayout_4 0 CompuMethod_111 0 65535 /end CHARACTERISTIC
/begin CHARACTERISTIC FaultManager.EST6_Short.Action_3 "Fault manager configuration.  Select up to 4 actions for each fault." VALUE 0x80002877 RecordLayout_4 0 CompuMethod_110 0 65535 /end CHARACTERISTIC
/begin CHARACTERISTIC FaultManager.EST6_Short.Action_3_Condition "Fault manager configuration.  Select up to 4 actions for each fault." VALUE 0x80002879 RecordLayout_4 0 CompuMethod_111 0 65535 /end CHARACTERISTIC
/begin CHARACTERISTIC FaultManager.EST6_Short.Action_4 "Fault manager configuration.  Select up to 4 actions for each fault." VALUE 0x8000287B RecordLayout_4 0 CompuMethod_110 0 65535 /end CHARACTERISTIC
/begin CHARACTERISTIC FaultManager.EST6_Short.Action_4_Condition "Fault manager configuration.  Select up to 4 actions for each fault." VALUE 0x8000287D RecordLayout_4 0 CompuMethod_111 0 65535 /end CHARACTERISTIC
/begin CHARACTERISTIC FaultManager.EST7_Open.Mode "Fault manager configuration.  Select up to 4 actions for each fault." VALUE 0x8000287F RecordLayout_4 0 CompuMethod_108 0 65535 /end CHARACTERISTIC
/begin CHARACTERISTIC FaultManager.EST7_Open.ID "Fault manager configuration.  Select up to 4 actions for each fault." VALUE 0x80002881 RecordLayout_4 0 CompuMethod_1 0 65535 /end CHARACTERISTIC
/begin CHARACTERISTIC FaultManager.EST7_Open.Test "Fault manager configuration.  Select up to 4 actions for each fault." VALUE 0x80002883 RecordLayout_4 0 CompuMethod_109 0 65535 /end CHARACTERISTIC
/begin CHARACTERISTIC FaultManager.EST7_Open.Faulty_Samples__X_ "Fault manager configuration.  Select up to 4 actions for each fault." VALUE 0x80002885 RecordLayout_4 0 CompuMethod_1 0 65535 /end CHARACTERISTIC
/begin CHARACTERISTIC FaultManager.EST7_Open.Total_Samples__Y_ "Fault manager configuration.  Select up to 4 actions for each fault." VALUE 0x80002887 RecordLayout_4 0 CompuMethod_1 0 65535 /end CHARACTERISTIC
/begin CHARACTERISTIC FaultManager.EST7_Open.Action_1 "Fault manager configuration.  Select up to 4 actions for each fault." VALUE 0x80002889 RecordLayout_4 0 CompuMethod_110 0 65535 /end CHARACTERISTIC
/begin CHARACTERISTIC FaultManager.EST7_Open.Action_1_Condition "Fault manager configuration.  Select up to 4 actions for each fault." VALUE 0x8000288B RecordLayout_4 0 CompuMethod_111 0 65535 /end CHARACTERISTIC
/begin CHARACTERISTIC FaultManager.EST7_Open.Action_2 "Fault manager configuration.  Select up to 4 actions for each fault." VALUE 0x8000288D RecordLayout_4 0 CompuMethod_110 0 65535 /end CHARACTERISTIC
/begin CHARACTERISTIC FaultManager.EST7_Open.Action_2_Condition "Fault manager configuration.  Select up to 4 actions for each fault." VALUE 0x8000288F RecordLayout_4 0 CompuMethod_111 0 65535 /end CHARACTERISTIC
/begin CHARACTERISTIC FaultManager.EST7_Open.Action_3 "Fault manager configuration.  Select up to 4 actions for each fault." VALUE 0x80002891 RecordLayout_4 0 CompuMethod_110 0 65535 /end CHARACTERISTIC
/begin CHARACTERISTIC FaultManager.EST7_Open.Action_3_Condition "Fault manager configuration.  Select up to 4 actions for each fault." VALUE 0x80002893 RecordLayout_4 0 CompuMethod_111 0 65535 /end CHARACTERISTIC
/begin CHARACTERISTIC FaultManager.EST7_Open.Action_4 "Fault manager configuration.  Select up to 4 actions for each fault." VALUE 0x80002895 RecordLayout_4 0 CompuMethod_110 0 65535 /end CHARACTERISTIC
/begin CHARACTERISTIC FaultManager.EST7_Open.Action_4_Condition "Fault manager configuration.  Select up to 4 actions for each fault." VALUE 0x80002897 RecordLayout_4 0 CompuMethod_111 0 65535 /end CHARACTERISTIC
/begin CHARACTERISTIC FaultManager.EST7_Short.Mode "Fault manager configuration.  Select up to 4 actions for each fault." VALUE 0x80002899 RecordLayout_4 0 CompuMethod_108 0 65535 /end CHARACTERISTIC
/begin CHARACTERISTIC FaultManager.EST7_Short.ID "Fault manager configuration.  Select up to 4 actions for each fault." VALUE 0x8000289B RecordLayout_4 0 CompuMethod_1 0 65535 /end CHARACTERISTIC
/begin CHARACTERISTIC FaultManager.EST7_Short.Test "Fault manager configuration.  Select up to 4 actions for each fault." VALUE 0x8000289D RecordLayout_4 0 CompuMethod_109 0 65535 /end CHARACTERISTIC
/begin CHARACTERISTIC FaultManager.EST7_Short.Faulty_Samples__X_ "Fault manager configuration.  Select up to 4 actions for each fault." VALUE 0x8000289F RecordLayout_4 0 CompuMethod_1 0 65535 /end CHARACTERISTIC
/begin CHARACTERISTIC FaultManager.EST7_Short.Total_Samples__Y_ "Fault manager configuration.  Select up to 4 actions for each fault." VALUE 0x800028A1 RecordLayout_4 0 CompuMethod_1 0 65535 /end CHARACTERISTIC
/begin CHARACTERISTIC FaultManager.EST7_Short.Action_1 "Fault manager configuration.  Select up to 4 actions for each fault." VALUE 0x800028A3 RecordLayout_4 0 CompuMethod_110 0 65535 /end CHARACTERISTIC
/begin CHARACTERISTIC FaultManager.EST7_Short.Action_1_Condition "Fault manager configuration.  Select up to 4 actions for each fault." VALUE 0x800028A5 RecordLayout_4 0 CompuMethod_111 0 65535 /end CHARACTERISTIC
/begin CHARACTERISTIC FaultManager.EST7_Short.Action_2 "Fault manager configuration.  Select up to 4 actions for each fault." VALUE 0x800028A7 RecordLayout_4 0 CompuMethod_110 0 65535 /end CHARACTERISTIC
/begin CHARACTERISTIC FaultManager.EST7_Short.Action_2_Condition "Fault manager configuration.  Select up to 4 actions for each fault." VALUE 0x800028A9 RecordLayout_4 0 CompuMethod_111 0 65535 /end CHARACTERISTIC
/begin CHARACTERISTIC FaultManager.EST7_Short.Action_3 "Fault manager configuration.  Select up to 4 actions for each fault." VALUE 0x800028AB RecordLayout_4 0 CompuMethod_110 0 65535 /end CHARACTERISTIC
/begin CHARACTERISTIC FaultManager.EST7_Short.Action_3_Condition "Fault manager configuration.  Select up to 4 actions for each fault." VALUE 0x800028AD RecordLayout_4 0 CompuMethod_111 0 65535 /end CHARACTERISTIC
/begin CHARACTERISTIC FaultManager.EST7_Short.Action_4 "Fault manager configuration.  Select up to 4 actions for each fault." VALUE 0x800028AF RecordLayout_4 0 CompuMethod_110 0 65535 /end CHARACTERISTIC
/begin CHARACTERISTIC FaultManager.EST7_Short.Action_4_Condition "Fault manager configuration.  Select up to 4 actions for each fault." VALUE 0x800028B1 RecordLayout_4 0 CompuMethod_111 0 65535 /end CHARACTERISTIC
/begin CHARACTERISTIC FaultManager.EST8_Open.Mode "Fault manager configuration.  Select up to 4 actions for each fault." VALUE 0x800028B3 RecordLayout_4 0 CompuMethod_108 0 65535 /end CHARACTERISTIC
/begin CHARACTERISTIC FaultManager.EST8_Open.ID "Fault manager configuration.  Select up to 4 actions for each fault." VALUE 0x800028B5 RecordLayout_4 0 CompuMethod_1 0 65535 /end CHARACTERISTIC
/begin CHARACTERISTIC FaultManager.EST8_Open.Test "Fault manager configuration.  Select up to 4 actions for each fault." VALUE 0x800028B7 RecordLayout_4 0 CompuMethod_109 0 65535 /end CHARACTERISTIC
/begin CHARACTERISTIC FaultManager.EST8_Open.Faulty_Samples__X_ "Fault manager configuration.  Select up to 4 actions for each fault." VALUE 0x800028B9 RecordLayout_4 0 CompuMethod_1 0 65535 /end CHARACTERISTIC
/begin CHARACTERISTIC FaultManager.EST8_Open.Total_Samples__Y_ "Fault manager configuration.  Select up to 4 actions for each fault." VALUE 0x800028BB RecordLayout_4 0 CompuMethod_1 0 65535 /end CHARACTERISTIC
/begin CHARACTERISTIC FaultManager.EST8_Open.Action_1 "Fault manager configuration.  Select up to 4 actions for each fault." VALUE 0x800028BD RecordLayout_4 0 CompuMethod_110 0 65535 /end CHARACTERISTIC
/begin CHARACTERISTIC FaultManager.EST8_Open.Action_1_Condition "Fault manager configuration.  Select up to 4 actions for each fault." VALUE 0x800028BF RecordLayout_4 0 CompuMethod_111 0 65535 /end CHARACTERISTIC
/begin CHARACTERISTIC FaultManager.EST8_Open.Action_2 "Fault manager configuration.  Select up to 4 actions for each fault." VALUE 0x800028C1 RecordLayout_4 0 CompuMethod_110 0 65535 /end CHARACTERISTIC
/begin CHARACTERISTIC FaultManager.EST8_Open.Action_2_Condition "Fault manager configuration.  Select up to 4 actions for each fault." VALUE 0x800028C3 RecordLayout_4 0 CompuMethod_111 0 65535 /end CHARACTERISTIC
/begin CHARACTERISTIC FaultManager.EST8_Open.Action_3 "Fault manager configuration.  Select up to 4 actions for each fault." VALUE 0x800028C5 RecordLayout_4 0 CompuMethod_110 0 65535 /end CHARACTERISTIC
/begin CHARACTERISTIC FaultManager.EST8_Open.Action_3_Condition "Fault manager configuration.  Select up to 4 actions for each fault." VALUE 0x800028C7 RecordLayout_4 0 CompuMethod_111 0 65535 /end CHARACTERISTIC
/begin CHARACTERISTIC FaultManager.EST8_Open.Action_4 "Fault manager configuration.  Select up to 4 actions for each fault." VALUE 0x800028C9 RecordLayout_4 0 CompuMethod_110 0 65535 /end CHARACTERISTIC
/begin CHARACTERISTIC FaultManager.EST8_Open.Action_4_Condition "Fault manager configuration.  Select up to 4 actions for each fault." VALUE 0x800028CB RecordLayout_4 0 CompuMethod_111 0 65535 /end CHARACTERISTIC
/begin CHARACTERISTIC FaultManager.EST8_Short.Mode "Fault manager configuration.  Select up to 4 actions for each fault." VALUE 0x800028CD RecordLayout_4 0 CompuMethod_108 0 65535 /end CHARACTERISTIC
/begin CHARACTERISTIC FaultManager.EST8_Short.ID "Fault manager configuration.  Select up to 4 actions for each fault." VALUE 0x800028CF RecordLayout_4 0 CompuMethod_1 0 65535 /end CHARACTERISTIC
/begin CHARACTERISTIC FaultManager.EST8_Short.Test "Fault manager configuration.  Select up to 4 actions for each fault." VALUE 0x800028D1 RecordLayout_4 0 CompuMethod_109 0 65535 /end CHARACTERISTIC
/begin CHARACTERISTIC FaultManager.EST8_Short.Faulty_Samples__X_ "Fault manager configuration.  Select up to 4 actions for each fault." VALUE 0x800028D3 RecordLayout_4 0 CompuMethod_1 0 65535 /end CHARACTERISTIC
/begin CHARACTERISTIC FaultManager.EST8_Short.Total_Samples__Y_ "Fault manager configuration.  Select up to 4 actions for each fault." VALUE 0x800028D5 RecordLayout_4 0 CompuMethod_1 0 65535 /end CHARACTERISTIC
/begin CHARACTERISTIC FaultManager.EST8_Short.Action_1 "Fault manager configuration.  Select up to 4 actions for each fault." VALUE 0x800028D7 RecordLayout_4 0 CompuMethod_110 0 65535 /end CHARACTERISTIC
/begin CHARACTERISTIC FaultManager.EST8_Short.Action_1_Condition "Fault manager configuration.  Select up to 4 actions for each fault." VALUE 0x800028D9 RecordLayout_4 0 CompuMethod_111 0 65535 /end CHARACTERISTIC
/begin CHARACTERISTIC FaultManager.EST8_Short.Action_2 "Fault manager configuration.  Select up to 4 actions for each fault." VALUE 0x800028DB RecordLayout_4 0 CompuMethod_110 0 65535 /end CHARACTERISTIC
/begin CHARACTERISTIC FaultManager.EST8_Short.Action_2_Condition "Fault manager configuration.  Select up to 4 actions for each fault." VALUE 0x800028DD RecordLayout_4 0 CompuMethod_111 0 65535 /end CHARACTERISTIC
/begin CHARACTERISTIC FaultManager.EST8_Short.Action_3 "Fault manager configuration.  Select up to 4 actions for each fault." VALUE 0x800028DF RecordLayout_4 0 CompuMethod_110 0 65535 /end CHARACTERISTIC
/begin CHARACTERISTIC FaultManager.EST8_Short.Action_3_Condition "Fault manager configuration.  Select up to 4 actions for each fault." VALUE 0x800028E1 RecordLayout_4 0 CompuMethod_111 0 65535 /end CHARACTERISTIC
/begin CHARACTERISTIC FaultManager.EST8_Short.Action_4 "Fault manager configuration.  Select up to 4 actions for each fault." VALUE 0x800028E3 RecordLayout_4 0 CompuMethod_110 0 65535 /end CHARACTERISTIC
/begin CHARACTERISTIC FaultManager.EST8_Short.Action_4_Condition "Fault manager configuration.  Select up to 4 actions for each fault." VALUE 0x800028E5 RecordLayout_4 0 CompuMethod_111 0 65535 /end CHARACTERISTIC
/begin CHARACTERISTIC FaultManager.ETCSpringTest.Mode "Fault manager configuration.  Select up to 4 actions for each fault." VALUE 0x800028E7 RecordLayout_4 0 CompuMethod_108 0 65535 /end CHARACTERISTIC
/begin CHARACTERISTIC FaultManager.ETCSpringTest.ID "Fault manager configuration.  Select up to 4 actions for each fault." VALUE 0x800028E9 RecordLayout_4 0 CompuMethod_1 0 65535 /end CHARACTERISTIC
/begin CHARACTERISTIC FaultManager.ETCSpringTest.Test "Fault manager configuration.  Select up to 4 actions for each fault." VALUE 0x800028EB RecordLayout_4 0 CompuMethod_109 0 65535 /end CHARACTERISTIC
/begin CHARACTERISTIC FaultManager.ETCSpringTest.Faulty_Samples__X_ "Fault manager configuration.  Select up to 4 actions for each fault." VALUE 0x800028ED RecordLayout_4 0 CompuMethod_1 0 65535 /end CHARACTERISTIC
/begin CHARACTERISTIC FaultManager.ETCSpringTest.Total_Samples__Y_ "Fault manager configuration.  Select up to 4 actions for each fault." VALUE 0x800028EF RecordLayout_4 0 CompuMethod_1 0 65535 /end CHARACTERISTIC
/begin CHARACTERISTIC FaultManager.ETCSpringTest.Action_1 "Fault manager configuration.  Select up to 4 actions for each fault." VALUE 0x800028F1 RecordLayout_4 0 CompuMethod_110 0 65535 /end CHARACTERISTIC
/begin CHARACTERISTIC FaultManager.ETCSpringTest.Action_1_Condition "Fault manager configuration.  Select up to 4 actions for each fault." VALUE 0x800028F3 RecordLayout_4 0 CompuMethod_111 0 65535 /end CHARACTERISTIC
/begin CHARACTERISTIC FaultManager.ETCSpringTest.Action_2 "Fault manager configuration.  Select up to 4 actions for each fault." VALUE 0x800028F5 RecordLayout_4 0 CompuMethod_110 0 65535 /end CHARACTERISTIC
/begin CHARACTERISTIC FaultManager.ETCSpringTest.Action_2_Condition "Fault manager configuration.  Select up to 4 actions for each fault." VALUE 0x800028F7 RecordLayout_4 0 CompuMethod_111 0 65535 /end CHARACTERISTIC
/begin CHARACTERISTIC FaultManager.ETCSpringTest.Action_3 "Fault manager configuration.  Select up to 4 actions for each fault." VALUE 0x800028F9 RecordLayout_4 0 CompuMethod_110 0 65535 /end CHARACTERISTIC
/begin CHARACTERISTIC FaultManager.ETCSpringTest.Action_3_Condition "Fault manager configuration.  Select up to 4 actions for each fault." VALUE 0x800028FB RecordLayout_4 0 CompuMethod_111 0 65535 /end CHARACTERISTIC
/begin CHARACTERISTIC FaultManager.ETCSpringTest.Action_4 "Fault manager configuration.  Select up to 4 actions for each fault." VALUE 0x800028FD RecordLayout_4 0 CompuMethod_110 0 65535 /end CHARACTERISTIC
/begin CHARACTERISTIC FaultManager.ETCSpringTest.Action_4_Condition "Fault manager configuration.  Select up to 4 actions for each fault." VALUE 0x800028FF RecordLayout_4 0 CompuMethod_111 0 65535 /end CHARACTERISTIC
/begin CHARACTERISTIC FaultManager.ETC_Open_Fault.Mode "Fault manager configuration.  Select up to 4 actions for each fault." VALUE 0x80002901 RecordLayout_4 0 CompuMethod_108 0 65535 /end CHARACTERISTIC
/begin CHARACTERISTIC FaultManager.ETC_Open_Fault.ID "Fault manager configuration.  Select up to 4 actions for each fault." VALUE 0x80002903 RecordLayout_4 0 CompuMethod_1 0 65535 /end CHARACTERISTIC
/begin CHARACTERISTIC FaultManager.ETC_Open_Fault.Test "Fault manager configuration.  Select up to 4 actions for each fault." VALUE 0x80002905 RecordLayout_4 0 CompuMethod_109 0 65535 /end CHARACTERISTIC
/begin CHARACTERISTIC FaultManager.ETC_Open_Fault.Faulty_Samples__X_ "Fault manager configuration.  Select up to 4 actions for each fault." VALUE 0x80002907 RecordLayout_4 0 CompuMethod_1 0 65535 /end CHARACTERISTIC
/begin CHARACTERISTIC FaultManager.ETC_Open_Fault.Total_Samples__Y_ "Fault manager configuration.  Select up to 4 actions for each fault." VALUE 0x80002909 RecordLayout_4 0 CompuMethod_1 0 65535 /end CHARACTERISTIC
/begin CHARACTERISTIC FaultManager.ETC_Open_Fault.Action_1 "Fault manager configuration.  Select up to 4 actions for each fault." VALUE 0x8000290B RecordLayout_4 0 CompuMethod_110 0 65535 /end CHARACTERISTIC
/begin CHARACTERISTIC FaultManager.ETC_Open_Fault.Action_1_Condition "Fault manager configuration.  Select up to 4 actions for each fault." VALUE 0x8000290D RecordLayout_4 0 CompuMethod_111 0 65535 /end CHARACTERISTIC
/begin CHARACTERISTIC FaultManager.ETC_Open_Fault.Action_2 "Fault manager configuration.  Select up to 4 actions for each fault." VALUE 0x8000290F RecordLayout_4 0 CompuMethod_110 0 65535 /end CHARACTERISTIC
/begin CHARACTERISTIC FaultManager.ETC_Open_Fault.Action_2_Condition "Fault manager configuration.  Select up to 4 actions for each fault." VALUE 0x80002911 RecordLayout_4 0 CompuMethod_111 0 65535 /end CHARACTERISTIC
/begin CHARACTERISTIC FaultManager.ETC_Open_Fault.Action_3 "Fault manager configuration.  Select up to 4 actions for each fault." VALUE 0x80002913 RecordLayout_4 0 CompuMethod_110 0 65535 /end CHARACTERISTIC
/begin CHARACTERISTIC FaultManager.ETC_Open_Fault.Action_3_Condition "Fault manager configuration.  Select up to 4 actions for each fault." VALUE 0x80002915 RecordLayout_4 0 CompuMethod_111 0 65535 /end CHARACTERISTIC
/begin CHARACTERISTIC FaultManager.ETC_Open_Fault.Action_4 "Fault manager configuration.  Select up to 4 actions for each fault." VALUE 0x80002917 RecordLayout_4 0 CompuMethod_110 0 65535 /end CHARACTERISTIC
/begin CHARACTERISTIC FaultManager.ETC_Open_Fault.Action_4_Condition "Fault manager configuration.  Select up to 4 actions for each fault." VALUE 0x80002919 RecordLayout_4 0 CompuMethod_111 0 65535 /end CHARACTERISTIC
/begin CHARACTERISTIC FaultManager.ETC_Sticking.Mode "Fault manager configuration.  Select up to 4 actions for each fault." VALUE 0x8000291B RecordLayout_4 0 CompuMethod_108 0 65535 /end CHARACTERISTIC
/begin CHARACTERISTIC FaultManager.ETC_Sticking.ID "Fault manager configuration.  Select up to 4 actions for each fault." VALUE 0x8000291D RecordLayout_4 0 CompuMethod_1 0 65535 /end CHARACTERISTIC
/begin CHARACTERISTIC FaultManager.ETC_Sticking.Test "Fault manager configuration.  Select up to 4 actions for each fault." VALUE 0x8000291F RecordLayout_4 0 CompuMethod_109 0 65535 /end CHARACTERISTIC
/begin CHARACTERISTIC FaultManager.ETC_Sticking.Faulty_Samples__X_ "Fault manager configuration.  Select up to 4 actions for each fault." VALUE 0x80002921 RecordLayout_4 0 CompuMethod_1 0 65535 /end CHARACTERISTIC
/begin CHARACTERISTIC FaultManager.ETC_Sticking.Total_Samples__Y_ "Fault manager configuration.  Select up to 4 actions for each fault." VALUE 0x80002923 RecordLayout_4 0 CompuMethod_1 0 65535 /end CHARACTERISTIC
/begin CHARACTERISTIC FaultManager.ETC_Sticking.Action_1 "Fault manager configuration.  Select up to 4 actions for each fault." VALUE 0x80002925 RecordLayout_4 0 CompuMethod_110 0 65535 /end CHARACTERISTIC
/begin CHARACTERISTIC FaultManager.ETC_Sticking.Action_1_Condition "Fault manager configuration.  Select up to 4 actions for each fault." VALUE 0x80002927 RecordLayout_4 0 CompuMethod_111 0 65535 /end CHARACTERISTIC
/begin CHARACTERISTIC FaultManager.ETC_Sticking.Action_2 "Fault manager configuration.  Select up to 4 actions for each fault." VALUE 0x80002929 RecordLayout_4 0 CompuMethod_110 0 65535 /end CHARACTERISTIC
/begin CHARACTERISTIC FaultManager.ETC_Sticking.Action_2_Condition "Fault manager configuration.  Select up to 4 actions for each fault." VALUE 0x8000292B RecordLayout_4 0 CompuMethod_111 0 65535 /end CHARACTERISTIC
/begin CHARACTERISTIC FaultManager.ETC_Sticking.Action_3 "Fault manager configuration.  Select up to 4 actions for each fault." VALUE 0x8000292D RecordLayout_4 0 CompuMethod_110 0 65535 /end CHARACTERISTIC
/begin CHARACTERISTIC FaultManager.ETC_Sticking.Action_3_Condition "Fault manager configuration.  Select up to 4 actions for each fault." VALUE 0x8000292F RecordLayout_4 0 CompuMethod_111 0 65535 /end CHARACTERISTIC
/begin CHARACTERISTIC FaultManager.ETC_Sticking.Action_4 "Fault manager configuration.  Select up to 4 actions for each fault." VALUE 0x80002931 RecordLayout_4 0 CompuMethod_110 0 65535 /end CHARACTERISTIC
/begin CHARACTERISTIC FaultManager.ETC_Sticking.Action_4_Condition "Fault manager configuration.  Select up to 4 actions for each fault." VALUE 0x80002933 RecordLayout_4 0 CompuMethod_111 0 65535 /end CHARACTERISTIC
/begin CHARACTERISTIC FaultManager.EVAPRangeHigh.Mode "Fault manager configuration.  Select up to 4 actions for each fault." VALUE 0x80002935 RecordLayout_4 0 CompuMethod_108 0 65535 /end CHARACTERISTIC
/begin CHARACTERISTIC FaultManager.EVAPRangeHigh.ID "Fault manager configuration.  Select up to 4 actions for each fault." VALUE 0x80002937 RecordLayout_4 0 CompuMethod_1 0 65535 /end CHARACTERISTIC
/begin CHARACTERISTIC FaultManager.EVAPRangeHigh.Test "Fault manager configuration.  Select up to 4 actions for each fault." VALUE 0x80002939 RecordLayout_4 0 CompuMethod_109 0 65535 /end CHARACTERISTIC
/begin CHARACTERISTIC FaultManager.EVAPRangeHigh.Faulty_Samples__X_ "Fault manager configuration.  Select up to 4 actions for each fault." VALUE 0x8000293B RecordLayout_4 0 CompuMethod_1 0 65535 /end CHARACTERISTIC
/begin CHARACTERISTIC FaultManager.EVAPRangeHigh.Total_Samples__Y_ "Fault manager configuration.  Select up to 4 actions for each fault." VALUE 0x8000293D RecordLayout_4 0 CompuMethod_1 0 65535 /end CHARACTERISTIC
/begin CHARACTERISTIC FaultManager.EVAPRangeHigh.Action_1 "Fault manager configuration.  Select up to 4 actions for each fault." VALUE 0x8000293F RecordLayout_4 0 CompuMethod_110 0 65535 /end CHARACTERISTIC
/begin CHARACTERISTIC FaultManager.EVAPRangeHigh.Action_1_Condition "Fault manager configuration.  Select up to 4 actions for each fault." VALUE 0x80002941 RecordLayout_4 0 CompuMethod_111 0 65535 /end CHARACTERISTIC
/begin CHARACTERISTIC FaultManager.EVAPRangeHigh.Action_2 "Fault manager configuration.  Select up to 4 actions for each fault." VALUE 0x80002943 RecordLayout_4 0 CompuMethod_110 0 65535 /end CHARACTERISTIC
/begin CHARACTERISTIC FaultManager.EVAPRangeHigh.Action_2_Condition "Fault manager configuration.  Select up to 4 actions for each fault." VALUE 0x80002945 RecordLayout_4 0 CompuMethod_111 0 65535 /end CHARACTERISTIC
/begin CHARACTERISTIC FaultManager.EVAPRangeHigh.Action_3 "Fault manager configuration.  Select up to 4 actions for each fault." VALUE 0x80002947 RecordLayout_4 0 CompuMethod_110 0 65535 /end CHARACTERISTIC
/begin CHARACTERISTIC FaultManager.EVAPRangeHigh.Action_3_Condition "Fault manager configuration.  Select up to 4 actions for each fault." VALUE 0x80002949 RecordLayout_4 0 CompuMethod_111 0 65535 /end CHARACTERISTIC
/begin CHARACTERISTIC FaultManager.EVAPRangeHigh.Action_4 "Fault manager configuration.  Select up to 4 actions for each fault." VALUE 0x8000294B RecordLayout_4 0 CompuMethod_110 0 65535 /end CHARACTERISTIC
/begin CHARACTERISTIC FaultManager.EVAPRangeHigh.Action_4_Condition "Fault manager configuration.  Select up to 4 actions for each fault." VALUE 0x8000294D RecordLayout_4 0 CompuMethod_111 0 65535 /end CHARACTERISTIC
/begin CHARACTERISTIC FaultManager.EVAPRangeLow.Mode "Fault manager configuration.  Select up to 4 actions for each fault." VALUE 0x8000294F RecordLayout_4 0 CompuMethod_108 0 65535 /end CHARACTERISTIC
/begin CHARACTERISTIC FaultManager.EVAPRangeLow.ID "Fault manager configuration.  Select up to 4 actions for each fault." VALUE 0x80002951 RecordLayout_4 0 CompuMethod_1 0 65535 /end CHARACTERISTIC
/begin CHARACTERISTIC FaultManager.EVAPRangeLow.Test "Fault manager configuration.  Select up to 4 actions for each fault." VALUE 0x80002953 RecordLayout_4 0 CompuMethod_109 0 65535 /end CHARACTERISTIC
/begin CHARACTERISTIC FaultManager.EVAPRangeLow.Faulty_Samples__X_ "Fault manager configuration.  Select up to 4 actions for each fault." VALUE 0x80002955 RecordLayout_4 0 CompuMethod_1 0 65535 /end CHARACTERISTIC
/begin CHARACTERISTIC FaultManager.EVAPRangeLow.Total_Samples__Y_ "Fault manager configuration.  Select up to 4 actions for each fault." VALUE 0x80002957 RecordLayout_4 0 CompuMethod_1 0 65535 /end CHARACTERISTIC
/begin CHARACTERISTIC FaultManager.EVAPRangeLow.Action_1 "Fault manager configuration.  Select up to 4 actions for each fault." VALUE 0x80002959 RecordLayout_4 0 CompuMethod_110 0 65535 /end CHARACTERISTIC
/begin CHARACTERISTIC FaultManager.EVAPRangeLow.Action_1_Condition "Fault manager configuration.  Select up to 4 actions for each fault." VALUE 0x8000295B RecordLayout_4 0 CompuMethod_111 0 65535 /end CHARACTERISTIC
/begin CHARACTERISTIC FaultManager.EVAPRangeLow.Action_2 "Fault manager configuration.  Select up to 4 actions for each fault." VALUE 0x8000295D RecordLayout_4 0 CompuMethod_110 0 65535 /end CHARACTERISTIC
/begin CHARACTERISTIC FaultManager.EVAPRangeLow.Action_2_Condition "Fault manager configuration.  Select up to 4 actions for each fault." VALUE 0x8000295F RecordLayout_4 0 CompuMethod_111 0 65535 /end CHARACTERISTIC
/begin CHARACTERISTIC FaultManager.EVAPRangeLow.Action_3 "Fault manager configuration.  Select up to 4 actions for each fault." VALUE 0x80002961 RecordLayout_4 0 CompuMethod_110 0 65535 /end CHARACTERISTIC
/begin CHARACTERISTIC FaultManager.EVAPRangeLow.Action_3_Condition "Fault manager configuration.  Select up to 4 actions for each fault." VALUE 0x80002963 RecordLayout_4 0 CompuMethod_111 0 65535 /end CHARACTERISTIC
/begin CHARACTERISTIC FaultManager.EVAPRangeLow.Action_4 "Fault manager configuration.  Select up to 4 actions for each fault." VALUE 0x80002965 RecordLayout_4 0 CompuMethod_110 0 65535 /end CHARACTERISTIC
/begin CHARACTERISTIC FaultManager.EVAPRangeLow.Action_4_Condition "Fault manager configuration.  Select up to 4 actions for each fault." VALUE 0x80002967 RecordLayout_4 0 CompuMethod_111 0 65535 /end CHARACTERISTIC
/begin CHARACTERISTIC FaultManager.FuelAdaptRangeHi_BankA.Mode "Fault manager configuration.  Select up to 4 actions for each fault." VALUE 0x80002969 RecordLayout_4 0 CompuMethod_108 0 65535 /end CHARACTERISTIC
/begin CHARACTERISTIC FaultManager.FuelAdaptRangeHi_BankA.ID "Fault manager configuration.  Select up to 4 actions for each fault." VALUE 0x8000296B RecordLayout_4 0 CompuMethod_1 0 65535 /end CHARACTERISTIC
/begin CHARACTERISTIC FaultManager.FuelAdaptRangeHi_BankA.Test "Fault manager configuration.  Select up to 4 actions for each fault." VALUE 0x8000296D RecordLayout_4 0 CompuMethod_109 0 65535 /end CHARACTERISTIC
/begin CHARACTERISTIC FaultManager.FuelAdaptRangeHi_BankA.Faulty_Samples__X_ "Fault manager configuration.  Select up to 4 actions for each fault." VALUE 0x8000296F RecordLayout_4 0 CompuMethod_1 0 65535 /end CHARACTERISTIC
/begin CHARACTERISTIC FaultManager.FuelAdaptRangeHi_BankA.Total_Samples__Y_ "Fault manager configuration.  Select up to 4 actions for each fault." VALUE 0x80002971 RecordLayout_4 0 CompuMethod_1 0 65535 /end CHARACTERISTIC
/begin CHARACTERISTIC FaultManager.FuelAdaptRangeHi_BankA.Action_1 "Fault manager configuration.  Select up to 4 actions for each fault." VALUE 0x80002973 RecordLayout_4 0 CompuMethod_110 0 65535 /end CHARACTERISTIC
/begin CHARACTERISTIC FaultManager.FuelAdaptRangeHi_BankA.Action_1_Condition "Fault manager configuration.  Select up to 4 actions for each fault." VALUE 0x80002975 RecordLayout_4 0 CompuMethod_111 0 65535 /end CHARACTERISTIC
/begin CHARACTERISTIC FaultManager.FuelAdaptRangeHi_BankA.Action_2 "Fault manager configuration.  Select up to 4 actions for each fault." VALUE 0x80002977 RecordLayout_4 0 CompuMethod_110 0 65535 /end CHARACTERISTIC
/begin CHARACTERISTIC FaultManager.FuelAdaptRangeHi_BankA.Action_2_Condition "Fault manager configuration.  Select up to 4 actions for each fault." VALUE 0x80002979 RecordLayout_4 0 CompuMethod_111 0 65535 /end CHARACTERISTIC
/begin CHARACTERISTIC FaultManager.FuelAdaptRangeHi_BankA.Action_3 "Fault manager configuration.  Select up to 4 actions for each fault." VALUE 0x8000297B RecordLayout_4 0 CompuMethod_110 0 65535 /end CHARACTERISTIC
/begin CHARACTERISTIC FaultManager.FuelAdaptRangeHi_BankA.Action_3_Condition "Fault manager configuration.  Select up to 4 actions for each fault." VALUE 0x8000297D RecordLayout_4 0 CompuMethod_111 0 65535 /end CHARACTERISTIC
/begin CHARACTERISTIC FaultManager.FuelAdaptRangeHi_BankA.Action_4 "Fault manager configuration.  Select up to 4 actions for each fault." VALUE 0x8000297F RecordLayout_4 0 CompuMethod_110 0 65535 /end CHARACTERISTIC
/begin CHARACTERISTIC FaultManager.FuelAdaptRangeHi_BankA.Action_4_Condition "Fault manager configuration.  Select up to 4 actions for each fault." VALUE 0x80002981 RecordLayout_4 0 CompuMethod_111 0 65535 /end CHARACTERISTIC
/begin CHARACTERISTIC FaultManager.FuelAdaptRangeHi_BankB.Mode "Fault manager configuration.  Select up to 4 actions for each fault." VALUE 0x80002983 RecordLayout_4 0 CompuMethod_108 0 65535 /end CHARACTERISTIC
/begin CHARACTERISTIC FaultManager.FuelAdaptRangeHi_BankB.ID "Fault manager configuration.  Select up to 4 actions for each fault." VALUE 0x80002985 RecordLayout_4 0 CompuMethod_1 0 65535 /end CHARACTERISTIC
/begin CHARACTERISTIC FaultManager.FuelAdaptRangeHi_BankB.Test "Fault manager configuration.  Select up to 4 actions for each fault." VALUE 0x80002987 RecordLayout_4 0 CompuMethod_109 0 65535 /end CHARACTERISTIC
/begin CHARACTERISTIC FaultManager.FuelAdaptRangeHi_BankB.Faulty_Samples__X_ "Fault manager configuration.  Select up to 4 actions for each fault." VALUE 0x80002989 RecordLayout_4 0 CompuMethod_1 0 65535 /end CHARACTERISTIC
/begin CHARACTERISTIC FaultManager.FuelAdaptRangeHi_BankB.Total_Samples__Y_ "Fault manager configuration.  Select up to 4 actions for each fault." VALUE 0x8000298B RecordLayout_4 0 CompuMethod_1 0 65535 /end CHARACTERISTIC
/begin CHARACTERISTIC FaultManager.FuelAdaptRangeHi_BankB.Action_1 "Fault manager configuration.  Select up to 4 actions for each fault." VALUE 0x8000298D RecordLayout_4 0 CompuMethod_110 0 65535 /end CHARACTERISTIC
/begin CHARACTERISTIC FaultManager.FuelAdaptRangeHi_BankB.Action_1_Condition "Fault manager configuration.  Select up to 4 actions for each fault." VALUE 0x8000298F RecordLayout_4 0 CompuMethod_111 0 65535 /end CHARACTERISTIC
/begin CHARACTERISTIC FaultManager.FuelAdaptRangeHi_BankB.Action_2 "Fault manager configuration.  Select up to 4 actions for each fault." VALUE 0x80002991 RecordLayout_4 0 CompuMethod_110 0 65535 /end CHARACTERISTIC
/begin CHARACTERISTIC FaultManager.FuelAdaptRangeHi_BankB.Action_2_Condition "Fault manager configuration.  Select up to 4 actions for each fault." VALUE 0x80002993 RecordLayout_4 0 CompuMethod_111 0 65535 /end CHARACTERISTIC
/begin CHARACTERISTIC FaultManager.FuelAdaptRangeHi_BankB.Action_3 "Fault manager configuration.  Select up to 4 actions for each fault." VALUE 0x80002995 RecordLayout_4 0 CompuMethod_110 0 65535 /end CHARACTERISTIC
/begin CHARACTERISTIC FaultManager.FuelAdaptRangeHi_BankB.Action_3_Condition "Fault manager configuration.  Select up to 4 actions for each fault." VALUE 0x80002997 RecordLayout_4 0 CompuMethod_111 0 65535 /end CHARACTERISTIC
/begin CHARACTERISTIC FaultManager.FuelAdaptRangeHi_BankB.Action_4 "Fault manager configuration.  Select up to 4 actions for each fault." VALUE 0x80002999 RecordLayout_4 0 CompuMethod_110 0 65535 /end CHARACTERISTIC
/begin CHARACTERISTIC FaultManager.FuelAdaptRangeHi_BankB.Action_4_Condition "Fault manager configuration.  Select up to 4 actions for each fault." VALUE 0x8000299B RecordLayout_4 0 CompuMethod_111 0 65535 /end CHARACTERISTIC
/begin CHARACTERISTIC FaultManager.FuelAdaptRangeLow_BankA.Mode "Fault manager configuration.  Select up to 4 actions for each fault." VALUE 0x8000299D RecordLayout_4 0 CompuMethod_108 0 65535 /end CHARACTERISTIC
/begin CHARACTERISTIC FaultManager.FuelAdaptRangeLow_BankA.ID "Fault manager configuration.  Select up to 4 actions for each fault." VALUE 0x8000299F RecordLayout_4 0 CompuMethod_1 0 65535 /end CHARACTERISTIC
/begin CHARACTERISTIC FaultManager.FuelAdaptRangeLow_BankA.Test "Fault manager configuration.  Select up to 4 actions for each fault." VALUE 0x800029A1 RecordLayout_4 0 CompuMethod_109 0 65535 /end CHARACTERISTIC
/begin CHARACTERISTIC FaultManager.FuelAdaptRangeLow_BankA.Faulty_Samples__X_ "Fault manager configuration.  Select up to 4 actions for each fault." VALUE 0x800029A3 RecordLayout_4 0 CompuMethod_1 0 65535 /end CHARACTERISTIC
/begin CHARACTERISTIC FaultManager.FuelAdaptRangeLow_BankA.Total_Samples__Y_ "Fault manager configuration.  Select up to 4 actions for each fault." VALUE 0x800029A5 RecordLayout_4 0 CompuMethod_1 0 65535 /end CHARACTERISTIC
/begin CHARACTERISTIC FaultManager.FuelAdaptRangeLow_BankA.Action_1 "Fault manager configuration.  Select up to 4 actions for each fault." VALUE 0x800029A7 RecordLayout_4 0 CompuMethod_110 0 65535 /end CHARACTERISTIC
/begin CHARACTERISTIC FaultManager.FuelAdaptRangeLow_BankA.Action_1_Condition "Fault manager configuration.  Select up to 4 actions for each fault." VALUE 0x800029A9 RecordLayout_4 0 CompuMethod_111 0 65535 /end CHARACTERISTIC
/begin CHARACTERISTIC FaultManager.FuelAdaptRangeLow_BankA.Action_2 "Fault manager configuration.  Select up to 4 actions for each fault." VALUE 0x800029AB RecordLayout_4 0 CompuMethod_110 0 65535 /end CHARACTERISTIC
/begin CHARACTERISTIC FaultManager.FuelAdaptRangeLow_BankA.Action_2_Condition "Fault manager configuration.  Select up to 4 actions for each fault." VALUE 0x800029AD RecordLayout_4 0 CompuMethod_111 0 65535 /end CHARACTERISTIC
/begin CHARACTERISTIC FaultManager.FuelAdaptRangeLow_BankA.Action_3 "Fault manager configuration.  Select up to 4 actions for each fault." VALUE 0x800029AF RecordLayout_4 0 CompuMethod_110 0 65535 /end CHARACTERISTIC
/begin CHARACTERISTIC FaultManager.FuelAdaptRangeLow_BankA.Action_3_Condition "Fault manager configuration.  Select up to 4 actions for each fault." VALUE 0x800029B1 RecordLayout_4 0 CompuMethod_111 0 65535 /end CHARACTERISTIC
/begin CHARACTERISTIC FaultManager.FuelAdaptRangeLow_BankA.Action_4 "Fault manager configuration.  Select up to 4 actions for each fault." VALUE 0x800029B3 RecordLayout_4 0 CompuMethod_110 0 65535 /end CHARACTERISTIC
/begin CHARACTERISTIC FaultManager.FuelAdaptRangeLow_BankA.Action_4_Condition "Fault manager configuration.  Select up to 4 actions for each fault." VALUE 0x800029B5 RecordLayout_4 0 CompuMethod_111 0 65535 /end CHARACTERISTIC
/begin CHARACTERISTIC FaultManager.FuelAdaptRangeLow_BankB.Mode "Fault manager configuration.  Select up to 4 actions for each fault." VALUE 0x800029B7 RecordLayout_4 0 CompuMethod_108 0 65535 /end CHARACTERISTIC
/begin CHARACTERISTIC FaultManager.FuelAdaptRangeLow_BankB.ID "Fault manager configuration.  Select up to 4 actions for each fault." VALUE 0x800029B9 RecordLayout_4 0 CompuMethod_1 0 65535 /end CHARACTERISTIC
/begin CHARACTERISTIC FaultManager.FuelAdaptRangeLow_BankB.Test "Fault manager configuration.  Select up to 4 actions for each fault." VALUE 0x800029BB RecordLayout_4 0 CompuMethod_109 0 65535 /end CHARACTERISTIC
/begin CHARACTERISTIC FaultManager.FuelAdaptRangeLow_BankB.Faulty_Samples__X_ "Fault manager configuration.  Select up to 4 actions for each fault." VALUE 0x800029BD RecordLayout_4 0 CompuMethod_1 0 65535 /end CHARACTERISTIC
/begin CHARACTERISTIC FaultManager.FuelAdaptRangeLow_BankB.Total_Samples__Y_ "Fault manager configuration.  Select up to 4 actions for each fault." VALUE 0x800029BF RecordLayout_4 0 CompuMethod_1 0 65535 /end CHARACTERISTIC
/begin CHARACTERISTIC FaultManager.FuelAdaptRangeLow_BankB.Action_1 "Fault manager configuration.  Select up to 4 actions for each fault." VALUE 0x800029C1 RecordLayout_4 0 CompuMethod_110 0 65535 /end CHARACTERISTIC
/begin CHARACTERISTIC FaultManager.FuelAdaptRangeLow_BankB.Action_1_Condition "Fault manager configuration.  Select up to 4 actions for each fault." VALUE 0x800029C3 RecordLayout_4 0 CompuMethod_111 0 65535 /end CHARACTERISTIC
/begin CHARACTERISTIC FaultManager.FuelAdaptRangeLow_BankB.Action_2 "Fault manager configuration.  Select up to 4 actions for each fault." VALUE 0x800029C5 RecordLayout_4 0 CompuMethod_110 0 65535 /end CHARACTERISTIC
/begin CHARACTERISTIC FaultManager.FuelAdaptRangeLow_BankB.Action_2_Condition "Fault manager configuration.  Select up to 4 actions for each fault." VALUE 0x800029C7 RecordLayout_4 0 CompuMethod_111 0 65535 /end CHARACTERISTIC
/begin CHARACTERISTIC FaultManager.FuelAdaptRangeLow_BankB.Action_3 "Fault manager configuration.  Select up to 4 actions for each fault." VALUE 0x800029C9 RecordLayout_4 0 CompuMethod_110 0 65535 /end CHARACTERISTIC
/begin CHARACTERISTIC FaultManager.FuelAdaptRangeLow_BankB.Action_3_Condition "Fault manager configuration.  Select up to 4 actions for each fault." VALUE 0x800029CB RecordLayout_4 0 CompuMethod_111 0 65535 /end CHARACTERISTIC
/begin CHARACTERISTIC FaultManager.FuelAdaptRangeLow_BankB.Action_4 "Fault manager configuration.  Select up to 4 actions for each fault." VALUE 0x800029CD RecordLayout_4 0 CompuMethod_110 0 65535 /end CHARACTERISTIC
/begin CHARACTERISTIC FaultManager.FuelAdaptRangeLow_BankB.Action_4_Condition "Fault manager configuration.  Select up to 4 actions for each fault." VALUE 0x800029CF RecordLayout_4 0 CompuMethod_111 0 65535 /end CHARACTERISTIC
/begin CHARACTERISTIC FaultManager.FuelPresHigh_Fault.Mode "Fault manager configuration.  Select up to 4 actions for each fault." VALUE 0x800029D1 RecordLayout_4 0 CompuMethod_108 0 65535 /end CHARACTERISTIC
/begin CHARACTERISTIC FaultManager.FuelPresHigh_Fault.ID "Fault manager configuration.  Select up to 4 actions for each fault." VALUE 0x800029D3 RecordLayout_4 0 CompuMethod_1 0 65535 /end CHARACTERISTIC
/begin CHARACTERISTIC FaultManager.FuelPresHigh_Fault.Test "Fault manager configuration.  Select up to 4 actions for each fault." VALUE 0x800029D5 RecordLayout_4 0 CompuMethod_109 0 65535 /end CHARACTERISTIC
/begin CHARACTERISTIC FaultManager.FuelPresHigh_Fault.Faulty_Samples__X_ "Fault manager configuration.  Select up to 4 actions for each fault." VALUE 0x800029D7 RecordLayout_4 0 CompuMethod_1 0 65535 /end CHARACTERISTIC
/begin CHARACTERISTIC FaultManager.FuelPresHigh_Fault.Total_Samples__Y_ "Fault manager configuration.  Select up to 4 actions for each fault." VALUE 0x800029D9 RecordLayout_4 0 CompuMethod_1 0 65535 /end CHARACTERISTIC
/begin CHARACTERISTIC FaultManager.FuelPresHigh_Fault.Action_1 "Fault manager configuration.  Select up to 4 actions for each fault." VALUE 0x800029DB RecordLayout_4 0 CompuMethod_110 0 65535 /end CHARACTERISTIC
/begin CHARACTERISTIC FaultManager.FuelPresHigh_Fault.Action_1_Condition "Fault manager configuration.  Select up to 4 actions for each fault." VALUE 0x800029DD RecordLayout_4 0 CompuMethod_111 0 65535 /end CHARACTERISTIC
/begin CHARACTERISTIC FaultManager.FuelPresHigh_Fault.Action_2 "Fault manager configuration.  Select up to 4 actions for each fault." VALUE 0x800029DF RecordLayout_4 0 CompuMethod_110 0 65535 /end CHARACTERISTIC
/begin CHARACTERISTIC FaultManager.FuelPresHigh_Fault.Action_2_Condition "Fault manager configuration.  Select up to 4 actions for each fault." VALUE 0x800029E1 RecordLayout_4 0 CompuMethod_111 0 65535 /end CHARACTERISTIC
/begin CHARACTERISTIC FaultManager.FuelPresHigh_Fault.Action_3 "Fault manager configuration.  Select up to 4 actions for each fault." VALUE 0x800029E3 RecordLayout_4 0 CompuMethod_110 0 65535 /end CHARACTERISTIC
/begin CHARACTERISTIC FaultManager.FuelPresHigh_Fault.Action_3_Condition "Fault manager configuration.  Select up to 4 actions for each fault." VALUE 0x800029E5 RecordLayout_4 0 CompuMethod_111 0 65535 /end CHARACTERISTIC
/begin CHARACTERISTIC FaultManager.FuelPresHigh_Fault.Action_4 "Fault manager configuration.  Select up to 4 actions for each fault." VALUE 0x800029E7 RecordLayout_4 0 CompuMethod_110 0 65535 /end CHARACTERISTIC
/begin CHARACTERISTIC FaultManager.FuelPresHigh_Fault.Action_4_Condition "Fault manager configuration.  Select up to 4 actions for each fault." VALUE 0x800029E9 RecordLayout_4 0 CompuMethod_111 0 65535 /end CHARACTERISTIC
/begin CHARACTERISTIC FaultManager.FuelPresLow_Fault.Mode "Fault manager configuration.  Select up to 4 actions for each fault." VALUE 0x800029EB RecordLayout_4 0 CompuMethod_108 0 65535 /end CHARACTERISTIC
/begin CHARACTERISTIC FaultManager.FuelPresLow_Fault.ID "Fault manager configuration.  Select up to 4 actions for each fault." VALUE 0x800029ED RecordLayout_4 0 CompuMethod_1 0 65535 /end CHARACTERISTIC
/begin CHARACTERISTIC FaultManager.FuelPresLow_Fault.Test "Fault manager configuration.  Select up to 4 actions for each fault." VALUE 0x800029EF RecordLayout_4 0 CompuMethod_109 0 65535 /end CHARACTERISTIC
/begin CHARACTERISTIC FaultManager.FuelPresLow_Fault.Faulty_Samples__X_ "Fault manager configuration.  Select up to 4 actions for each fault." VALUE 0x800029F1 RecordLayout_4 0 CompuMethod_1 0 65535 /end CHARACTERISTIC
/begin CHARACTERISTIC FaultManager.FuelPresLow_Fault.Total_Samples__Y_ "Fault manager configuration.  Select up to 4 actions for each fault." VALUE 0x800029F3 RecordLayout_4 0 CompuMethod_1 0 65535 /end CHARACTERISTIC
/begin CHARACTERISTIC FaultManager.FuelPresLow_Fault.Action_1 "Fault manager configuration.  Select up to 4 actions for each fault." VALUE 0x800029F5 RecordLayout_4 0 CompuMethod_110 0 65535 /end CHARACTERISTIC
/begin CHARACTERISTIC FaultManager.FuelPresLow_Fault.Action_1_Condition "Fault manager configuration.  Select up to 4 actions for each fault." VALUE 0x800029F7 RecordLayout_4 0 CompuMethod_111 0 65535 /end CHARACTERISTIC
/begin CHARACTERISTIC FaultManager.FuelPresLow_Fault.Action_2 "Fault manager configuration.  Select up to 4 actions for each fault." VALUE 0x800029F9 RecordLayout_4 0 CompuMethod_110 0 65535 /end CHARACTERISTIC
/begin CHARACTERISTIC FaultManager.FuelPresLow_Fault.Action_2_Condition "Fault manager configuration.  Select up to 4 actions for each fault." VALUE 0x800029FB RecordLayout_4 0 CompuMethod_111 0 65535 /end CHARACTERISTIC
/begin CHARACTERISTIC FaultManager.FuelPresLow_Fault.Action_3 "Fault manager configuration.  Select up to 4 actions for each fault." VALUE 0x800029FD RecordLayout_4 0 CompuMethod_110 0 65535 /end CHARACTERISTIC
/begin CHARACTERISTIC FaultManager.FuelPresLow_Fault.Action_3_Condition "Fault manager configuration.  Select up to 4 actions for each fault." VALUE 0x800029FF RecordLayout_4 0 CompuMethod_111 0 65535 /end CHARACTERISTIC
/begin CHARACTERISTIC FaultManager.FuelPresLow_Fault.Action_4 "Fault manager configuration.  Select up to 4 actions for each fault." VALUE 0x80002A01 RecordLayout_4 0 CompuMethod_110 0 65535 /end CHARACTERISTIC
/begin CHARACTERISTIC FaultManager.FuelPresLow_Fault.Action_4_Condition "Fault manager configuration.  Select up to 4 actions for each fault." VALUE 0x80002A03 RecordLayout_4 0 CompuMethod_111 0 65535 /end CHARACTERISTIC
/begin CHARACTERISTIC FaultManager.FuelPresRangeHigh.Mode "Fault manager configuration.  Select up to 4 actions for each fault." VALUE 0x80002A05 RecordLayout_4 0 CompuMethod_108 0 65535 /end CHARACTERISTIC
/begin CHARACTERISTIC FaultManager.FuelPresRangeHigh.ID "Fault manager configuration.  Select up to 4 actions for each fault." VALUE 0x80002A07 RecordLayout_4 0 CompuMethod_1 0 65535 /end CHARACTERISTIC
/begin CHARACTERISTIC FaultManager.FuelPresRangeHigh.Test "Fault manager configuration.  Select up to 4 actions for each fault." VALUE 0x80002A09 RecordLayout_4 0 CompuMethod_109 0 65535 /end CHARACTERISTIC
/begin CHARACTERISTIC FaultManager.FuelPresRangeHigh.Faulty_Samples__X_ "Fault manager configuration.  Select up to 4 actions for each fault." VALUE 0x80002A0B RecordLayout_4 0 CompuMethod_1 0 65535 /end CHARACTERISTIC
/begin CHARACTERISTIC FaultManager.FuelPresRangeHigh.Total_Samples__Y_ "Fault manager configuration.  Select up to 4 actions for each fault." VALUE 0x80002A0D RecordLayout_4 0 CompuMethod_1 0 65535 /end CHARACTERISTIC
/begin CHARACTERISTIC FaultManager.FuelPresRangeHigh.Action_1 "Fault manager configuration.  Select up to 4 actions for each fault." VALUE 0x80002A0F RecordLayout_4 0 CompuMethod_110 0 65535 /end CHARACTERISTIC
/begin CHARACTERISTIC FaultManager.FuelPresRangeHigh.Action_1_Condition "Fault manager configuration.  Select up to 4 actions for each fault." VALUE 0x80002A11 RecordLayout_4 0 CompuMethod_111 0 65535 /end CHARACTERISTIC
/begin CHARACTERISTIC FaultManager.FuelPresRangeHigh.Action_2 "Fault manager configuration.  Select up to 4 actions for each fault." VALUE 0x80002A13 RecordLayout_4 0 CompuMethod_110 0 65535 /end CHARACTERISTIC
/begin CHARACTERISTIC FaultManager.FuelPresRangeHigh.Action_2_Condition "Fault manager configuration.  Select up to 4 actions for each fault." VALUE 0x80002A15 RecordLayout_4 0 CompuMethod_111 0 65535 /end CHARACTERISTIC
/begin CHARACTERISTIC FaultManager.FuelPresRangeHigh.Action_3 "Fault manager configuration.  Select up to 4 actions for each fault." VALUE 0x80002A17 RecordLayout_4 0 CompuMethod_110 0 65535 /end CHARACTERISTIC
/begin CHARACTERISTIC FaultManager.FuelPresRangeHigh.Action_3_Condition "Fault manager configuration.  Select up to 4 actions for each fault." VALUE 0x80002A19 RecordLayout_4 0 CompuMethod_111 0 65535 /end CHARACTERISTIC
/begin CHARACTERISTIC FaultManager.FuelPresRangeHigh.Action_4 "Fault manager configuration.  Select up to 4 actions for each fault." VALUE 0x80002A1B RecordLayout_4 0 CompuMethod_110 0 65535 /end CHARACTERISTIC
/begin CHARACTERISTIC FaultManager.FuelPresRangeHigh.Action_4_Condition "Fault manager configuration.  Select up to 4 actions for each fault." VALUE 0x80002A1D RecordLayout_4 0 CompuMethod_111 0 65535 /end CHARACTERISTIC
/begin CHARACTERISTIC FaultManager.FuelPresRangeLow.Mode "Fault manager configuration.  Select up to 4 actions for each fault." VALUE 0x80002A1F RecordLayout_4 0 CompuMethod_108 0 65535 /end CHARACTERISTIC
/begin CHARACTERISTIC FaultManager.FuelPresRangeLow.ID "Fault manager configuration.  Select up to 4 actions for each fault." VALUE 0x80002A21 RecordLayout_4 0 CompuMethod_1 0 65535 /end CHARACTERISTIC
/begin CHARACTERISTIC FaultManager.FuelPresRangeLow.Test "Fault manager configuration.  Select up to 4 actions for each fault." VALUE 0x80002A23 RecordLayout_4 0 CompuMethod_109 0 65535 /end CHARACTERISTIC
/begin CHARACTERISTIC FaultManager.FuelPresRangeLow.Faulty_Samples__X_ "Fault manager configuration.  Select up to 4 actions for each fault." VALUE 0x80002A25 RecordLayout_4 0 CompuMethod_1 0 65535 /end CHARACTERISTIC
/begin CHARACTERISTIC FaultManager.FuelPresRangeLow.Total_Samples__Y_ "Fault manager configuration.  Select up to 4 actions for each fault." VALUE 0x80002A27 RecordLayout_4 0 CompuMethod_1 0 65535 /end CHARACTERISTIC
/begin CHARACTERISTIC FaultManager.FuelPresRangeLow.Action_1 "Fault manager configuration.  Select up to 4 actions for each fault." VALUE 0x80002A29 RecordLayout_4 0 CompuMethod_110 0 65535 /end CHARACTERISTIC
/begin CHARACTERISTIC FaultManager.FuelPresRangeLow.Action_1_Condition "Fault manager configuration.  Select up to 4 actions for each fault." VALUE 0x80002A2B RecordLayout_4 0 CompuMethod_111 0 65535 /end CHARACTERISTIC
/begin CHARACTERISTIC FaultManager.FuelPresRangeLow.Action_2 "Fault manager configuration.  Select up to 4 actions for each fault." VALUE 0x80002A2D RecordLayout_4 0 CompuMethod_110 0 65535 /end CHARACTERISTIC
/begin CHARACTERISTIC FaultManager.FuelPresRangeLow.Action_2_Condition "Fault manager configuration.  Select up to 4 actions for each fault." VALUE 0x80002A2F RecordLayout_4 0 CompuMethod_111 0 65535 /end CHARACTERISTIC
/begin CHARACTERISTIC FaultManager.FuelPresRangeLow.Action_3 "Fault manager configuration.  Select up to 4 actions for each fault." VALUE 0x80002A31 RecordLayout_4 0 CompuMethod_110 0 65535 /end CHARACTERISTIC
/begin CHARACTERISTIC FaultManager.FuelPresRangeLow.Action_3_Condition "Fault manager configuration.  Select up to 4 actions for each fault." VALUE 0x80002A33 RecordLayout_4 0 CompuMethod_111 0 65535 /end CHARACTERISTIC
/begin CHARACTERISTIC FaultManager.FuelPresRangeLow.Action_4 "Fault manager configuration.  Select up to 4 actions for each fault." VALUE 0x80002A35 RecordLayout_4 0 CompuMethod_110 0 65535 /end CHARACTERISTIC
/begin CHARACTERISTIC FaultManager.FuelPresRangeLow.Action_4_Condition "Fault manager configuration.  Select up to 4 actions for each fault." VALUE 0x80002A37 RecordLayout_4 0 CompuMethod_111 0 65535 /end CHARACTERISTIC
/begin CHARACTERISTIC FaultManager.FuelSensRangeHigh.Mode "Fault manager configuration.  Select up to 4 actions for each fault." VALUE 0x80002A39 RecordLayout_4 0 CompuMethod_108 0 65535 /end CHARACTERISTIC
/begin CHARACTERISTIC FaultManager.FuelSensRangeHigh.ID "Fault manager configuration.  Select up to 4 actions for each fault." VALUE 0x80002A3B RecordLayout_4 0 CompuMethod_1 0 65535 /end CHARACTERISTIC
/begin CHARACTERISTIC FaultManager.FuelSensRangeHigh.Test "Fault manager configuration.  Select up to 4 actions for each fault." VALUE 0x80002A3D RecordLayout_4 0 CompuMethod_109 0 65535 /end CHARACTERISTIC
/begin CHARACTERISTIC FaultManager.FuelSensRangeHigh.Faulty_Samples__X_ "Fault manager configuration.  Select up to 4 actions for each fault." VALUE 0x80002A3F RecordLayout_4 0 CompuMethod_1 0 65535 /end CHARACTERISTIC
/begin CHARACTERISTIC FaultManager.FuelSensRangeHigh.Total_Samples__Y_ "Fault manager configuration.  Select up to 4 actions for each fault." VALUE 0x80002A41 RecordLayout_4 0 CompuMethod_1 0 65535 /end CHARACTERISTIC
/begin CHARACTERISTIC FaultManager.FuelSensRangeHigh.Action_1 "Fault manager configuration.  Select up to 4 actions for each fault." VALUE 0x80002A43 RecordLayout_4 0 CompuMethod_110 0 65535 /end CHARACTERISTIC
/begin CHARACTERISTIC FaultManager.FuelSensRangeHigh.Action_1_Condition "Fault manager configuration.  Select up to 4 actions for each fault." VALUE 0x80002A45 RecordLayout_4 0 CompuMethod_111 0 65535 /end CHARACTERISTIC
/begin CHARACTERISTIC FaultManager.FuelSensRangeHigh.Action_2 "Fault manager configuration.  Select up to 4 actions for each fault." VALUE 0x80002A47 RecordLayout_4 0 CompuMethod_110 0 65535 /end CHARACTERISTIC
/begin CHARACTERISTIC FaultManager.FuelSensRangeHigh.Action_2_Condition "Fault manager configuration.  Select up to 4 actions for each fault." VALUE 0x80002A49 RecordLayout_4 0 CompuMethod_111 0 65535 /end CHARACTERISTIC
/begin CHARACTERISTIC FaultManager.FuelSensRangeHigh.Action_3 "Fault manager configuration.  Select up to 4 actions for each fault." VALUE 0x80002A4B RecordLayout_4 0 CompuMethod_110 0 65535 /end CHARACTERISTIC
/begin CHARACTERISTIC FaultManager.FuelSensRangeHigh.Action_3_Condition "Fault manager configuration.  Select up to 4 actions for each fault." VALUE 0x80002A4D RecordLayout_4 0 CompuMethod_111 0 65535 /end CHARACTERISTIC
/begin CHARACTERISTIC FaultManager.FuelSensRangeHigh.Action_4 "Fault manager configuration.  Select up to 4 actions for each fault." VALUE 0x80002A4F RecordLayout_4 0 CompuMethod_110 0 65535 /end CHARACTERISTIC
/begin CHARACTERISTIC FaultManager.FuelSensRangeHigh.Action_4_Condition "Fault manager configuration.  Select up to 4 actions for each fault." VALUE 0x80002A51 RecordLayout_4 0 CompuMethod_111 0 65535 /end CHARACTERISTIC
/begin CHARACTERISTIC FaultManager.FuelSensRangeLow.Mode "Fault manager configuration.  Select up to 4 actions for each fault." VALUE 0x80002A53 RecordLayout_4 0 CompuMethod_108 0 65535 /end CHARACTERISTIC
/begin CHARACTERISTIC FaultManager.FuelSensRangeLow.ID "Fault manager configuration.  Select up to 4 actions for each fault." VALUE 0x80002A55 RecordLayout_4 0 CompuMethod_1 0 65535 /end CHARACTERISTIC
/begin CHARACTERISTIC FaultManager.FuelSensRangeLow.Test "Fault manager configuration.  Select up to 4 actions for each fault." VALUE 0x80002A57 RecordLayout_4 0 CompuMethod_109 0 65535 /end CHARACTERISTIC
/begin CHARACTERISTIC FaultManager.FuelSensRangeLow.Faulty_Samples__X_ "Fault manager configuration.  Select up to 4 actions for each fault." VALUE 0x80002A59 RecordLayout_4 0 CompuMethod_1 0 65535 /end CHARACTERISTIC
/begin CHARACTERISTIC FaultManager.FuelSensRangeLow.Total_Samples__Y_ "Fault manager configuration.  Select up to 4 actions for each fault." VALUE 0x80002A5B RecordLayout_4 0 CompuMethod_1 0 65535 /end CHARACTERISTIC
/begin CHARACTERISTIC FaultManager.FuelSensRangeLow.Action_1 "Fault manager configuration.  Select up to 4 actions for each fault." VALUE 0x80002A5D RecordLayout_4 0 CompuMethod_110 0 65535 /end CHARACTERISTIC
/begin CHARACTERISTIC FaultManager.FuelSensRangeLow.Action_1_Condition "Fault manager configuration.  Select up to 4 actions for each fault." VALUE 0x80002A5F RecordLayout_4 0 CompuMethod_111 0 65535 /end CHARACTERISTIC
/begin CHARACTERISTIC FaultManager.FuelSensRangeLow.Action_2 "Fault manager configuration.  Select up to 4 actions for each fault." VALUE 0x80002A61 RecordLayout_4 0 CompuMethod_110 0 65535 /end CHARACTERISTIC
/begin CHARACTERISTIC FaultManager.FuelSensRangeLow.Action_2_Condition "Fault manager configuration.  Select up to 4 actions for each fault." VALUE 0x80002A63 RecordLayout_4 0 CompuMethod_111 0 65535 /end CHARACTERISTIC
/begin CHARACTERISTIC FaultManager.FuelSensRangeLow.Action_3 "Fault manager configuration.  Select up to 4 actions for each fault." VALUE 0x80002A65 RecordLayout_4 0 CompuMethod_110 0 65535 /end CHARACTERISTIC
/begin CHARACTERISTIC FaultManager.FuelSensRangeLow.Action_3_Condition "Fault manager configuration.  Select up to 4 actions for each fault." VALUE 0x80002A67 RecordLayout_4 0 CompuMethod_111 0 65535 /end CHARACTERISTIC
/begin CHARACTERISTIC FaultManager.FuelSensRangeLow.Action_4 "Fault manager configuration.  Select up to 4 actions for each fault." VALUE 0x80002A69 RecordLayout_4 0 CompuMethod_110 0 65535 /end CHARACTERISTIC
/begin CHARACTERISTIC FaultManager.FuelSensRangeLow.Action_4_Condition "Fault manager configuration.  Select up to 4 actions for each fault." VALUE 0x80002A6B RecordLayout_4 0 CompuMethod_111 0 65535 /end CHARACTERISTIC
/begin CHARACTERISTIC FaultManager.Fuel_LvlRangeHigh.Mode "Fault manager configuration.  Select up to 4 actions for each fault." VALUE 0x80002A6D RecordLayout_4 0 CompuMethod_108 0 65535 /end CHARACTERISTIC
/begin CHARACTERISTIC FaultManager.Fuel_LvlRangeHigh.ID "Fault manager configuration.  Select up to 4 actions for each fault." VALUE 0x80002A6F RecordLayout_4 0 CompuMethod_1 0 65535 /end CHARACTERISTIC
/begin CHARACTERISTIC FaultManager.Fuel_LvlRangeHigh.Test "Fault manager configuration.  Select up to 4 actions for each fault." VALUE 0x80002A71 RecordLayout_4 0 CompuMethod_109 0 65535 /end CHARACTERISTIC
/begin CHARACTERISTIC FaultManager.Fuel_LvlRangeHigh.Faulty_Samples__X_ "Fault manager configuration.  Select up to 4 actions for each fault." VALUE 0x80002A73 RecordLayout_4 0 CompuMethod_1 0 65535 /end CHARACTERISTIC
/begin CHARACTERISTIC FaultManager.Fuel_LvlRangeHigh.Total_Samples__Y_ "Fault manager configuration.  Select up to 4 actions for each fault." VALUE 0x80002A75 RecordLayout_4 0 CompuMethod_1 0 65535 /end CHARACTERISTIC
/begin CHARACTERISTIC FaultManager.Fuel_LvlRangeHigh.Action_1 "Fault manager configuration.  Select up to 4 actions for each fault." VALUE 0x80002A77 RecordLayout_4 0 CompuMethod_110 0 65535 /end CHARACTERISTIC
/begin CHARACTERISTIC FaultManager.Fuel_LvlRangeHigh.Action_1_Condition "Fault manager configuration.  Select up to 4 actions for each fault." VALUE 0x80002A79 RecordLayout_4 0 CompuMethod_111 0 65535 /end CHARACTERISTIC
/begin CHARACTERISTIC FaultManager.Fuel_LvlRangeHigh.Action_2 "Fault manager configuration.  Select up to 4 actions for each fault." VALUE 0x80002A7B RecordLayout_4 0 CompuMethod_110 0 65535 /end CHARACTERISTIC
/begin CHARACTERISTIC FaultManager.Fuel_LvlRangeHigh.Action_2_Condition "Fault manager configuration.  Select up to 4 actions for each fault." VALUE 0x80002A7D RecordLayout_4 0 CompuMethod_111 0 65535 /end CHARACTERISTIC
/begin CHARACTERISTIC FaultManager.Fuel_LvlRangeHigh.Action_3 "Fault manager configuration.  Select up to 4 actions for each fault." VALUE 0x80002A7F RecordLayout_4 0 CompuMethod_110 0 65535 /end CHARACTERISTIC
/begin CHARACTERISTIC FaultManager.Fuel_LvlRangeHigh.Action_3_Condition "Fault manager configuration.  Select up to 4 actions for each fault." VALUE 0x80002A81 RecordLayout_4 0 CompuMethod_111 0 65535 /end CHARACTERISTIC
/begin CHARACTERISTIC FaultManager.Fuel_LvlRangeHigh.Action_4 "Fault manager configuration.  Select up to 4 actions for each fault." VALUE 0x80002A83 RecordLayout_4 0 CompuMethod_110 0 65535 /end CHARACTERISTIC
/begin CHARACTERISTIC FaultManager.Fuel_LvlRangeHigh.Action_4_Condition "Fault manager configuration.  Select up to 4 actions for each fault." VALUE 0x80002A85 RecordLayout_4 0 CompuMethod_111 0 65535 /end CHARACTERISTIC
/begin CHARACTERISTIC FaultManager.Fuel_LvlRangeLow.Mode "Fault manager configuration.  Select up to 4 actions for each fault." VALUE 0x80002A87 RecordLayout_4 0 CompuMethod_108 0 65535 /end CHARACTERISTIC
/begin CHARACTERISTIC FaultManager.Fuel_LvlRangeLow.ID "Fault manager configuration.  Select up to 4 actions for each fault." VALUE 0x80002A89 RecordLayout_4 0 CompuMethod_1 0 65535 /end CHARACTERISTIC
/begin CHARACTERISTIC FaultManager.Fuel_LvlRangeLow.Test "Fault manager configuration.  Select up to 4 actions for each fault." VALUE 0x80002A8B RecordLayout_4 0 CompuMethod_109 0 65535 /end CHARACTERISTIC
/begin CHARACTERISTIC FaultManager.Fuel_LvlRangeLow.Faulty_Samples__X_ "Fault manager configuration.  Select up to 4 actions for each fault." VALUE 0x80002A8D RecordLayout_4 0 CompuMethod_1 0 65535 /end CHARACTERISTIC
/begin CHARACTERISTIC FaultManager.Fuel_LvlRangeLow.Total_Samples__Y_ "Fault manager configuration.  Select up to 4 actions for each fault." VALUE 0x80002A8F RecordLayout_4 0 CompuMethod_1 0 65535 /end CHARACTERISTIC
/begin CHARACTERISTIC FaultManager.Fuel_LvlRangeLow.Action_1 "Fault manager configuration.  Select up to 4 actions for each fault." VALUE 0x80002A91 RecordLayout_4 0 CompuMethod_110 0 65535 /end CHARACTERISTIC
/begin CHARACTERISTIC FaultManager.Fuel_LvlRangeLow.Action_1_Condition "Fault manager configuration.  Select up to 4 actions for each fault." VALUE 0x80002A93 RecordLayout_4 0 CompuMethod_111 0 65535 /end CHARACTERISTIC
/begin CHARACTERISTIC FaultManager.Fuel_LvlRangeLow.Action_2 "Fault manager configuration.  Select up to 4 actions for each fault." VALUE 0x80002A95 RecordLayout_4 0 CompuMethod_110 0 65535 /end CHARACTERISTIC
/begin CHARACTERISTIC FaultManager.Fuel_LvlRangeLow.Action_2_Condition "Fault manager configuration.  Select up to 4 actions for each fault." VALUE 0x80002A97 RecordLayout_4 0 CompuMethod_111 0 65535 /end CHARACTERISTIC
/begin CHARACTERISTIC FaultManager.Fuel_LvlRangeLow.Action_3 "Fault manager configuration.  Select up to 4 actions for each fault." VALUE 0x80002A99 RecordLayout_4 0 CompuMethod_110 0 65535 /end CHARACTERISTIC
/begin CHARACTERISTIC FaultManager.Fuel_LvlRangeLow.Action_3_Condition "Fault manager configuration.  Select up to 4 actions for each fault." VALUE 0x80002A9B RecordLayout_4 0 CompuMethod_111 0 65535 /end CHARACTERISTIC
/begin CHARACTERISTIC FaultManager.Fuel_LvlRangeLow.Action_4 "Fault manager configuration.  Select up to 4 actions for each fault." VALUE 0x80002A9D RecordLayout_4 0 CompuMethod_110 0 65535 /end CHARACTERISTIC
/begin CHARACTERISTIC FaultManager.Fuel_LvlRangeLow.Action_4_Condition "Fault manager configuration.  Select up to 4 actions for each fault." VALUE 0x80002A9F RecordLayout_4 0 CompuMethod_111 0 65535 /end CHARACTERISTIC
/begin CHARACTERISTIC FaultManager.GPS_DateTime_Timeout.Mode "Fault manager configuration.  Select up to 4 actions for each fault." VALUE 0x80002AA1 RecordLayout_4 0 CompuMethod_108 0 65535 /end CHARACTERISTIC
/begin CHARACTERISTIC FaultManager.GPS_DateTime_Timeout.ID "Fault manager configuration.  Select up to 4 actions for each fault." VALUE 0x80002AA3 RecordLayout_4 0 CompuMethod_1 0 65535 /end CHARACTERISTIC
/begin CHARACTERISTIC FaultManager.GPS_DateTime_Timeout.Test "Fault manager configuration.  Select up to 4 actions for each fault." VALUE 0x80002AA5 RecordLayout_4 0 CompuMethod_109 0 65535 /end CHARACTERISTIC
/begin CHARACTERISTIC FaultManager.GPS_DateTime_Timeout.Faulty_Samples__X_ "Fault manager configuration.  Select up to 4 actions for each fault." VALUE 0x80002AA7 RecordLayout_4 0 CompuMethod_1 0 65535 /end CHARACTERISTIC
/begin CHARACTERISTIC FaultManager.GPS_DateTime_Timeout.Total_Samples__Y_ "Fault manager configuration.  Select up to 4 actions for each fault." VALUE 0x80002AA9 RecordLayout_4 0 CompuMethod_1 0 65535 /end CHARACTERISTIC
/begin CHARACTERISTIC FaultManager.GPS_DateTime_Timeout.Action_1 "Fault manager configuration.  Select up to 4 actions for each fault." VALUE 0x80002AAB RecordLayout_4 0 CompuMethod_110 0 65535 /end CHARACTERISTIC
/begin CHARACTERISTIC FaultManager.GPS_DateTime_Timeout.Action_1_Condition "Fault manager configuration.  Select up to 4 actions for each fault." VALUE 0x80002AAD RecordLayout_4 0 CompuMethod_111 0 65535 /end CHARACTERISTIC
/begin CHARACTERISTIC FaultManager.GPS_DateTime_Timeout.Action_2 "Fault manager configuration.  Select up to 4 actions for each fault." VALUE 0x80002AAF RecordLayout_4 0 CompuMethod_110 0 65535 /end CHARACTERISTIC
/begin CHARACTERISTIC FaultManager.GPS_DateTime_Timeout.Action_2_Condition "Fault manager configuration.  Select up to 4 actions for each fault." VALUE 0x80002AB1 RecordLayout_4 0 CompuMethod_111 0 65535 /end CHARACTERISTIC
/begin CHARACTERISTIC FaultManager.GPS_DateTime_Timeout.Action_3 "Fault manager configuration.  Select up to 4 actions for each fault." VALUE 0x80002AB3 RecordLayout_4 0 CompuMethod_110 0 65535 /end CHARACTERISTIC
/begin CHARACTERISTIC FaultManager.GPS_DateTime_Timeout.Action_3_Condition "Fault manager configuration.  Select up to 4 actions for each fault." VALUE 0x80002AB5 RecordLayout_4 0 CompuMethod_111 0 65535 /end CHARACTERISTIC
/begin CHARACTERISTIC FaultManager.GPS_DateTime_Timeout.Action_4 "Fault manager configuration.  Select up to 4 actions for each fault." VALUE 0x80002AB7 RecordLayout_4 0 CompuMethod_110 0 65535 /end CHARACTERISTIC
/begin CHARACTERISTIC FaultManager.GPS_DateTime_Timeout.Action_4_Condition "Fault manager configuration.  Select up to 4 actions for each fault." VALUE 0x80002AB9 RecordLayout_4 0 CompuMethod_111 0 65535 /end CHARACTERISTIC
/begin CHARACTERISTIC FaultManager.GPS_LatLong_Timeout.Mode "Fault manager configuration.  Select up to 4 actions for each fault." VALUE 0x80002ABB RecordLayout_4 0 CompuMethod_108 0 65535 /end CHARACTERISTIC
/begin CHARACTERISTIC FaultManager.GPS_LatLong_Timeout.ID "Fault manager configuration.  Select up to 4 actions for each fault." VALUE 0x80002ABD RecordLayout_4 0 CompuMethod_1 0 65535 /end CHARACTERISTIC
/begin CHARACTERISTIC FaultManager.GPS_LatLong_Timeout.Test "Fault manager configuration.  Select up to 4 actions for each fault." VALUE 0x80002ABF RecordLayout_4 0 CompuMethod_109 0 65535 /end CHARACTERISTIC
/begin CHARACTERISTIC FaultManager.GPS_LatLong_Timeout.Faulty_Samples__X_ "Fault manager configuration.  Select up to 4 actions for each fault." VALUE 0x80002AC1 RecordLayout_4 0 CompuMethod_1 0 65535 /end CHARACTERISTIC
/begin CHARACTERISTIC FaultManager.GPS_LatLong_Timeout.Total_Samples__Y_ "Fault manager configuration.  Select up to 4 actions for each fault." VALUE 0x80002AC3 RecordLayout_4 0 CompuMethod_1 0 65535 /end CHARACTERISTIC
/begin CHARACTERISTIC FaultManager.GPS_LatLong_Timeout.Action_1 "Fault manager configuration.  Select up to 4 actions for each fault." VALUE 0x80002AC5 RecordLayout_4 0 CompuMethod_110 0 65535 /end CHARACTERISTIC
/begin CHARACTERISTIC FaultManager.GPS_LatLong_Timeout.Action_1_Condition "Fault manager configuration.  Select up to 4 actions for each fault." VALUE 0x80002AC7 RecordLayout_4 0 CompuMethod_111 0 65535 /end CHARACTERISTIC
/begin CHARACTERISTIC FaultManager.GPS_LatLong_Timeout.Action_2 "Fault manager configuration.  Select up to 4 actions for each fault." VALUE 0x80002AC9 RecordLayout_4 0 CompuMethod_110 0 65535 /end CHARACTERISTIC
/begin CHARACTERISTIC FaultManager.GPS_LatLong_Timeout.Action_2_Condition "Fault manager configuration.  Select up to 4 actions for each fault." VALUE 0x80002ACB RecordLayout_4 0 CompuMethod_111 0 65535 /end CHARACTERISTIC
/begin CHARACTERISTIC FaultManager.GPS_LatLong_Timeout.Action_3 "Fault manager configuration.  Select up to 4 actions for each fault." VALUE 0x80002ACD RecordLayout_4 0 CompuMethod_110 0 65535 /end CHARACTERISTIC
/begin CHARACTERISTIC FaultManager.GPS_LatLong_Timeout.Action_3_Condition "Fault manager configuration.  Select up to 4 actions for each fault." VALUE 0x80002ACF RecordLayout_4 0 CompuMethod_111 0 65535 /end CHARACTERISTIC
/begin CHARACTERISTIC FaultManager.GPS_LatLong_Timeout.Action_4 "Fault manager configuration.  Select up to 4 actions for each fault." VALUE 0x80002AD1 RecordLayout_4 0 CompuMethod_110 0 65535 /end CHARACTERISTIC
/begin CHARACTERISTIC FaultManager.GPS_LatLong_Timeout.Action_4_Condition "Fault manager configuration.  Select up to 4 actions for each fault." VALUE 0x80002AD3 RecordLayout_4 0 CompuMethod_111 0 65535 /end CHARACTERISTIC
/begin CHARACTERISTIC FaultManager.GPS_SpeedDir_Timeout.Mode "Fault manager configuration.  Select up to 4 actions for each fault." VALUE 0x80002AD5 RecordLayout_4 0 CompuMethod_108 0 65535 /end CHARACTERISTIC
/begin CHARACTERISTIC FaultManager.GPS_SpeedDir_Timeout.ID "Fault manager configuration.  Select up to 4 actions for each fault." VALUE 0x80002AD7 RecordLayout_4 0 CompuMethod_1 0 65535 /end CHARACTERISTIC
/begin CHARACTERISTIC FaultManager.GPS_SpeedDir_Timeout.Test "Fault manager configuration.  Select up to 4 actions for each fault." VALUE 0x80002AD9 RecordLayout_4 0 CompuMethod_109 0 65535 /end CHARACTERISTIC
/begin CHARACTERISTIC FaultManager.GPS_SpeedDir_Timeout.Faulty_Samples__X_ "Fault manager configuration.  Select up to 4 actions for each fault." VALUE 0x80002ADB RecordLayout_4 0 CompuMethod_1 0 65535 /end CHARACTERISTIC
/begin CHARACTERISTIC FaultManager.GPS_SpeedDir_Timeout.Total_Samples__Y_ "Fault manager configuration.  Select up to 4 actions for each fault." VALUE 0x80002ADD RecordLayout_4 0 CompuMethod_1 0 65535 /end CHARACTERISTIC
/begin CHARACTERISTIC FaultManager.GPS_SpeedDir_Timeout.Action_1 "Fault manager configuration.  Select up to 4 actions for each fault." VALUE 0x80002ADF RecordLayout_4 0 CompuMethod_110 0 65535 /end CHARACTERISTIC
/begin CHARACTERISTIC FaultManager.GPS_SpeedDir_Timeout.Action_1_Condition "Fault manager configuration.  Select up to 4 actions for each fault." VALUE 0x80002AE1 RecordLayout_4 0 CompuMethod_111 0 65535 /end CHARACTERISTIC
/begin CHARACTERISTIC FaultManager.GPS_SpeedDir_Timeout.Action_2 "Fault manager configuration.  Select up to 4 actions for each fault." VALUE 0x80002AE3 RecordLayout_4 0 CompuMethod_110 0 65535 /end CHARACTERISTIC
/begin CHARACTERISTIC FaultManager.GPS_SpeedDir_Timeout.Action_2_Condition "Fault manager configuration.  Select up to 4 actions for each fault." VALUE 0x80002AE5 RecordLayout_4 0 CompuMethod_111 0 65535 /end CHARACTERISTIC
/begin CHARACTERISTIC FaultManager.GPS_SpeedDir_Timeout.Action_3 "Fault manager configuration.  Select up to 4 actions for each fault." VALUE 0x80002AE7 RecordLayout_4 0 CompuMethod_110 0 65535 /end CHARACTERISTIC
/begin CHARACTERISTIC FaultManager.GPS_SpeedDir_Timeout.Action_3_Condition "Fault manager configuration.  Select up to 4 actions for each fault." VALUE 0x80002AE9 RecordLayout_4 0 CompuMethod_111 0 65535 /end CHARACTERISTIC
/begin CHARACTERISTIC FaultManager.GPS_SpeedDir_Timeout.Action_4 "Fault manager configuration.  Select up to 4 actions for each fault." VALUE 0x80002AEB RecordLayout_4 0 CompuMethod_110 0 65535 /end CHARACTERISTIC
/begin CHARACTERISTIC FaultManager.GPS_SpeedDir_Timeout.Action_4_Condition "Fault manager configuration.  Select up to 4 actions for each fault." VALUE 0x80002AED RecordLayout_4 0 CompuMethod_111 0 65535 /end CHARACTERISTIC
/begin CHARACTERISTIC FaultManager.HardOverspeed.Mode "Fault manager configuration.  Select up to 4 actions for each fault." VALUE 0x80002AEF RecordLayout_4 0 CompuMethod_108 0 65535 /end CHARACTERISTIC
/begin CHARACTERISTIC FaultManager.HardOverspeed.ID "Fault manager configuration.  Select up to 4 actions for each fault." VALUE 0x80002AF1 RecordLayout_4 0 CompuMethod_1 0 65535 /end CHARACTERISTIC
/begin CHARACTERISTIC FaultManager.HardOverspeed.Test "Fault manager configuration.  Select up to 4 actions for each fault." VALUE 0x80002AF3 RecordLayout_4 0 CompuMethod_109 0 65535 /end CHARACTERISTIC
/begin CHARACTERISTIC FaultManager.HardOverspeed.Faulty_Samples__X_ "Fault manager configuration.  Select up to 4 actions for each fault." VALUE 0x80002AF5 RecordLayout_4 0 CompuMethod_1 0 65535 /end CHARACTERISTIC
/begin CHARACTERISTIC FaultManager.HardOverspeed.Total_Samples__Y_ "Fault manager configuration.  Select up to 4 actions for each fault." VALUE 0x80002AF7 RecordLayout_4 0 CompuMethod_1 0 65535 /end CHARACTERISTIC
/begin CHARACTERISTIC FaultManager.HardOverspeed.Action_1 "Fault manager configuration.  Select up to 4 actions for each fault." VALUE 0x80002AF9 RecordLayout_4 0 CompuMethod_110 0 65535 /end CHARACTERISTIC
/begin CHARACTERISTIC FaultManager.HardOverspeed.Action_1_Condition "Fault manager configuration.  Select up to 4 actions for each fault." VALUE 0x80002AFB RecordLayout_4 0 CompuMethod_111 0 65535 /end CHARACTERISTIC
/begin CHARACTERISTIC FaultManager.HardOverspeed.Action_2 "Fault manager configuration.  Select up to 4 actions for each fault." VALUE 0x80002AFD RecordLayout_4 0 CompuMethod_110 0 65535 /end CHARACTERISTIC
/begin CHARACTERISTIC FaultManager.HardOverspeed.Action_2_Condition "Fault manager configuration.  Select up to 4 actions for each fault." VALUE 0x80002AFF RecordLayout_4 0 CompuMethod_111 0 65535 /end CHARACTERISTIC
/begin CHARACTERISTIC FaultManager.HardOverspeed.Action_3 "Fault manager configuration.  Select up to 4 actions for each fault." VALUE 0x80002B01 RecordLayout_4 0 CompuMethod_110 0 65535 /end CHARACTERISTIC
/begin CHARACTERISTIC FaultManager.HardOverspeed.Action_3_Condition "Fault manager configuration.  Select up to 4 actions for each fault." VALUE 0x80002B03 RecordLayout_4 0 CompuMethod_111 0 65535 /end CHARACTERISTIC
/begin CHARACTERISTIC FaultManager.HardOverspeed.Action_4 "Fault manager configuration.  Select up to 4 actions for each fault." VALUE 0x80002B05 RecordLayout_4 0 CompuMethod_110 0 65535 /end CHARACTERISTIC
/begin CHARACTERISTIC FaultManager.HardOverspeed.Action_4_Condition "Fault manager configuration.  Select up to 4 actions for each fault." VALUE 0x80002B07 RecordLayout_4 0 CompuMethod_111 0 65535 /end CHARACTERISTIC
/begin CHARACTERISTIC FaultManager.IATRangeHigh.Mode "Fault manager configuration.  Select up to 4 actions for each fault." VALUE 0x80002B09 RecordLayout_4 0 CompuMethod_108 0 65535 /end CHARACTERISTIC
/begin CHARACTERISTIC FaultManager.IATRangeHigh.ID "Fault manager configuration.  Select up to 4 actions for each fault." VALUE 0x80002B0B RecordLayout_4 0 CompuMethod_1 0 65535 /end CHARACTERISTIC
/begin CHARACTERISTIC FaultManager.IATRangeHigh.Test "Fault manager configuration.  Select up to 4 actions for each fault." VALUE 0x80002B0D RecordLayout_4 0 CompuMethod_109 0 65535 /end CHARACTERISTIC
/begin CHARACTERISTIC FaultManager.IATRangeHigh.Faulty_Samples__X_ "Fault manager configuration.  Select up to 4 actions for each fault." VALUE 0x80002B0F RecordLayout_4 0 CompuMethod_1 0 65535 /end CHARACTERISTIC
/begin CHARACTERISTIC FaultManager.IATRangeHigh.Total_Samples__Y_ "Fault manager configuration.  Select up to 4 actions for each fault." VALUE 0x80002B11 RecordLayout_4 0 CompuMethod_1 0 65535 /end CHARACTERISTIC
/begin CHARACTERISTIC FaultManager.IATRangeHigh.Action_1 "Fault manager configuration.  Select up to 4 actions for each fault." VALUE 0x80002B13 RecordLayout_4 0 CompuMethod_110 0 65535 /end CHARACTERISTIC
/begin CHARACTERISTIC FaultManager.IATRangeHigh.Action_1_Condition "Fault manager configuration.  Select up to 4 actions for each fault." VALUE 0x80002B15 RecordLayout_4 0 CompuMethod_111 0 65535 /end CHARACTERISTIC
/begin CHARACTERISTIC FaultManager.IATRangeHigh.Action_2 "Fault manager configuration.  Select up to 4 actions for each fault." VALUE 0x80002B17 RecordLayout_4 0 CompuMethod_110 0 65535 /end CHARACTERISTIC
/begin CHARACTERISTIC FaultManager.IATRangeHigh.Action_2_Condition "Fault manager configuration.  Select up to 4 actions for each fault." VALUE 0x80002B19 RecordLayout_4 0 CompuMethod_111 0 65535 /end CHARACTERISTIC
/begin CHARACTERISTIC FaultManager.IATRangeHigh.Action_3 "Fault manager configuration.  Select up to 4 actions for each fault." VALUE 0x80002B1B RecordLayout_4 0 CompuMethod_110 0 65535 /end CHARACTERISTIC
/begin CHARACTERISTIC FaultManager.IATRangeHigh.Action_3_Condition "Fault manager configuration.  Select up to 4 actions for each fault." VALUE 0x80002B1D RecordLayout_4 0 CompuMethod_111 0 65535 /end CHARACTERISTIC
/begin CHARACTERISTIC FaultManager.IATRangeHigh.Action_4 "Fault manager configuration.  Select up to 4 actions for each fault." VALUE 0x80002B1F RecordLayout_4 0 CompuMethod_110 0 65535 /end CHARACTERISTIC
/begin CHARACTERISTIC FaultManager.IATRangeHigh.Action_4_Condition "Fault manager configuration.  Select up to 4 actions for each fault." VALUE 0x80002B21 RecordLayout_4 0 CompuMethod_111 0 65535 /end CHARACTERISTIC
/begin CHARACTERISTIC FaultManager.IATRangeLow.Mode "Fault manager configuration.  Select up to 4 actions for each fault." VALUE 0x80002B23 RecordLayout_4 0 CompuMethod_108 0 65535 /end CHARACTERISTIC
/begin CHARACTERISTIC FaultManager.IATRangeLow.ID "Fault manager configuration.  Select up to 4 actions for each fault." VALUE 0x80002B25 RecordLayout_4 0 CompuMethod_1 0 65535 /end CHARACTERISTIC
/begin CHARACTERISTIC FaultManager.IATRangeLow.Test "Fault manager configuration.  Select up to 4 actions for each fault." VALUE 0x80002B27 RecordLayout_4 0 CompuMethod_109 0 65535 /end CHARACTERISTIC
/begin CHARACTERISTIC FaultManager.IATRangeLow.Faulty_Samples__X_ "Fault manager configuration.  Select up to 4 actions for each fault." VALUE 0x80002B29 RecordLayout_4 0 CompuMethod_1 0 65535 /end CHARACTERISTIC
/begin CHARACTERISTIC FaultManager.IATRangeLow.Total_Samples__Y_ "Fault manager configuration.  Select up to 4 actions for each fault." VALUE 0x80002B2B RecordLayout_4 0 CompuMethod_1 0 65535 /end CHARACTERISTIC
/begin CHARACTERISTIC FaultManager.IATRangeLow.Action_1 "Fault manager configuration.  Select up to 4 actions for each fault." VALUE 0x80002B2D RecordLayout_4 0 CompuMethod_110 0 65535 /end CHARACTERISTIC
/begin CHARACTERISTIC FaultManager.IATRangeLow.Action_1_Condition "Fault manager configuration.  Select up to 4 actions for each fault." VALUE 0x80002B2F RecordLayout_4 0 CompuMethod_111 0 65535 /end CHARACTERISTIC
/begin CHARACTERISTIC FaultManager.IATRangeLow.Action_2 "Fault manager configuration.  Select up to 4 actions for each fault." VALUE 0x80002B31 RecordLayout_4 0 CompuMethod_110 0 65535 /end CHARACTERISTIC
/begin CHARACTERISTIC FaultManager.IATRangeLow.Action_2_Condition "Fault manager configuration.  Select up to 4 actions for each fault." VALUE 0x80002B33 RecordLayout_4 0 CompuMethod_111 0 65535 /end CHARACTERISTIC
/begin CHARACTERISTIC FaultManager.IATRangeLow.Action_3 "Fault manager configuration.  Select up to 4 actions for each fault." VALUE 0x80002B35 RecordLayout_4 0 CompuMethod_110 0 65535 /end CHARACTERISTIC
/begin CHARACTERISTIC FaultManager.IATRangeLow.Action_3_Condition "Fault manager configuration.  Select up to 4 actions for each fault." VALUE 0x80002B37 RecordLayout_4 0 CompuMethod_111 0 65535 /end CHARACTERISTIC
/begin CHARACTERISTIC FaultManager.IATRangeLow.Action_4 "Fault manager configuration.  Select up to 4 actions for each fault." VALUE 0x80002B39 RecordLayout_4 0 CompuMethod_110 0 65535 /end CHARACTERISTIC
/begin CHARACTERISTIC FaultManager.IATRangeLow.Action_4_Condition "Fault manager configuration.  Select up to 4 actions for each fault." VALUE 0x80002B3B RecordLayout_4 0 CompuMethod_111 0 65535 /end CHARACTERISTIC
/begin CHARACTERISTIC FaultManager.Inj1Open.Mode "Fault manager configuration.  Select up to 4 actions for each fault." VALUE 0x80002B3D RecordLayout_4 0 CompuMethod_108 0 65535 /end CHARACTERISTIC
/begin CHARACTERISTIC FaultManager.Inj1Open.ID "Fault manager configuration.  Select up to 4 actions for each fault." VALUE 0x80002B3F RecordLayout_4 0 CompuMethod_1 0 65535 /end CHARACTERISTIC
/begin CHARACTERISTIC FaultManager.Inj1Open.Test "Fault manager configuration.  Select up to 4 actions for each fault." VALUE 0x80002B41 RecordLayout_4 0 CompuMethod_109 0 65535 /end CHARACTERISTIC
/begin CHARACTERISTIC FaultManager.Inj1Open.Faulty_Samples__X_ "Fault manager configuration.  Select up to 4 actions for each fault." VALUE 0x80002B43 RecordLayout_4 0 CompuMethod_1 0 65535 /end CHARACTERISTIC
/begin CHARACTERISTIC FaultManager.Inj1Open.Total_Samples__Y_ "Fault manager configuration.  Select up to 4 actions for each fault." VALUE 0x80002B45 RecordLayout_4 0 CompuMethod_1 0 65535 /end CHARACTERISTIC
/begin CHARACTERISTIC FaultManager.Inj1Open.Action_1 "Fault manager configuration.  Select up to 4 actions for each fault." VALUE 0x80002B47 RecordLayout_4 0 CompuMethod_110 0 65535 /end CHARACTERISTIC
/begin CHARACTERISTIC FaultManager.Inj1Open.Action_1_Condition "Fault manager configuration.  Select up to 4 actions for each fault." VALUE 0x80002B49 RecordLayout_4 0 CompuMethod_111 0 65535 /end CHARACTERISTIC
/begin CHARACTERISTIC FaultManager.Inj1Open.Action_2 "Fault manager configuration.  Select up to 4 actions for each fault." VALUE 0x80002B4B RecordLayout_4 0 CompuMethod_110 0 65535 /end CHARACTERISTIC
/begin CHARACTERISTIC FaultManager.Inj1Open.Action_2_Condition "Fault manager configuration.  Select up to 4 actions for each fault." VALUE 0x80002B4D RecordLayout_4 0 CompuMethod_111 0 65535 /end CHARACTERISTIC
/begin CHARACTERISTIC FaultManager.Inj1Open.Action_3 "Fault manager configuration.  Select up to 4 actions for each fault." VALUE 0x80002B4F RecordLayout_4 0 CompuMethod_110 0 65535 /end CHARACTERISTIC
/begin CHARACTERISTIC FaultManager.Inj1Open.Action_3_Condition "Fault manager configuration.  Select up to 4 actions for each fault." VALUE 0x80002B51 RecordLayout_4 0 CompuMethod_111 0 65535 /end CHARACTERISTIC
/begin CHARACTERISTIC FaultManager.Inj1Open.Action_4 "Fault manager configuration.  Select up to 4 actions for each fault." VALUE 0x80002B53 RecordLayout_4 0 CompuMethod_110 0 65535 /end CHARACTERISTIC
/begin CHARACTERISTIC FaultManager.Inj1Open.Action_4_Condition "Fault manager configuration.  Select up to 4 actions for each fault." VALUE 0x80002B55 RecordLayout_4 0 CompuMethod_111 0 65535 /end CHARACTERISTIC
/begin CHARACTERISTIC FaultManager.Inj2Open.Mode "Fault manager configuration.  Select up to 4 actions for each fault." VALUE 0x80002B57 RecordLayout_4 0 CompuMethod_108 0 65535 /end CHARACTERISTIC
/begin CHARACTERISTIC FaultManager.Inj2Open.ID "Fault manager configuration.  Select up to 4 actions for each fault." VALUE 0x80002B59 RecordLayout_4 0 CompuMethod_1 0 65535 /end CHARACTERISTIC
/begin CHARACTERISTIC FaultManager.Inj2Open.Test "Fault manager configuration.  Select up to 4 actions for each fault." VALUE 0x80002B5B RecordLayout_4 0 CompuMethod_109 0 65535 /end CHARACTERISTIC
/begin CHARACTERISTIC FaultManager.Inj2Open.Faulty_Samples__X_ "Fault manager configuration.  Select up to 4 actions for each fault." VALUE 0x80002B5D RecordLayout_4 0 CompuMethod_1 0 65535 /end CHARACTERISTIC
/begin CHARACTERISTIC FaultManager.Inj2Open.Total_Samples__Y_ "Fault manager configuration.  Select up to 4 actions for each fault." VALUE 0x80002B5F RecordLayout_4 0 CompuMethod_1 0 65535 /end CHARACTERISTIC
/begin CHARACTERISTIC FaultManager.Inj2Open.Action_1 "Fault manager configuration.  Select up to 4 actions for each fault." VALUE 0x80002B61 RecordLayout_4 0 CompuMethod_110 0 65535 /end CHARACTERISTIC
/begin CHARACTERISTIC FaultManager.Inj2Open.Action_1_Condition "Fault manager configuration.  Select up to 4 actions for each fault." VALUE 0x80002B63 RecordLayout_4 0 CompuMethod_111 0 65535 /end CHARACTERISTIC
/begin CHARACTERISTIC FaultManager.Inj2Open.Action_2 "Fault manager configuration.  Select up to 4 actions for each fault." VALUE 0x80002B65 RecordLayout_4 0 CompuMethod_110 0 65535 /end CHARACTERISTIC
/begin CHARACTERISTIC FaultManager.Inj2Open.Action_2_Condition "Fault manager configuration.  Select up to 4 actions for each fault." VALUE 0x80002B67 RecordLayout_4 0 CompuMethod_111 0 65535 /end CHARACTERISTIC
/begin CHARACTERISTIC FaultManager.Inj2Open.Action_3 "Fault manager configuration.  Select up to 4 actions for each fault." VALUE 0x80002B69 RecordLayout_4 0 CompuMethod_110 0 65535 /end CHARACTERISTIC
/begin CHARACTERISTIC FaultManager.Inj2Open.Action_3_Condition "Fault manager configuration.  Select up to 4 actions for each fault." VALUE 0x80002B6B RecordLayout_4 0 CompuMethod_111 0 65535 /end CHARACTERISTIC
/begin CHARACTERISTIC FaultManager.Inj2Open.Action_4 "Fault manager configuration.  Select up to 4 actions for each fault." VALUE 0x80002B6D RecordLayout_4 0 CompuMethod_110 0 65535 /end CHARACTERISTIC
/begin CHARACTERISTIC FaultManager.Inj2Open.Action_4_Condition "Fault manager configuration.  Select up to 4 actions for each fault." VALUE 0x80002B6F RecordLayout_4 0 CompuMethod_111 0 65535 /end CHARACTERISTIC
/begin CHARACTERISTIC FaultManager.Inj3Open.Mode "Fault manager configuration.  Select up to 4 actions for each fault." VALUE 0x80002B71 RecordLayout_4 0 CompuMethod_108 0 65535 /end CHARACTERISTIC
/begin CHARACTERISTIC FaultManager.Inj3Open.ID "Fault manager configuration.  Select up to 4 actions for each fault." VALUE 0x80002B73 RecordLayout_4 0 CompuMethod_1 0 65535 /end CHARACTERISTIC
/begin CHARACTERISTIC FaultManager.Inj3Open.Test "Fault manager configuration.  Select up to 4 actions for each fault." VALUE 0x80002B75 RecordLayout_4 0 CompuMethod_109 0 65535 /end CHARACTERISTIC
/begin CHARACTERISTIC FaultManager.Inj3Open.Faulty_Samples__X_ "Fault manager configuration.  Select up to 4 actions for each fault." VALUE 0x80002B77 RecordLayout_4 0 CompuMethod_1 0 65535 /end CHARACTERISTIC
/begin CHARACTERISTIC FaultManager.Inj3Open.Total_Samples__Y_ "Fault manager configuration.  Select up to 4 actions for each fault." VALUE 0x80002B79 RecordLayout_4 0 CompuMethod_1 0 65535 /end CHARACTERISTIC
/begin CHARACTERISTIC FaultManager.Inj3Open.Action_1 "Fault manager configuration.  Select up to 4 actions for each fault." VALUE 0x80002B7B RecordLayout_4 0 CompuMethod_110 0 65535 /end CHARACTERISTIC
/begin CHARACTERISTIC FaultManager.Inj3Open.Action_1_Condition "Fault manager configuration.  Select up to 4 actions for each fault." VALUE 0x80002B7D RecordLayout_4 0 CompuMethod_111 0 65535 /end CHARACTERISTIC
/begin CHARACTERISTIC FaultManager.Inj3Open.Action_2 "Fault manager configuration.  Select up to 4 actions for each fault." VALUE 0x80002B7F RecordLayout_4 0 CompuMethod_110 0 65535 /end CHARACTERISTIC
/begin CHARACTERISTIC FaultManager.Inj3Open.Action_2_Condition "Fault manager configuration.  Select up to 4 actions for each fault." VALUE 0x80002B81 RecordLayout_4 0 CompuMethod_111 0 65535 /end CHARACTERISTIC
/begin CHARACTERISTIC FaultManager.Inj3Open.Action_3 "Fault manager configuration.  Select up to 4 actions for each fault." VALUE 0x80002B83 RecordLayout_4 0 CompuMethod_110 0 65535 /end CHARACTERISTIC
/begin CHARACTERISTIC FaultManager.Inj3Open.Action_3_Condition "Fault manager configuration.  Select up to 4 actions for each fault." VALUE 0x80002B85 RecordLayout_4 0 CompuMethod_111 0 65535 /end CHARACTERISTIC
/begin CHARACTERISTIC FaultManager.Inj3Open.Action_4 "Fault manager configuration.  Select up to 4 actions for each fault." VALUE 0x80002B87 RecordLayout_4 0 CompuMethod_110 0 65535 /end CHARACTERISTIC
/begin CHARACTERISTIC FaultManager.Inj3Open.Action_4_Condition "Fault manager configuration.  Select up to 4 actions for each fault." VALUE 0x80002B89 RecordLayout_4 0 CompuMethod_111 0 65535 /end CHARACTERISTIC
/begin CHARACTERISTIC FaultManager.Inj4Open.Mode "Fault manager configuration.  Select up to 4 actions for each fault." VALUE 0x80002B8B RecordLayout_4 0 CompuMethod_108 0 65535 /end CHARACTERISTIC
/begin CHARACTERISTIC FaultManager.Inj4Open.ID "Fault manager configuration.  Select up to 4 actions for each fault." VALUE 0x80002B8D RecordLayout_4 0 CompuMethod_1 0 65535 /end CHARACTERISTIC
/begin CHARACTERISTIC FaultManager.Inj4Open.Test "Fault manager configuration.  Select up to 4 actions for each fault." VALUE 0x80002B8F RecordLayout_4 0 CompuMethod_109 0 65535 /end CHARACTERISTIC
/begin CHARACTERISTIC FaultManager.Inj4Open.Faulty_Samples__X_ "Fault manager configuration.  Select up to 4 actions for each fault." VALUE 0x80002B91 RecordLayout_4 0 CompuMethod_1 0 65535 /end CHARACTERISTIC
/begin CHARACTERISTIC FaultManager.Inj4Open.Total_Samples__Y_ "Fault manager configuration.  Select up to 4 actions for each fault." VALUE 0x80002B93 RecordLayout_4 0 CompuMethod_1 0 65535 /end CHARACTERISTIC
/begin CHARACTERISTIC FaultManager.Inj4Open.Action_1 "Fault manager configuration.  Select up to 4 actions for each fault." VALUE 0x80002B95 RecordLayout_4 0 CompuMethod_110 0 65535 /end CHARACTERISTIC
/begin CHARACTERISTIC FaultManager.Inj4Open.Action_1_Condition "Fault manager configuration.  Select up to 4 actions for each fault." VALUE 0x80002B97 RecordLayout_4 0 CompuMethod_111 0 65535 /end CHARACTERISTIC
/begin CHARACTERISTIC FaultManager.Inj4Open.Action_2 "Fault manager configuration.  Select up to 4 actions for each fault." VALUE 0x80002B99 RecordLayout_4 0 CompuMethod_110 0 65535 /end CHARACTERISTIC
/begin CHARACTERISTIC FaultManager.Inj4Open.Action_2_Condition "Fault manager configuration.  Select up to 4 actions for each fault." VALUE 0x80002B9B RecordLayout_4 0 CompuMethod_111 0 65535 /end CHARACTERISTIC
/begin CHARACTERISTIC FaultManager.Inj4Open.Action_3 "Fault manager configuration.  Select up to 4 actions for each fault." VALUE 0x80002B9D RecordLayout_4 0 CompuMethod_110 0 65535 /end CHARACTERISTIC
/begin CHARACTERISTIC FaultManager.Inj4Open.Action_3_Condition "Fault manager configuration.  Select up to 4 actions for each fault." VALUE 0x80002B9F RecordLayout_4 0 CompuMethod_111 0 65535 /end CHARACTERISTIC
/begin CHARACTERISTIC FaultManager.Inj4Open.Action_4 "Fault manager configuration.  Select up to 4 actions for each fault." VALUE 0x80002BA1 RecordLayout_4 0 CompuMethod_110 0 65535 /end CHARACTERISTIC
/begin CHARACTERISTIC FaultManager.Inj4Open.Action_4_Condition "Fault manager configuration.  Select up to 4 actions for each fault." VALUE 0x80002BA3 RecordLayout_4 0 CompuMethod_111 0 65535 /end CHARACTERISTIC
/begin CHARACTERISTIC FaultManager.Inj5Open.Mode "Fault manager configuration.  Select up to 4 actions for each fault." VALUE 0x80002BA5 RecordLayout_4 0 CompuMethod_108 0 65535 /end CHARACTERISTIC
/begin CHARACTERISTIC FaultManager.Inj5Open.ID "Fault manager configuration.  Select up to 4 actions for each fault." VALUE 0x80002BA7 RecordLayout_4 0 CompuMethod_1 0 65535 /end CHARACTERISTIC
/begin CHARACTERISTIC FaultManager.Inj5Open.Test "Fault manager configuration.  Select up to 4 actions for each fault." VALUE 0x80002BA9 RecordLayout_4 0 CompuMethod_109 0 65535 /end CHARACTERISTIC
/begin CHARACTERISTIC FaultManager.Inj5Open.Faulty_Samples__X_ "Fault manager configuration.  Select up to 4 actions for each fault." VALUE 0x80002BAB RecordLayout_4 0 CompuMethod_1 0 65535 /end CHARACTERISTIC
/begin CHARACTERISTIC FaultManager.Inj5Open.Total_Samples__Y_ "Fault manager configuration.  Select up to 4 actions for each fault." VALUE 0x80002BAD RecordLayout_4 0 CompuMethod_1 0 65535 /end CHARACTERISTIC
/begin CHARACTERISTIC FaultManager.Inj5Open.Action_1 "Fault manager configuration.  Select up to 4 actions for each fault." VALUE 0x80002BAF RecordLayout_4 0 CompuMethod_110 0 65535 /end CHARACTERISTIC
/begin CHARACTERISTIC FaultManager.Inj5Open.Action_1_Condition "Fault manager configuration.  Select up to 4 actions for each fault." VALUE 0x80002BB1 RecordLayout_4 0 CompuMethod_111 0 65535 /end CHARACTERISTIC
/begin CHARACTERISTIC FaultManager.Inj5Open.Action_2 "Fault manager configuration.  Select up to 4 actions for each fault." VALUE 0x80002BB3 RecordLayout_4 0 CompuMethod_110 0 65535 /end CHARACTERISTIC
/begin CHARACTERISTIC FaultManager.Inj5Open.Action_2_Condition "Fault manager configuration.  Select up to 4 actions for each fault." VALUE 0x80002BB5 RecordLayout_4 0 CompuMethod_111 0 65535 /end CHARACTERISTIC
/begin CHARACTERISTIC FaultManager.Inj5Open.Action_3 "Fault manager configuration.  Select up to 4 actions for each fault." VALUE 0x80002BB7 RecordLayout_4 0 CompuMethod_110 0 65535 /end CHARACTERISTIC
/begin CHARACTERISTIC FaultManager.Inj5Open.Action_3_Condition "Fault manager configuration.  Select up to 4 actions for each fault." VALUE 0x80002BB9 RecordLayout_4 0 CompuMethod_111 0 65535 /end CHARACTERISTIC
/begin CHARACTERISTIC FaultManager.Inj5Open.Action_4 "Fault manager configuration.  Select up to 4 actions for each fault." VALUE 0x80002BBB RecordLayout_4 0 CompuMethod_110 0 65535 /end CHARACTERISTIC
/begin CHARACTERISTIC FaultManager.Inj5Open.Action_4_Condition "Fault manager configuration.  Select up to 4 actions for each fault." VALUE 0x80002BBD RecordLayout_4 0 CompuMethod_111 0 65535 /end CHARACTERISTIC
/begin CHARACTERISTIC FaultManager.Inj6Open.Mode "Fault manager configuration.  Select up to 4 actions for each fault." VALUE 0x80002BBF RecordLayout_4 0 CompuMethod_108 0 65535 /end CHARACTERISTIC
/begin CHARACTERISTIC FaultManager.Inj6Open.ID "Fault manager configuration.  Select up to 4 actions for each fault." VALUE 0x80002BC1 RecordLayout_4 0 CompuMethod_1 0 65535 /end CHARACTERISTIC
/begin CHARACTERISTIC FaultManager.Inj6Open.Test "Fault manager configuration.  Select up to 4 actions for each fault." VALUE 0x80002BC3 RecordLayout_4 0 CompuMethod_109 0 65535 /end CHARACTERISTIC
/begin CHARACTERISTIC FaultManager.Inj6Open.Faulty_Samples__X_ "Fault manager configuration.  Select up to 4 actions for each fault." VALUE 0x80002BC5 RecordLayout_4 0 CompuMethod_1 0 65535 /end CHARACTERISTIC
/begin CHARACTERISTIC FaultManager.Inj6Open.Total_Samples__Y_ "Fault manager configuration.  Select up to 4 actions for each fault." VALUE 0x80002BC7 RecordLayout_4 0 CompuMethod_1 0 65535 /end CHARACTERISTIC
/begin CHARACTERISTIC FaultManager.Inj6Open.Action_1 "Fault manager configuration.  Select up to 4 actions for each fault." VALUE 0x80002BC9 RecordLayout_4 0 CompuMethod_110 0 65535 /end CHARACTERISTIC
/begin CHARACTERISTIC FaultManager.Inj6Open.Action_1_Condition "Fault manager configuration.  Select up to 4 actions for each fault." VALUE 0x80002BCB RecordLayout_4 0 CompuMethod_111 0 65535 /end CHARACTERISTIC
/begin CHARACTERISTIC FaultManager.Inj6Open.Action_2 "Fault manager configuration.  Select up to 4 actions for each fault." VALUE 0x80002BCD RecordLayout_4 0 CompuMethod_110 0 65535 /end CHARACTERISTIC
/begin CHARACTERISTIC FaultManager.Inj6Open.Action_2_Condition "Fault manager configuration.  Select up to 4 actions for each fault." VALUE 0x80002BCF RecordLayout_4 0 CompuMethod_111 0 65535 /end CHARACTERISTIC
/begin CHARACTERISTIC FaultManager.Inj6Open.Action_3 "Fault manager configuration.  Select up to 4 actions for each fault." VALUE 0x80002BD1 RecordLayout_4 0 CompuMethod_110 0 65535 /end CHARACTERISTIC
/begin CHARACTERISTIC FaultManager.Inj6Open.Action_3_Condition "Fault manager configuration.  Select up to 4 actions for each fault." VALUE 0x80002BD3 RecordLayout_4 0 CompuMethod_111 0 65535 /end CHARACTERISTIC
/begin CHARACTERISTIC FaultManager.Inj6Open.Action_4 "Fault manager configuration.  Select up to 4 actions for each fault." VALUE 0x80002BD5 RecordLayout_4 0 CompuMethod_110 0 65535 /end CHARACTERISTIC
/begin CHARACTERISTIC FaultManager.Inj6Open.Action_4_Condition "Fault manager configuration.  Select up to 4 actions for each fault." VALUE 0x80002BD7 RecordLayout_4 0 CompuMethod_111 0 65535 /end CHARACTERISTIC
/begin CHARACTERISTIC FaultManager.Inj7Open.Mode "Fault manager configuration.  Select up to 4 actions for each fault." VALUE 0x80002BD9 RecordLayout_4 0 CompuMethod_108 0 65535 /end CHARACTERISTIC
/begin CHARACTERISTIC FaultManager.Inj7Open.ID "Fault manager configuration.  Select up to 4 actions for each fault." VALUE 0x80002BDB RecordLayout_4 0 CompuMethod_1 0 65535 /end CHARACTERISTIC
/begin CHARACTERISTIC FaultManager.Inj7Open.Test "Fault manager configuration.  Select up to 4 actions for each fault." VALUE 0x80002BDD RecordLayout_4 0 CompuMethod_109 0 65535 /end CHARACTERISTIC
/begin CHARACTERISTIC FaultManager.Inj7Open.Faulty_Samples__X_ "Fault manager configuration.  Select up to 4 actions for each fault." VALUE 0x80002BDF RecordLayout_4 0 CompuMethod_1 0 65535 /end CHARACTERISTIC
/begin CHARACTERISTIC FaultManager.Inj7Open.Total_Samples__Y_ "Fault manager configuration.  Select up to 4 actions for each fault." VALUE 0x80002BE1 RecordLayout_4 0 CompuMethod_1 0 65535 /end CHARACTERISTIC
/begin CHARACTERISTIC FaultManager.Inj7Open.Action_1 "Fault manager configuration.  Select up to 4 actions for each fault." VALUE 0x80002BE3 RecordLayout_4 0 CompuMethod_110 0 65535 /end CHARACTERISTIC
/begin CHARACTERISTIC FaultManager.Inj7Open.Action_1_Condition "Fault manager configuration.  Select up to 4 actions for each fault." VALUE 0x80002BE5 RecordLayout_4 0 CompuMethod_111 0 65535 /end CHARACTERISTIC
/begin CHARACTERISTIC FaultManager.Inj7Open.Action_2 "Fault manager configuration.  Select up to 4 actions for each fault." VALUE 0x80002BE7 RecordLayout_4 0 CompuMethod_110 0 65535 /end CHARACTERISTIC
/begin CHARACTERISTIC FaultManager.Inj7Open.Action_2_Condition "Fault manager configuration.  Select up to 4 actions for each fault." VALUE 0x80002BE9 RecordLayout_4 0 CompuMethod_111 0 65535 /end CHARACTERISTIC
/begin CHARACTERISTIC FaultManager.Inj7Open.Action_3 "Fault manager configuration.  Select up to 4 actions for each fault." VALUE 0x80002BEB RecordLayout_4 0 CompuMethod_110 0 65535 /end CHARACTERISTIC
/begin CHARACTERISTIC FaultManager.Inj7Open.Action_3_Condition "Fault manager configuration.  Select up to 4 actions for each fault." VALUE 0x80002BED RecordLayout_4 0 CompuMethod_111 0 65535 /end CHARACTERISTIC
/begin CHARACTERISTIC FaultManager.Inj7Open.Action_4 "Fault manager configuration.  Select up to 4 actions for each fault." VALUE 0x80002BEF RecordLayout_4 0 CompuMethod_110 0 65535 /end CHARACTERISTIC
/begin CHARACTERISTIC FaultManager.Inj7Open.Action_4_Condition "Fault manager configuration.  Select up to 4 actions for each fault." VALUE 0x80002BF1 RecordLayout_4 0 CompuMethod_111 0 65535 /end CHARACTERISTIC
/begin CHARACTERISTIC FaultManager.Inj8Open.Mode "Fault manager configuration.  Select up to 4 actions for each fault." VALUE 0x80002BF3 RecordLayout_4 0 CompuMethod_108 0 65535 /end CHARACTERISTIC
/begin CHARACTERISTIC FaultManager.Inj8Open.ID "Fault manager configuration.  Select up to 4 actions for each fault." VALUE 0x80002BF5 RecordLayout_4 0 CompuMethod_1 0 65535 /end CHARACTERISTIC
/begin CHARACTERISTIC FaultManager.Inj8Open.Test "Fault manager configuration.  Select up to 4 actions for each fault." VALUE 0x80002BF7 RecordLayout_4 0 CompuMethod_109 0 65535 /end CHARACTERISTIC
/begin CHARACTERISTIC FaultManager.Inj8Open.Faulty_Samples__X_ "Fault manager configuration.  Select up to 4 actions for each fault." VALUE 0x80002BF9 RecordLayout_4 0 CompuMethod_1 0 65535 /end CHARACTERISTIC
/begin CHARACTERISTIC FaultManager.Inj8Open.Total_Samples__Y_ "Fault manager configuration.  Select up to 4 actions for each fault." VALUE 0x80002BFB RecordLayout_4 0 CompuMethod_1 0 65535 /end CHARACTERISTIC
/begin CHARACTERISTIC FaultManager.Inj8Open.Action_1 "Fault manager configuration.  Select up to 4 actions for each fault." VALUE 0x80002BFD RecordLayout_4 0 CompuMethod_110 0 65535 /end CHARACTERISTIC
/begin CHARACTERISTIC FaultManager.Inj8Open.Action_1_Condition "Fault manager configuration.  Select up to 4 actions for each fault." VALUE 0x80002BFF RecordLayout_4 0 CompuMethod_111 0 65535 /end CHARACTERISTIC
/begin CHARACTERISTIC FaultManager.Inj8Open.Action_2 "Fault manager configuration.  Select up to 4 actions for each fault." VALUE 0x80002C01 RecordLayout_4 0 CompuMethod_110 0 65535 /end CHARACTERISTIC
/begin CHARACTERISTIC FaultManager.Inj8Open.Action_2_Condition "Fault manager configuration.  Select up to 4 actions for each fault." VALUE 0x80002C03 RecordLayout_4 0 CompuMethod_111 0 65535 /end CHARACTERISTIC
/begin CHARACTERISTIC FaultManager.Inj8Open.Action_3 "Fault manager configuration.  Select up to 4 actions for each fault." VALUE 0x80002C05 RecordLayout_4 0 CompuMethod_110 0 65535 /end CHARACTERISTIC
/begin CHARACTERISTIC FaultManager.Inj8Open.Action_3_Condition "Fault manager configuration.  Select up to 4 actions for each fault." VALUE 0x80002C07 RecordLayout_4 0 CompuMethod_111 0 65535 /end CHARACTERISTIC
/begin CHARACTERISTIC FaultManager.Inj8Open.Action_4 "Fault manager configuration.  Select up to 4 actions for each fault." VALUE 0x80002C09 RecordLayout_4 0 CompuMethod_110 0 65535 /end CHARACTERISTIC
/begin CHARACTERISTIC FaultManager.Inj8Open.Action_4_Condition "Fault manager configuration.  Select up to 4 actions for each fault." VALUE 0x80002C0B RecordLayout_4 0 CompuMethod_111 0 65535 /end CHARACTERISTIC
/begin CHARACTERISTIC FaultManager.Lambda1Error_Fault.Mode "Fault manager configuration.  Select up to 4 actions for each fault." VALUE 0x80002C0D RecordLayout_4 0 CompuMethod_108 0 65535 /end CHARACTERISTIC
/begin CHARACTERISTIC FaultManager.Lambda1Error_Fault.ID "Fault manager configuration.  Select up to 4 actions for each fault." VALUE 0x80002C0F RecordLayout_4 0 CompuMethod_1 0 65535 /end CHARACTERISTIC
/begin CHARACTERISTIC FaultManager.Lambda1Error_Fault.Test "Fault manager configuration.  Select up to 4 actions for each fault." VALUE 0x80002C11 RecordLayout_4 0 CompuMethod_109 0 65535 /end CHARACTERISTIC
/begin CHARACTERISTIC FaultManager.Lambda1Error_Fault.Faulty_Samples__X_ "Fault manager configuration.  Select up to 4 actions for each fault." VALUE 0x80002C13 RecordLayout_4 0 CompuMethod_1 0 65535 /end CHARACTERISTIC
/begin CHARACTERISTIC FaultManager.Lambda1Error_Fault.Total_Samples__Y_ "Fault manager configuration.  Select up to 4 actions for each fault." VALUE 0x80002C15 RecordLayout_4 0 CompuMethod_1 0 65535 /end CHARACTERISTIC
/begin CHARACTERISTIC FaultManager.Lambda1Error_Fault.Action_1 "Fault manager configuration.  Select up to 4 actions for each fault." VALUE 0x80002C17 RecordLayout_4 0 CompuMethod_110 0 65535 /end CHARACTERISTIC
/begin CHARACTERISTIC FaultManager.Lambda1Error_Fault.Action_1_Condition "Fault manager configuration.  Select up to 4 actions for each fault." VALUE 0x80002C19 RecordLayout_4 0 CompuMethod_111 0 65535 /end CHARACTERISTIC
/begin CHARACTERISTIC FaultManager.Lambda1Error_Fault.Action_2 "Fault manager configuration.  Select up to 4 actions for each fault." VALUE 0x80002C1B RecordLayout_4 0 CompuMethod_110 0 65535 /end CHARACTERISTIC
/begin CHARACTERISTIC FaultManager.Lambda1Error_Fault.Action_2_Condition "Fault manager configuration.  Select up to 4 actions for each fault." VALUE 0x80002C1D RecordLayout_4 0 CompuMethod_111 0 65535 /end CHARACTERISTIC
/begin CHARACTERISTIC FaultManager.Lambda1Error_Fault.Action_3 "Fault manager configuration.  Select up to 4 actions for each fault." VALUE 0x80002C1F RecordLayout_4 0 CompuMethod_110 0 65535 /end CHARACTERISTIC
/begin CHARACTERISTIC FaultManager.Lambda1Error_Fault.Action_3_Condition "Fault manager configuration.  Select up to 4 actions for each fault." VALUE 0x80002C21 RecordLayout_4 0 CompuMethod_111 0 65535 /end CHARACTERISTIC
/begin CHARACTERISTIC FaultManager.Lambda1Error_Fault.Action_4 "Fault manager configuration.  Select up to 4 actions for each fault." VALUE 0x80002C23 RecordLayout_4 0 CompuMethod_110 0 65535 /end CHARACTERISTIC
/begin CHARACTERISTIC FaultManager.Lambda1Error_Fault.Action_4_Condition "Fault manager configuration.  Select up to 4 actions for each fault." VALUE 0x80002C25 RecordLayout_4 0 CompuMethod_111 0 65535 /end CHARACTERISTIC
/begin CHARACTERISTIC FaultManager.Lambda1Fault_Fault.Mode "Fault manager configuration.  Select up to 4 actions for each fault." VALUE 0x80002C27 RecordLayout_4 0 CompuMethod_108 0 65535 /end CHARACTERISTIC
/begin CHARACTERISTIC FaultManager.Lambda1Fault_Fault.ID "Fault manager configuration.  Select up to 4 actions for each fault." VALUE 0x80002C29 RecordLayout_4 0 CompuMethod_1 0 65535 /end CHARACTERISTIC
/begin CHARACTERISTIC FaultManager.Lambda1Fault_Fault.Test "Fault manager configuration.  Select up to 4 actions for each fault." VALUE 0x80002C2B RecordLayout_4 0 CompuMethod_109 0 65535 /end CHARACTERISTIC
/begin CHARACTERISTIC FaultManager.Lambda1Fault_Fault.Faulty_Samples__X_ "Fault manager configuration.  Select up to 4 actions for each fault." VALUE 0x80002C2D RecordLayout_4 0 CompuMethod_1 0 65535 /end CHARACTERISTIC
/begin CHARACTERISTIC FaultManager.Lambda1Fault_Fault.Total_Samples__Y_ "Fault manager configuration.  Select up to 4 actions for each fault." VALUE 0x80002C2F RecordLayout_4 0 CompuMethod_1 0 65535 /end CHARACTERISTIC
/begin CHARACTERISTIC FaultManager.Lambda1Fault_Fault.Action_1 "Fault manager configuration.  Select up to 4 actions for each fault." VALUE 0x80002C31 RecordLayout_4 0 CompuMethod_110 0 65535 /end CHARACTERISTIC
/begin CHARACTERISTIC FaultManager.Lambda1Fault_Fault.Action_1_Condition "Fault manager configuration.  Select up to 4 actions for each fault." VALUE 0x80002C33 RecordLayout_4 0 CompuMethod_111 0 65535 /end CHARACTERISTIC
/begin CHARACTERISTIC FaultManager.Lambda1Fault_Fault.Action_2 "Fault manager configuration.  Select up to 4 actions for each fault." VALUE 0x80002C35 RecordLayout_4 0 CompuMethod_110 0 65535 /end CHARACTERISTIC
/begin CHARACTERISTIC FaultManager.Lambda1Fault_Fault.Action_2_Condition "Fault manager configuration.  Select up to 4 actions for each fault." VALUE 0x80002C37 RecordLayout_4 0 CompuMethod_111 0 65535 /end CHARACTERISTIC
/begin CHARACTERISTIC FaultManager.Lambda1Fault_Fault.Action_3 "Fault manager configuration.  Select up to 4 actions for each fault." VALUE 0x80002C39 RecordLayout_4 0 CompuMethod_110 0 65535 /end CHARACTERISTIC
/begin CHARACTERISTIC FaultManager.Lambda1Fault_Fault.Action_3_Condition "Fault manager configuration.  Select up to 4 actions for each fault." VALUE 0x80002C3B RecordLayout_4 0 CompuMethod_111 0 65535 /end CHARACTERISTIC
/begin CHARACTERISTIC FaultManager.Lambda1Fault_Fault.Action_4 "Fault manager configuration.  Select up to 4 actions for each fault." VALUE 0x80002C3D RecordLayout_4 0 CompuMethod_110 0 65535 /end CHARACTERISTIC
/begin CHARACTERISTIC FaultManager.Lambda1Fault_Fault.Action_4_Condition "Fault manager configuration.  Select up to 4 actions for each fault." VALUE 0x80002C3F RecordLayout_4 0 CompuMethod_111 0 65535 /end CHARACTERISTIC
/begin CHARACTERISTIC FaultManager.Lambda1HtrOpen_Fault.Mode "Fault manager configuration.  Select up to 4 actions for each fault." VALUE 0x80002C41 RecordLayout_4 0 CompuMethod_108 0 65535 /end CHARACTERISTIC
/begin CHARACTERISTIC FaultManager.Lambda1HtrOpen_Fault.ID "Fault manager configuration.  Select up to 4 actions for each fault." VALUE 0x80002C43 RecordLayout_4 0 CompuMethod_1 0 65535 /end CHARACTERISTIC
/begin CHARACTERISTIC FaultManager.Lambda1HtrOpen_Fault.Test "Fault manager configuration.  Select up to 4 actions for each fault." VALUE 0x80002C45 RecordLayout_4 0 CompuMethod_109 0 65535 /end CHARACTERISTIC
/begin CHARACTERISTIC FaultManager.Lambda1HtrOpen_Fault.Faulty_Samples__X_ "Fault manager configuration.  Select up to 4 actions for each fault." VALUE 0x80002C47 RecordLayout_4 0 CompuMethod_1 0 65535 /end CHARACTERISTIC
/begin CHARACTERISTIC FaultManager.Lambda1HtrOpen_Fault.Total_Samples__Y_ "Fault manager configuration.  Select up to 4 actions for each fault." VALUE 0x80002C49 RecordLayout_4 0 CompuMethod_1 0 65535 /end CHARACTERISTIC
/begin CHARACTERISTIC FaultManager.Lambda1HtrOpen_Fault.Action_1 "Fault manager configuration.  Select up to 4 actions for each fault." VALUE 0x80002C4B RecordLayout_4 0 CompuMethod_110 0 65535 /end CHARACTERISTIC
/begin CHARACTERISTIC FaultManager.Lambda1HtrOpen_Fault.Action_1_Condition "Fault manager configuration.  Select up to 4 actions for each fault." VALUE 0x80002C4D RecordLayout_4 0 CompuMethod_111 0 65535 /end CHARACTERISTIC
/begin CHARACTERISTIC FaultManager.Lambda1HtrOpen_Fault.Action_2 "Fault manager configuration.  Select up to 4 actions for each fault." VALUE 0x80002C4F RecordLayout_4 0 CompuMethod_110 0 65535 /end CHARACTERISTIC
/begin CHARACTERISTIC FaultManager.Lambda1HtrOpen_Fault.Action_2_Condition "Fault manager configuration.  Select up to 4 actions for each fault." VALUE 0x80002C51 RecordLayout_4 0 CompuMethod_111 0 65535 /end CHARACTERISTIC
/begin CHARACTERISTIC FaultManager.Lambda1HtrOpen_Fault.Action_3 "Fault manager configuration.  Select up to 4 actions for each fault." VALUE 0x80002C53 RecordLayout_4 0 CompuMethod_110 0 65535 /end CHARACTERISTIC
/begin CHARACTERISTIC FaultManager.Lambda1HtrOpen_Fault.Action_3_Condition "Fault manager configuration.  Select up to 4 actions for each fault." VALUE 0x80002C55 RecordLayout_4 0 CompuMethod_111 0 65535 /end CHARACTERISTIC
/begin CHARACTERISTIC FaultManager.Lambda1HtrOpen_Fault.Action_4 "Fault manager configuration.  Select up to 4 actions for each fault." VALUE 0x80002C57 RecordLayout_4 0 CompuMethod_110 0 65535 /end CHARACTERISTIC
/begin CHARACTERISTIC FaultManager.Lambda1HtrOpen_Fault.Action_4_Condition "Fault manager configuration.  Select up to 4 actions for each fault." VALUE 0x80002C59 RecordLayout_4 0 CompuMethod_111 0 65535 /end CHARACTERISTIC
/begin CHARACTERISTIC FaultManager.Lambda1HtrShort_Fault.Mode "Fault manager configuration.  Select up to 4 actions for each fault." VALUE 0x80002C5B RecordLayout_4 0 CompuMethod_108 0 65535 /end CHARACTERISTIC
/begin CHARACTERISTIC FaultManager.Lambda1HtrShort_Fault.ID "Fault manager configuration.  Select up to 4 actions for each fault." VALUE 0x80002C5D RecordLayout_4 0 CompuMethod_1 0 65535 /end CHARACTERISTIC
/begin CHARACTERISTIC FaultManager.Lambda1HtrShort_Fault.Test "Fault manager configuration.  Select up to 4 actions for each fault." VALUE 0x80002C5F RecordLayout_4 0 CompuMethod_109 0 65535 /end CHARACTERISTIC
/begin CHARACTERISTIC FaultManager.Lambda1HtrShort_Fault.Faulty_Samples__X_ "Fault manager configuration.  Select up to 4 actions for each fault." VALUE 0x80002C61 RecordLayout_4 0 CompuMethod_1 0 65535 /end CHARACTERISTIC
/begin CHARACTERISTIC FaultManager.Lambda1HtrShort_Fault.Total_Samples__Y_ "Fault manager configuration.  Select up to 4 actions for each fault." VALUE 0x80002C63 RecordLayout_4 0 CompuMethod_1 0 65535 /end CHARACTERISTIC
/begin CHARACTERISTIC FaultManager.Lambda1HtrShort_Fault.Action_1 "Fault manager configuration.  Select up to 4 actions for each fault." VALUE 0x80002C65 RecordLayout_4 0 CompuMethod_110 0 65535 /end CHARACTERISTIC
/begin CHARACTERISTIC FaultManager.Lambda1HtrShort_Fault.Action_1_Condition "Fault manager configuration.  Select up to 4 actions for each fault." VALUE 0x80002C67 RecordLayout_4 0 CompuMethod_111 0 65535 /end CHARACTERISTIC
/begin CHARACTERISTIC FaultManager.Lambda1HtrShort_Fault.Action_2 "Fault manager configuration.  Select up to 4 actions for each fault." VALUE 0x80002C69 RecordLayout_4 0 CompuMethod_110 0 65535 /end CHARACTERISTIC
/begin CHARACTERISTIC FaultManager.Lambda1HtrShort_Fault.Action_2_Condition "Fault manager configuration.  Select up to 4 actions for each fault." VALUE 0x80002C6B RecordLayout_4 0 CompuMethod_111 0 65535 /end CHARACTERISTIC
/begin CHARACTERISTIC FaultManager.Lambda1HtrShort_Fault.Action_3 "Fault manager configuration.  Select up to 4 actions for each fault." VALUE 0x80002C6D RecordLayout_4 0 CompuMethod_110 0 65535 /end CHARACTERISTIC
/begin CHARACTERISTIC FaultManager.Lambda1HtrShort_Fault.Action_3_Condition "Fault manager configuration.  Select up to 4 actions for each fault." VALUE 0x80002C6F RecordLayout_4 0 CompuMethod_111 0 65535 /end CHARACTERISTIC
/begin CHARACTERISTIC FaultManager.Lambda1HtrShort_Fault.Action_4 "Fault manager configuration.  Select up to 4 actions for each fault." VALUE 0x80002C71 RecordLayout_4 0 CompuMethod_110 0 65535 /end CHARACTERISTIC
/begin CHARACTERISTIC FaultManager.Lambda1HtrShort_Fault.Action_4_Condition "Fault manager configuration.  Select up to 4 actions for each fault." VALUE 0x80002C73 RecordLayout_4 0 CompuMethod_111 0 65535 /end CHARACTERISTIC
/begin CHARACTERISTIC FaultManager.Lambda1Overcool_Fault.Mode "Fault manager configuration.  Select up to 4 actions for each fault." VALUE 0x80002C75 RecordLayout_4 0 CompuMethod_108 0 65535 /end CHARACTERISTIC
/begin CHARACTERISTIC FaultManager.Lambda1Overcool_Fault.ID "Fault manager configuration.  Select up to 4 actions for each fault." VALUE 0x80002C77 RecordLayout_4 0 CompuMethod_1 0 65535 /end CHARACTERISTIC
/begin CHARACTERISTIC FaultManager.Lambda1Overcool_Fault.Test "Fault manager configuration.  Select up to 4 actions for each fault." VALUE 0x80002C79 RecordLayout_4 0 CompuMethod_109 0 65535 /end CHARACTERISTIC
/begin CHARACTERISTIC FaultManager.Lambda1Overcool_Fault.Faulty_Samples__X_ "Fault manager configuration.  Select up to 4 actions for each fault." VALUE 0x80002C7B RecordLayout_4 0 CompuMethod_1 0 65535 /end CHARACTERISTIC
/begin CHARACTERISTIC FaultManager.Lambda1Overcool_Fault.Total_Samples__Y_ "Fault manager configuration.  Select up to 4 actions for each fault." VALUE 0x80002C7D RecordLayout_4 0 CompuMethod_1 0 65535 /end CHARACTERISTIC
/begin CHARACTERISTIC FaultManager.Lambda1Overcool_Fault.Action_1 "Fault manager configuration.  Select up to 4 actions for each fault." VALUE 0x80002C7F RecordLayout_4 0 CompuMethod_110 0 65535 /end CHARACTERISTIC
/begin CHARACTERISTIC FaultManager.Lambda1Overcool_Fault.Action_1_Condition "Fault manager configuration.  Select up to 4 actions for each fault." VALUE 0x80002C81 RecordLayout_4 0 CompuMethod_111 0 65535 /end CHARACTERISTIC
/begin CHARACTERISTIC FaultManager.Lambda1Overcool_Fault.Action_2 "Fault manager configuration.  Select up to 4 actions for each fault." VALUE 0x80002C83 RecordLayout_4 0 CompuMethod_110 0 65535 /end CHARACTERISTIC
/begin CHARACTERISTIC FaultManager.Lambda1Overcool_Fault.Action_2_Condition "Fault manager configuration.  Select up to 4 actions for each fault." VALUE 0x80002C85 RecordLayout_4 0 CompuMethod_111 0 65535 /end CHARACTERISTIC
/begin CHARACTERISTIC FaultManager.Lambda1Overcool_Fault.Action_3 "Fault manager configuration.  Select up to 4 actions for each fault." VALUE 0x80002C87 RecordLayout_4 0 CompuMethod_110 0 65535 /end CHARACTERISTIC
/begin CHARACTERISTIC FaultManager.Lambda1Overcool_Fault.Action_3_Condition "Fault manager configuration.  Select up to 4 actions for each fault." VALUE 0x80002C89 RecordLayout_4 0 CompuMethod_111 0 65535 /end CHARACTERISTIC
/begin CHARACTERISTIC FaultManager.Lambda1Overcool_Fault.Action_4 "Fault manager configuration.  Select up to 4 actions for each fault." VALUE 0x80002C8B RecordLayout_4 0 CompuMethod_110 0 65535 /end CHARACTERISTIC
/begin CHARACTERISTIC FaultManager.Lambda1Overcool_Fault.Action_4_Condition "Fault manager configuration.  Select up to 4 actions for each fault." VALUE 0x80002C8D RecordLayout_4 0 CompuMethod_111 0 65535 /end CHARACTERISTIC
/begin CHARACTERISTIC FaultManager.Lambda1Overheat_Fault.Mode "Fault manager configuration.  Select up to 4 actions for each fault." VALUE 0x80002C8F RecordLayout_4 0 CompuMethod_108 0 65535 /end CHARACTERISTIC
/begin CHARACTERISTIC FaultManager.Lambda1Overheat_Fault.ID "Fault manager configuration.  Select up to 4 actions for each fault." VALUE 0x80002C91 RecordLayout_4 0 CompuMethod_1 0 65535 /end CHARACTERISTIC
/begin CHARACTERISTIC FaultManager.Lambda1Overheat_Fault.Test "Fault manager configuration.  Select up to 4 actions for each fault." VALUE 0x80002C93 RecordLayout_4 0 CompuMethod_109 0 65535 /end CHARACTERISTIC
/begin CHARACTERISTIC FaultManager.Lambda1Overheat_Fault.Faulty_Samples__X_ "Fault manager configuration.  Select up to 4 actions for each fault." VALUE 0x80002C95 RecordLayout_4 0 CompuMethod_1 0 65535 /end CHARACTERISTIC
/begin CHARACTERISTIC FaultManager.Lambda1Overheat_Fault.Total_Samples__Y_ "Fault manager configuration.  Select up to 4 actions for each fault." VALUE 0x80002C97 RecordLayout_4 0 CompuMethod_1 0 65535 /end CHARACTERISTIC
/begin CHARACTERISTIC FaultManager.Lambda1Overheat_Fault.Action_1 "Fault manager configuration.  Select up to 4 actions for each fault." VALUE 0x80002C99 RecordLayout_4 0 CompuMethod_110 0 65535 /end CHARACTERISTIC
/begin CHARACTERISTIC FaultManager.Lambda1Overheat_Fault.Action_1_Condition "Fault manager configuration.  Select up to 4 actions for each fault." VALUE 0x80002C9B RecordLayout_4 0 CompuMethod_111 0 65535 /end CHARACTERISTIC
/begin CHARACTERISTIC FaultManager.Lambda1Overheat_Fault.Action_2 "Fault manager configuration.  Select up to 4 actions for each fault." VALUE 0x80002C9D RecordLayout_4 0 CompuMethod_110 0 65535 /end CHARACTERISTIC
/begin CHARACTERISTIC FaultManager.Lambda1Overheat_Fault.Action_2_Condition "Fault manager configuration.  Select up to 4 actions for each fault." VALUE 0x80002C9F RecordLayout_4 0 CompuMethod_111 0 65535 /end CHARACTERISTIC
/begin CHARACTERISTIC FaultManager.Lambda1Overheat_Fault.Action_3 "Fault manager configuration.  Select up to 4 actions for each fault." VALUE 0x80002CA1 RecordLayout_4 0 CompuMethod_110 0 65535 /end CHARACTERISTIC
/begin CHARACTERISTIC FaultManager.Lambda1Overheat_Fault.Action_3_Condition "Fault manager configuration.  Select up to 4 actions for each fault." VALUE 0x80002CA3 RecordLayout_4 0 CompuMethod_111 0 65535 /end CHARACTERISTIC
/begin CHARACTERISTIC FaultManager.Lambda1Overheat_Fault.Action_4 "Fault manager configuration.  Select up to 4 actions for each fault." VALUE 0x80002CA5 RecordLayout_4 0 CompuMethod_110 0 65535 /end CHARACTERISTIC
/begin CHARACTERISTIC FaultManager.Lambda1Overheat_Fault.Action_4_Condition "Fault manager configuration.  Select up to 4 actions for each fault." VALUE 0x80002CA7 RecordLayout_4 0 CompuMethod_111 0 65535 /end CHARACTERISTIC
/begin CHARACTERISTIC FaultManager.Lambda1StuckInReset_Fault.Mode "Fault manager configuration.  Select up to 4 actions for each fault." VALUE 0x80002CA9 RecordLayout_4 0 CompuMethod_108 0 65535 /end CHARACTERISTIC
/begin CHARACTERISTIC FaultManager.Lambda1StuckInReset_Fault.ID "Fault manager configuration.  Select up to 4 actions for each fault." VALUE 0x80002CAB RecordLayout_4 0 CompuMethod_1 0 65535 /end CHARACTERISTIC
/begin CHARACTERISTIC FaultManager.Lambda1StuckInReset_Fault.Test "Fault manager configuration.  Select up to 4 actions for each fault." VALUE 0x80002CAD RecordLayout_4 0 CompuMethod_109 0 65535 /end CHARACTERISTIC
/begin CHARACTERISTIC FaultManager.Lambda1StuckInReset_Fault.Faulty_Samples__X_ "Fault manager configuration.  Select up to 4 actions for each fault." VALUE 0x80002CAF RecordLayout_4 0 CompuMethod_1 0 65535 /end CHARACTERISTIC
/begin CHARACTERISTIC FaultManager.Lambda1StuckInReset_Fault.Total_Samples__Y_ "Fault manager configuration.  Select up to 4 actions for each fault." VALUE 0x80002CB1 RecordLayout_4 0 CompuMethod_1 0 65535 /end CHARACTERISTIC
/begin CHARACTERISTIC FaultManager.Lambda1StuckInReset_Fault.Action_1 "Fault manager configuration.  Select up to 4 actions for each fault." VALUE 0x80002CB3 RecordLayout_4 0 CompuMethod_110 0 65535 /end CHARACTERISTIC
/begin CHARACTERISTIC FaultManager.Lambda1StuckInReset_Fault.Action_1_Condition "Fault manager configuration.  Select up to 4 actions for each fault." VALUE 0x80002CB5 RecordLayout_4 0 CompuMethod_111 0 65535 /end CHARACTERISTIC
/begin CHARACTERISTIC FaultManager.Lambda1StuckInReset_Fault.Action_2 "Fault manager configuration.  Select up to 4 actions for each fault." VALUE 0x80002CB7 RecordLayout_4 0 CompuMethod_110 0 65535 /end CHARACTERISTIC
/begin CHARACTERISTIC FaultManager.Lambda1StuckInReset_Fault.Action_2_Condition "Fault manager configuration.  Select up to 4 actions for each fault." VALUE 0x80002CB9 RecordLayout_4 0 CompuMethod_111 0 65535 /end CHARACTERISTIC
/begin CHARACTERISTIC FaultManager.Lambda1StuckInReset_Fault.Action_3 "Fault manager configuration.  Select up to 4 actions for each fault." VALUE 0x80002CBB RecordLayout_4 0 CompuMethod_110 0 65535 /end CHARACTERISTIC
/begin CHARACTERISTIC FaultManager.Lambda1StuckInReset_Fault.Action_3_Condition "Fault manager configuration.  Select up to 4 actions for each fault." VALUE 0x80002CBD RecordLayout_4 0 CompuMethod_111 0 65535 /end CHARACTERISTIC
/begin CHARACTERISTIC FaultManager.Lambda1StuckInReset_Fault.Action_4 "Fault manager configuration.  Select up to 4 actions for each fault." VALUE 0x80002CBF RecordLayout_4 0 CompuMethod_110 0 65535 /end CHARACTERISTIC
/begin CHARACTERISTIC FaultManager.Lambda1StuckInReset_Fault.Action_4_Condition "Fault manager configuration.  Select up to 4 actions for each fault." VALUE 0x80002CC1 RecordLayout_4 0 CompuMethod_111 0 65535 /end CHARACTERISTIC
/begin CHARACTERISTIC FaultManager.Lambda1StuckInWarmup_Fault.Mode "Fault manager configuration.  Select up to 4 actions for each fault." VALUE 0x80002CC3 RecordLayout_4 0 CompuMethod_108 0 65535 /end CHARACTERISTIC
/begin CHARACTERISTIC FaultManager.Lambda1StuckInWarmup_Fault.ID "Fault manager configuration.  Select up to 4 actions for each fault." VALUE 0x80002CC5 RecordLayout_4 0 CompuMethod_1 0 65535 /end CHARACTERISTIC
/begin CHARACTERISTIC FaultManager.Lambda1StuckInWarmup_Fault.Test "Fault manager configuration.  Select up to 4 actions for each fault." VALUE 0x80002CC7 RecordLayout_4 0 CompuMethod_109 0 65535 /end CHARACTERISTIC
/begin CHARACTERISTIC FaultManager.Lambda1StuckInWarmup_Fault.Faulty_Samples__X_ "Fault manager configuration.  Select up to 4 actions for each fault." VALUE 0x80002CC9 RecordLayout_4 0 CompuMethod_1 0 65535 /end CHARACTERISTIC
/begin CHARACTERISTIC FaultManager.Lambda1StuckInWarmup_Fault.Total_Samples__Y_ "Fault manager configuration.  Select up to 4 actions for each fault." VALUE 0x80002CCB RecordLayout_4 0 CompuMethod_1 0 65535 /end CHARACTERISTIC
/begin CHARACTERISTIC FaultManager.Lambda1StuckInWarmup_Fault.Action_1 "Fault manager configuration.  Select up to 4 actions for each fault." VALUE 0x80002CCD RecordLayout_4 0 CompuMethod_110 0 65535 /end CHARACTERISTIC
/begin CHARACTERISTIC FaultManager.Lambda1StuckInWarmup_Fault.Action_1_Condition "Fault manager configuration.  Select up to 4 actions for each fault." VALUE 0x80002CCF RecordLayout_4 0 CompuMethod_111 0 65535 /end CHARACTERISTIC
/begin CHARACTERISTIC FaultManager.Lambda1StuckInWarmup_Fault.Action_2 "Fault manager configuration.  Select up to 4 actions for each fault." VALUE 0x80002CD1 RecordLayout_4 0 CompuMethod_110 0 65535 /end CHARACTERISTIC
/begin CHARACTERISTIC FaultManager.Lambda1StuckInWarmup_Fault.Action_2_Condition "Fault manager configuration.  Select up to 4 actions for each fault." VALUE 0x80002CD3 RecordLayout_4 0 CompuMethod_111 0 65535 /end CHARACTERISTIC
/begin CHARACTERISTIC FaultManager.Lambda1StuckInWarmup_Fault.Action_3 "Fault manager configuration.  Select up to 4 actions for each fault." VALUE 0x80002CD5 RecordLayout_4 0 CompuMethod_110 0 65535 /end CHARACTERISTIC
/begin CHARACTERISTIC FaultManager.Lambda1StuckInWarmup_Fault.Action_3_Condition "Fault manager configuration.  Select up to 4 actions for each fault." VALUE 0x80002CD7 RecordLayout_4 0 CompuMethod_111 0 65535 /end CHARACTERISTIC
/begin CHARACTERISTIC FaultManager.Lambda1StuckInWarmup_Fault.Action_4 "Fault manager configuration.  Select up to 4 actions for each fault." VALUE 0x80002CD9 RecordLayout_4 0 CompuMethod_110 0 65535 /end CHARACTERISTIC
/begin CHARACTERISTIC FaultManager.Lambda1StuckInWarmup_Fault.Action_4_Condition "Fault manager configuration.  Select up to 4 actions for each fault." VALUE 0x80002CDB RecordLayout_4 0 CompuMethod_111 0 65535 /end CHARACTERISTIC
/begin CHARACTERISTIC FaultManager.Lambda1VoltHigh_Fault.Mode "Fault manager configuration.  Select up to 4 actions for each fault." VALUE 0x80002CDD RecordLayout_4 0 CompuMethod_108 0 65535 /end CHARACTERISTIC
/begin CHARACTERISTIC FaultManager.Lambda1VoltHigh_Fault.ID "Fault manager configuration.  Select up to 4 actions for each fault." VALUE 0x80002CDF RecordLayout_4 0 CompuMethod_1 0 65535 /end CHARACTERISTIC
/begin CHARACTERISTIC FaultManager.Lambda1VoltHigh_Fault.Test "Fault manager configuration.  Select up to 4 actions for each fault." VALUE 0x80002CE1 RecordLayout_4 0 CompuMethod_109 0 65535 /end CHARACTERISTIC
/begin CHARACTERISTIC FaultManager.Lambda1VoltHigh_Fault.Faulty_Samples__X_ "Fault manager configuration.  Select up to 4 actions for each fault." VALUE 0x80002CE3 RecordLayout_4 0 CompuMethod_1 0 65535 /end CHARACTERISTIC
/begin CHARACTERISTIC FaultManager.Lambda1VoltHigh_Fault.Total_Samples__Y_ "Fault manager configuration.  Select up to 4 actions for each fault." VALUE 0x80002CE5 RecordLayout_4 0 CompuMethod_1 0 65535 /end CHARACTERISTIC
/begin CHARACTERISTIC FaultManager.Lambda1VoltHigh_Fault.Action_1 "Fault manager configuration.  Select up to 4 actions for each fault." VALUE 0x80002CE7 RecordLayout_4 0 CompuMethod_110 0 65535 /end CHARACTERISTIC
/begin CHARACTERISTIC FaultManager.Lambda1VoltHigh_Fault.Action_1_Condition "Fault manager configuration.  Select up to 4 actions for each fault." VALUE 0x80002CE9 RecordLayout_4 0 CompuMethod_111 0 65535 /end CHARACTERISTIC
/begin CHARACTERISTIC FaultManager.Lambda1VoltHigh_Fault.Action_2 "Fault manager configuration.  Select up to 4 actions for each fault." VALUE 0x80002CEB RecordLayout_4 0 CompuMethod_110 0 65535 /end CHARACTERISTIC
/begin CHARACTERISTIC FaultManager.Lambda1VoltHigh_Fault.Action_2_Condition "Fault manager configuration.  Select up to 4 actions for each fault." VALUE 0x80002CED RecordLayout_4 0 CompuMethod_111 0 65535 /end CHARACTERISTIC
/begin CHARACTERISTIC FaultManager.Lambda1VoltHigh_Fault.Action_3 "Fault manager configuration.  Select up to 4 actions for each fault." VALUE 0x80002CEF RecordLayout_4 0 CompuMethod_110 0 65535 /end CHARACTERISTIC
/begin CHARACTERISTIC FaultManager.Lambda1VoltHigh_Fault.Action_3_Condition "Fault manager configuration.  Select up to 4 actions for each fault." VALUE 0x80002CF1 RecordLayout_4 0 CompuMethod_111 0 65535 /end CHARACTERISTIC
/begin CHARACTERISTIC FaultManager.Lambda1VoltHigh_Fault.Action_4 "Fault manager configuration.  Select up to 4 actions for each fault." VALUE 0x80002CF3 RecordLayout_4 0 CompuMethod_110 0 65535 /end CHARACTERISTIC
/begin CHARACTERISTIC FaultManager.Lambda1VoltHigh_Fault.Action_4_Condition "Fault manager configuration.  Select up to 4 actions for each fault." VALUE 0x80002CF5 RecordLayout_4 0 CompuMethod_111 0 65535 /end CHARACTERISTIC
/begin CHARACTERISTIC FaultManager.Lambda1VoltLow_Fault.Mode "Fault manager configuration.  Select up to 4 actions for each fault." VALUE 0x80002CF7 RecordLayout_4 0 CompuMethod_108 0 65535 /end CHARACTERISTIC
/begin CHARACTERISTIC FaultManager.Lambda1VoltLow_Fault.ID "Fault manager configuration.  Select up to 4 actions for each fault." VALUE 0x80002CF9 RecordLayout_4 0 CompuMethod_1 0 65535 /end CHARACTERISTIC
/begin CHARACTERISTIC FaultManager.Lambda1VoltLow_Fault.Test "Fault manager configuration.  Select up to 4 actions for each fault." VALUE 0x80002CFB RecordLayout_4 0 CompuMethod_109 0 65535 /end CHARACTERISTIC
/begin CHARACTERISTIC FaultManager.Lambda1VoltLow_Fault.Faulty_Samples__X_ "Fault manager configuration.  Select up to 4 actions for each fault." VALUE 0x80002CFD RecordLayout_4 0 CompuMethod_1 0 65535 /end CHARACTERISTIC
/begin CHARACTERISTIC FaultManager.Lambda1VoltLow_Fault.Total_Samples__Y_ "Fault manager configuration.  Select up to 4 actions for each fault." VALUE 0x80002CFF RecordLayout_4 0 CompuMethod_1 0 65535 /end CHARACTERISTIC
/begin CHARACTERISTIC FaultManager.Lambda1VoltLow_Fault.Action_1 "Fault manager configuration.  Select up to 4 actions for each fault." VALUE 0x80002D01 RecordLayout_4 0 CompuMethod_110 0 65535 /end CHARACTERISTIC
/begin CHARACTERISTIC FaultManager.Lambda1VoltLow_Fault.Action_1_Condition "Fault manager configuration.  Select up to 4 actions for each fault." VALUE 0x80002D03 RecordLayout_4 0 CompuMethod_111 0 65535 /end CHARACTERISTIC
/begin CHARACTERISTIC FaultManager.Lambda1VoltLow_Fault.Action_2 "Fault manager configuration.  Select up to 4 actions for each fault." VALUE 0x80002D05 RecordLayout_4 0 CompuMethod_110 0 65535 /end CHARACTERISTIC
/begin CHARACTERISTIC FaultManager.Lambda1VoltLow_Fault.Action_2_Condition "Fault manager configuration.  Select up to 4 actions for each fault." VALUE 0x80002D07 RecordLayout_4 0 CompuMethod_111 0 65535 /end CHARACTERISTIC
/begin CHARACTERISTIC FaultManager.Lambda1VoltLow_Fault.Action_3 "Fault manager configuration.  Select up to 4 actions for each fault." VALUE 0x80002D09 RecordLayout_4 0 CompuMethod_110 0 65535 /end CHARACTERISTIC
/begin CHARACTERISTIC FaultManager.Lambda1VoltLow_Fault.Action_3_Condition "Fault manager configuration.  Select up to 4 actions for each fault." VALUE 0x80002D0B RecordLayout_4 0 CompuMethod_111 0 65535 /end CHARACTERISTIC
/begin CHARACTERISTIC FaultManager.Lambda1VoltLow_Fault.Action_4 "Fault manager configuration.  Select up to 4 actions for each fault." VALUE 0x80002D0D RecordLayout_4 0 CompuMethod_110 0 65535 /end CHARACTERISTIC
/begin CHARACTERISTIC FaultManager.Lambda1VoltLow_Fault.Action_4_Condition "Fault manager configuration.  Select up to 4 actions for each fault." VALUE 0x80002D0F RecordLayout_4 0 CompuMethod_111 0 65535 /end CHARACTERISTIC
/begin CHARACTERISTIC FaultManager.Lambda2Error_Fault.Mode "Fault manager configuration.  Select up to 4 actions for each fault." VALUE 0x80002D11 RecordLayout_4 0 CompuMethod_108 0 65535 /end CHARACTERISTIC
/begin CHARACTERISTIC FaultManager.Lambda2Error_Fault.ID "Fault manager configuration.  Select up to 4 actions for each fault." VALUE 0x80002D13 RecordLayout_4 0 CompuMethod_1 0 65535 /end CHARACTERISTIC
/begin CHARACTERISTIC FaultManager.Lambda2Error_Fault.Test "Fault manager configuration.  Select up to 4 actions for each fault." VALUE 0x80002D15 RecordLayout_4 0 CompuMethod_109 0 65535 /end CHARACTERISTIC
/begin CHARACTERISTIC FaultManager.Lambda2Error_Fault.Faulty_Samples__X_ "Fault manager configuration.  Select up to 4 actions for each fault." VALUE 0x80002D17 RecordLayout_4 0 CompuMethod_1 0 65535 /end CHARACTERISTIC
/begin CHARACTERISTIC FaultManager.Lambda2Error_Fault.Total_Samples__Y_ "Fault manager configuration.  Select up to 4 actions for each fault." VALUE 0x80002D19 RecordLayout_4 0 CompuMethod_1 0 65535 /end CHARACTERISTIC
/begin CHARACTERISTIC FaultManager.Lambda2Error_Fault.Action_1 "Fault manager configuration.  Select up to 4 actions for each fault." VALUE 0x80002D1B RecordLayout_4 0 CompuMethod_110 0 65535 /end CHARACTERISTIC
/begin CHARACTERISTIC FaultManager.Lambda2Error_Fault.Action_1_Condition "Fault manager configuration.  Select up to 4 actions for each fault." VALUE 0x80002D1D RecordLayout_4 0 CompuMethod_111 0 65535 /end CHARACTERISTIC
/begin CHARACTERISTIC FaultManager.Lambda2Error_Fault.Action_2 "Fault manager configuration.  Select up to 4 actions for each fault." VALUE 0x80002D1F RecordLayout_4 0 CompuMethod_110 0 65535 /end CHARACTERISTIC
/begin CHARACTERISTIC FaultManager.Lambda2Error_Fault.Action_2_Condition "Fault manager configuration.  Select up to 4 actions for each fault." VALUE 0x80002D21 RecordLayout_4 0 CompuMethod_111 0 65535 /end CHARACTERISTIC
/begin CHARACTERISTIC FaultManager.Lambda2Error_Fault.Action_3 "Fault manager configuration.  Select up to 4 actions for each fault." VALUE 0x80002D23 RecordLayout_4 0 CompuMethod_110 0 65535 /end CHARACTERISTIC
/begin CHARACTERISTIC FaultManager.Lambda2Error_Fault.Action_3_Condition "Fault manager configuration.  Select up to 4 actions for each fault." VALUE 0x80002D25 RecordLayout_4 0 CompuMethod_111 0 65535 /end CHARACTERISTIC
/begin CHARACTERISTIC FaultManager.Lambda2Error_Fault.Action_4 "Fault manager configuration.  Select up to 4 actions for each fault." VALUE 0x80002D27 RecordLayout_4 0 CompuMethod_110 0 65535 /end CHARACTERISTIC
/begin CHARACTERISTIC FaultManager.Lambda2Error_Fault.Action_4_Condition "Fault manager configuration.  Select up to 4 actions for each fault." VALUE 0x80002D29 RecordLayout_4 0 CompuMethod_111 0 65535 /end CHARACTERISTIC
/begin CHARACTERISTIC FaultManager.Lambda2Fault_Fault.Mode "Fault manager configuration.  Select up to 4 actions for each fault." VALUE 0x80002D2B RecordLayout_4 0 CompuMethod_108 0 65535 /end CHARACTERISTIC
/begin CHARACTERISTIC FaultManager.Lambda2Fault_Fault.ID "Fault manager configuration.  Select up to 4 actions for each fault." VALUE 0x80002D2D RecordLayout_4 0 CompuMethod_1 0 65535 /end CHARACTERISTIC
/begin CHARACTERISTIC FaultManager.Lambda2Fault_Fault.Test "Fault manager configuration.  Select up to 4 actions for each fault." VALUE 0x80002D2F RecordLayout_4 0 CompuMethod_109 0 65535 /end CHARACTERISTIC
/begin CHARACTERISTIC FaultManager.Lambda2Fault_Fault.Faulty_Samples__X_ "Fault manager configuration.  Select up to 4 actions for each fault." VALUE 0x80002D31 RecordLayout_4 0 CompuMethod_1 0 65535 /end CHARACTERISTIC
/begin CHARACTERISTIC FaultManager.Lambda2Fault_Fault.Total_Samples__Y_ "Fault manager configuration.  Select up to 4 actions for each fault." VALUE 0x80002D33 RecordLayout_4 0 CompuMethod_1 0 65535 /end CHARACTERISTIC
/begin CHARACTERISTIC FaultManager.Lambda2Fault_Fault.Action_1 "Fault manager configuration.  Select up to 4 actions for each fault." VALUE 0x80002D35 RecordLayout_4 0 CompuMethod_110 0 65535 /end CHARACTERISTIC
/begin CHARACTERISTIC FaultManager.Lambda2Fault_Fault.Action_1_Condition "Fault manager configuration.  Select up to 4 actions for each fault." VALUE 0x80002D37 RecordLayout_4 0 CompuMethod_111 0 65535 /end CHARACTERISTIC
/begin CHARACTERISTIC FaultManager.Lambda2Fault_Fault.Action_2 "Fault manager configuration.  Select up to 4 actions for each fault." VALUE 0x80002D39 RecordLayout_4 0 CompuMethod_110 0 65535 /end CHARACTERISTIC
/begin CHARACTERISTIC FaultManager.Lambda2Fault_Fault.Action_2_Condition "Fault manager configuration.  Select up to 4 actions for each fault." VALUE 0x80002D3B RecordLayout_4 0 CompuMethod_111 0 65535 /end CHARACTERISTIC
/begin CHARACTERISTIC FaultManager.Lambda2Fault_Fault.Action_3 "Fault manager configuration.  Select up to 4 actions for each fault." VALUE 0x80002D3D RecordLayout_4 0 CompuMethod_110 0 65535 /end CHARACTERISTIC
/begin CHARACTERISTIC FaultManager.Lambda2Fault_Fault.Action_3_Condition "Fault manager configuration.  Select up to 4 actions for each fault." VALUE 0x80002D3F RecordLayout_4 0 CompuMethod_111 0 65535 /end CHARACTERISTIC
/begin CHARACTERISTIC FaultManager.Lambda2Fault_Fault.Action_4 "Fault manager configuration.  Select up to 4 actions for each fault." VALUE 0x80002D41 RecordLayout_4 0 CompuMethod_110 0 65535 /end CHARACTERISTIC
/begin CHARACTERISTIC FaultManager.Lambda2Fault_Fault.Action_4_Condition "Fault manager configuration.  Select up to 4 actions for each fault." VALUE 0x80002D43 RecordLayout_4 0 CompuMethod_111 0 65535 /end CHARACTERISTIC
/begin CHARACTERISTIC FaultManager.Lambda2HtrOpen_Fault.Mode "Fault manager configuration.  Select up to 4 actions for each fault." VALUE 0x80002D45 RecordLayout_4 0 CompuMethod_108 0 65535 /end CHARACTERISTIC
/begin CHARACTERISTIC FaultManager.Lambda2HtrOpen_Fault.ID "Fault manager configuration.  Select up to 4 actions for each fault." VALUE 0x80002D47 RecordLayout_4 0 CompuMethod_1 0 65535 /end CHARACTERISTIC
/begin CHARACTERISTIC FaultManager.Lambda2HtrOpen_Fault.Test "Fault manager configuration.  Select up to 4 actions for each fault." VALUE 0x80002D49 RecordLayout_4 0 CompuMethod_109 0 65535 /end CHARACTERISTIC
/begin CHARACTERISTIC FaultManager.Lambda2HtrOpen_Fault.Faulty_Samples__X_ "Fault manager configuration.  Select up to 4 actions for each fault." VALUE 0x80002D4B RecordLayout_4 0 CompuMethod_1 0 65535 /end CHARACTERISTIC
/begin CHARACTERISTIC FaultManager.Lambda2HtrOpen_Fault.Total_Samples__Y_ "Fault manager configuration.  Select up to 4 actions for each fault." VALUE 0x80002D4D RecordLayout_4 0 CompuMethod_1 0 65535 /end CHARACTERISTIC
/begin CHARACTERISTIC FaultManager.Lambda2HtrOpen_Fault.Action_1 "Fault manager configuration.  Select up to 4 actions for each fault." VALUE 0x80002D4F RecordLayout_4 0 CompuMethod_110 0 65535 /end CHARACTERISTIC
/begin CHARACTERISTIC FaultManager.Lambda2HtrOpen_Fault.Action_1_Condition "Fault manager configuration.  Select up to 4 actions for each fault." VALUE 0x80002D51 RecordLayout_4 0 CompuMethod_111 0 65535 /end CHARACTERISTIC
/begin CHARACTERISTIC FaultManager.Lambda2HtrOpen_Fault.Action_2 "Fault manager configuration.  Select up to 4 actions for each fault." VALUE 0x80002D53 RecordLayout_4 0 CompuMethod_110 0 65535 /end CHARACTERISTIC
/begin CHARACTERISTIC FaultManager.Lambda2HtrOpen_Fault.Action_2_Condition "Fault manager configuration.  Select up to 4 actions for each fault." VALUE 0x80002D55 RecordLayout_4 0 CompuMethod_111 0 65535 /end CHARACTERISTIC
/begin CHARACTERISTIC FaultManager.Lambda2HtrOpen_Fault.Action_3 "Fault manager configuration.  Select up to 4 actions for each fault." VALUE 0x80002D57 RecordLayout_4 0 CompuMethod_110 0 65535 /end CHARACTERISTIC
/begin CHARACTERISTIC FaultManager.Lambda2HtrOpen_Fault.Action_3_Condition "Fault manager configuration.  Select up to 4 actions for each fault." VALUE 0x80002D59 RecordLayout_4 0 CompuMethod_111 0 65535 /end CHARACTERISTIC
/begin CHARACTERISTIC FaultManager.Lambda2HtrOpen_Fault.Action_4 "Fault manager configuration.  Select up to 4 actions for each fault." VALUE 0x80002D5B RecordLayout_4 0 CompuMethod_110 0 65535 /end CHARACTERISTIC
/begin CHARACTERISTIC FaultManager.Lambda2HtrOpen_Fault.Action_4_Condition "Fault manager configuration.  Select up to 4 actions for each fault." VALUE 0x80002D5D RecordLayout_4 0 CompuMethod_111 0 65535 /end CHARACTERISTIC
/begin CHARACTERISTIC FaultManager.Lambda2HtrShort_Fault.Mode "Fault manager configuration.  Select up to 4 actions for each fault." VALUE 0x80002D5F RecordLayout_4 0 CompuMethod_108 0 65535 /end CHARACTERISTIC
/begin CHARACTERISTIC FaultManager.Lambda2HtrShort_Fault.ID "Fault manager configuration.  Select up to 4 actions for each fault." VALUE 0x80002D61 RecordLayout_4 0 CompuMethod_1 0 65535 /end CHARACTERISTIC
/begin CHARACTERISTIC FaultManager.Lambda2HtrShort_Fault.Test "Fault manager configuration.  Select up to 4 actions for each fault." VALUE 0x80002D63 RecordLayout_4 0 CompuMethod_109 0 65535 /end CHARACTERISTIC
/begin CHARACTERISTIC FaultManager.Lambda2HtrShort_Fault.Faulty_Samples__X_ "Fault manager configuration.  Select up to 4 actions for each fault." VALUE 0x80002D65 RecordLayout_4 0 CompuMethod_1 0 65535 /end CHARACTERISTIC
/begin CHARACTERISTIC FaultManager.Lambda2HtrShort_Fault.Total_Samples__Y_ "Fault manager configuration.  Select up to 4 actions for each fault." VALUE 0x80002D67 RecordLayout_4 0 CompuMethod_1 0 65535 /end CHARACTERISTIC
/begin CHARACTERISTIC FaultManager.Lambda2HtrShort_Fault.Action_1 "Fault manager configuration.  Select up to 4 actions for each fault." VALUE 0x80002D69 RecordLayout_4 0 CompuMethod_110 0 65535 /end CHARACTERISTIC
/begin CHARACTERISTIC FaultManager.Lambda2HtrShort_Fault.Action_1_Condition "Fault manager configuration.  Select up to 4 actions for each fault." VALUE 0x80002D6B RecordLayout_4 0 CompuMethod_111 0 65535 /end CHARACTERISTIC
/begin CHARACTERISTIC FaultManager.Lambda2HtrShort_Fault.Action_2 "Fault manager configuration.  Select up to 4 actions for each fault." VALUE 0x80002D6D RecordLayout_4 0 CompuMethod_110 0 65535 /end CHARACTERISTIC
/begin CHARACTERISTIC FaultManager.Lambda2HtrShort_Fault.Action_2_Condition "Fault manager configuration.  Select up to 4 actions for each fault." VALUE 0x80002D6F RecordLayout_4 0 CompuMethod_111 0 65535 /end CHARACTERISTIC
/begin CHARACTERISTIC FaultManager.Lambda2HtrShort_Fault.Action_3 "Fault manager configuration.  Select up to 4 actions for each fault." VALUE 0x80002D71 RecordLayout_4 0 CompuMethod_110 0 65535 /end CHARACTERISTIC
/begin CHARACTERISTIC FaultManager.Lambda2HtrShort_Fault.Action_3_Condition "Fault manager configuration.  Select up to 4 actions for each fault." VALUE 0x80002D73 RecordLayout_4 0 CompuMethod_111 0 65535 /end CHARACTERISTIC
/begin CHARACTERISTIC FaultManager.Lambda2HtrShort_Fault.Action_4 "Fault manager configuration.  Select up to 4 actions for each fault." VALUE 0x80002D75 RecordLayout_4 0 CompuMethod_110 0 65535 /end CHARACTERISTIC
/begin CHARACTERISTIC FaultManager.Lambda2HtrShort_Fault.Action_4_Condition "Fault manager configuration.  Select up to 4 actions for each fault." VALUE 0x80002D77 RecordLayout_4 0 CompuMethod_111 0 65535 /end CHARACTERISTIC
/begin CHARACTERISTIC FaultManager.Lambda2Overcool_Fault.Mode "Fault manager configuration.  Select up to 4 actions for each fault." VALUE 0x80002D79 RecordLayout_4 0 CompuMethod_108 0 65535 /end CHARACTERISTIC
/begin CHARACTERISTIC FaultManager.Lambda2Overcool_Fault.ID "Fault manager configuration.  Select up to 4 actions for each fault." VALUE 0x80002D7B RecordLayout_4 0 CompuMethod_1 0 65535 /end CHARACTERISTIC
/begin CHARACTERISTIC FaultManager.Lambda2Overcool_Fault.Test "Fault manager configuration.  Select up to 4 actions for each fault." VALUE 0x80002D7D RecordLayout_4 0 CompuMethod_109 0 65535 /end CHARACTERISTIC
/begin CHARACTERISTIC FaultManager.Lambda2Overcool_Fault.Faulty_Samples__X_ "Fault manager configuration.  Select up to 4 actions for each fault." VALUE 0x80002D7F RecordLayout_4 0 CompuMethod_1 0 65535 /end CHARACTERISTIC
/begin CHARACTERISTIC FaultManager.Lambda2Overcool_Fault.Total_Samples__Y_ "Fault manager configuration.  Select up to 4 actions for each fault." VALUE 0x80002D81 RecordLayout_4 0 CompuMethod_1 0 65535 /end CHARACTERISTIC
/begin CHARACTERISTIC FaultManager.Lambda2Overcool_Fault.Action_1 "Fault manager configuration.  Select up to 4 actions for each fault." VALUE 0x80002D83 RecordLayout_4 0 CompuMethod_110 0 65535 /end CHARACTERISTIC
/begin CHARACTERISTIC FaultManager.Lambda2Overcool_Fault.Action_1_Condition "Fault manager configuration.  Select up to 4 actions for each fault." VALUE 0x80002D85 RecordLayout_4 0 CompuMethod_111 0 65535 /end CHARACTERISTIC
/begin CHARACTERISTIC FaultManager.Lambda2Overcool_Fault.Action_2 "Fault manager configuration.  Select up to 4 actions for each fault." VALUE 0x80002D87 RecordLayout_4 0 CompuMethod_110 0 65535 /end CHARACTERISTIC
/begin CHARACTERISTIC FaultManager.Lambda2Overcool_Fault.Action_2_Condition "Fault manager configuration.  Select up to 4 actions for each fault." VALUE 0x80002D89 RecordLayout_4 0 CompuMethod_111 0 65535 /end CHARACTERISTIC
/begin CHARACTERISTIC FaultManager.Lambda2Overcool_Fault.Action_3 "Fault manager configuration.  Select up to 4 actions for each fault." VALUE 0x80002D8B RecordLayout_4 0 CompuMethod_110 0 65535 /end CHARACTERISTIC
/begin CHARACTERISTIC FaultManager.Lambda2Overcool_Fault.Action_3_Condition "Fault manager configuration.  Select up to 4 actions for each fault." VALUE 0x80002D8D RecordLayout_4 0 CompuMethod_111 0 65535 /end CHARACTERISTIC
/begin CHARACTERISTIC FaultManager.Lambda2Overcool_Fault.Action_4 "Fault manager configuration.  Select up to 4 actions for each fault." VALUE 0x80002D8F RecordLayout_4 0 CompuMethod_110 0 65535 /end CHARACTERISTIC
/begin CHARACTERISTIC FaultManager.Lambda2Overcool_Fault.Action_4_Condition "Fault manager configuration.  Select up to 4 actions for each fault." VALUE 0x80002D91 RecordLayout_4 0 CompuMethod_111 0 65535 /end CHARACTERISTIC
/begin CHARACTERISTIC FaultManager.Lambda2Overheat_Fault.Mode "Fault manager configuration.  Select up to 4 actions for each fault." VALUE 0x80002D93 RecordLayout_4 0 CompuMethod_108 0 65535 /end CHARACTERISTIC
/begin CHARACTERISTIC FaultManager.Lambda2Overheat_Fault.ID "Fault manager configuration.  Select up to 4 actions for each fault." VALUE 0x80002D95 RecordLayout_4 0 CompuMethod_1 0 65535 /end CHARACTERISTIC
/begin CHARACTERISTIC FaultManager.Lambda2Overheat_Fault.Test "Fault manager configuration.  Select up to 4 actions for each fault." VALUE 0x80002D97 RecordLayout_4 0 CompuMethod_109 0 65535 /end CHARACTERISTIC
/begin CHARACTERISTIC FaultManager.Lambda2Overheat_Fault.Faulty_Samples__X_ "Fault manager configuration.  Select up to 4 actions for each fault." VALUE 0x80002D99 RecordLayout_4 0 CompuMethod_1 0 65535 /end CHARACTERISTIC
/begin CHARACTERISTIC FaultManager.Lambda2Overheat_Fault.Total_Samples__Y_ "Fault manager configuration.  Select up to 4 actions for each fault." VALUE 0x80002D9B RecordLayout_4 0 CompuMethod_1 0 65535 /end CHARACTERISTIC
/begin CHARACTERISTIC FaultManager.Lambda2Overheat_Fault.Action_1 "Fault manager configuration.  Select up to 4 actions for each fault." VALUE 0x80002D9D RecordLayout_4 0 CompuMethod_110 0 65535 /end CHARACTERISTIC
/begin CHARACTERISTIC FaultManager.Lambda2Overheat_Fault.Action_1_Condition "Fault manager configuration.  Select up to 4 actions for each fault." VALUE 0x80002D9F RecordLayout_4 0 CompuMethod_111 0 65535 /end CHARACTERISTIC
/begin CHARACTERISTIC FaultManager.Lambda2Overheat_Fault.Action_2 "Fault manager configuration.  Select up to 4 actions for each fault." VALUE 0x80002DA1 RecordLayout_4 0 CompuMethod_110 0 65535 /end CHARACTERISTIC
/begin CHARACTERISTIC FaultManager.Lambda2Overheat_Fault.Action_2_Condition "Fault manager configuration.  Select up to 4 actions for each fault." VALUE 0x80002DA3 RecordLayout_4 0 CompuMethod_111 0 65535 /end CHARACTERISTIC
/begin CHARACTERISTIC FaultManager.Lambda2Overheat_Fault.Action_3 "Fault manager configuration.  Select up to 4 actions for each fault." VALUE 0x80002DA5 RecordLayout_4 0 CompuMethod_110 0 65535 /end CHARACTERISTIC
/begin CHARACTERISTIC FaultManager.Lambda2Overheat_Fault.Action_3_Condition "Fault manager configuration.  Select up to 4 actions for each fault." VALUE 0x80002DA7 RecordLayout_4 0 CompuMethod_111 0 65535 /end CHARACTERISTIC
/begin CHARACTERISTIC FaultManager.Lambda2Overheat_Fault.Action_4 "Fault manager configuration.  Select up to 4 actions for each fault." VALUE 0x80002DA9 RecordLayout_4 0 CompuMethod_110 0 65535 /end CHARACTERISTIC
/begin CHARACTERISTIC FaultManager.Lambda2Overheat_Fault.Action_4_Condition "Fault manager configuration.  Select up to 4 actions for each fault." VALUE 0x80002DAB RecordLayout_4 0 CompuMethod_111 0 65535 /end CHARACTERISTIC
/begin CHARACTERISTIC FaultManager.Lambda2StuckInReset_Fault.Mode "Fault manager configuration.  Select up to 4 actions for each fault." VALUE 0x80002DAD RecordLayout_4 0 CompuMethod_108 0 65535 /end CHARACTERISTIC
/begin CHARACTERISTIC FaultManager.Lambda2StuckInReset_Fault.ID "Fault manager configuration.  Select up to 4 actions for each fault." VALUE 0x80002DAF RecordLayout_4 0 CompuMethod_1 0 65535 /end CHARACTERISTIC
/begin CHARACTERISTIC FaultManager.Lambda2StuckInReset_Fault.Test "Fault manager configuration.  Select up to 4 actions for each fault." VALUE 0x80002DB1 RecordLayout_4 0 CompuMethod_109 0 65535 /end CHARACTERISTIC
/begin CHARACTERISTIC FaultManager.Lambda2StuckInReset_Fault.Faulty_Samples__X_ "Fault manager configuration.  Select up to 4 actions for each fault." VALUE 0x80002DB3 RecordLayout_4 0 CompuMethod_1 0 65535 /end CHARACTERISTIC
/begin CHARACTERISTIC FaultManager.Lambda2StuckInReset_Fault.Total_Samples__Y_ "Fault manager configuration.  Select up to 4 actions for each fault." VALUE 0x80002DB5 RecordLayout_4 0 CompuMethod_1 0 65535 /end CHARACTERISTIC
/begin CHARACTERISTIC FaultManager.Lambda2StuckInReset_Fault.Action_1 "Fault manager configuration.  Select up to 4 actions for each fault." VALUE 0x80002DB7 RecordLayout_4 0 CompuMethod_110 0 65535 /end CHARACTERISTIC
/begin RECORD_LAYOUT RecordLayout_4 FNC_VALUES 1 UWORD ROW_DIR DIRECT /end RECORD_LAYOUT
/*~~~~~~~~~ 6.3.31 COMPU_METHODs ~~~~~~~~~*/
/begin COMPU_METHOD CompuMethod_1 "" RAT_FUNC "%3.0" "" COEFFS 0 1 0 0 0 1 /end COMPU_METHOD
/begin COMPU_METHOD CompuMethod_108 "" TAB_VERB "%3.0" "" COMPU_TAB_REF CompuVtab_33 /end COMPU_METHOD
/begin COMPU_METHOD CompuMethod_109 "" TAB_VERB "%3.0" "" COMPU_TAB_REF CompuVtab_34 /end COMPU_METHOD
/begin COMPU_METHOD CompuMethod_110 "" TAB_VERB "%3.0" "" COMPU_TAB_REF CompuVtab_35 /end COMPU_METHOD
/begin COMPU_METHOD CompuMethod_111 "" TAB_VERB "%3.0" "" COMPU_TAB_REF CompuVtab_36 /end COMPU_METHOD
/begin COMPU_VTAB CompuVtab_33 "" TAB_VERB 6 0 "Disabled" 1 "Enabled" 2 "Sticky" 3 "Enabled - Persistent" 4 "Sticky - Persistent" 5 "Save Occurred" /end COMPU_VTAB
/begin COMPU_VTAB CompuVtab_34 "" TAB_VERB 2 0 "-" 1 "Test" /end COMPU_VTAB
/begin COMPU_VTAB CompuVtab_35 "" TAB_VERB 15 0 "CutThrottle" 1 "DFCODisable" 2 "DelayedEngineShutdown" 3 "DisableAC" 4 "DisableFanRun" 5 "DisableFanStall" 6 "DisableO2Ctrl" 7 "DisableVEAdapt" 8 "EngineProtectLED" 9 "EngineShutdown" 10 "HardRevLimit" 11 "MIL_LED" 12 "MediumRevLimit" 13 "SoftRevLimit" 14 "(None)" /end COMPU_VTAB
/begin COMPU_VTAB CompuVtab_36 "" TAB_VERB 8 0 "(None)" 1 "Suspected" 2 "Active" 3 "Suspected or Active" 4 "Occurred" 5 "Suspected or Occurred" 6 "Active or Occurred" 7 "Suspected or Active or Occurred" /end COMPU_VTAB
/begin FUNCTION BaseEngineController_LS ""
 /begin DEF_CHARACTERISTIC FaultManager.EST5_Open.Faulty_Samples__X_ FaultManager.EST5_Open.Total_Samples__Y_ FaultManager.EST5_Open.Action_1 FaultManager.EST5_Open.Action_1_Condition FaultManager.EST5_Open.Action_2 FaultManager.EST5_Open.Action_2_Condition FaultManager.EST5_Open.Action_3 FaultManager.EST5_Open.Action_3_Condition FaultManager.EST5_Open.Action_4 FaultManager.EST5_Open.Action_4_Condition FaultManager.EST5_Short.Mode FaultManager.EST5_Short.ID FaultManager.EST5_Short.Test FaultManager.EST5_Short.Faulty_Samples__X_ FaultManager.EST5_Short.Total_Samples__Y_ FaultManager.EST5_Short.Action_1 FaultManager.EST5_Short.Action_1_Condition FaultManager.EST5_Short.Action_2 FaultManager.EST5_Short.Action_2_Condition FaultManager.EST5_Short.Action_3 FaultManager.EST5_Short.Action_3_Condition FaultManager.EST5_Short.Action_4 FaultManager.EST5_Short.Action_4_Condition FaultManager.EST6_Open.Mode FaultManager.EST6_Open.ID FaultManager.EST6_Open.Test FaultManager.EST6_Open.Faulty_Samples__X_ FaultManager.EST6_Open.Total_Samples__Y_ FaultManager.EST6_Open.Action_1 FaultManager.EST6_Open.Action_1_Condition FaultManager.EST6_Open.Action_2 FaultManager.EST6_Open.Action_2_Condition FaultManager.EST6_Open.Action_3 FaultManager.EST6_Open.Action_3_Condition FaultManager.EST6_Open.Action_4 FaultManager.EST6_Open.Action_4_Condition FaultManager.EST6_Short.Mode FaultManager.EST6_Short.ID FaultManager.EST6_Short.Test FaultManager.EST6_Short.Faulty_Samples__X_ FaultManager.EST6_Short.Total_Samples__Y_ FaultManager.EST6_Short.Action_1 FaultManager.EST6_Short.Action_1_Condition FaultManager.EST6_Short.Action_2 FaultManager.EST6_Short.Action_2_Condition FaultManager.EST6_Short.Action_3 FaultManager.EST6_Short.Action_3_Condition FaultManager.EST6_Short.Action_4 FaultManager.EST6_Short.Action_4_Condition FaultManager.EST7_Open.Mode FaultManager.EST7_Open.ID FaultManager.EST7_Open.Test FaultManager.EST7_Open.Faulty_Samples__X_ FaultManager.EST7_Open.Total_Samples__Y_ FaultManager.EST7_Open.Action_1 FaultManager.EST7_Open.Action_1_Condition FaultManager.EST7_Open.Action_2 FaultManager.EST7_Open.Action_2_Condition FaultManager.EST7_Open.Action_3 FaultManager.EST7_Open.Action_3_Condition FaultManager.EST7_Open.Action_4 FaultManager.EST7_Open.Action_4_Condition FaultManager.EST7_Short.Mode FaultManager.EST7_Short.ID FaultManager.EST7_Short.Test FaultManager.EST7_Short.Faulty_Samples__X_ FaultManager.EST7_Short.Total_Samples__Y_ FaultManager.EST7_Short.Action_1 FaultManager.EST7_Short.Action_1_Condition FaultManager.EST7_Short.Action_2 FaultManager.EST7_Short.Action_2_Condition FaultManager.EST7_Short.Action_3 FaultManager.EST7_Short.Action_3_Condition FaultManager.EST7_Short.Action_4 FaultManager.EST7_Short.Action_4_Condition FaultManager.EST8_Open.Mode FaultManager.EST8_Open.ID FaultManager.EST8_Open.Test FaultManager.EST8_Open.Faulty_Samples__X_ FaultManager.EST8_Open.Total_Samples__Y_ FaultManager.EST8_Open.Action_1 FaultManager.EST8_Open.Action_1_Condition FaultManager.EST8_Open.Action_2 FaultManager.EST8_Open.Action_2_Condition FaultManager.EST8_Open.Action_3 FaultManager.EST8_Open.Action_3_Condition FaultManager.EST8_Open.Action_4 FaultManager.EST8_Open.Action_4_Condition FaultManager.EST8_Short.Mode FaultManager.EST8_Short.ID FaultManager.EST8_Short.Test FaultManager.EST8_Short.Faulty_Samples__X_ FaultManager.EST8_Short.Total_Samples__Y_ FaultManager.EST8_Short.Action_1 FaultManager.EST8_Short.Action_1_Condition FaultManager.EST8_Short.Action_2 FaultManager.EST8_Short.Action_2_Condition FaultManager.EST8_Short.Action_3 FaultManager.EST8_Short.Action_3_Condition FaultManager.EST8_Short.Action_4 FaultManager.EST8_Short.Action_4_Condition FaultManager.ETCSpringTest.Mode FaultManager.ETCSpringTest.ID FaultManager.ETCSpringTest.Test FaultManager.ETCSpringTest.Faulty_Samples__X_ FaultManager.ETCSpringTest.Total_Samples__Y_ FaultManager.ETCSpringTest.Action_1 FaultManager.ETCSpringTest.Action_1_Condition FaultManager.ETCSpringTest.Action_2 FaultManager.ETCSpringTest.Action_2_Condition FaultManager.ETCSpringTest.Action_3 FaultManager.ETCSpringTest.Action_3_Condition FaultManager.ETCSpringTest.Action_4 FaultManager.ETCSpringTest.Action_4_Condition FaultManager.ETC_Open_Fault.Mode FaultManager.ETC_Open_Fault.ID FaultManager.ETC_Open_Fault.Test FaultManager.ETC_Open_Fault.Faulty_Samples__X_ FaultManager.ETC_Open_Fault.Total_Samples__Y_ FaultManager.ETC_Open_Fault.Action_1 FaultManager.ETC_Open_Fault.Action_1_Condition FaultManager.ETC_Open_Fault.Action_2 FaultManager.ETC_Open_Fault.Action_2_Condition FaultManager.ETC_Open_Fault.Action_3 FaultManager.ETC_Open_Fault.Action_3_Condition FaultManager.ETC_Open_Fault.Action_4 FaultManager.ETC_Open_Fault.Action_4_Condition FaultManager.ETC_Sticking.Mode FaultManager.ETC_Sticking.ID FaultManager.ETC_Sticking.Test FaultManager.ETC_Sticking.Faulty_Samples__X_ FaultManager.ETC_Sticking.Total_Samples__Y_ FaultManager.ETC_Sticking.Action_1 FaultManager.ETC_Sticking.Action_1_Condition FaultManager.ETC_Sticking.Action_2 FaultManager.ETC_Sticking.Action_2_Condition FaultManager.ETC_Sticking.Action_3 FaultManager.ETC_Sticking.Action_3_Condition FaultManager.ETC_Sticking.Action_4 FaultManager.ETC_Sticking.Action_4_Condition FaultManager.EVAPRangeHigh.Mode FaultManager.EVAPRangeHigh.ID FaultManager.EVAPRangeHigh.Test FaultManager.EVAPRangeHigh.Faulty_Samples__X_ FaultManager.EVAPRangeHigh.Total_Samples__Y_ FaultManager.EVAPRangeHigh.Action_1 FaultManager.EVAPRangeHigh.Action_1_Condition FaultManager.EVAPRangeHigh.Action_2 FaultManager.EVAPRangeHigh.Action_2_Condition FaultManager.EVAPRangeHigh.Action_3 FaultManager.EVAPRangeHigh.Action_3_Condition FaultManager.EVAPRangeHigh.Action_4 FaultManager.EVAPRangeHigh.Action_4_Condition FaultManager.EVAPRangeLow.Mode FaultManager.EVAPRangeLow.ID FaultManager.EVAPRangeLow.Test FaultManager.EVAPRangeLow.Faulty_Samples__X_ FaultManager.EVAPRangeLow.Total_Samples__Y_ FaultManager.EVAPRangeLow.Action_1 FaultManager.EVAPRangeLow.Action_1_Condition FaultManager.EVAPRangeLow.Action_2 FaultManager.EVAPRangeLow.Action_2_Condition FaultManager.EVAPRangeLow.Action_3 FaultManager.EVAPRangeLow.Action_3_Condition FaultManager.EVAPRangeLow.Action_4 FaultManager.EVAPRangeLow.Action_4_Condition FaultManager.FuelAdaptRangeHi_BankA.Mode FaultManager.FuelAdaptRangeHi_BankA.ID FaultManager.FuelAdaptRangeHi_BankA.Test FaultManager.FuelAdaptRangeHi_BankA.Faulty_Samples__X_ FaultManager.FuelAdaptRangeHi_BankA.Total_Samples__Y_ FaultManager.FuelAdaptRangeHi_BankA.Action_1 FaultManager.FuelAdaptRangeHi_BankA.Action_1_Condition FaultManager.FuelAdaptRangeHi_BankA.Action_2 FaultManager.FuelAdaptRangeHi_BankA.Action_2_Condition FaultManager.FuelAdaptRangeHi_BankA.Action_3 FaultManager.FuelAdaptRangeHi_BankA.Action_3_Condition FaultManager.FuelAdaptRangeHi_BankA.Action_4 FaultManager.FuelAdaptRangeHi_BankA.Action_4_Condition FaultManager.FuelAdaptRangeHi_BankB.Mode FaultManager.FuelAdaptRangeHi_BankB.ID FaultManager.FuelAdaptRangeHi_BankB.Test FaultManager.FuelAdaptRangeHi_BankB.Faulty_Samples__X_ FaultManager.FuelAdaptRangeHi_BankB.Total_Samples__Y_ FaultManager.FuelAdaptRangeHi_BankB.Action_1 FaultManager.FuelAdaptRangeHi_BankB.Action_1_Condition FaultManager.FuelAdaptRangeHi_BankB.Action_2 FaultManager.FuelAdaptRangeHi_BankB.Action_2_Condition FaultManager.FuelAdaptRangeHi_BankB.Action_3 FaultManager.FuelAdaptRangeHi_BankB.Action_3_Condition FaultManager.FuelAdaptRangeHi_BankB.Action_4 FaultManager.FuelAdaptRangeHi_BankB.Action_4_Condition FaultManager.FuelAdaptRangeLow_BankA.Mode FaultManager.FuelAdaptRangeLow_BankA.ID FaultManager.FuelAdaptRangeLow_BankA.Test FaultManager.FuelAdaptRangeLow_BankA.Faulty_Samples__X_ FaultManager.FuelAdaptRangeLow_BankA.Total_Samples__Y_ FaultManager.FuelAdaptRangeLow_BankA.Action_1 FaultManager.FuelAdaptRangeLow_BankA.Action_1_Condition FaultManager.FuelAdaptRangeLow_BankA.Action_2 FaultManager.FuelAdaptRangeLow_BankA.Action_2_Condition FaultManager.FuelAdaptRangeLow_BankA.Action_3 FaultManager.FuelAdaptRangeLow_BankA.Action_3_Condition FaultManager.FuelAdaptRangeLow_BankA.Action_4 FaultManager.FuelAdaptRangeLow_BankA.Action_4_Condition FaultManager.FuelAdaptRangeLow_BankB.Mode FaultManager.FuelAdaptRangeLow_BankB.ID FaultManager.FuelAdaptRangeLow_BankB.Test FaultManager.FuelAdaptRangeLow_BankB.Faulty_Samples__X_ FaultManager.FuelAdaptRangeLow_BankB.Total_Samples__Y_ FaultManager.FuelAdaptRangeLow_BankB.Action_1 FaultManager.FuelAdaptRangeLow_BankB.Action_1_Condition FaultManager.FuelAdaptRangeLow_BankB.Action_2 FaultManager.FuelAdaptRangeLow_BankB.Action_2_Condition FaultManager.FuelAdaptRangeLow_BankB.Action_3 FaultManager.FuelAdaptRangeLow_BankB.Action_3_Condition FaultManager.FuelAdaptRangeLow_BankB.Action_4 FaultManager.FuelAdaptRangeLow_BankB.Action_4_Condition FaultManager.FuelPresHigh_Fault.Mode FaultManager.FuelPresHigh_Fault.ID FaultManager.FuelPresHigh_Fault.Test FaultManager.FuelPresHigh_Fault.Faulty_Samples__X_ FaultManager.FuelPresHigh_Fault.Total_Samples__Y_ FaultManager.FuelPresHigh_Fault.Action_1 FaultManager.FuelPresHigh_Fault.Action_1_Condition FaultManager.FuelPresHigh_Fault.Action_2 FaultManager.FuelPresHigh_Fault.Action_2_Condition FaultManager.FuelPresHigh_Fault.Action_3 FaultManager.FuelPresHigh_Fault.Action_3_Condition FaultManager.FuelPresHigh_Fault.Action_4 FaultManager.FuelPresHigh_Fault.Action_4_Condition FaultManager.FuelPresLow_Fault.Mode FaultManager.FuelPresLow_Fault.ID FaultManager.FuelPresLow_Fault.Test FaultManager.FuelPresLow_Fault.Faulty_Samples__X_ FaultManager.FuelPresLow_Fault.Total_Samples__Y_ FaultManager.FuelPresLow_Fault.Action_1 FaultManager.FuelPresLow_Fault.Action_1_Condition FaultManager.FuelPresLow_Fault.Action_2 FaultManager.FuelPresLow_Fault.Action_2_Condition FaultManager.FuelPresLow_Fault.Action_3 FaultManager.FuelPresLow_Fault.Action_3_Condition FaultManager.FuelPresLow_Fault.Action_4 FaultManager.FuelPresLow_Fault.Action_4_Condition FaultManager.FuelPresRangeHigh.Mode FaultManager.FuelPresRangeHigh.ID FaultManager.FuelPresRangeHigh.Test FaultManager.FuelPresRangeHigh.Faulty_Samples__X_ FaultManager.FuelPresRangeHigh.Total_Samples__Y_ FaultManager.FuelPresRangeHigh.Action_1 FaultManager.FuelPresRangeHigh.Action_1_Condition FaultManager.FuelPresRangeHigh.Action_2 FaultManager.FuelPresRangeHigh.Action_2_Condition FaultManager.FuelPresRangeHigh.Action_3 FaultManager.FuelPresRangeHigh.Action_3_Condition FaultManager.FuelPresRangeHigh.Action_4 FaultManager.FuelPresRangeHigh.Action_4_Condition FaultManager.FuelPresRangeLow.Mode FaultManager.FuelPresRangeLow.ID FaultManager.FuelPresRangeLow.Test FaultManager.FuelPresRangeLow.Faulty_Samples__X_ FaultManager.FuelPresRangeLow.Total_Samples__Y_ FaultManager.FuelPresRangeLow.Action_1 FaultManager.FuelPresRangeLow.Action_1_Condition FaultManager.FuelPresRangeLow.Action_2 FaultManager.FuelPresRangeLow.Action_2_Condition FaultManager.FuelPresRangeLow.Action_3 FaultManager.FuelPresRangeLow.Action_3_Condition FaultManager.FuelPresRangeLow.Action_4 FaultManager.FuelPresRangeLow.Action_4_Condition FaultManager.FuelSensRangeHigh.Mode FaultManager.FuelSensRangeHigh.ID FaultManager.FuelSensRangeHigh.Test FaultManager.FuelSensRangeHigh.Faulty_Samples__X_ FaultManager.FuelSensRangeHigh.Total_Samples__Y_ FaultManager.FuelSensRangeHigh.Action_1 FaultManager.FuelSensRangeHigh.Action_1_Condition FaultManager.FuelSensRangeHigh.Action_2 FaultManager.FuelSensRangeHigh.Action_2_Condition FaultManager.FuelSensRangeHigh.Action_3 FaultManager.FuelSensRangeHigh.Action_3_Condition FaultManager.FuelSensRangeHigh.Action_4 FaultManager.FuelSensRangeHigh.Action_4_Condition FaultManager.FuelSensRangeLow.Mode FaultManager.FuelSensRangeLow.ID FaultManager.FuelSensRangeLow.Test FaultManager.FuelSensRangeLow.Faulty_Samples__X_ FaultManager.FuelSensRangeLow.Total_Samples__Y_ FaultManager.FuelSensRangeLow.Action_1 FaultManager.FuelSensRangeLow.Action_1_Condition FaultManager.FuelSensRangeLow.Action_2 FaultManager.FuelSensRangeLow.Action_2_Condition FaultManager.FuelSensRangeLow.Action_3 FaultManager.FuelSensRangeLow.Action_3_Condition FaultManager.FuelSensRangeLow.Action_4 FaultManager.FuelSensRangeLow.Action_4_Condition FaultManager.Fuel_LvlRangeHigh.Mode FaultManager.Fuel_LvlRangeHigh.ID FaultManager.Fuel_LvlRangeHigh.Test FaultManager.Fuel_LvlRangeHigh.Faulty_Samples__X_ FaultManager.Fuel_LvlRangeHigh.Total_Samples__Y_ FaultManager.Fuel_LvlRangeHigh.Action_1 FaultManager.Fuel_LvlRangeHigh.Action_1_Condition FaultManager.Fuel_LvlRangeHigh.Action_2 FaultManager.Fuel_LvlRangeHigh.Action_2_Condition FaultManager.Fuel_LvlRangeHigh.Action_3 FaultManager.Fuel_LvlRangeHigh.Action_3_Condition FaultManager.Fuel_LvlRangeHigh.Action_4 FaultManager.Fuel_LvlRangeHigh.Action_4_Condition FaultManager.Fuel_LvlRangeLow.Mode FaultManager.Fuel_LvlRangeLow.ID FaultManager.Fuel_LvlRangeLow.Test FaultManager.Fuel_LvlRangeLow.Faulty_Samples__X_ FaultManager.Fuel_LvlRangeLow.Total_Samples__Y_ FaultManager.Fuel_LvlRangeLow.Action_1 FaultManager.Fuel_LvlRangeLow.Action_1_Condition FaultManager.Fuel_LvlRangeLow.Action_2 FaultManager.Fuel_LvlRangeLow.Action_2_Condition FaultManager.Fuel_LvlRangeLow.Action_3 FaultManager.Fuel_LvlRangeLow.Action_3_Condition FaultManager.Fuel_LvlRangeLow.Action_4 FaultManager.Fuel_LvlRangeLow.Action_4_Condition FaultManager.GPS_DateTime_Timeout.Mode FaultManager.GPS_DateTime_Timeout.ID FaultManager.GPS_DateTime_Timeout.Test FaultManager.GPS_DateTime_Timeout.Faulty_Samples__X_ FaultManager.GPS_DateTime_Timeout.Total_Samples__Y_ FaultManager.GPS_DateTime_Timeout.Action_1 FaultManager.GPS_DateTime_Timeout.Action_1_Condition FaultManager.GPS_DateTime_Timeout.Action_2 FaultManager.GPS_DateTime_Timeout.Action_2_Condition FaultManager.GPS_DateTime_Timeout.Action_3 FaultManager.GPS_DateTime_Timeout.Action_3_Condition FaultManager.GPS_DateTime_Timeout.Action_4 FaultManager.GPS_DateTime_Timeout.Action_4_Condition FaultManager.GPS_LatLong_Timeout.Mode FaultManager.GPS_LatLong_Timeout.ID FaultManager.GPS_LatLong_Timeout.Test FaultManager.GPS_LatLong_Timeout.Faulty_Samples__X_ FaultManager.GPS_LatLong_Timeout.Total_Samples__Y_ FaultManager.GPS_LatLong_Timeout.Action_1 FaultManager.GPS_LatLong_Timeout.Action_1_Condition FaultManager.GPS_LatLong_Timeout.Action_2 FaultManager.GPS_LatLong_Timeout.Action_2_Condition FaultManager.GPS_LatLong_Timeout.Action_3 FaultManager.GPS_LatLong_Timeout.Action_3_Condition FaultManager.GPS_LatLong_Timeout.Action_4 FaultManager.GPS_LatLong_Timeout.Action_4_Condition FaultManager.GPS_SpeedDir_Timeout.Mode FaultManager.GPS_SpeedDir_Timeout.ID FaultManager.GPS_SpeedDir_Timeout.Test FaultManager.GPS_SpeedDir_Timeout.Faulty_Samples__X_ FaultManager.GPS_SpeedDir_Timeout.Total_Samples__Y_ FaultManager.GPS_SpeedDir_Timeout.Action_1 FaultManager.GPS_SpeedDir_Timeout.Action_1_Condition FaultManager.GPS_SpeedDir_Timeout.Action_2 FaultManager.GPS_SpeedDir_Timeout.Action_2_Condition FaultManager.GPS_SpeedDir_Timeout.Action_3 FaultManager.GPS_SpeedDir_Timeout.Action_3_Condition FaultManager.GPS_SpeedDir_Timeout.Action_4 FaultManager.GPS_SpeedDir_Timeout.Action_4_Condition FaultManager.HardOverspeed.Mode FaultManager.HardOverspeed.ID FaultManager.HardOverspeed.Test FaultManager.HardOverspeed.Faulty_Samples__X_ FaultManager.HardOverspeed.Total_Samples__Y_ FaultManager.HardOverspeed.Action_1 FaultManager.HardOverspeed.Action_1_Condition FaultManager.HardOverspeed.Action_2 FaultManager.HardOverspeed.Action_2_Condition FaultManager.HardOverspeed.Action_3 FaultManager.HardOverspeed.Action_3_Condition FaultManager.HardOverspeed.Action_4 FaultManager.HardOverspeed.Action_4_Condition FaultManager.IATRangeHigh.Mode FaultManager.IATRangeHigh.ID FaultManager.IATRangeHigh.Test FaultManager.IATRangeHigh.Faulty_Samples__X_ FaultManager.IATRangeHigh.Total_Samples__Y_ FaultManager.IATRangeHigh.Action_1 FaultManager.IATRangeHigh.Action_1_Condition FaultManager.IATRangeHigh.Action_2 FaultManager.IATRangeHigh.Action_2_Condition FaultManager.IATRangeHigh.Action_3 FaultManager.IATRangeHigh.Action_3_Condition FaultManager.IATRangeHigh.Action_4 FaultManager.IATRangeHigh.Action_4_Condition FaultManager.IATRangeLow.Mode FaultManager.IATRangeLow.ID FaultManager.IATRangeLow.Test FaultManager.IATRangeLow.Faulty_Samples__X_ FaultManager.IATRangeLow.Total_Samples__Y_ FaultManager.IATRangeLow.Action_1 FaultManager.IATRangeLow.Action_1_Condition FaultManager.IATRangeLow.Action_2 FaultManager.IATRangeLow.Action_2_Condition FaultManager.IATRangeLow.Action_3 FaultManager.IATRangeLow.Action_3_Condition FaultManager.IATRangeLow.Action_4 FaultManager.IATRangeLow.Action_4_Condition FaultManager.Inj1Open.Mode FaultManager.Inj1Open.ID FaultManager.Inj1Open.Test FaultManager.Inj1Open.Faulty_Samples__X_ FaultManager.Inj1Open.Total_Samples__Y_ FaultManager.Inj1Open.Action_1 FaultManager.Inj1Open.Action_1_Condition FaultManager.Inj1Open.Action_2 FaultManager.Inj1Open.Action_2_Condition FaultManager.Inj1Open.Action_3 FaultManager.Inj1Open.Action_3_Condition FaultManager.Inj1Open.Action_4 FaultManager.Inj1Open.Action_4_Condition FaultManager.Inj2Open.Mode FaultManager.Inj2Open.ID FaultManager.Inj2Open.Test FaultManager.Inj2Open.Faulty_Samples__X_ FaultManager.Inj2Open.Total_Samples__Y_ FaultManager.Inj2Open.Action_1 FaultManager.Inj2Open.Action_1_Condition FaultManager.Inj2Open.Action_2 FaultManager.Inj2Open.Action_2_Condition FaultManager.Inj2Open.Action_3 FaultManager.Inj2Open.Action_3_Condition FaultManager.Inj2Open.Action_4 FaultManager.Inj2Open.Action_4_Condition FaultManager.Inj3Open.Mode FaultManager.Inj3Open.ID FaultManager.Inj3Open.Test FaultManager.Inj3Open.Faulty_Samples__X_ FaultManager.Inj3Open.Total_Samples__Y_ FaultManager.Inj3Open.Action_1 FaultManager.Inj3Open.Action_1_Condition FaultManager.Inj3Open.Action_2 FaultManager.Inj3Open.Action_2_Condition FaultManager.Inj3Open.Action_3 FaultManager.Inj3Open.Action_3_Condition FaultManager.Inj3Open.Action_4 FaultManager.Inj3Open.Action_4_Condition FaultManager.Inj4Open.Mode FaultManager.Inj4Open.ID FaultManager.Inj4Open.Test FaultManager.Inj4Open.Faulty_Samples__X_ FaultManager.Inj4Open.Total_Samples__Y_ FaultManager.Inj4Open.Action_1 FaultManager.Inj4Open.Action_1_Condition FaultManager.Inj4Open.Action_2 FaultManager.Inj4Open.Action_2_Condition FaultManager.Inj4Open.Action_3 FaultManager.Inj4Open.Action_3_Condition FaultManager.Inj4Open.Action_4 FaultManager.Inj4Open.Action_4_Condition FaultManager.Inj5Open.Mode FaultManager.Inj5Open.ID FaultManager.Inj5Open.Test FaultManager.Inj5Open.Faulty_Samples__X_ FaultManager.Inj5Open.Total_Samples__Y_ FaultManager.Inj5Open.Action_1 FaultManager.Inj5Open.Action_1_Condition FaultManager.Inj5Open.Action_2 FaultManager.Inj5Open.Action_2_Condition FaultManager.Inj5Open.Action_3 FaultManager.Inj5Open.Action_3_Condition FaultManager.Inj5Open.Action_4 FaultManager.Inj5Open.Action_4_Condition FaultManager.Inj6Open.Mode FaultManager.Inj6Open.ID FaultManager.Inj6Open.Test FaultManager.Inj6Open.Faulty_Samples__X_ FaultManager.Inj6Open.Total_Samples__Y_ FaultManager.Inj6Open.Action_1 FaultManager.Inj6Open.Action_1_Condition FaultManager.Inj6Open.Action_2 FaultManager.Inj6Open.Action_2_Condition FaultManager.Inj6Open.Action_3 FaultManager.Inj6Open.Action_3_Condition FaultManager.Inj6Open.Action_4 FaultManager.Inj6Open.Action_4_Condition FaultManager.Inj7Open.Mode FaultManager.Inj7Open.ID FaultManager.Inj7Open.Test FaultManager.Inj7Open.Faulty_Samples__X_ FaultManager.Inj7Open.Total_Samples__Y_ FaultManager.Inj7Open.Action_1 FaultManager.Inj7Open.Action_1_Condition FaultManager.Inj7Open.Action_2 FaultManager.Inj7Open.Action_2_Condition FaultManager.Inj7Open.Action_3 FaultManager.Inj7Open.Action_3_Condition FaultManager.Inj7Open.Action_4 FaultManager.Inj7Open.Action_4_Condition FaultManager.Inj8Open.Mode FaultManager.Inj8Open.ID FaultManager.Inj8Open.Test FaultManager.Inj8Open.Faulty_Samples__X_ FaultManager.Inj8Open.Total_Samples__Y_ FaultManager.Inj8Open.Action_1 FaultManager.Inj8Open.Action_1_Condition FaultManager.Inj8Open.Action_2 FaultManager.Inj8Open.Action_2_Condition FaultManager.Inj8Open.Action_3 FaultManager.Inj8Open.Action_3_Condition FaultManager.Inj8Open.Action_4 FaultManager.Inj8Open.Action_4_Condition FaultManager.Lambda1Error_Fault.Mode FaultManager.Lambda1Error_Fault.ID FaultManager.Lambda1Error_Fault.Test FaultManager.Lambda1Error_Fault.Faulty_Samples__X_ FaultManager.Lambda1Error_Fault.Total_Samples__Y_ FaultManager.Lambda1Error_Fault.Action_1 FaultManager.Lambda1Error_Fault.Action_1_Condition FaultManager.Lambda1Error_Fault.Action_2 FaultManager.Lambda1Error_Fault.Action_2_Condition FaultManager.Lambda1Error_Fault.Action_3 FaultManager.Lambda1Error_Fault.Action_3_Condition FaultManager.Lambda1Error_Fault.Action_4 FaultManager.Lambda1Error_Fault.Action_4_Condition FaultManager.Lambda1Fault_Fault.Mode FaultManager.Lambda1Fault_Fault.ID FaultManager.Lambda1Fault_Fault.Test FaultManager.Lambda1Fault_Fault.Faulty_Samples__X_ FaultManager.Lambda1Fault_Fault.Total_Samples__Y_ FaultManager.Lambda1Fault_Fault.Action_1 FaultManager.Lambda1Fault_Fault.Action_1_Condition FaultManager.Lambda1Fault_Fault.Action_2 FaultManager.Lambda1Fault_Fault.Action_2_Condition FaultManager.Lambda1Fault_Fault.Action_3 FaultManager.Lambda1Fault_Fault.Action_3_Condition FaultManager.Lambda1Fault_Fault.Action_4 FaultManager.Lambda1Fault_Fault.Action_4_Condition FaultManager.Lambda1HtrOpen_Fault.Mode FaultManager.Lambda1HtrOpen_Fault.ID FaultManager.Lambda1HtrOpen_Fault.Test FaultManager.Lambda1HtrOpen_Fault.Faulty_Samples__X_ FaultManager.Lambda1HtrOpen_Fault.Total_Samples__Y_ FaultManager.Lambda1HtrOpen_Fault.Action_1 FaultManager.Lambda1HtrOpen_Fault.Action_1_Condition FaultManager.Lambda1HtrOpen_Fault.Action_2 FaultManager.Lambda1HtrOpen_Fault.Action_2_Condition FaultManager.Lambda1HtrOpen_Fault.Action_3 FaultManager.Lambda1HtrOpen_Fault.Action_3_Condition FaultManager.Lambda1HtrOpen_Fault.Action_4 FaultManager.Lambda1HtrOpen_Fault.Action_4_Condition FaultManager.Lambda1HtrShort_Fault.Mode FaultManager.Lambda1HtrShort_Fault.ID FaultManager.Lambda1HtrShort_Fault.Test FaultManager.Lambda1HtrShort_Fault.Faulty_Samples__X_ FaultManager.Lambda1HtrShort_Fault.Total_Samples__Y_ FaultManager.Lambda1HtrShort_Fault.Action_1 FaultManager.Lambda1HtrShort_Fault.Action_1_Condition FaultManager.Lambda1HtrShort_Fault.Action_2 FaultManager.Lambda1HtrShort_Fault.Action_2_Condition FaultManager.Lambda1HtrShort_Fault.Action_3 FaultManager.Lambda1HtrShort_Fault.Action_3_Condition FaultManager.Lambda1HtrShort_Fault.Action_4 FaultManager.Lambda1HtrShort_Fault.Action_4_Condition FaultManager.Lambda1Overcool_Fault.Mode FaultManager.Lambda1Overcool_Fault.ID FaultManager.Lambda1Overcool_Fault.Test FaultManager.Lambda1Overcool_Fault.Faulty_Samples__X_ FaultManager.Lambda1Overcool_Fault.Total_Samples__Y_ FaultManager.Lambda1Overcool_Fault.Action_1 FaultManager.Lambda1Overcool_Fault.Action_1_Condition FaultManager.Lambda1Overcool_Fault.Action_2 FaultManager.Lambda1Overcool_Fault.Action_2_Condition FaultManager.Lambda1Overcool_Fault.Action_3 FaultManager.Lambda1Overcool_Fault.Action_3_Condition FaultManager.Lambda1Overcool_Fault.Action_4 FaultManager.Lambda1Overcool_Fault.Action_4_Condition FaultManager.Lambda1Overheat_Fault.Mode FaultManager.Lambda1Overheat_Fault.ID FaultManager.Lambda1Overheat_Fault.Test FaultManager.Lambda1Overheat_Fault.Faulty_Samples__X_ FaultManager.Lambda1Overheat_Fault.Total_Samples__Y_ FaultManager.Lambda1Overheat_Fault.Action_1 FaultManager.Lambda1Overheat_Fault.Action_1_Condition FaultManager.Lambda1Overheat_Fault.Action_2 FaultManager.Lambda1Overheat_Fault.Action_2_Condition FaultManager.Lambda1Overheat_Fault.Action_3 FaultManager.Lambda1Overheat_Fault.Action_3_Condition FaultManager.Lambda1Overheat_Fault.Action_4 FaultManager.Lambda1Overheat_Fault.Action_4_Condition FaultManager.Lambda1StuckInReset_Fault.Mode FaultManager.Lambda1StuckInReset_Fault.ID FaultManager.Lambda1StuckInReset_Fault.Test FaultManager.Lambda1StuckInReset_Fault.Faulty_Samples__X_ FaultManager.Lambda1StuckInReset_Fault.Total_Samples__Y_ FaultManager.Lambda1StuckInReset_Fault.Action_1 FaultManager.Lambda1StuckInReset_Fault.Action_1_Condition FaultManager.Lambda1StuckInReset_Fault.Action_2 FaultManager.Lambda1StuckInReset_Fault.Action_2_Condition FaultManager.Lambda1StuckInReset_Fault.Action_3 FaultManager.Lambda1StuckInReset_Fault.Action_3_Condition FaultManager.Lambda1StuckInReset_Fault.Action_4 FaultManager.Lambda1StuckInReset_Fault.Action_4_Condition FaultManager.Lambda1StuckInWarmup_Fault.Mode FaultManager.Lambda1StuckInWarmup_Fault.ID FaultManager.Lambda1StuckInWarmup_Fault.Test FaultManager.Lambda1StuckInWarmup_Fault.Faulty_Samples__X_ FaultManager.Lambda1StuckInWarmup_Fault.Total_Samples__Y_ FaultManager.Lambda1StuckInWarmup_Fault.Action_1 FaultManager.Lambda1StuckInWarmup_Fault.Action_1_Condition FaultManager.Lambda1StuckInWarmup_Fault.Action_2 FaultManager.Lambda1StuckInWarmup_Fault.Action_2_Condition FaultManager.Lambda1StuckInWarmup_Fault.Action_3 FaultManager.Lambda1StuckInWarmup_Fault.Action_3_Condition FaultManager.Lambda1StuckInWarmup_Fault.Action_4 FaultManager.Lambda1StuckInWarmup_Fault.Action_4_Condition FaultManager.Lambda1VoltHigh_Fault.Mode FaultManager.Lambda1VoltHigh_Fault.ID FaultManager.Lambda1VoltHigh_Fault.Test FaultManager.Lambda1VoltHigh_Fault.Faulty_Samples__X_ FaultManager.Lambda1VoltHigh_Fault.Total_Samples__Y_ FaultManager.Lambda1VoltHigh_Fault.Action_1 FaultManager.Lambda1VoltHigh_Fault.Action_1_Condition FaultManager.Lambda1VoltHigh_Fault.Action_2 FaultManager.Lambda1VoltHigh_Fault.Action_2_Condition FaultManager.Lambda1VoltHigh_Fault.Action_3 FaultManager.Lambda1VoltHigh_Fault.Action_3_Condition FaultManager.Lambda1VoltHigh_Fault.Action_4 FaultManager.Lambda1VoltHigh_Fault.Action_4_Condition FaultManager.Lambda1VoltLow_Fault.Mode FaultManager.Lambda1VoltLow_Fault.ID FaultManager.Lambda1VoltLow_Fault.Test FaultManager.Lambda1VoltLow_Fault.Faulty_Samples__X_ FaultManager.Lambda1VoltLow_Fault.Total_Samples__Y_ FaultManager.Lambda1VoltLow_Fault.Action_1 FaultManager.Lambda1VoltLow_Fault.Action_1_Condition FaultManager.Lambda1VoltLow_Fault.Action_2 FaultManager.Lambda1VoltLow_Fault.Action_2_Condition FaultManager.Lambda1VoltLow_Fault.Action_3 FaultManager.Lambda1VoltLow_Fault.Action_3_Condition FaultManager.Lambda1VoltLow_Fault.Action_4 FaultManager.Lambda1VoltLow_Fault.Action_4_Condition FaultManager.Lambda2Error_Fault.Mode FaultManager.Lambda2Error_Fault.ID FaultManager.Lambda2Error_Fault.Test FaultManager.Lambda2Error_Fault.Faulty_Samples__X_ FaultManager.Lambda2Error_Fault.Total_Samples__Y_ FaultManager.Lambda2Error_Fault.Action_1 FaultManager.Lambda2Error_Fault.Action_1_Condition FaultManager.Lambda2Error_Fault.Action_2 FaultManager.Lambda2Error_Fault.Action_2_Condition FaultManager.Lambda2Error_Fault.Action_3 FaultManager.Lambda2Error_Fault.Action_3_Condition FaultManager.Lambda2Error_Fault.Action_4 FaultManager.Lambda2Error_Fault.Action_4_Condition FaultManager.Lambda2Fault_Fault.Mode FaultManager.Lambda2Fault_Fault.ID FaultManager.Lambda2Fault_Fault.Test FaultManager.Lambda2Fault_Fault.Faulty_Samples__X_ FaultManager.Lambda2Fault_Fault.Total_Samples__Y_ FaultManager.Lambda2Fault_Fault.Action_1 FaultManager.Lambda2Fault_Fault.Action_1_Condition FaultManager.Lambda2Fault_Fault.Action_2 FaultManager.Lambda2Fault_Fault.Action_2_Condition FaultManager.Lambda2Fault_Fault.Action_3 FaultManager.Lambda2Fault_Fault.Action_3_Condition FaultManager.Lambda2Fault_Fault.Action_4 FaultManager.Lambda2Fault_Fault.Action_4_Condition FaultManager.Lambda2HtrOpen_Fault.Mode FaultManager.Lambda2HtrOpen_Fault.ID FaultManager.Lambda2HtrOpen_Fault.Test FaultManager.Lambda2HtrOpen_Fault.Faulty_Samples__X_ FaultManager.Lambda2HtrOpen_Fault.Total_Samples__Y_ FaultManager.Lambda2HtrOpen_Fault.Action_1 FaultManager.Lambda2HtrOpen_Fault.Action_1_Condition FaultManager.Lambda2HtrOpen_Fault.Action_2 FaultManager.Lambda2HtrOpen_Fault.Action_2_Condition FaultManager.Lambda2HtrOpen_Fault.Action_3 FaultManager.Lambda2HtrOpen_Fault.Action_3_Condition FaultManager.Lambda2HtrOpen_Fault.Action_4 FaultManager.Lambda2HtrOpen_Fault.Action_4_Condition FaultManager.Lambda2HtrShort_Fault.Mode FaultManager.Lambda2HtrShort_Fault.ID FaultManager.Lambda2HtrShort_Fault.Test FaultManager.Lambda2HtrShort_Fault.Faulty_Samples__X_ FaultManager.Lambda2HtrShort_Fault.Total_Samples__Y_ FaultManager.Lambda2HtrShort_Fault.Action_1 FaultManager.Lambda2HtrShort_Fault.Action_1_Condition FaultManager.Lambda2HtrShort_Fault.Action_2 FaultManager.Lambda2HtrShort_Fault.Action_2_Condition FaultManager.Lambda2HtrShort_Fault.Action_3 FaultManager.Lambda2HtrShort_Fault.Action_3_Condition FaultManager.Lambda2HtrShort_Fault.Action_4 FaultManager.Lambda2HtrShort_Fault.Action_4_Condition FaultManager.Lambda2Overcool_Fault.Mode FaultManager.Lambda2Overcool_Fault.ID FaultManager.Lambda2Overcool_Fault.Test FaultManager.Lambda2Overcool_Fault.Faulty_Samples__X_ FaultManager.Lambda2Overcool_Fault.Total_Samples__Y_ FaultManager.Lambda2Overcool_Fault.Action_1 FaultManager.Lambda2Overcool_Fault.Action_1_Condition FaultManager.Lambda2Overcool_Fault.Action_2 FaultManager.Lambda2Overcool_Fault.Action_2_Condition FaultManager.Lambda2Overcool_Fault.Action_3 FaultManager.Lambda2Overcool_Fault.Action_3_Condition FaultManager.Lambda2Overcool_Fault.Action_4 FaultManager.Lambda2Overcool_Fault.Action_4_Condition FaultManager.Lambda2Overheat_Fault.Mode FaultManager.Lambda2Overheat_Fault.ID FaultManager.Lambda2Overheat_Fault.Test FaultManager.Lambda2Overheat_Fault.Faulty_Samples__X_ FaultManager.Lambda2Overheat_Fault.Total_Samples__Y_ FaultManager.Lambda2Overheat_Fault.Action_1 FaultManager.Lambda2Overheat_Fault.Action_1_Condition FaultManager.Lambda2Overheat_Fault.Action_2 FaultManager.Lambda2Overheat_Fault.Action_2_Condition FaultManager.Lambda2Overheat_Fault.Action_3 FaultManager.Lambda2Overheat_Fault.Action_3_Condition FaultManager.Lambda2Overheat_Fault.Action_4 FaultManager.Lambda2Overheat_Fault.Action_4_Condition FaultManager.Lambda2StuckInReset_Fault.Mode FaultManager.Lambda2StuckInReset_Fault.ID FaultManager.Lambda2StuckInReset_Fault.Test FaultManager.Lambda2StuckInReset_Fault.Faulty_Samples__X_ FaultManager.Lambda2StuckInReset_Fault.Total_Samples__Y_ FaultManager.Lambda2StuckInReset_Fault.Action_1 /end DEF_CHARACTERISTIC
/end FUNCTION
/end MODULE
/end PROJECT
