ASAP2_VERSION 1 51
/begin PROJECT Project ""
/begin MODULE BaseEngin_034 ""
/begin MOD_COMMON /* MOD_COMMON Comment */ "" BYTE_ORDER MSB_FIRST ALIGNMENT_BYTE 1 ALIGNMENT_FLOAT32_IEEE 1 ALIGNMENT_FLOAT64_IEEE 1 ALIGNMENT_LONG 1 ALIGNMENT_WORD 1 /end MOD_COMMON
/begin CHARACTERISTIC AC_new "Override actuator, in engineering units" VALUE 0x80000023 RecordLayout_2 0 CompuMethod_6 0 1 /end CHARACTERISTIC
/begin CHARACTERISTIC AC_ovr "" VALUE 0x80000024 RecordLayout_2 0 CompuMethod_7 0 1 /end CHARACTERISTIC
/begin CHARACTERISTIC AC_Polarity "Inverts the output of the actuator relative to the desired command - 0 = High True    1 = Low True" VALUE 0x80000025 RecordLayout_2 0 CompuMethod_6 0 1 /end CHARACTERISTIC
/begin CHARACTERISTIC FaultManager.Lambda2HtrOpen_Fault.Action_3_Condition "Fault manager configuration.  Select up to 4 actions for each fault." VALUE 0x8000325F RecordLayout_3 0 CompuMethod_108 0 65535 /end CHARACTERISTIC
/begin CHARACTERISTIC FaultManager.Lambda2HtrOpen_Fault.Action_4 "Fault manager configuration.  Select up to 4 actions for each fault." VALUE 0x80003261 RecordLayout_3 0 CompuMethod_107 0 65535 /end CHARACTERISTIC
/begin CHARACTERISTIC FaultManager.Lambda2HtrOpen_Fault.Action_4_Condition "Fault manager configuration.  Select up to 4 actions for each fault." VALUE 0x80003263 RecordLayout_3 0 CompuMethod_108 0 65535 /end CHARACTERISTIC
/begin CHARACTERISTIC FaultManager.Lambda2HtrShort_Fault.Mode "Fault manager configuration.  Select up to 4 actions for each fault." VALUE 0x80003265 RecordLayout_3 0 CompuMethod_105 0 65535 /end CHARACTERISTIC
/begin CHARACTERISTIC FaultManager.Lambda2HtrShort_Fault.ID "Fault manager configuration.  Select up to 4 actions for each fault." VALUE 0x80003267 RecordLayout_3 0 CompuMethod_1 0 65535 /end CHARACTERISTIC
/begin CHARACTERISTIC FaultManager.Lambda2HtrShort_Fault.Test "Fault manager configuration.  Select up to 4 actions for each fault." VALUE 0x80003269 RecordLayout_3 0 CompuMethod_106 0 65535 /end CHARACTERISTIC
/begin CHARACTERISTIC FaultManager.Lambda2HtrShort_Fault.Faulty_Samples__X_ "Fault manager configuration.  Select up to 4 actions for each fault." VALUE 0x8000326B RecordLayout_3 0 CompuMethod_1 0 65535 /end CHARACTERISTIC
/begin CHARACTERISTIC FaultManager.Lambda2HtrShort_Fault.Total_Samples__Y_ "Fault manager configuration.  Select up to 4 actions for each fault." VALUE 0x8000326D RecordLayout_3 0 CompuMethod_1 0 65535 /end CHARACTERISTIC
/begin CHARACTERISTIC FaultManager.Lambda2HtrShort_Fault.Action_1 "Fault manager configuration.  Select up to 4 actions for each fault." VALUE 0x8000326F RecordLayout_3 0 CompuMethod_107 0 65535 /end CHARACTERISTIC
/begin CHARACTERISTIC FaultManager.Lambda2HtrShort_Fault.Action_1_Condition "Fault manager configuration.  Select up to 4 actions for each fault." VALUE 0x80003271 RecordLayout_3 0 CompuMethod_108 0 65535 /end CHARACTERISTIC
/begin CHARACTERISTIC FaultManager.Lambda2HtrShort_Fault.Action_2 "Fault manager configuration.  Select up to 4 actions for each fault." VALUE 0x80003273 RecordLayout_3 0 CompuMethod_107 0 65535 /end CHARACTERISTIC
/begin CHARACTERISTIC FaultManager.Lambda2HtrShort_Fault.Action_2_Condition "Fault manager configuration.  Select up to 4 actions for each fault." VALUE 0x80003275 RecordLayout_3 0 CompuMethod_108 0 65535 /end CHARACTERISTIC
/begin CHARACTERISTIC FaultManager.Lambda2HtrShort_Fault.Action_3 "Fault manager configuration.  Select up to 4 actions for each fault." VALUE 0x80003277 RecordLayout_3 0 CompuMethod_107 0 65535 /end CHARACTERISTIC
/begin CHARACTERISTIC FaultManager.Lambda2HtrShort_Fault.Action_3_Condition "Fault manager configuration.  Select up to 4 actions for each fault." VALUE 0x80003279 RecordLayout_3 0 CompuMethod_108 0 65535 /end CHARACTERISTIC
/begin CHARACTERISTIC FaultManager.Lambda2HtrShort_Fault.Action_4 "Fault manager configuration.  Select up to 4 actions for each fault." VALUE 0x8000327B RecordLayout_3 0 CompuMethod_107 0 65535 /end CHARACTERISTIC
/begin CHARACTERISTIC FaultManager.Lambda2HtrShort_Fault.Action_4_Condition "Fault manager configuration.  Select up to 4 actions for each fault." VALUE 0x8000327D RecordLayout_3 0 CompuMethod_108 0 65535 /end CHARACTERISTIC
/begin CHARACTERISTIC FaultManager.Lambda2Overcool_Fault.Mode "Fault manager configuration.  Select up to 4 actions for each fault." VALUE 0x8000327F RecordLayout_3 0 CompuMethod_105 0 65535 /end CHARACTERISTIC
/begin CHARACTERISTIC FaultManager.Lambda2Overcool_Fault.ID "Fault manager configuration.  Select up to 4 actions for each fault." VALUE 0x80003281 RecordLayout_3 0 CompuMethod_1 0 65535 /end CHARACTERISTIC
/begin CHARACTERISTIC FaultManager.Lambda2Overcool_Fault.Test "Fault manager configuration.  Select up to 4 actions for each fault." VALUE 0x80003283 RecordLayout_3 0 CompuMethod_106 0 65535 /end CHARACTERISTIC
/begin CHARACTERISTIC FaultManager.Lambda2Overcool_Fault.Faulty_Samples__X_ "Fault manager configuration.  Select up to 4 actions for each fault." VALUE 0x80003285 RecordLayout_3 0 CompuMethod_1 0 65535 /end CHARACTERISTIC
/begin CHARACTERISTIC FaultManager.Lambda2Overcool_Fault.Total_Samples__Y_ "Fault manager configuration.  Select up to 4 actions for each fault." VALUE 0x80003287 RecordLayout_3 0 CompuMethod_1 0 65535 /end CHARACTERISTIC
/begin CHARACTERISTIC FaultManager.Lambda2Overcool_Fault.Action_1 "Fault manager configuration.  Select up to 4 actions for each fault." VALUE 0x80003289 RecordLayout_3 0 CompuMethod_107 0 65535 /end CHARACTERISTIC
/begin CHARACTERISTIC FaultManager.Lambda2Overcool_Fault.Action_1_Condition "Fault manager configuration.  Select up to 4 actions for each fault." VALUE 0x8000328B RecordLayout_3 0 CompuMethod_108 0 65535 /end CHARACTERISTIC
/begin CHARACTERISTIC FaultManager.Lambda2Overcool_Fault.Action_2 "Fault manager configuration.  Select up to 4 actions for each fault." VALUE 0x8000328D RecordLayout_3 0 CompuMethod_107 0 65535 /end CHARACTERISTIC
/begin CHARACTERISTIC FaultManager.Lambda2Overcool_Fault.Action_2_Condition "Fault manager configuration.  Select up to 4 actions for each fault." VALUE 0x8000328F RecordLayout_3 0 CompuMethod_108 0 65535 /end CHARACTERISTIC
/begin CHARACTERISTIC FaultManager.Lambda2Overcool_Fault.Action_3 "Fault manager configuration.  Select up to 4 actions for each fault." VALUE 0x80003291 RecordLayout_3 0 CompuMethod_107 0 65535 /end CHARACTERISTIC
/begin CHARACTERISTIC FaultManager.Lambda2Overcool_Fault.Action_3_Condition "Fault manager configuration.  Select up to 4 actions for each fault." VALUE 0x80003293 RecordLayout_3 0 CompuMethod_108 0 65535 /end CHARACTERISTIC
/begin CHARACTERISTIC FaultManager.Lambda2Overcool_Fault.Action_4 "Fault manager configuration.  Select up to 4 actions for each fault." VALUE 0x80003295 RecordLayout_3 0 CompuMethod_107 0 65535 /end CHARACTERISTIC
/begin CHARACTERISTIC FaultManager.Lambda2Overcool_Fault.Action_4_Condition "Fault manager configuration.  Select up to 4 actions for each fault." VALUE 0x80003297 RecordLayout_3 0 CompuMethod_108 0 65535 /end CHARACTERISTIC
/begin CHARACTERISTIC FaultManager.Lambda2Overheat_Fault.Mode "Fault manager configuration.  Select up to 4 actions for each fault." VALUE 0x80003299 RecordLayout_3 0 CompuMethod_105 0 65535 /end CHARACTERISTIC
/begin CHARACTERISTIC FaultManager.Lambda2Overheat_Fault.ID "Fault manager configuration.  Select up to 4 actions for each fault." VALUE 0x8000329B RecordLayout_3 0 CompuMethod_1 0 65535 /end CHARACTERISTIC
/begin CHARACTERISTIC FaultManager.Lambda2Overheat_Fault.Test "Fault manager configuration.  Select up to 4 actions for each fault." VALUE 0x8000329D RecordLayout_3 0 CompuMethod_106 0 65535 /end CHARACTERISTIC
/begin CHARACTERISTIC FaultManager.Lambda2Overheat_Fault.Faulty_Samples__X_ "Fault manager configuration.  Select up to 4 actions for each fault." VALUE 0x8000329F RecordLayout_3 0 CompuMethod_1 0 65535 /end CHARACTERISTIC
/begin CHARACTERISTIC FaultManager.Lambda2Overheat_Fault.Total_Samples__Y_ "Fault manager configuration.  Select up to 4 actions for each fault." VALUE 0x800032A1 RecordLayout_3 0 CompuMethod_1 0 65535 /end CHARACTERISTIC
/begin CHARACTERISTIC FaultManager.Lambda2Overheat_Fault.Action_1 "Fault manager configuration.  Select up to 4 actions for each fault." VALUE 0x800032A3 RecordLayout_3 0 CompuMethod_107 0 65535 /end CHARACTERISTIC
/begin CHARACTERISTIC FaultManager.Lambda2Overheat_Fault.Action_1_Condition "Fault manager configuration.  Select up to 4 actions for each fault." VALUE 0x800032A5 RecordLayout_3 0 CompuMethod_108 0 65535 /end CHARACTERISTIC
/begin CHARACTERISTIC FaultManager.Lambda2Overheat_Fault.Action_2 "Fault manager configuration.  Select up to 4 actions for each fault." VALUE 0x800032A7 RecordLayout_3 0 CompuMethod_107 0 65535 /end CHARACTERISTIC
/begin CHARACTERISTIC FaultManager.Lambda2Overheat_Fault.Action_2_Condition "Fault manager configuration.  Select up to 4 actions for each fault." VALUE 0x800032A9 RecordLayout_3 0 CompuMethod_108 0 65535 /end CHARACTERISTIC
/begin CHARACTERISTIC FaultManager.Lambda2Overheat_Fault.Action_3 "Fault manager configuration.  Select up to 4 actions for each fault." VALUE 0x800032AB RecordLayout_3 0 CompuMethod_107 0 65535 /end CHARACTERISTIC
/begin CHARACTERISTIC FaultManager.Lambda2Overheat_Fault.Action_3_Condition "Fault manager configuration.  Select up to 4 actions for each fault." VALUE 0x800032AD RecordLayout_3 0 CompuMethod_108 0 65535 /end CHARACTERISTIC
/begin CHARACTERISTIC FaultManager.Lambda2Overheat_Fault.Action_4 "Fault manager configuration.  Select up to 4 actions for each fault." VALUE 0x800032AF RecordLayout_3 0 CompuMethod_107 0 65535 /end CHARACTERISTIC
/begin CHARACTERISTIC FaultManager.Lambda2Overheat_Fault.Action_4_Condition "Fault manager configuration.  Select up to 4 actions for each fault." VALUE 0x800032B1 RecordLayout_3 0 CompuMethod_108 0 65535 /end CHARACTERISTIC
/begin CHARACTERISTIC FaultManager.Lambda2StuckInReset_Fault.Mode "Fault manager configuration.  Select up to 4 actions for each fault." VALUE 0x800032B3 RecordLayout_3 0 CompuMethod_105 0 65535 /end CHARACTERISTIC
/begin CHARACTERISTIC FaultManager.Lambda2StuckInReset_Fault.ID "Fault manager configuration.  Select up to 4 actions for each fault." VALUE 0x800032B5 RecordLayout_3 0 CompuMethod_1 0 65535 /end CHARACTERISTIC
/begin CHARACTERISTIC FaultManager.Lambda2StuckInReset_Fault.Test "Fault manager configuration.  Select up to 4 actions for each fault." VALUE 0x800032B7 RecordLayout_3 0 CompuMethod_106 0 65535 /end CHARACTERISTIC
/begin CHARACTERISTIC FaultManager.Lambda2StuckInReset_Fault.Faulty_Samples__X_ "Fault manager configuration.  Select up to 4 actions for each fault." VALUE 0x800032B9 RecordLayout_3 0 CompuMethod_1 0 65535 /end CHARACTERISTIC
/begin CHARACTERISTIC FaultManager.Lambda2StuckInReset_Fault.Total_Samples__Y_ "Fault manager configuration.  Select up to 4 actions for each fault." VALUE 0x800032BB RecordLayout_3 0 CompuMethod_1 0 65535 /end CHARACTERISTIC
/begin CHARACTERISTIC FaultManager.Lambda2StuckInReset_Fault.Action_1 "Fault manager configuration.  Select up to 4 actions for each fault." VALUE 0x800032BD RecordLayout_3 0 CompuMethod_107 0 65535 /end CHARACTERISTIC
/begin CHARACTERISTIC FaultManager.Lambda2StuckInReset_Fault.Action_1_Condition "Fault manager configuration.  Select up to 4 actions for each fault." VALUE 0x800032BF RecordLayout_3 0 CompuMethod_108 0 65535 /end CHARACTERISTIC
/begin CHARACTERISTIC FaultManager.Lambda2StuckInReset_Fault.Action_2 "Fault manager configuration.  Select up to 4 actions for each fault." VALUE 0x800032C1 RecordLayout_3 0 CompuMethod_107 0 65535 /end CHARACTERISTIC
/begin CHARACTERISTIC FaultManager.Lambda2StuckInReset_Fault.Action_2_Condition "Fault manager configuration.  Select up to 4 actions for each fault." VALUE 0x800032C3 RecordLayout_3 0 CompuMethod_108 0 65535 /end CHARACTERISTIC
/begin CHARACTERISTIC FaultManager.Lambda2StuckInReset_Fault.Action_3 "Fault manager configuration.  Select up to 4 actions for each fault." VALUE 0x800032C5 RecordLayout_3 0 CompuMethod_107 0 65535 /end CHARACTERISTIC
/begin CHARACTERISTIC FaultManager.Lambda2StuckInReset_Fault.Action_3_Condition "Fault manager configuration.  Select up to 4 actions for each fault." VALUE 0x800032C7 RecordLayout_3 0 CompuMethod_108 0 65535 /end CHARACTERISTIC
/begin CHARACTERISTIC FaultManager.Lambda2StuckInReset_Fault.Action_4 "Fault manager configuration.  Select up to 4 actions for each fault." VALUE 0x800032C9 RecordLayout_3 0 CompuMethod_107 0 65535 /end CHARACTERISTIC
/begin CHARACTERISTIC FaultManager.Lambda2StuckInReset_Fault.Action_4_Condition "Fault manager configuration.  Select up to 4 actions for each fault." VALUE 0x800032CB RecordLayout_3 0 CompuMethod_108 0 65535 /end CHARACTERISTIC
/begin CHARACTERISTIC FaultManager.Lambda2StuckInWarmup_Fault.Mode "Fault manager configuration.  Select up to 4 actions for each fault." VALUE 0x800032CD RecordLayout_3 0 CompuMethod_105 0 65535 /end CHARACTERISTIC
/begin CHARACTERISTIC FaultManager.Lambda2StuckInWarmup_Fault.ID "Fault manager configuration.  Select up to 4 actions for each fault." VALUE 0x800032CF RecordLayout_3 0 CompuMethod_1 0 65535 /end CHARACTERISTIC
/begin CHARACTERISTIC FaultManager.Lambda2StuckInWarmup_Fault.Test "Fault manager configuration.  Select up to 4 actions for each fault." VALUE 0x800032D1 RecordLayout_3 0 CompuMethod_106 0 65535 /end CHARACTERISTIC
/begin CHARACTERISTIC FaultManager.Lambda2StuckInWarmup_Fault.Faulty_Samples__X_ "Fault manager configuration.  Select up to 4 actions for each fault." VALUE 0x800032D3 RecordLayout_3 0 CompuMethod_1 0 65535 /end CHARACTERISTIC
/begin CHARACTERISTIC FaultManager.Lambda2StuckInWarmup_Fault.Total_Samples__Y_ "Fault manager configuration.  Select up to 4 actions for each fault." VALUE 0x800032D5 RecordLayout_3 0 CompuMethod_1 0 65535 /end CHARACTERISTIC
/begin CHARACTERISTIC FaultManager.Lambda2StuckInWarmup_Fault.Action_1 "Fault manager configuration.  Select up to 4 actions for each fault." VALUE 0x800032D7 RecordLayout_3 0 CompuMethod_107 0 65535 /end CHARACTERISTIC
/begin CHARACTERISTIC FaultManager.Lambda2StuckInWarmup_Fault.Action_1_Condition "Fault manager configuration.  Select up to 4 actions for each fault." VALUE 0x800032D9 RecordLayout_3 0 CompuMethod_108 0 65535 /end CHARACTERISTIC
/begin CHARACTERISTIC FaultManager.Lambda2StuckInWarmup_Fault.Action_2 "Fault manager configuration.  Select up to 4 actions for each fault." VALUE 0x800032DB RecordLayout_3 0 CompuMethod_107 0 65535 /end CHARACTERISTIC
/begin CHARACTERISTIC FaultManager.Lambda2StuckInWarmup_Fault.Action_2_Condition "Fault manager configuration.  Select up to 4 actions for each fault." VALUE 0x800032DD RecordLayout_3 0 CompuMethod_108 0 65535 /end CHARACTERISTIC
/begin CHARACTERISTIC FaultManager.Lambda2StuckInWarmup_Fault.Action_3 "Fault manager configuration.  Select up to 4 actions for each fault." VALUE 0x800032DF RecordLayout_3 0 CompuMethod_107 0 65535 /end CHARACTERISTIC
/begin CHARACTERISTIC FaultManager.Lambda2StuckInWarmup_Fault.Action_3_Condition "Fault manager configuration.  Select up to 4 actions for each fault." VALUE 0x800032E1 RecordLayout_3 0 CompuMethod_108 0 65535 /end CHARACTERISTIC
/begin CHARACTERISTIC FaultManager.Lambda2StuckInWarmup_Fault.Action_4 "Fault manager configuration.  Select up to 4 actions for each fault." VALUE 0x800032E3 RecordLayout_3 0 CompuMethod_107 0 65535 /end CHARACTERISTIC
/begin CHARACTERISTIC FaultManager.Lambda2StuckInWarmup_Fault.Action_4_Condition "Fault manager configuration.  Select up to 4 actions for each fault." VALUE 0x800032E5 RecordLayout_3 0 CompuMethod_108 0 65535 /end CHARACTERISTIC
/begin CHARACTERISTIC FaultManager.Lambda2VoltHigh_Fault.Mode "Fault manager configuration.  Select up to 4 actions for each fault." VALUE 0x800032E7 RecordLayout_3 0 CompuMethod_105 0 65535 /end CHARACTERISTIC
/begin CHARACTERISTIC FaultManager.Lambda2VoltHigh_Fault.ID "Fault manager configuration.  Select up to 4 actions for each fault." VALUE 0x800032E9 RecordLayout_3 0 CompuMethod_1 0 65535 /end CHARACTERISTIC
/begin CHARACTERISTIC FaultManager.Lambda2VoltHigh_Fault.Test "Fault manager configuration.  Select up to 4 actions for each fault." VALUE 0x800032EB RecordLayout_3 0 CompuMethod_106 0 65535 /end CHARACTERISTIC
/begin CHARACTERISTIC FaultManager.Lambda2VoltHigh_Fault.Faulty_Samples__X_ "Fault manager configuration.  Select up to 4 actions for each fault." VALUE 0x800032ED RecordLayout_3 0 CompuMethod_1 0 65535 /end CHARACTERISTIC
/begin CHARACTERISTIC FaultManager.Lambda2VoltHigh_Fault.Total_Samples__Y_ "Fault manager configuration.  Select up to 4 actions for each fault." VALUE 0x800032EF RecordLayout_3 0 CompuMethod_1 0 65535 /end CHARACTERISTIC
/begin CHARACTERISTIC FaultManager.Lambda2VoltHigh_Fault.Action_1 "Fault manager configuration.  Select up to 4 actions for each fault." VALUE 0x800032F1 RecordLayout_3 0 CompuMethod_107 0 65535 /end CHARACTERISTIC
/begin CHARACTERISTIC FaultManager.Lambda2VoltHigh_Fault.Action_1_Condition "Fault manager configuration.  Select up to 4 actions for each fault." VALUE 0x800032F3 RecordLayout_3 0 CompuMethod_108 0 65535 /end CHARACTERISTIC
/begin CHARACTERISTIC FaultManager.Lambda2VoltHigh_Fault.Action_2 "Fault manager configuration.  Select up to 4 actions for each fault." VALUE 0x800032F5 RecordLayout_3 0 CompuMethod_107 0 65535 /end CHARACTERISTIC
/begin CHARACTERISTIC FaultManager.Lambda2VoltHigh_Fault.Action_2_Condition "Fault manager configuration.  Select up to 4 actions for each fault." VALUE 0x800032F7 RecordLayout_3 0 CompuMethod_108 0 65535 /end CHARACTERISTIC
/begin CHARACTERISTIC FaultManager.Lambda2VoltHigh_Fault.Action_3 "Fault manager configuration.  Select up to 4 actions for each fault." VALUE 0x800032F9 RecordLayout_3 0 CompuMethod_107 0 65535 /end CHARACTERISTIC
/begin CHARACTERISTIC FaultManager.Lambda2VoltHigh_Fault.Action_3_Condition "Fault manager configuration.  Select up to 4 actions for each fault." VALUE 0x800032FB RecordLayout_3 0 CompuMethod_108 0 65535 /end CHARACTERISTIC
/begin CHARACTERISTIC FaultManager.Lambda2VoltHigh_Fault.Action_4 "Fault manager configuration.  Select up to 4 actions for each fault." VALUE 0x800032FD RecordLayout_3 0 CompuMethod_107 0 65535 /end CHARACTERISTIC
/begin CHARACTERISTIC FaultManager.Lambda2VoltHigh_Fault.Action_4_Condition "Fault manager configuration.  Select up to 4 actions for each fault." VALUE 0x800032FF RecordLayout_3 0 CompuMethod_108 0 65535 /end CHARACTERISTIC
/begin CHARACTERISTIC FaultManager.Lambda2VoltLow_Fault.Mode "Fault manager configuration.  Select up to 4 actions for each fault." VALUE 0x80003301 RecordLayout_3 0 CompuMethod_105 0 65535 /end CHARACTERISTIC
/begin CHARACTERISTIC FaultManager.Lambda2VoltLow_Fault.ID "Fault manager configuration.  Select up to 4 actions for each fault." VALUE 0x80003303 RecordLayout_3 0 CompuMethod_1 0 65535 /end CHARACTERISTIC
/begin CHARACTERISTIC FaultManager.Lambda2VoltLow_Fault.Test "Fault manager configuration.  Select up to 4 actions for each fault." VALUE 0x80003305 RecordLayout_3 0 CompuMethod_106 0 65535 /end CHARACTERISTIC
/begin CHARACTERISTIC FaultManager.Lambda2VoltLow_Fault.Faulty_Samples__X_ "Fault manager configuration.  Select up to 4 actions for each fault." VALUE 0x80003307 RecordLayout_3 0 CompuMethod_1 0 65535 /end CHARACTERISTIC
/begin CHARACTERISTIC FaultManager.Lambda2VoltLow_Fault.Total_Samples__Y_ "Fault manager configuration.  Select up to 4 actions for each fault." VALUE 0x80003309 RecordLayout_3 0 CompuMethod_1 0 65535 /end CHARACTERISTIC
/begin CHARACTERISTIC FaultManager.Lambda2VoltLow_Fault.Action_1 "Fault manager configuration.  Select up to 4 actions for each fault." VALUE 0x8000330B RecordLayout_3 0 CompuMethod_107 0 65535 /end CHARACTERISTIC
/begin CHARACTERISTIC FaultManager.Lambda2VoltLow_Fault.Action_1_Condition "Fault manager configuration.  Select up to 4 actions for each fault." VALUE 0x8000330D RecordLayout_3 0 CompuMethod_108 0 65535 /end CHARACTERISTIC
/begin CHARACTERISTIC FaultManager.Lambda2VoltLow_Fault.Action_2 "Fault manager configuration.  Select up to 4 actions for each fault." VALUE 0x8000330F RecordLayout_3 0 CompuMethod_107 0 65535 /end CHARACTERISTIC
/begin CHARACTERISTIC FaultManager.Lambda2VoltLow_Fault.Action_2_Condition "Fault manager configuration.  Select up to 4 actions for each fault." VALUE 0x80003311 RecordLayout_3 0 CompuMethod_108 0 65535 /end CHARACTERISTIC
/begin CHARACTERISTIC FaultManager.Lambda2VoltLow_Fault.Action_3 "Fault manager configuration.  Select up to 4 actions for each fault." VALUE 0x80003313 RecordLayout_3 0 CompuMethod_107 0 65535 /end CHARACTERISTIC
/begin CHARACTERISTIC FaultManager.Lambda2VoltLow_Fault.Action_3_Condition "Fault manager configuration.  Select up to 4 actions for each fault." VALUE 0x80003315 RecordLayout_3 0 CompuMethod_108 0 65535 /end CHARACTERISTIC
/begin CHARACTERISTIC FaultManager.Lambda2VoltLow_Fault.Action_4 "Fault manager configuration.  Select up to 4 actions for each fault." VALUE 0x80003317 RecordLayout_3 0 CompuMethod_107 0 65535 /end CHARACTERISTIC
/begin CHARACTERISTIC FaultManager.Lambda2VoltLow_Fault.Action_4_Condition "Fault manager configuration.  Select up to 4 actions for each fault." VALUE 0x80003319 RecordLayout_3 0 CompuMethod_108 0 65535 /end CHARACTERISTIC
/begin CHARACTERISTIC FaultManager.Lambda_1_Timeout.Mode "Fault manager configuration.  Select up to 4 actions for each fault." VALUE 0x8000331B RecordLayout_3 0 CompuMethod_105 0 65535 /end CHARACTERISTIC
/begin CHARACTERISTIC FaultManager.Lambda_1_Timeout.ID "Fault manager configuration.  Select up to 4 actions for each fault." VALUE 0x8000331D RecordLayout_3 0 CompuMethod_1 0 65535 /end CHARACTERISTIC
/begin CHARACTERISTIC FaultManager.Lambda_1_Timeout.Test "Fault manager configuration.  Select up to 4 actions for each fault." VALUE 0x8000331F RecordLayout_3 0 CompuMethod_106 0 65535 /end CHARACTERISTIC
/begin CHARACTERISTIC FaultManager.Lambda_1_Timeout.Faulty_Samples__X_ "Fault manager configuration.  Select up to 4 actions for each fault." VALUE 0x80003321 RecordLayout_3 0 CompuMethod_1 0 65535 /end CHARACTERISTIC
/begin CHARACTERISTIC FaultManager.Lambda_1_Timeout.Total_Samples__Y_ "Fault manager configuration.  Select up to 4 actions for each fault." VALUE 0x80003323 RecordLayout_3 0 CompuMethod_1 0 65535 /end CHARACTERISTIC
/begin CHARACTERISTIC FaultManager.Lambda_1_Timeout.Action_1 "Fault manager configuration.  Select up to 4 actions for each fault." VALUE 0x80003325 RecordLayout_3 0 CompuMethod_107 0 65535 /end CHARACTERISTIC
/begin CHARACTERISTIC FaultManager.Lambda_1_Timeout.Action_1_Condition "Fault manager configuration.  Select up to 4 actions for each fault." VALUE 0x80003327 RecordLayout_3 0 CompuMethod_108 0 65535 /end CHARACTERISTIC
/begin CHARACTERISTIC FaultManager.Lambda_1_Timeout.Action_2 "Fault manager configuration.  Select up to 4 actions for each fault." VALUE 0x80003329 RecordLayout_3 0 CompuMethod_107 0 65535 /end CHARACTERISTIC
/begin CHARACTERISTIC FaultManager.Lambda_1_Timeout.Action_2_Condition "Fault manager configuration.  Select up to 4 actions for each fault." VALUE 0x8000332B RecordLayout_3 0 CompuMethod_108 0 65535 /end CHARACTERISTIC
/begin CHARACTERISTIC FaultManager.Lambda_1_Timeout.Action_3 "Fault manager configuration.  Select up to 4 actions for each fault." VALUE 0x8000332D RecordLayout_3 0 CompuMethod_107 0 65535 /end CHARACTERISTIC
/begin CHARACTERISTIC FaultManager.Lambda_1_Timeout.Action_3_Condition "Fault manager configuration.  Select up to 4 actions for each fault." VALUE 0x8000332F RecordLayout_3 0 CompuMethod_108 0 65535 /end CHARACTERISTIC
/begin CHARACTERISTIC FaultManager.Lambda_1_Timeout.Action_4 "Fault manager configuration.  Select up to 4 actions for each fault." VALUE 0x80003331 RecordLayout_3 0 CompuMethod_107 0 65535 /end CHARACTERISTIC
/begin CHARACTERISTIC FaultManager.Lambda_1_Timeout.Action_4_Condition "Fault manager configuration.  Select up to 4 actions for each fault." VALUE 0x80003333 RecordLayout_3 0 CompuMethod_108 0 65535 /end CHARACTERISTIC
/begin CHARACTERISTIC FaultManager.Lambda_2_Timeout.Mode "Fault manager configuration.  Select up to 4 actions for each fault." VALUE 0x80003335 RecordLayout_3 0 CompuMethod_105 0 65535 /end CHARACTERISTIC
/begin CHARACTERISTIC FaultManager.Lambda_2_Timeout.ID "Fault manager configuration.  Select up to 4 actions for each fault." VALUE 0x80003337 RecordLayout_3 0 CompuMethod_1 0 65535 /end CHARACTERISTIC
/begin CHARACTERISTIC FaultManager.Lambda_2_Timeout.Test "Fault manager configuration.  Select up to 4 actions for each fault." VALUE 0x80003339 RecordLayout_3 0 CompuMethod_106 0 65535 /end CHARACTERISTIC
/begin CHARACTERISTIC FaultManager.Lambda_2_Timeout.Faulty_Samples__X_ "Fault manager configuration.  Select up to 4 actions for each fault." VALUE 0x8000333B RecordLayout_3 0 CompuMethod_1 0 65535 /end CHARACTERISTIC
/begin CHARACTERISTIC FaultManager.Lambda_2_Timeout.Total_Samples__Y_ "Fault manager configuration.  Select up to 4 actions for each fault." VALUE 0x8000333D RecordLayout_3 0 CompuMethod_1 0 65535 /end CHARACTERISTIC
/begin CHARACTERISTIC FaultManager.Lambda_2_Timeout.Action_1 "Fault manager configuration.  Select up to 4 actions for each fault." VALUE 0x8000333F RecordLayout_3 0 CompuMethod_107 0 65535 /end CHARACTERISTIC
/begin CHARACTERISTIC FaultManager.Lambda_2_Timeout.Action_1_Condition "Fault manager configuration.  Select up to 4 actions for each fault." VALUE 0x80003341 RecordLayout_3 0 CompuMethod_108 0 65535 /end CHARACTERISTIC
/begin CHARACTERISTIC FaultManager.Lambda_2_Timeout.Action_2 "Fault manager configuration.  Select up to 4 actions for each fault." VALUE 0x80003343 RecordLayout_3 0 CompuMethod_107 0 65535 /end CHARACTERISTIC
/begin CHARACTERISTIC FaultManager.Lambda_2_Timeout.Action_2_Condition "Fault manager configuration.  Select up to 4 actions for each fault." VALUE 0x80003345 RecordLayout_3 0 CompuMethod_108 0 65535 /end CHARACTERISTIC
/begin CHARACTERISTIC FaultManager.Lambda_2_Timeout.Action_3 "Fault manager configuration.  Select up to 4 actions for each fault." VALUE 0x80003347 RecordLayout_3 0 CompuMethod_107 0 65535 /end CHARACTERISTIC
/begin CHARACTERISTIC FaultManager.Lambda_2_Timeout.Action_3_Condition "Fault manager configuration.  Select up to 4 actions for each fault." VALUE 0x80003349 RecordLayout_3 0 CompuMethod_108 0 65535 /end CHARACTERISTIC
/begin CHARACTERISTIC FaultManager.Lambda_2_Timeout.Action_4 "Fault manager configuration.  Select up to 4 actions for each fault." VALUE 0x8000334B RecordLayout_3 0 CompuMethod_107 0 65535 /end CHARACTERISTIC
/begin CHARACTERISTIC FaultManager.Lambda_2_Timeout.Action_4_Condition "Fault manager configuration.  Select up to 4 actions for each fault." VALUE 0x8000334D RecordLayout_3 0 CompuMethod_108 0 65535 /end CHARACTERISTIC
/begin CHARACTERISTIC FaultManager.Lambda_Bank2Bank_Fault.Mode "Fault manager configuration.  Select up to 4 actions for each fault." VALUE 0x8000334F RecordLayout_3 0 CompuMethod_105 0 65535 /end CHARACTERISTIC
/begin CHARACTERISTIC FaultManager.Lambda_Bank2Bank_Fault.ID "Fault manager configuration.  Select up to 4 actions for each fault." VALUE 0x80003351 RecordLayout_3 0 CompuMethod_1 0 65535 /end CHARACTERISTIC
/begin CHARACTERISTIC FaultManager.Lambda_Bank2Bank_Fault.Test "Fault manager configuration.  Select up to 4 actions for each fault." VALUE 0x80003353 RecordLayout_3 0 CompuMethod_106 0 65535 /end CHARACTERISTIC
/begin CHARACTERISTIC FaultManager.Lambda_Bank2Bank_Fault.Faulty_Samples__X_ "Fault manager configuration.  Select up to 4 actions for each fault." VALUE 0x80003355 RecordLayout_3 0 CompuMethod_1 0 65535 /end CHARACTERISTIC
/begin CHARACTERISTIC FaultManager.Lambda_Bank2Bank_Fault.Total_Samples__Y_ "Fault manager configuration.  Select up to 4 actions for each fault." VALUE 0x80003357 RecordLayout_3 0 CompuMethod_1 0 65535 /end CHARACTERISTIC
/begin CHARACTERISTIC FaultManager.Lambda_Bank2Bank_Fault.Action_1 "Fault manager configuration.  Select up to 4 actions for each fault." VALUE 0x80003359 RecordLayout_3 0 CompuMethod_107 0 65535 /end CHARACTERISTIC
/begin CHARACTERISTIC FaultManager.Lambda_Bank2Bank_Fault.Action_1_Condition "Fault manager configuration.  Select up to 4 actions for each fault." VALUE 0x8000335B RecordLayout_3 0 CompuMethod_108 0 65535 /end CHARACTERISTIC
/begin CHARACTERISTIC FaultManager.Lambda_Bank2Bank_Fault.Action_2 "Fault manager configuration.  Select up to 4 actions for each fault." VALUE 0x8000335D RecordLayout_3 0 CompuMethod_107 0 65535 /end CHARACTERISTIC
/begin CHARACTERISTIC FaultManager.Lambda_Bank2Bank_Fault.Action_2_Condition "Fault manager configuration.  Select up to 4 actions for each fault." VALUE 0x8000335F RecordLayout_3 0 CompuMethod_108 0 65535 /end CHARACTERISTIC
/begin CHARACTERISTIC FaultManager.Lambda_Bank2Bank_Fault.Action_3 "Fault manager configuration.  Select up to 4 actions for each fault." VALUE 0x80003361 RecordLayout_3 0 CompuMethod_107 0 65535 /end CHARACTERISTIC
/begin CHARACTERISTIC FaultManager.Lambda_Bank2Bank_Fault.Action_3_Condition "Fault manager configuration.  Select up to 4 actions for each fault." VALUE 0x80003363 RecordLayout_3 0 CompuMethod_108 0 65535 /end CHARACTERISTIC
/begin CHARACTERISTIC FaultManager.Lambda_Bank2Bank_Fault.Action_4 "Fault manager configuration.  Select up to 4 actions for each fault." VALUE 0x80003365 RecordLayout_3 0 CompuMethod_107 0 65535 /end CHARACTERISTIC
/begin CHARACTERISTIC FaultManager.Lambda_Bank2Bank_Fault.Action_4_Condition "Fault manager configuration.  Select up to 4 actions for each fault." VALUE 0x80003367 RecordLayout_3 0 CompuMethod_108 0 65535 /end CHARACTERISTIC
/begin CHARACTERISTIC FaultManager.LeanProtect_Fault.Mode "Fault manager configuration.  Select up to 4 actions for each fault." VALUE 0x80003369 RecordLayout_3 0 CompuMethod_105 0 65535 /end CHARACTERISTIC
/begin CHARACTERISTIC FaultManager.LeanProtect_Fault.ID "Fault manager configuration.  Select up to 4 actions for each fault." VALUE 0x8000336B RecordLayout_3 0 CompuMethod_1 0 65535 /end CHARACTERISTIC
/begin CHARACTERISTIC FaultManager.LeanProtect_Fault.Test "Fault manager configuration.  Select up to 4 actions for each fault." VALUE 0x8000336D RecordLayout_3 0 CompuMethod_106 0 65535 /end CHARACTERISTIC
/begin CHARACTERISTIC FaultManager.LeanProtect_Fault.Faulty_Samples__X_ "Fault manager configuration.  Select up to 4 actions for each fault." VALUE 0x8000336F RecordLayout_3 0 CompuMethod_1 0 65535 /end CHARACTERISTIC
/begin CHARACTERISTIC FaultManager.LeanProtect_Fault.Total_Samples__Y_ "Fault manager configuration.  Select up to 4 actions for each fault." VALUE 0x80003371 RecordLayout_3 0 CompuMethod_1 0 65535 /end CHARACTERISTIC
/begin CHARACTERISTIC FaultManager.LeanProtect_Fault.Action_1 "Fault manager configuration.  Select up to 4 actions for each fault." VALUE 0x80003373 RecordLayout_3 0 CompuMethod_107 0 65535 /end CHARACTERISTIC
/begin CHARACTERISTIC FaultManager.LeanProtect_Fault.Action_1_Condition "Fault manager configuration.  Select up to 4 actions for each fault." VALUE 0x80003375 RecordLayout_3 0 CompuMethod_108 0 65535 /end CHARACTERISTIC
/begin CHARACTERISTIC FaultManager.LeanProtect_Fault.Action_2 "Fault manager configuration.  Select up to 4 actions for each fault." VALUE 0x80003377 RecordLayout_3 0 CompuMethod_107 0 65535 /end CHARACTERISTIC
/begin CHARACTERISTIC FaultManager.LeanProtect_Fault.Action_2_Condition "Fault manager configuration.  Select up to 4 actions for each fault." VALUE 0x80003379 RecordLayout_3 0 CompuMethod_108 0 65535 /end CHARACTERISTIC
/begin CHARACTERISTIC FaultManager.LeanProtect_Fault.Action_3 "Fault manager configuration.  Select up to 4 actions for each fault." VALUE 0x8000337B RecordLayout_3 0 CompuMethod_107 0 65535 /end CHARACTERISTIC
/begin CHARACTERISTIC FaultManager.LeanProtect_Fault.Action_3_Condition "Fault manager configuration.  Select up to 4 actions for each fault." VALUE 0x8000337D RecordLayout_3 0 CompuMethod_108 0 65535 /end CHARACTERISTIC
/begin CHARACTERISTIC FaultManager.LeanProtect_Fault.Action_4 "Fault manager configuration.  Select up to 4 actions for each fault." VALUE 0x8000337F RecordLayout_3 0 CompuMethod_107 0 65535 /end CHARACTERISTIC
/begin CHARACTERISTIC FaultManager.LeanProtect_Fault.Action_4_Condition "Fault manager configuration.  Select up to 4 actions for each fault." VALUE 0x80003381 RecordLayout_3 0 CompuMethod_108 0 65535 /end CHARACTERISTIC
/begin CHARACTERISTIC FaultManager.MAFRangeHigh.Mode "Fault manager configuration.  Select up to 4 actions for each fault." VALUE 0x80003383 RecordLayout_3 0 CompuMethod_105 0 65535 /end CHARACTERISTIC
/begin CHARACTERISTIC FaultManager.MAFRangeHigh.ID "Fault manager configuration.  Select up to 4 actions for each fault." VALUE 0x80003385 RecordLayout_3 0 CompuMethod_1 0 65535 /end CHARACTERISTIC
/begin CHARACTERISTIC FaultManager.MAFRangeHigh.Test "Fault manager configuration.  Select up to 4 actions for each fault." VALUE 0x80003387 RecordLayout_3 0 CompuMethod_106 0 65535 /end CHARACTERISTIC
/begin CHARACTERISTIC FaultManager.MAFRangeHigh.Faulty_Samples__X_ "Fault manager configuration.  Select up to 4 actions for each fault." VALUE 0x80003389 RecordLayout_3 0 CompuMethod_1 0 65535 /end CHARACTERISTIC
/begin CHARACTERISTIC FaultManager.MAFRangeHigh.Total_Samples__Y_ "Fault manager configuration.  Select up to 4 actions for each fault." VALUE 0x8000338B RecordLayout_3 0 CompuMethod_1 0 65535 /end CHARACTERISTIC
/begin CHARACTERISTIC FaultManager.MAFRangeHigh.Action_1 "Fault manager configuration.  Select up to 4 actions for each fault." VALUE 0x8000338D RecordLayout_3 0 CompuMethod_107 0 65535 /end CHARACTERISTIC
/begin CHARACTERISTIC FaultManager.MAFRangeHigh.Action_1_Condition "Fault manager configuration.  Select up to 4 actions for each fault." VALUE 0x8000338F RecordLayout_3 0 CompuMethod_108 0 65535 /end CHARACTERISTIC
/begin CHARACTERISTIC FaultManager.MAFRangeHigh.Action_2 "Fault manager configuration.  Select up to 4 actions for each fault." VALUE 0x80003391 RecordLayout_3 0 CompuMethod_107 0 65535 /end CHARACTERISTIC
/begin CHARACTERISTIC FaultManager.MAFRangeHigh.Action_2_Condition "Fault manager configuration.  Select up to 4 actions for each fault." VALUE 0x80003393 RecordLayout_3 0 CompuMethod_108 0 65535 /end CHARACTERISTIC
/begin CHARACTERISTIC FaultManager.MAFRangeHigh.Action_3 "Fault manager configuration.  Select up to 4 actions for each fault." VALUE 0x80003395 RecordLayout_3 0 CompuMethod_107 0 65535 /end CHARACTERISTIC
/begin CHARACTERISTIC FaultManager.MAFRangeHigh.Action_3_Condition "Fault manager configuration.  Select up to 4 actions for each fault." VALUE 0x80003397 RecordLayout_3 0 CompuMethod_108 0 65535 /end CHARACTERISTIC
/begin CHARACTERISTIC FaultManager.MAFRangeHigh.Action_4 "Fault manager configuration.  Select up to 4 actions for each fault." VALUE 0x80003399 RecordLayout_3 0 CompuMethod_107 0 65535 /end CHARACTERISTIC
/begin CHARACTERISTIC FaultManager.MAFRangeHigh.Action_4_Condition "Fault manager configuration.  Select up to 4 actions for each fault." VALUE 0x8000339B RecordLayout_3 0 CompuMethod_108 0 65535 /end CHARACTERISTIC
/begin CHARACTERISTIC FaultManager.MAFRangeLow.Mode "Fault manager configuration.  Select up to 4 actions for each fault." VALUE 0x8000339D RecordLayout_3 0 CompuMethod_105 0 65535 /end CHARACTERISTIC
/begin CHARACTERISTIC FaultManager.MAFRangeLow.ID "Fault manager configuration.  Select up to 4 actions for each fault." VALUE 0x8000339F RecordLayout_3 0 CompuMethod_1 0 65535 /end CHARACTERISTIC
/begin CHARACTERISTIC FaultManager.MAFRangeLow.Test "Fault manager configuration.  Select up to 4 actions for each fault." VALUE 0x800033A1 RecordLayout_3 0 CompuMethod_106 0 65535 /end CHARACTERISTIC
/begin CHARACTERISTIC FaultManager.MAFRangeLow.Faulty_Samples__X_ "Fault manager configuration.  Select up to 4 actions for each fault." VALUE 0x800033A3 RecordLayout_3 0 CompuMethod_1 0 65535 /end CHARACTERISTIC
/begin CHARACTERISTIC FaultManager.MAFRangeLow.Total_Samples__Y_ "Fault manager configuration.  Select up to 4 actions for each fault." VALUE 0x800033A5 RecordLayout_3 0 CompuMethod_1 0 65535 /end CHARACTERISTIC
/begin CHARACTERISTIC FaultManager.MAFRangeLow.Action_1 "Fault manager configuration.  Select up to 4 actions for each fault." VALUE 0x800033A7 RecordLayout_3 0 CompuMethod_107 0 65535 /end CHARACTERISTIC
/begin CHARACTERISTIC FaultManager.MAFRangeLow.Action_1_Condition "Fault manager configuration.  Select up to 4 actions for each fault." VALUE 0x800033A9 RecordLayout_3 0 CompuMethod_108 0 65535 /end CHARACTERISTIC
/begin CHARACTERISTIC FaultManager.MAFRangeLow.Action_2 "Fault manager configuration.  Select up to 4 actions for each fault." VALUE 0x800033AB RecordLayout_3 0 CompuMethod_107 0 65535 /end CHARACTERISTIC
/begin CHARACTERISTIC FaultManager.MAFRangeLow.Action_2_Condition "Fault manager configuration.  Select up to 4 actions for each fault." VALUE 0x800033AD RecordLayout_3 0 CompuMethod_108 0 65535 /end CHARACTERISTIC
/begin CHARACTERISTIC FaultManager.MAFRangeLow.Action_3 "Fault manager configuration.  Select up to 4 actions for each fault." VALUE 0x800033AF RecordLayout_3 0 CompuMethod_107 0 65535 /end CHARACTERISTIC
/begin CHARACTERISTIC FaultManager.MAFRangeLow.Action_3_Condition "Fault manager configuration.  Select up to 4 actions for each fault." VALUE 0x800033B1 RecordLayout_3 0 CompuMethod_108 0 65535 /end CHARACTERISTIC
/begin CHARACTERISTIC FaultManager.MAFRangeLow.Action_4 "Fault manager configuration.  Select up to 4 actions for each fault." VALUE 0x800033B3 RecordLayout_3 0 CompuMethod_107 0 65535 /end CHARACTERISTIC
/begin CHARACTERISTIC FaultManager.MAFRangeLow.Action_4_Condition "Fault manager configuration.  Select up to 4 actions for each fault." VALUE 0x800033B5 RecordLayout_3 0 CompuMethod_108 0 65535 /end CHARACTERISTIC
/begin CHARACTERISTIC FaultManager.MAPRangeHigh.Mode "Fault manager configuration.  Select up to 4 actions for each fault." VALUE 0x800033B7 RecordLayout_3 0 CompuMethod_105 0 65535 /end CHARACTERISTIC
/begin CHARACTERISTIC FaultManager.MAPRangeHigh.ID "Fault manager configuration.  Select up to 4 actions for each fault." VALUE 0x800033B9 RecordLayout_3 0 CompuMethod_1 0 65535 /end CHARACTERISTIC
/begin CHARACTERISTIC FaultManager.MAPRangeHigh.Test "Fault manager configuration.  Select up to 4 actions for each fault." VALUE 0x800033BB RecordLayout_3 0 CompuMethod_106 0 65535 /end CHARACTERISTIC
/begin CHARACTERISTIC FaultManager.MAPRangeHigh.Faulty_Samples__X_ "Fault manager configuration.  Select up to 4 actions for each fault." VALUE 0x800033BD RecordLayout_3 0 CompuMethod_1 0 65535 /end CHARACTERISTIC
/begin CHARACTERISTIC FaultManager.MAPRangeHigh.Total_Samples__Y_ "Fault manager configuration.  Select up to 4 actions for each fault." VALUE 0x800033BF RecordLayout_3 0 CompuMethod_1 0 65535 /end CHARACTERISTIC
/begin CHARACTERISTIC FaultManager.MAPRangeHigh.Action_1 "Fault manager configuration.  Select up to 4 actions for each fault." VALUE 0x800033C1 RecordLayout_3 0 CompuMethod_107 0 65535 /end CHARACTERISTIC
/begin CHARACTERISTIC FaultManager.MAPRangeHigh.Action_1_Condition "Fault manager configuration.  Select up to 4 actions for each fault." VALUE 0x800033C3 RecordLayout_3 0 CompuMethod_108 0 65535 /end CHARACTERISTIC
/begin CHARACTERISTIC FaultManager.MAPRangeHigh.Action_2 "Fault manager configuration.  Select up to 4 actions for each fault." VALUE 0x800033C5 RecordLayout_3 0 CompuMethod_107 0 65535 /end CHARACTERISTIC
/begin CHARACTERISTIC FaultManager.MAPRangeHigh.Action_2_Condition "Fault manager configuration.  Select up to 4 actions for each fault." VALUE 0x800033C7 RecordLayout_3 0 CompuMethod_108 0 65535 /end CHARACTERISTIC
/begin CHARACTERISTIC FaultManager.MAPRangeHigh.Action_3 "Fault manager configuration.  Select up to 4 actions for each fault." VALUE 0x800033C9 RecordLayout_3 0 CompuMethod_107 0 65535 /end CHARACTERISTIC
/begin CHARACTERISTIC FaultManager.MAPRangeHigh.Action_3_Condition "Fault manager configuration.  Select up to 4 actions for each fault." VALUE 0x800033CB RecordLayout_3 0 CompuMethod_108 0 65535 /end CHARACTERISTIC
/begin CHARACTERISTIC FaultManager.MAPRangeHigh.Action_4 "Fault manager configuration.  Select up to 4 actions for each fault." VALUE 0x800033CD RecordLayout_3 0 CompuMethod_107 0 65535 /end CHARACTERISTIC
/begin CHARACTERISTIC FaultManager.MAPRangeHigh.Action_4_Condition "Fault manager configuration.  Select up to 4 actions for each fault." VALUE 0x800033CF RecordLayout_3 0 CompuMethod_108 0 65535 /end CHARACTERISTIC
/begin CHARACTERISTIC FaultManager.MAPRangeLow.Mode "Fault manager configuration.  Select up to 4 actions for each fault." VALUE 0x800033D1 RecordLayout_3 0 CompuMethod_105 0 65535 /end CHARACTERISTIC
/begin CHARACTERISTIC FaultManager.MAPRangeLow.ID "Fault manager configuration.  Select up to 4 actions for each fault." VALUE 0x800033D3 RecordLayout_3 0 CompuMethod_1 0 65535 /end CHARACTERISTIC
/begin CHARACTERISTIC FaultManager.MAPRangeLow.Test "Fault manager configuration.  Select up to 4 actions for each fault." VALUE 0x800033D5 RecordLayout_3 0 CompuMethod_106 0 65535 /end CHARACTERISTIC
/begin CHARACTERISTIC FaultManager.MAPRangeLow.Faulty_Samples__X_ "Fault manager configuration.  Select up to 4 actions for each fault." VALUE 0x800033D7 RecordLayout_3 0 CompuMethod_1 0 65535 /end CHARACTERISTIC
/begin CHARACTERISTIC FaultManager.MAPRangeLow.Total_Samples__Y_ "Fault manager configuration.  Select up to 4 actions for each fault." VALUE 0x800033D9 RecordLayout_3 0 CompuMethod_1 0 65535 /end CHARACTERISTIC
/begin CHARACTERISTIC FaultManager.MAPRangeLow.Action_1 "Fault manager configuration.  Select up to 4 actions for each fault." VALUE 0x800033DB RecordLayout_3 0 CompuMethod_107 0 65535 /end CHARACTERISTIC
/begin CHARACTERISTIC FaultManager.MAPRangeLow.Action_1_Condition "Fault manager configuration.  Select up to 4 actions for each fault." VALUE 0x800033DD RecordLayout_3 0 CompuMethod_108 0 65535 /end CHARACTERISTIC
/begin CHARACTERISTIC FaultManager.MAPRangeLow.Action_2 "Fault manager configuration.  Select up to 4 actions for each fault." VALUE 0x800033DF RecordLayout_3 0 CompuMethod_107 0 65535 /end CHARACTERISTIC
/begin CHARACTERISTIC FaultManager.MAPRangeLow.Action_2_Condition "Fault manager configuration.  Select up to 4 actions for each fault." VALUE 0x800033E1 RecordLayout_3 0 CompuMethod_108 0 65535 /end CHARACTERISTIC
/begin CHARACTERISTIC FaultManager.MAPRangeLow.Action_3 "Fault manager configuration.  Select up to 4 actions for each fault." VALUE 0x800033E3 RecordLayout_3 0 CompuMethod_107 0 65535 /end CHARACTERISTIC
/begin CHARACTERISTIC FaultManager.MAPRangeLow.Action_3_Condition "Fault manager configuration.  Select up to 4 actions for each fault." VALUE 0x800033E5 RecordLayout_3 0 CompuMethod_108 0 65535 /end CHARACTERISTIC
/begin CHARACTERISTIC FaultManager.MAPRangeLow.Action_4 "Fault manager configuration.  Select up to 4 actions for each fault." VALUE 0x800033E7 RecordLayout_3 0 CompuMethod_107 0 65535 /end CHARACTERISTIC
/begin CHARACTERISTIC FaultManager.MAPRangeLow.Action_4_Condition "Fault manager configuration.  Select up to 4 actions for each fault." VALUE 0x800033E9 RecordLayout_3 0 CompuMethod_108 0 65535 /end CHARACTERISTIC
/begin CHARACTERISTIC FaultManager.MAPTimeRangeHigh.Mode "Fault manager configuration.  Select up to 4 actions for each fault." VALUE 0x800033EB RecordLayout_3 0 CompuMethod_105 0 65535 /end CHARACTERISTIC
/begin CHARACTERISTIC FaultManager.MAPTimeRangeHigh.ID "Fault manager configuration.  Select up to 4 actions for each fault." VALUE 0x800033ED RecordLayout_3 0 CompuMethod_1 0 65535 /end CHARACTERISTIC
/begin CHARACTERISTIC FaultManager.MAPTimeRangeHigh.Test "Fault manager configuration.  Select up to 4 actions for each fault." VALUE 0x800033EF RecordLayout_3 0 CompuMethod_106 0 65535 /end CHARACTERISTIC
/begin CHARACTERISTIC FaultManager.MAPTimeRangeHigh.Faulty_Samples__X_ "Fault manager configuration.  Select up to 4 actions for each fault." VALUE 0x800033F1 RecordLayout_3 0 CompuMethod_1 0 65535 /end CHARACTERISTIC
/begin CHARACTERISTIC FaultManager.MAPTimeRangeHigh.Total_Samples__Y_ "Fault manager configuration.  Select up to 4 actions for each fault." VALUE 0x800033F3 RecordLayout_3 0 CompuMethod_1 0 65535 /end CHARACTERISTIC
/begin CHARACTERISTIC FaultManager.MAPTimeRangeHigh.Action_1 "Fault manager configuration.  Select up to 4 actions for each fault." VALUE 0x800033F5 RecordLayout_3 0 CompuMethod_107 0 65535 /end CHARACTERISTIC
/begin CHARACTERISTIC FaultManager.MAPTimeRangeHigh.Action_1_Condition "Fault manager configuration.  Select up to 4 actions for each fault." VALUE 0x800033F7 RecordLayout_3 0 CompuMethod_108 0 65535 /end CHARACTERISTIC
/begin CHARACTERISTIC FaultManager.MAPTimeRangeHigh.Action_2 "Fault manager configuration.  Select up to 4 actions for each fault." VALUE 0x800033F9 RecordLayout_3 0 CompuMethod_107 0 65535 /end CHARACTERISTIC
/begin CHARACTERISTIC FaultManager.MAPTimeRangeHigh.Action_2_Condition "Fault manager configuration.  Select up to 4 actions for each fault." VALUE 0x800033FB RecordLayout_3 0 CompuMethod_108 0 65535 /end CHARACTERISTIC
/begin CHARACTERISTIC FaultManager.MAPTimeRangeHigh.Action_3 "Fault manager configuration.  Select up to 4 actions for each fault." VALUE 0x800033FD RecordLayout_3 0 CompuMethod_107 0 65535 /end CHARACTERISTIC
/begin CHARACTERISTIC FaultManager.MAPTimeRangeHigh.Action_3_Condition "Fault manager configuration.  Select up to 4 actions for each fault." VALUE 0x800033FF RecordLayout_3 0 CompuMethod_108 0 65535 /end CHARACTERISTIC
/begin CHARACTERISTIC FaultManager.MAPTimeRangeHigh.Action_4 "Fault manager configuration.  Select up to 4 actions for each fault." VALUE 0x80003401 RecordLayout_3 0 CompuMethod_107 0 65535 /end CHARACTERISTIC
/begin CHARACTERISTIC FaultManager.MAPTimeRangeHigh.Action_4_Condition "Fault manager configuration.  Select up to 4 actions for each fault." VALUE 0x80003403 RecordLayout_3 0 CompuMethod_108 0 65535 /end CHARACTERISTIC
/begin CHARACTERISTIC FaultManager.MAPTimeRangeLow.Mode "Fault manager configuration.  Select up to 4 actions for each fault." VALUE 0x80003405 RecordLayout_3 0 CompuMethod_105 0 65535 /end CHARACTERISTIC
/begin CHARACTERISTIC FaultManager.MAPTimeRangeLow.ID "Fault manager configuration.  Select up to 4 actions for each fault." VALUE 0x80003407 RecordLayout_3 0 CompuMethod_1 0 65535 /end CHARACTERISTIC
/begin CHARACTERISTIC FaultManager.MAPTimeRangeLow.Test "Fault manager configuration.  Select up to 4 actions for each fault." VALUE 0x80003409 RecordLayout_3 0 CompuMethod_106 0 65535 /end CHARACTERISTIC
/begin CHARACTERISTIC FaultManager.MAPTimeRangeLow.Faulty_Samples__X_ "Fault manager configuration.  Select up to 4 actions for each fault." VALUE 0x8000340B RecordLayout_3 0 CompuMethod_1 0 65535 /end CHARACTERISTIC
/begin CHARACTERISTIC FaultManager.MAPTimeRangeLow.Total_Samples__Y_ "Fault manager configuration.  Select up to 4 actions for each fault." VALUE 0x8000340D RecordLayout_3 0 CompuMethod_1 0 65535 /end CHARACTERISTIC
/begin CHARACTERISTIC FaultManager.MAPTimeRangeLow.Action_1 "Fault manager configuration.  Select up to 4 actions for each fault." VALUE 0x8000340F RecordLayout_3 0 CompuMethod_107 0 65535 /end CHARACTERISTIC
/begin CHARACTERISTIC FaultManager.MAPTimeRangeLow.Action_1_Condition "Fault manager configuration.  Select up to 4 actions for each fault." VALUE 0x80003411 RecordLayout_3 0 CompuMethod_108 0 65535 /end CHARACTERISTIC
/begin CHARACTERISTIC FaultManager.MAPTimeRangeLow.Action_2 "Fault manager configuration.  Select up to 4 actions for each fault." VALUE 0x80003413 RecordLayout_3 0 CompuMethod_107 0 65535 /end CHARACTERISTIC
/begin CHARACTERISTIC FaultManager.MAPTimeRangeLow.Action_2_Condition "Fault manager configuration.  Select up to 4 actions for each fault." VALUE 0x80003415 RecordLayout_3 0 CompuMethod_108 0 65535 /end CHARACTERISTIC
/begin CHARACTERISTIC FaultManager.MAPTimeRangeLow.Action_3 "Fault manager configuration.  Select up to 4 actions for each fault." VALUE 0x80003417 RecordLayout_3 0 CompuMethod_107 0 65535 /end CHARACTERISTIC
/begin CHARACTERISTIC FaultManager.MAPTimeRangeLow.Action_3_Condition "Fault manager configuration.  Select up to 4 actions for each fault." VALUE 0x80003419 RecordLayout_3 0 CompuMethod_108 0 65535 /end CHARACTERISTIC
/begin CHARACTERISTIC FaultManager.MAPTimeRangeLow.Action_4 "Fault manager configuration.  Select up to 4 actions for each fault." VALUE 0x8000341B RecordLayout_3 0 CompuMethod_107 0 65535 /end CHARACTERISTIC
/begin CHARACTERISTIC FaultManager.MAPTimeRangeLow.Action_4_Condition "Fault manager configuration.  Select up to 4 actions for each fault." VALUE 0x8000341D RecordLayout_3 0 CompuMethod_108 0 65535 /end CHARACTERISTIC
/begin CHARACTERISTIC FaultManager.MAP_IR_HI.Mode "Fault manager configuration.  Select up to 4 actions for each fault." VALUE 0x8000341F RecordLayout_3 0 CompuMethod_105 0 65535 /end CHARACTERISTIC
/begin CHARACTERISTIC FaultManager.MAP_IR_HI.ID "Fault manager configuration.  Select up to 4 actions for each fault." VALUE 0x80003421 RecordLayout_3 0 CompuMethod_1 0 65535 /end CHARACTERISTIC
/begin CHARACTERISTIC FaultManager.MAP_IR_HI.Test "Fault manager configuration.  Select up to 4 actions for each fault." VALUE 0x80003423 RecordLayout_3 0 CompuMethod_106 0 65535 /end CHARACTERISTIC
/begin CHARACTERISTIC FaultManager.MAP_IR_HI.Faulty_Samples__X_ "Fault manager configuration.  Select up to 4 actions for each fault." VALUE 0x80003425 RecordLayout_3 0 CompuMethod_1 0 65535 /end CHARACTERISTIC
/begin CHARACTERISTIC FaultManager.MAP_IR_HI.Total_Samples__Y_ "Fault manager configuration.  Select up to 4 actions for each fault." VALUE 0x80003427 RecordLayout_3 0 CompuMethod_1 0 65535 /end CHARACTERISTIC
/begin CHARACTERISTIC FaultManager.MAP_IR_HI.Action_1 "Fault manager configuration.  Select up to 4 actions for each fault." VALUE 0x80003429 RecordLayout_3 0 CompuMethod_107 0 65535 /end CHARACTERISTIC
/begin CHARACTERISTIC FaultManager.MAP_IR_HI.Action_1_Condition "Fault manager configuration.  Select up to 4 actions for each fault." VALUE 0x8000342B RecordLayout_3 0 CompuMethod_108 0 65535 /end CHARACTERISTIC
/begin CHARACTERISTIC FaultManager.MAP_IR_HI.Action_2 "Fault manager configuration.  Select up to 4 actions for each fault." VALUE 0x8000342D RecordLayout_3 0 CompuMethod_107 0 65535 /end CHARACTERISTIC
/begin CHARACTERISTIC FaultManager.MAP_IR_HI.Action_2_Condition "Fault manager configuration.  Select up to 4 actions for each fault." VALUE 0x8000342F RecordLayout_3 0 CompuMethod_108 0 65535 /end CHARACTERISTIC
/begin CHARACTERISTIC FaultManager.MAP_IR_HI.Action_3 "Fault manager configuration.  Select up to 4 actions for each fault." VALUE 0x80003431 RecordLayout_3 0 CompuMethod_107 0 65535 /end CHARACTERISTIC
/begin CHARACTERISTIC FaultManager.MAP_IR_HI.Action_3_Condition "Fault manager configuration.  Select up to 4 actions for each fault." VALUE 0x80003433 RecordLayout_3 0 CompuMethod_108 0 65535 /end CHARACTERISTIC
/begin CHARACTERISTIC FaultManager.MAP_IR_HI.Action_4 "Fault manager configuration.  Select up to 4 actions for each fault." VALUE 0x80003435 RecordLayout_3 0 CompuMethod_107 0 65535 /end CHARACTERISTIC
/begin CHARACTERISTIC FaultManager.MAP_IR_HI.Action_4_Condition "Fault manager configuration.  Select up to 4 actions for each fault." VALUE 0x80003437 RecordLayout_3 0 CompuMethod_108 0 65535 /end CHARACTERISTIC
/begin CHARACTERISTIC FaultManager.MAP_IR_LO.Mode "Fault manager configuration.  Select up to 4 actions for each fault." VALUE 0x80003439 RecordLayout_3 0 CompuMethod_105 0 65535 /end CHARACTERISTIC
/begin CHARACTERISTIC FaultManager.MAP_IR_LO.ID "Fault manager configuration.  Select up to 4 actions for each fault." VALUE 0x8000343B RecordLayout_3 0 CompuMethod_1 0 65535 /end CHARACTERISTIC
/begin CHARACTERISTIC FaultManager.MAP_IR_LO.Test "Fault manager configuration.  Select up to 4 actions for each fault." VALUE 0x8000343D RecordLayout_3 0 CompuMethod_106 0 65535 /end CHARACTERISTIC
/begin CHARACTERISTIC FaultManager.MAP_IR_LO.Faulty_Samples__X_ "Fault manager configuration.  Select up to 4 actions for each fault." VALUE 0x8000343F RecordLayout_3 0 CompuMethod_1 0 65535 /end CHARACTERISTIC
/begin CHARACTERISTIC FaultManager.MAP_IR_LO.Total_Samples__Y_ "Fault manager configuration.  Select up to 4 actions for each fault." VALUE 0x80003441 RecordLayout_3 0 CompuMethod_1 0 65535 /end CHARACTERISTIC
/begin CHARACTERISTIC FaultManager.MAP_IR_LO.Action_1 "Fault manager configuration.  Select up to 4 actions for each fault." VALUE 0x80003443 RecordLayout_3 0 CompuMethod_107 0 65535 /end CHARACTERISTIC
/begin CHARACTERISTIC FaultManager.MAP_IR_LO.Action_1_Condition "Fault manager configuration.  Select up to 4 actions for each fault." VALUE 0x80003445 RecordLayout_3 0 CompuMethod_108 0 65535 /end CHARACTERISTIC
/begin CHARACTERISTIC FaultManager.MAP_IR_LO.Action_2 "Fault manager configuration.  Select up to 4 actions for each fault." VALUE 0x80003447 RecordLayout_3 0 CompuMethod_107 0 65535 /end CHARACTERISTIC
/begin CHARACTERISTIC FaultManager.MAP_IR_LO.Action_2_Condition "Fault manager configuration.  Select up to 4 actions for each fault." VALUE 0x80003449 RecordLayout_3 0 CompuMethod_108 0 65535 /end CHARACTERISTIC
/begin CHARACTERISTIC FaultManager.MAP_IR_LO.Action_3 "Fault manager configuration.  Select up to 4 actions for each fault." VALUE 0x8000344B RecordLayout_3 0 CompuMethod_107 0 65535 /end CHARACTERISTIC
/begin CHARACTERISTIC FaultManager.MAP_IR_LO.Action_3_Condition "Fault manager configuration.  Select up to 4 actions for each fault." VALUE 0x8000344D RecordLayout_3 0 CompuMethod_108 0 65535 /end CHARACTERISTIC
/begin CHARACTERISTIC FaultManager.MAP_IR_LO.Action_4 "Fault manager configuration.  Select up to 4 actions for each fault." VALUE 0x8000344F RecordLayout_3 0 CompuMethod_107 0 65535 /end CHARACTERISTIC
/begin CHARACTERISTIC FaultManager.MAP_IR_LO.Action_4_Condition "Fault manager configuration.  Select up to 4 actions for each fault." VALUE 0x80003451 RecordLayout_3 0 CompuMethod_108 0 65535 /end CHARACTERISTIC
/begin CHARACTERISTIC FaultManager.MAP_STICKING.Mode "Fault manager configuration.  Select up to 4 actions for each fault." VALUE 0x80003453 RecordLayout_3 0 CompuMethod_105 0 65535 /end CHARACTERISTIC
/begin CHARACTERISTIC FaultManager.MAP_STICKING.ID "Fault manager configuration.  Select up to 4 actions for each fault." VALUE 0x80003455 RecordLayout_3 0 CompuMethod_1 0 65535 /end CHARACTERISTIC
/begin CHARACTERISTIC FaultManager.MAP_STICKING.Test "Fault manager configuration.  Select up to 4 actions for each fault." VALUE 0x80003457 RecordLayout_3 0 CompuMethod_106 0 65535 /end CHARACTERISTIC
/begin CHARACTERISTIC FaultManager.MAP_STICKING.Faulty_Samples__X_ "Fault manager configuration.  Select up to 4 actions for each fault." VALUE 0x80003459 RecordLayout_3 0 CompuMethod_1 0 65535 /end CHARACTERISTIC
/begin CHARACTERISTIC FaultManager.MAP_STICKING.Total_Samples__Y_ "Fault manager configuration.  Select up to 4 actions for each fault." VALUE 0x8000345B RecordLayout_3 0 CompuMethod_1 0 65535 /end CHARACTERISTIC
/begin CHARACTERISTIC FaultManager.MAP_STICKING.Action_1 "Fault manager configuration.  Select up to 4 actions for each fault." VALUE 0x8000345D RecordLayout_3 0 CompuMethod_107 0 65535 /end CHARACTERISTIC
/begin CHARACTERISTIC FaultManager.MAP_STICKING.Action_1_Condition "Fault manager configuration.  Select up to 4 actions for each fault." VALUE 0x8000345F RecordLayout_3 0 CompuMethod_108 0 65535 /end CHARACTERISTIC
/begin CHARACTERISTIC FaultManager.MAP_STICKING.Action_2 "Fault manager configuration.  Select up to 4 actions for each fault." VALUE 0x80003461 RecordLayout_3 0 CompuMethod_107 0 65535 /end CHARACTERISTIC
/begin CHARACTERISTIC FaultManager.MAP_STICKING.Action_2_Condition "Fault manager configuration.  Select up to 4 actions for each fault." VALUE 0x80003463 RecordLayout_3 0 CompuMethod_108 0 65535 /end CHARACTERISTIC
/begin CHARACTERISTIC FaultManager.MAP_STICKING.Action_3 "Fault manager configuration.  Select up to 4 actions for each fault." VALUE 0x80003465 RecordLayout_3 0 CompuMethod_107 0 65535 /end CHARACTERISTIC
/begin CHARACTERISTIC FaultManager.MAP_STICKING.Action_3_Condition "Fault manager configuration.  Select up to 4 actions for each fault." VALUE 0x80003467 RecordLayout_3 0 CompuMethod_108 0 65535 /end CHARACTERISTIC
/begin CHARACTERISTIC FaultManager.MAP_STICKING.Action_4 "Fault manager configuration.  Select up to 4 actions for each fault." VALUE 0x80003469 RecordLayout_3 0 CompuMethod_107 0 65535 /end CHARACTERISTIC
/begin CHARACTERISTIC FaultManager.MAP_STICKING.Action_4_Condition "Fault manager configuration.  Select up to 4 actions for each fault." VALUE 0x8000346B RecordLayout_3 0 CompuMethod_108 0 65535 /end CHARACTERISTIC
/begin CHARACTERISTIC FaultManager.MediumOverspeed.Mode "Fault manager configuration.  Select up to 4 actions for each fault." VALUE 0x8000346D RecordLayout_3 0 CompuMethod_105 0 65535 /end CHARACTERISTIC
/begin CHARACTERISTIC FaultManager.MediumOverspeed.ID "Fault manager configuration.  Select up to 4 actions for each fault." VALUE 0x8000346F RecordLayout_3 0 CompuMethod_1 0 65535 /end CHARACTERISTIC
/begin CHARACTERISTIC FaultManager.MediumOverspeed.Test "Fault manager configuration.  Select up to 4 actions for each fault." VALUE 0x80003471 RecordLayout_3 0 CompuMethod_106 0 65535 /end CHARACTERISTIC
/begin CHARACTERISTIC FaultManager.MediumOverspeed.Faulty_Samples__X_ "Fault manager configuration.  Select up to 4 actions for each fault." VALUE 0x80003473 RecordLayout_3 0 CompuMethod_1 0 65535 /end CHARACTERISTIC
/begin CHARACTERISTIC FaultManager.MediumOverspeed.Total_Samples__Y_ "Fault manager configuration.  Select up to 4 actions for each fault." VALUE 0x80003475 RecordLayout_3 0 CompuMethod_1 0 65535 /end CHARACTERISTIC
/begin CHARACTERISTIC FaultManager.MediumOverspeed.Action_1 "Fault manager configuration.  Select up to 4 actions for each fault." VALUE 0x80003477 RecordLayout_3 0 CompuMethod_107 0 65535 /end CHARACTERISTIC
/begin CHARACTERISTIC FaultManager.MediumOverspeed.Action_1_Condition "Fault manager configuration.  Select up to 4 actions for each fault." VALUE 0x80003479 RecordLayout_3 0 CompuMethod_108 0 65535 /end CHARACTERISTIC
/begin CHARACTERISTIC FaultManager.MediumOverspeed.Action_2 "Fault manager configuration.  Select up to 4 actions for each fault." VALUE 0x8000347B RecordLayout_3 0 CompuMethod_107 0 65535 /end CHARACTERISTIC
/begin CHARACTERISTIC FaultManager.MediumOverspeed.Action_2_Condition "Fault manager configuration.  Select up to 4 actions for each fault." VALUE 0x8000347D RecordLayout_3 0 CompuMethod_108 0 65535 /end CHARACTERISTIC
/begin CHARACTERISTIC FaultManager.MediumOverspeed.Action_3 "Fault manager configuration.  Select up to 4 actions for each fault." VALUE 0x8000347F RecordLayout_3 0 CompuMethod_107 0 65535 /end CHARACTERISTIC
/begin CHARACTERISTIC FaultManager.MediumOverspeed.Action_3_Condition "Fault manager configuration.  Select up to 4 actions for each fault." VALUE 0x80003481 RecordLayout_3 0 CompuMethod_108 0 65535 /end CHARACTERISTIC
/begin CHARACTERISTIC FaultManager.MediumOverspeed.Action_4 "Fault manager configuration.  Select up to 4 actions for each fault." VALUE 0x80003483 RecordLayout_3 0 CompuMethod_107 0 65535 /end CHARACTERISTIC
/begin CHARACTERISTIC FaultManager.MediumOverspeed.Action_4_Condition "Fault manager configuration.  Select up to 4 actions for each fault." VALUE 0x80003485 RecordLayout_3 0 CompuMethod_108 0 65535 /end CHARACTERISTIC
/begin CHARACTERISTIC FaultManager.NoOil_Fault.Mode "Fault manager configuration.  Select up to 4 actions for each fault." VALUE 0x80003487 RecordLayout_3 0 CompuMethod_105 0 65535 /end CHARACTERISTIC
/begin CHARACTERISTIC FaultManager.NoOil_Fault.ID "Fault manager configuration.  Select up to 4 actions for each fault." VALUE 0x80003489 RecordLayout_3 0 CompuMethod_1 0 65535 /end CHARACTERISTIC
/begin CHARACTERISTIC FaultManager.NoOil_Fault.Test "Fault manager configuration.  Select up to 4 actions for each fault." VALUE 0x8000348B RecordLayout_3 0 CompuMethod_106 0 65535 /end CHARACTERISTIC
/begin CHARACTERISTIC FaultManager.NoOil_Fault.Faulty_Samples__X_ "Fault manager configuration.  Select up to 4 actions for each fault." VALUE 0x8000348D RecordLayout_3 0 CompuMethod_1 0 65535 /end CHARACTERISTIC
/begin CHARACTERISTIC FaultManager.NoOil_Fault.Total_Samples__Y_ "Fault manager configuration.  Select up to 4 actions for each fault." VALUE 0x8000348F RecordLayout_3 0 CompuMethod_1 0 65535 /end CHARACTERISTIC
/begin CHARACTERISTIC FaultManager.NoOil_Fault.Action_1 "Fault manager configuration.  Select up to 4 actions for each fault." VALUE 0x80003491 RecordLayout_3 0 CompuMethod_107 0 65535 /end CHARACTERISTIC
/begin CHARACTERISTIC FaultManager.NoOil_Fault.Action_1_Condition "Fault manager configuration.  Select up to 4 actions for each fault." VALUE 0x80003493 RecordLayout_3 0 CompuMethod_108 0 65535 /end CHARACTERISTIC
/begin CHARACTERISTIC FaultManager.NoOil_Fault.Action_2 "Fault manager configuration.  Select up to 4 actions for each fault." VALUE 0x80003495 RecordLayout_3 0 CompuMethod_107 0 65535 /end CHARACTERISTIC
/begin CHARACTERISTIC FaultManager.NoOil_Fault.Action_2_Condition "Fault manager configuration.  Select up to 4 actions for each fault." VALUE 0x80003497 RecordLayout_3 0 CompuMethod_108 0 65535 /end CHARACTERISTIC
/begin CHARACTERISTIC FaultManager.NoOil_Fault.Action_3 "Fault manager configuration.  Select up to 4 actions for each fault." VALUE 0x80003499 RecordLayout_3 0 CompuMethod_107 0 65535 /end CHARACTERISTIC
/begin CHARACTERISTIC FaultManager.NoOil_Fault.Action_3_Condition "Fault manager configuration.  Select up to 4 actions for each fault." VALUE 0x8000349B RecordLayout_3 0 CompuMethod_108 0 65535 /end CHARACTERISTIC
/begin CHARACTERISTIC FaultManager.NoOil_Fault.Action_4 "Fault manager configuration.  Select up to 4 actions for each fault." VALUE 0x8000349D RecordLayout_3 0 CompuMethod_107 0 65535 /end CHARACTERISTIC
/begin CHARACTERISTIC FaultManager.NoOil_Fault.Action_4_Condition "Fault manager configuration.  Select up to 4 actions for each fault." VALUE 0x8000349F RecordLayout_3 0 CompuMethod_108 0 65535 /end CHARACTERISTIC
/begin CHARACTERISTIC FaultManager.O2FailedLean_BankA.Mode "Fault manager configuration.  Select up to 4 actions for each fault." VALUE 0x800034A1 RecordLayout_3 0 CompuMethod_105 0 65535 /end CHARACTERISTIC
/begin CHARACTERISTIC FaultManager.O2FailedLean_BankA.ID "Fault manager configuration.  Select up to 4 actions for each fault." VALUE 0x800034A3 RecordLayout_3 0 CompuMethod_1 0 65535 /end CHARACTERISTIC
/begin CHARACTERISTIC FaultManager.O2FailedLean_BankA.Test "Fault manager configuration.  Select up to 4 actions for each fault." VALUE 0x800034A5 RecordLayout_3 0 CompuMethod_106 0 65535 /end CHARACTERISTIC
/begin CHARACTERISTIC FaultManager.O2FailedLean_BankA.Faulty_Samples__X_ "Fault manager configuration.  Select up to 4 actions for each fault." VALUE 0x800034A7 RecordLayout_3 0 CompuMethod_1 0 65535 /end CHARACTERISTIC
/begin CHARACTERISTIC FaultManager.O2FailedLean_BankA.Total_Samples__Y_ "Fault manager configuration.  Select up to 4 actions for each fault." VALUE 0x800034A9 RecordLayout_3 0 CompuMethod_1 0 65535 /end CHARACTERISTIC
/begin CHARACTERISTIC FaultManager.O2FailedLean_BankA.Action_1 "Fault manager configuration.  Select up to 4 actions for each fault." VALUE 0x800034AB RecordLayout_3 0 CompuMethod_107 0 65535 /end CHARACTERISTIC
/begin CHARACTERISTIC FaultManager.O2FailedLean_BankA.Action_1_Condition "Fault manager configuration.  Select up to 4 actions for each fault." VALUE 0x800034AD RecordLayout_3 0 CompuMethod_108 0 65535 /end CHARACTERISTIC
/begin CHARACTERISTIC FaultManager.O2FailedLean_BankA.Action_2 "Fault manager configuration.  Select up to 4 actions for each fault." VALUE 0x800034AF RecordLayout_3 0 CompuMethod_107 0 65535 /end CHARACTERISTIC
/begin CHARACTERISTIC FaultManager.O2FailedLean_BankA.Action_2_Condition "Fault manager configuration.  Select up to 4 actions for each fault." VALUE 0x800034B1 RecordLayout_3 0 CompuMethod_108 0 65535 /end CHARACTERISTIC
/begin CHARACTERISTIC FaultManager.O2FailedLean_BankA.Action_3 "Fault manager configuration.  Select up to 4 actions for each fault." VALUE 0x800034B3 RecordLayout_3 0 CompuMethod_107 0 65535 /end CHARACTERISTIC
/begin CHARACTERISTIC FaultManager.O2FailedLean_BankA.Action_3_Condition "Fault manager configuration.  Select up to 4 actions for each fault." VALUE 0x800034B5 RecordLayout_3 0 CompuMethod_108 0 65535 /end CHARACTERISTIC
/begin CHARACTERISTIC FaultManager.O2FailedLean_BankA.Action_4 "Fault manager configuration.  Select up to 4 actions for each fault." VALUE 0x800034B7 RecordLayout_3 0 CompuMethod_107 0 65535 /end CHARACTERISTIC
/begin CHARACTERISTIC FaultManager.O2FailedLean_BankA.Action_4_Condition "Fault manager configuration.  Select up to 4 actions for each fault." VALUE 0x800034B9 RecordLayout_3 0 CompuMethod_108 0 65535 /end CHARACTERISTIC
/begin CHARACTERISTIC FaultManager.O2FailedLean_BankB.Mode "Fault manager configuration.  Select up to 4 actions for each fault." VALUE 0x800034BB RecordLayout_3 0 CompuMethod_105 0 65535 /end CHARACTERISTIC
/begin CHARACTERISTIC FaultManager.O2FailedLean_BankB.ID "Fault manager configuration.  Select up to 4 actions for each fault." VALUE 0x800034BD RecordLayout_3 0 CompuMethod_1 0 65535 /end CHARACTERISTIC
/begin CHARACTERISTIC FaultManager.O2FailedLean_BankB.Test "Fault manager configuration.  Select up to 4 actions for each fault." VALUE 0x800034BF RecordLayout_3 0 CompuMethod_106 0 65535 /end CHARACTERISTIC
/begin CHARACTERISTIC FaultManager.O2FailedLean_BankB.Faulty_Samples__X_ "Fault manager configuration.  Select up to 4 actions for each fault." VALUE 0x800034C1 RecordLayout_3 0 CompuMethod_1 0 65535 /end CHARACTERISTIC
/begin CHARACTERISTIC FaultManager.O2FailedLean_BankB.Total_Samples__Y_ "Fault manager configuration.  Select up to 4 actions for each fault." VALUE 0x800034C3 RecordLayout_3 0 CompuMethod_1 0 65535 /end CHARACTERISTIC
/begin CHARACTERISTIC FaultManager.O2FailedLean_BankB.Action_1 "Fault manager configuration.  Select up to 4 actions for each fault." VALUE 0x800034C5 RecordLayout_3 0 CompuMethod_107 0 65535 /end CHARACTERISTIC
/begin CHARACTERISTIC FaultManager.O2FailedLean_BankB.Action_1_Condition "Fault manager configuration.  Select up to 4 actions for each fault." VALUE 0x800034C7 RecordLayout_3 0 CompuMethod_108 0 65535 /end CHARACTERISTIC
/begin CHARACTERISTIC FaultManager.O2FailedLean_BankB.Action_2 "Fault manager configuration.  Select up to 4 actions for each fault." VALUE 0x800034C9 RecordLayout_3 0 CompuMethod_107 0 65535 /end CHARACTERISTIC
/begin CHARACTERISTIC FaultManager.O2FailedLean_BankB.Action_2_Condition "Fault manager configuration.  Select up to 4 actions for each fault." VALUE 0x800034CB RecordLayout_3 0 CompuMethod_108 0 65535 /end CHARACTERISTIC
/begin CHARACTERISTIC FaultManager.O2FailedLean_BankB.Action_3 "Fault manager configuration.  Select up to 4 actions for each fault." VALUE 0x800034CD RecordLayout_3 0 CompuMethod_107 0 65535 /end CHARACTERISTIC
/begin CHARACTERISTIC FaultManager.O2FailedLean_BankB.Action_3_Condition "Fault manager configuration.  Select up to 4 actions for each fault." VALUE 0x800034CF RecordLayout_3 0 CompuMethod_108 0 65535 /end CHARACTERISTIC
/begin CHARACTERISTIC FaultManager.O2FailedLean_BankB.Action_4 "Fault manager configuration.  Select up to 4 actions for each fault." VALUE 0x800034D1 RecordLayout_3 0 CompuMethod_107 0 65535 /end CHARACTERISTIC
/begin CHARACTERISTIC FaultManager.O2FailedLean_BankB.Action_4_Condition "Fault manager configuration.  Select up to 4 actions for each fault." VALUE 0x800034D3 RecordLayout_3 0 CompuMethod_108 0 65535 /end CHARACTERISTIC
/begin CHARACTERISTIC FaultManager.O2FailedRich_BankA.Mode "Fault manager configuration.  Select up to 4 actions for each fault." VALUE 0x800034D5 RecordLayout_3 0 CompuMethod_105 0 65535 /end CHARACTERISTIC
/begin CHARACTERISTIC FaultManager.O2FailedRich_BankA.ID "Fault manager configuration.  Select up to 4 actions for each fault." VALUE 0x800034D7 RecordLayout_3 0 CompuMethod_1 0 65535 /end CHARACTERISTIC
/begin CHARACTERISTIC FaultManager.O2FailedRich_BankA.Test "Fault manager configuration.  Select up to 4 actions for each fault." VALUE 0x800034D9 RecordLayout_3 0 CompuMethod_106 0 65535 /end CHARACTERISTIC
/begin CHARACTERISTIC FaultManager.O2FailedRich_BankA.Faulty_Samples__X_ "Fault manager configuration.  Select up to 4 actions for each fault." VALUE 0x800034DB RecordLayout_3 0 CompuMethod_1 0 65535 /end CHARACTERISTIC
/begin CHARACTERISTIC FaultManager.O2FailedRich_BankA.Total_Samples__Y_ "Fault manager configuration.  Select up to 4 actions for each fault." VALUE 0x800034DD RecordLayout_3 0 CompuMethod_1 0 65535 /end CHARACTERISTIC
/begin CHARACTERISTIC FaultManager.O2FailedRich_BankA.Action_1 "Fault manager configuration.  Select up to 4 actions for each fault." VALUE 0x800034DF RecordLayout_3 0 CompuMethod_107 0 65535 /end CHARACTERISTIC
/begin CHARACTERISTIC FaultManager.O2FailedRich_BankA.Action_1_Condition "Fault manager configuration.  Select up to 4 actions for each fault." VALUE 0x800034E1 RecordLayout_3 0 CompuMethod_108 0 65535 /end CHARACTERISTIC
/begin CHARACTERISTIC FaultManager.O2FailedRich_BankA.Action_2 "Fault manager configuration.  Select up to 4 actions for each fault." VALUE 0x800034E3 RecordLayout_3 0 CompuMethod_107 0 65535 /end CHARACTERISTIC
/begin CHARACTERISTIC FaultManager.O2FailedRich_BankA.Action_2_Condition "Fault manager configuration.  Select up to 4 actions for each fault." VALUE 0x800034E5 RecordLayout_3 0 CompuMethod_108 0 65535 /end CHARACTERISTIC
/begin CHARACTERISTIC FaultManager.O2FailedRich_BankA.Action_3 "Fault manager configuration.  Select up to 4 actions for each fault." VALUE 0x800034E7 RecordLayout_3 0 CompuMethod_107 0 65535 /end CHARACTERISTIC
/begin CHARACTERISTIC FaultManager.O2FailedRich_BankA.Action_3_Condition "Fault manager configuration.  Select up to 4 actions for each fault." VALUE 0x800034E9 RecordLayout_3 0 CompuMethod_108 0 65535 /end CHARACTERISTIC
/begin CHARACTERISTIC FaultManager.O2FailedRich_BankA.Action_4 "Fault manager configuration.  Select up to 4 actions for each fault." VALUE 0x800034EB RecordLayout_3 0 CompuMethod_107 0 65535 /end CHARACTERISTIC
/begin CHARACTERISTIC FaultManager.O2FailedRich_BankA.Action_4_Condition "Fault manager configuration.  Select up to 4 actions for each fault." VALUE 0x800034ED RecordLayout_3 0 CompuMethod_108 0 65535 /end CHARACTERISTIC
/begin CHARACTERISTIC FaultManager.O2FailedRich_BankB.Mode "Fault manager configuration.  Select up to 4 actions for each fault." VALUE 0x800034EF RecordLayout_3 0 CompuMethod_105 0 65535 /end CHARACTERISTIC
/begin CHARACTERISTIC FaultManager.O2FailedRich_BankB.ID "Fault manager configuration.  Select up to 4 actions for each fault." VALUE 0x800034F1 RecordLayout_3 0 CompuMethod_1 0 65535 /end CHARACTERISTIC
/begin CHARACTERISTIC FaultManager.O2FailedRich_BankB.Test "Fault manager configuration.  Select up to 4 actions for each fault." VALUE 0x800034F3 RecordLayout_3 0 CompuMethod_106 0 65535 /end CHARACTERISTIC
/begin CHARACTERISTIC FaultManager.O2FailedRich_BankB.Faulty_Samples__X_ "Fault manager configuration.  Select up to 4 actions for each fault." VALUE 0x800034F5 RecordLayout_3 0 CompuMethod_1 0 65535 /end CHARACTERISTIC
/begin CHARACTERISTIC FaultManager.O2FailedRich_BankB.Total_Samples__Y_ "Fault manager configuration.  Select up to 4 actions for each fault." VALUE 0x800034F7 RecordLayout_3 0 CompuMethod_1 0 65535 /end CHARACTERISTIC
/begin CHARACTERISTIC FaultManager.O2FailedRich_BankB.Action_1 "Fault manager configuration.  Select up to 4 actions for each fault." VALUE 0x800034F9 RecordLayout_3 0 CompuMethod_107 0 65535 /end CHARACTERISTIC
/begin CHARACTERISTIC FaultManager.O2FailedRich_BankB.Action_1_Condition "Fault manager configuration.  Select up to 4 actions for each fault." VALUE 0x800034FB RecordLayout_3 0 CompuMethod_108 0 65535 /end CHARACTERISTIC
/begin CHARACTERISTIC FaultManager.O2FailedRich_BankB.Action_2 "Fault manager configuration.  Select up to 4 actions for each fault." VALUE 0x800034FD RecordLayout_3 0 CompuMethod_107 0 65535 /end CHARACTERISTIC
/begin CHARACTERISTIC FaultManager.O2FailedRich_BankB.Action_2_Condition "Fault manager configuration.  Select up to 4 actions for each fault." VALUE 0x800034FF RecordLayout_3 0 CompuMethod_108 0 65535 /end CHARACTERISTIC
/begin CHARACTERISTIC FaultManager.O2FailedRich_BankB.Action_3 "Fault manager configuration.  Select up to 4 actions for each fault." VALUE 0x80003501 RecordLayout_3 0 CompuMethod_107 0 65535 /end CHARACTERISTIC
/begin CHARACTERISTIC FaultManager.O2FailedRich_BankB.Action_3_Condition "Fault manager configuration.  Select up to 4 actions for each fault." VALUE 0x80003503 RecordLayout_3 0 CompuMethod_108 0 65535 /end CHARACTERISTIC
/begin CHARACTERISTIC FaultManager.O2FailedRich_BankB.Action_4 "Fault manager configuration.  Select up to 4 actions for each fault." VALUE 0x80003505 RecordLayout_3 0 CompuMethod_107 0 65535 /end CHARACTERISTIC
/begin CHARACTERISTIC FaultManager.O2FailedRich_BankB.Action_4_Condition "Fault manager configuration.  Select up to 4 actions for each fault." VALUE 0x80003507 RecordLayout_3 0 CompuMethod_108 0 65535 /end CHARACTERISTIC
/begin CHARACTERISTIC FaultManager.O2NotActive_BankA.Mode "Fault manager configuration.  Select up to 4 actions for each fault." VALUE 0x80003509 RecordLayout_3 0 CompuMethod_105 0 65535 /end CHARACTERISTIC
/begin CHARACTERISTIC FaultManager.O2NotActive_BankA.ID "Fault manager configuration.  Select up to 4 actions for each fault." VALUE 0x8000350B RecordLayout_3 0 CompuMethod_1 0 65535 /end CHARACTERISTIC
/begin CHARACTERISTIC FaultManager.O2NotActive_BankA.Test "Fault manager configuration.  Select up to 4 actions for each fault." VALUE 0x8000350D RecordLayout_3 0 CompuMethod_106 0 65535 /end CHARACTERISTIC
/begin CHARACTERISTIC FaultManager.O2NotActive_BankA.Faulty_Samples__X_ "Fault manager configuration.  Select up to 4 actions for each fault." VALUE 0x8000350F RecordLayout_3 0 CompuMethod_1 0 65535 /end CHARACTERISTIC
/begin CHARACTERISTIC FaultManager.O2NotActive_BankA.Total_Samples__Y_ "Fault manager configuration.  Select up to 4 actions for each fault." VALUE 0x80003511 RecordLayout_3 0 CompuMethod_1 0 65535 /end CHARACTERISTIC
/begin CHARACTERISTIC FaultManager.O2NotActive_BankA.Action_1 "Fault manager configuration.  Select up to 4 actions for each fault." VALUE 0x80003513 RecordLayout_3 0 CompuMethod_107 0 65535 /end CHARACTERISTIC
/begin CHARACTERISTIC FaultManager.O2NotActive_BankA.Action_1_Condition "Fault manager configuration.  Select up to 4 actions for each fault." VALUE 0x80003515 RecordLayout_3 0 CompuMethod_108 0 65535 /end CHARACTERISTIC
/begin CHARACTERISTIC FaultManager.O2NotActive_BankA.Action_2 "Fault manager configuration.  Select up to 4 actions for each fault." VALUE 0x80003517 RecordLayout_3 0 CompuMethod_107 0 65535 /end CHARACTERISTIC
/begin CHARACTERISTIC FaultManager.O2NotActive_BankA.Action_2_Condition "Fault manager configuration.  Select up to 4 actions for each fault." VALUE 0x80003519 RecordLayout_3 0 CompuMethod_108 0 65535 /end CHARACTERISTIC
/begin CHARACTERISTIC FaultManager.O2NotActive_BankA.Action_3 "Fault manager configuration.  Select up to 4 actions for each fault." VALUE 0x8000351B RecordLayout_3 0 CompuMethod_107 0 65535 /end CHARACTERISTIC
/begin CHARACTERISTIC FaultManager.O2NotActive_BankA.Action_3_Condition "Fault manager configuration.  Select up to 4 actions for each fault." VALUE 0x8000351D RecordLayout_3 0 CompuMethod_108 0 65535 /end CHARACTERISTIC
/begin CHARACTERISTIC FaultManager.O2NotActive_BankA.Action_4 "Fault manager configuration.  Select up to 4 actions for each fault." VALUE 0x8000351F RecordLayout_3 0 CompuMethod_107 0 65535 /end CHARACTERISTIC
/begin CHARACTERISTIC FaultManager.O2NotActive_BankA.Action_4_Condition "Fault manager configuration.  Select up to 4 actions for each fault." VALUE 0x80003521 RecordLayout_3 0 CompuMethod_108 0 65535 /end CHARACTERISTIC
/begin CHARACTERISTIC FaultManager.O2NotActive_BankB.Mode "Fault manager configuration.  Select up to 4 actions for each fault." VALUE 0x80003523 RecordLayout_3 0 CompuMethod_105 0 65535 /end CHARACTERISTIC
/begin CHARACTERISTIC FaultManager.O2NotActive_BankB.ID "Fault manager configuration.  Select up to 4 actions for each fault." VALUE 0x80003525 RecordLayout_3 0 CompuMethod_1 0 65535 /end CHARACTERISTIC
/begin CHARACTERISTIC FaultManager.O2NotActive_BankB.Test "Fault manager configuration.  Select up to 4 actions for each fault." VALUE 0x80003527 RecordLayout_3 0 CompuMethod_106 0 65535 /end CHARACTERISTIC
/begin CHARACTERISTIC FaultManager.O2NotActive_BankB.Faulty_Samples__X_ "Fault manager configuration.  Select up to 4 actions for each fault." VALUE 0x80003529 RecordLayout_3 0 CompuMethod_1 0 65535 /end CHARACTERISTIC
/begin CHARACTERISTIC FaultManager.O2NotActive_BankB.Total_Samples__Y_ "Fault manager configuration.  Select up to 4 actions for each fault." VALUE 0x8000352B RecordLayout_3 0 CompuMethod_1 0 65535 /end CHARACTERISTIC
/begin CHARACTERISTIC FaultManager.O2NotActive_BankB.Action_1 "Fault manager configuration.  Select up to 4 actions for each fault." VALUE 0x8000352D RecordLayout_3 0 CompuMethod_107 0 65535 /end CHARACTERISTIC
/begin CHARACTERISTIC FaultManager.O2NotActive_BankB.Action_1_Condition "Fault manager configuration.  Select up to 4 actions for each fault." VALUE 0x8000352F RecordLayout_3 0 CompuMethod_108 0 65535 /end CHARACTERISTIC
/begin CHARACTERISTIC FaultManager.O2NotActive_BankB.Action_2 "Fault manager configuration.  Select up to 4 actions for each fault." VALUE 0x80003531 RecordLayout_3 0 CompuMethod_107 0 65535 /end CHARACTERISTIC
/begin CHARACTERISTIC FaultManager.O2NotActive_BankB.Action_2_Condition "Fault manager configuration.  Select up to 4 actions for each fault." VALUE 0x80003533 RecordLayout_3 0 CompuMethod_108 0 65535 /end CHARACTERISTIC
/begin CHARACTERISTIC FaultManager.O2NotActive_BankB.Action_3 "Fault manager configuration.  Select up to 4 actions for each fault." VALUE 0x80003535 RecordLayout_3 0 CompuMethod_107 0 65535 /end CHARACTERISTIC
/begin CHARACTERISTIC FaultManager.O2NotActive_BankB.Action_3_Condition "Fault manager configuration.  Select up to 4 actions for each fault." VALUE 0x80003537 RecordLayout_3 0 CompuMethod_108 0 65535 /end CHARACTERISTIC
/begin CHARACTERISTIC FaultManager.O2NotActive_BankB.Action_4 "Fault manager configuration.  Select up to 4 actions for each fault." VALUE 0x80003539 RecordLayout_3 0 CompuMethod_107 0 65535 /end CHARACTERISTIC
/begin CHARACTERISTIC FaultManager.O2NotActive_BankB.Action_4_Condition "Fault manager configuration.  Select up to 4 actions for each fault." VALUE 0x8000353B RecordLayout_3 0 CompuMethod_108 0 65535 /end CHARACTERISTIC
/begin CHARACTERISTIC FaultManager.OilPresRangeHigh.Mode "Fault manager configuration.  Select up to 4 actions for each fault." VALUE 0x8000353D RecordLayout_3 0 CompuMethod_105 0 65535 /end CHARACTERISTIC
/begin CHARACTERISTIC FaultManager.OilPresRangeHigh.ID "Fault manager configuration.  Select up to 4 actions for each fault." VALUE 0x8000353F RecordLayout_3 0 CompuMethod_1 0 65535 /end CHARACTERISTIC
/begin CHARACTERISTIC FaultManager.OilPresRangeHigh.Test "Fault manager configuration.  Select up to 4 actions for each fault." VALUE 0x80003541 RecordLayout_3 0 CompuMethod_106 0 65535 /end CHARACTERISTIC
/begin CHARACTERISTIC FaultManager.OilPresRangeHigh.Faulty_Samples__X_ "Fault manager configuration.  Select up to 4 actions for each fault." VALUE 0x80003543 RecordLayout_3 0 CompuMethod_1 0 65535 /end CHARACTERISTIC
/begin CHARACTERISTIC FaultManager.OilPresRangeHigh.Total_Samples__Y_ "Fault manager configuration.  Select up to 4 actions for each fault." VALUE 0x80003545 RecordLayout_3 0 CompuMethod_1 0 65535 /end CHARACTERISTIC
/begin CHARACTERISTIC FaultManager.OilPresRangeHigh.Action_1 "Fault manager configuration.  Select up to 4 actions for each fault." VALUE 0x80003547 RecordLayout_3 0 CompuMethod_107 0 65535 /end CHARACTERISTIC
/begin CHARACTERISTIC FaultManager.OilPresRangeHigh.Action_1_Condition "Fault manager configuration.  Select up to 4 actions for each fault." VALUE 0x80003549 RecordLayout_3 0 CompuMethod_108 0 65535 /end CHARACTERISTIC
/begin CHARACTERISTIC FaultManager.OilPresRangeHigh.Action_2 "Fault manager configuration.  Select up to 4 actions for each fault." VALUE 0x8000354B RecordLayout_3 0 CompuMethod_107 0 65535 /end CHARACTERISTIC
/begin CHARACTERISTIC FaultManager.OilPresRangeHigh.Action_2_Condition "Fault manager configuration.  Select up to 4 actions for each fault." VALUE 0x8000354D RecordLayout_3 0 CompuMethod_108 0 65535 /end CHARACTERISTIC
/begin CHARACTERISTIC FaultManager.OilPresRangeHigh.Action_3 "Fault manager configuration.  Select up to 4 actions for each fault." VALUE 0x8000354F RecordLayout_3 0 CompuMethod_107 0 65535 /end CHARACTERISTIC
/begin CHARACTERISTIC FaultManager.OilPresRangeHigh.Action_3_Condition "Fault manager configuration.  Select up to 4 actions for each fault." VALUE 0x80003551 RecordLayout_3 0 CompuMethod_108 0 65535 /end CHARACTERISTIC
/begin CHARACTERISTIC FaultManager.OilPresRangeHigh.Action_4 "Fault manager configuration.  Select up to 4 actions for each fault." VALUE 0x80003553 RecordLayout_3 0 CompuMethod_107 0 65535 /end CHARACTERISTIC
/begin CHARACTERISTIC FaultManager.OilPresRangeHigh.Action_4_Condition "Fault manager configuration.  Select up to 4 actions for each fault." VALUE 0x80003555 RecordLayout_3 0 CompuMethod_108 0 65535 /end CHARACTERISTIC
/begin CHARACTERISTIC FaultManager.OilPresRangeLow.Mode "Fault manager configuration.  Select up to 4 actions for each fault." VALUE 0x80003557 RecordLayout_3 0 CompuMethod_105 0 65535 /end CHARACTERISTIC
/begin CHARACTERISTIC FaultManager.OilPresRangeLow.ID "Fault manager configuration.  Select up to 4 actions for each fault." VALUE 0x80003559 RecordLayout_3 0 CompuMethod_1 0 65535 /end CHARACTERISTIC
/begin CHARACTERISTIC FaultManager.OilPresRangeLow.Test "Fault manager configuration.  Select up to 4 actions for each fault." VALUE 0x8000355B RecordLayout_3 0 CompuMethod_106 0 65535 /end CHARACTERISTIC
/begin CHARACTERISTIC FaultManager.OilPresRangeLow.Faulty_Samples__X_ "Fault manager configuration.  Select up to 4 actions for each fault." VALUE 0x8000355D RecordLayout_3 0 CompuMethod_1 0 65535 /end CHARACTERISTIC
/begin CHARACTERISTIC FaultManager.OilPresRangeLow.Total_Samples__Y_ "Fault manager configuration.  Select up to 4 actions for each fault." VALUE 0x8000355F RecordLayout_3 0 CompuMethod_1 0 65535 /end CHARACTERISTIC
/begin CHARACTERISTIC FaultManager.OilPresRangeLow.Action_1 "Fault manager configuration.  Select up to 4 actions for each fault." VALUE 0x80003561 RecordLayout_3 0 CompuMethod_107 0 65535 /end CHARACTERISTIC
/begin CHARACTERISTIC FaultManager.OilPresRangeLow.Action_1_Condition "Fault manager configuration.  Select up to 4 actions for each fault." VALUE 0x80003563 RecordLayout_3 0 CompuMethod_108 0 65535 /end CHARACTERISTIC
/begin CHARACTERISTIC FaultManager.OilPresRangeLow.Action_2 "Fault manager configuration.  Select up to 4 actions for each fault." VALUE 0x80003565 RecordLayout_3 0 CompuMethod_107 0 65535 /end CHARACTERISTIC
/begin CHARACTERISTIC FaultManager.OilPresRangeLow.Action_2_Condition "Fault manager configuration.  Select up to 4 actions for each fault." VALUE 0x80003567 RecordLayout_3 0 CompuMethod_108 0 65535 /end CHARACTERISTIC
/begin CHARACTERISTIC FaultManager.OilPresRangeLow.Action_3 "Fault manager configuration.  Select up to 4 actions for each fault." VALUE 0x80003569 RecordLayout_3 0 CompuMethod_107 0 65535 /end CHARACTERISTIC
/begin CHARACTERISTIC FaultManager.OilPresRangeLow.Action_3_Condition "Fault manager configuration.  Select up to 4 actions for each fault." VALUE 0x8000356B RecordLayout_3 0 CompuMethod_108 0 65535 /end CHARACTERISTIC
/begin CHARACTERISTIC FaultManager.OilPresRangeLow.Action_4 "Fault manager configuration.  Select up to 4 actions for each fault." VALUE 0x8000356D RecordLayout_3 0 CompuMethod_107 0 65535 /end CHARACTERISTIC
/begin CHARACTERISTIC FaultManager.OilPresRangeLow.Action_4_Condition "Fault manager configuration.  Select up to 4 actions for each fault." VALUE 0x8000356F RecordLayout_3 0 CompuMethod_108 0 65535 /end CHARACTERISTIC
/begin CHARACTERISTIC FaultManager.ScrambleStuckHigh_Fault.Mode "Fault manager configuration.  Select up to 4 actions for each fault." VALUE 0x80003571 RecordLayout_3 0 CompuMethod_105 0 65535 /end CHARACTERISTIC
/begin CHARACTERISTIC FaultManager.ScrambleStuckHigh_Fault.ID "Fault manager configuration.  Select up to 4 actions for each fault." VALUE 0x80003573 RecordLayout_3 0 CompuMethod_1 0 65535 /end CHARACTERISTIC
/begin CHARACTERISTIC FaultManager.ScrambleStuckHigh_Fault.Test "Fault manager configuration.  Select up to 4 actions for each fault." VALUE 0x80003575 RecordLayout_3 0 CompuMethod_106 0 65535 /end CHARACTERISTIC
/begin CHARACTERISTIC FaultManager.ScrambleStuckHigh_Fault.Faulty_Samples__X_ "Fault manager configuration.  Select up to 4 actions for each fault." VALUE 0x80003577 RecordLayout_3 0 CompuMethod_1 0 65535 /end CHARACTERISTIC
/begin CHARACTERISTIC FaultManager.ScrambleStuckHigh_Fault.Total_Samples__Y_ "Fault manager configuration.  Select up to 4 actions for each fault." VALUE 0x80003579 RecordLayout_3 0 CompuMethod_1 0 65535 /end CHARACTERISTIC
/begin CHARACTERISTIC FaultManager.ScrambleStuckHigh_Fault.Action_1 "Fault manager configuration.  Select up to 4 actions for each fault." VALUE 0x8000357B RecordLayout_3 0 CompuMethod_107 0 65535 /end CHARACTERISTIC
/begin CHARACTERISTIC FaultManager.ScrambleStuckHigh_Fault.Action_1_Condition "Fault manager configuration.  Select up to 4 actions for each fault." VALUE 0x8000357D RecordLayout_3 0 CompuMethod_108 0 65535 /end CHARACTERISTIC
/begin CHARACTERISTIC FaultManager.ScrambleStuckHigh_Fault.Action_2 "Fault manager configuration.  Select up to 4 actions for each fault." VALUE 0x8000357F RecordLayout_3 0 CompuMethod_107 0 65535 /end CHARACTERISTIC
/begin CHARACTERISTIC FaultManager.ScrambleStuckHigh_Fault.Action_2_Condition "Fault manager configuration.  Select up to 4 actions for each fault." VALUE 0x80003581 RecordLayout_3 0 CompuMethod_108 0 65535 /end CHARACTERISTIC
/begin CHARACTERISTIC FaultManager.ScrambleStuckHigh_Fault.Action_3 "Fault manager configuration.  Select up to 4 actions for each fault." VALUE 0x80003583 RecordLayout_3 0 CompuMethod_107 0 65535 /end CHARACTERISTIC
/begin CHARACTERISTIC FaultManager.ScrambleStuckHigh_Fault.Action_3_Condition "Fault manager configuration.  Select up to 4 actions for each fault." VALUE 0x80003585 RecordLayout_3 0 CompuMethod_108 0 65535 /end CHARACTERISTIC
/begin CHARACTERISTIC FaultManager.ScrambleStuckHigh_Fault.Action_4 "Fault manager configuration.  Select up to 4 actions for each fault." VALUE 0x80003587 RecordLayout_3 0 CompuMethod_107 0 65535 /end CHARACTERISTIC
/begin CHARACTERISTIC FaultManager.ScrambleStuckHigh_Fault.Action_4_Condition "Fault manager configuration.  Select up to 4 actions for each fault." VALUE 0x80003589 RecordLayout_3 0 CompuMethod_108 0 65535 /end CHARACTERISTIC
/begin CHARACTERISTIC FaultManager.SensVoltRangeHigh.Mode "Fault manager configuration.  Select up to 4 actions for each fault." VALUE 0x8000358B RecordLayout_3 0 CompuMethod_105 0 65535 /end CHARACTERISTIC
/begin CHARACTERISTIC FaultManager.SensVoltRangeHigh.ID "Fault manager configuration.  Select up to 4 actions for each fault." VALUE 0x8000358D RecordLayout_3 0 CompuMethod_1 0 65535 /end CHARACTERISTIC
/begin CHARACTERISTIC FaultManager.SensVoltRangeHigh.Test "Fault manager configuration.  Select up to 4 actions for each fault." VALUE 0x8000358F RecordLayout_3 0 CompuMethod_106 0 65535 /end CHARACTERISTIC
/begin CHARACTERISTIC FaultManager.SensVoltRangeHigh.Faulty_Samples__X_ "Fault manager configuration.  Select up to 4 actions for each fault." VALUE 0x80003591 RecordLayout_3 0 CompuMethod_1 0 65535 /end CHARACTERISTIC
/begin CHARACTERISTIC FaultManager.SensVoltRangeHigh.Total_Samples__Y_ "Fault manager configuration.  Select up to 4 actions for each fault." VALUE 0x80003593 RecordLayout_3 0 CompuMethod_1 0 65535 /end CHARACTERISTIC
/begin CHARACTERISTIC FaultManager.SensVoltRangeHigh.Action_1 "Fault manager configuration.  Select up to 4 actions for each fault." VALUE 0x80003595 RecordLayout_3 0 CompuMethod_107 0 65535 /end CHARACTERISTIC
/begin CHARACTERISTIC FaultManager.SensVoltRangeHigh.Action_1_Condition "Fault manager configuration.  Select up to 4 actions for each fault." VALUE 0x80003597 RecordLayout_3 0 CompuMethod_108 0 65535 /end CHARACTERISTIC
/begin CHARACTERISTIC FaultManager.SensVoltRangeHigh.Action_2 "Fault manager configuration.  Select up to 4 actions for each fault." VALUE 0x80003599 RecordLayout_3 0 CompuMethod_107 0 65535 /end CHARACTERISTIC
/begin CHARACTERISTIC FaultManager.SensVoltRangeHigh.Action_2_Condition "Fault manager configuration.  Select up to 4 actions for each fault." VALUE 0x8000359B RecordLayout_3 0 CompuMethod_108 0 65535 /end CHARACTERISTIC
/begin CHARACTERISTIC FaultManager.SensVoltRangeHigh.Action_3 "Fault manager configuration.  Select up to 4 actions for each fault." VALUE 0x8000359D RecordLayout_3 0 CompuMethod_107 0 65535 /end CHARACTERISTIC
/begin CHARACTERISTIC FaultManager.SensVoltRangeHigh.Action_3_Condition "Fault manager configuration.  Select up to 4 actions for each fault." VALUE 0x8000359F RecordLayout_3 0 CompuMethod_108 0 65535 /end CHARACTERISTIC
/begin CHARACTERISTIC FaultManager.SensVoltRangeHigh.Action_4 "Fault manager configuration.  Select up to 4 actions for each fault." VALUE 0x800035A1 RecordLayout_3 0 CompuMethod_107 0 65535 /end CHARACTERISTIC
/begin CHARACTERISTIC FaultManager.SensVoltRangeHigh.Action_4_Condition "Fault manager configuration.  Select up to 4 actions for each fault." VALUE 0x800035A3 RecordLayout_3 0 CompuMethod_108 0 65535 /end CHARACTERISTIC
/begin CHARACTERISTIC FaultManager.SensVoltRangeLow.Mode "Fault manager configuration.  Select up to 4 actions for each fault." VALUE 0x800035A5 RecordLayout_3 0 CompuMethod_105 0 65535 /end CHARACTERISTIC
/begin CHARACTERISTIC FaultManager.SensVoltRangeLow.ID "Fault manager configuration.  Select up to 4 actions for each fault." VALUE 0x800035A7 RecordLayout_3 0 CompuMethod_1 0 65535 /end CHARACTERISTIC
/begin CHARACTERISTIC FaultManager.SensVoltRangeLow.Test "Fault manager configuration.  Select up to 4 actions for each fault." VALUE 0x800035A9 RecordLayout_3 0 CompuMethod_106 0 65535 /end CHARACTERISTIC
/begin CHARACTERISTIC FaultManager.SensVoltRangeLow.Faulty_Samples__X_ "Fault manager configuration.  Select up to 4 actions for each fault." VALUE 0x800035AB RecordLayout_3 0 CompuMethod_1 0 65535 /end CHARACTERISTIC
/begin CHARACTERISTIC FaultManager.SensVoltRangeLow.Total_Samples__Y_ "Fault manager configuration.  Select up to 4 actions for each fault." VALUE 0x800035AD RecordLayout_3 0 CompuMethod_1 0 65535 /end CHARACTERISTIC
/begin CHARACTERISTIC FaultManager.SensVoltRangeLow.Action_1 "Fault manager configuration.  Select up to 4 actions for each fault." VALUE 0x800035AF RecordLayout_3 0 CompuMethod_107 0 65535 /end CHARACTERISTIC
/begin CHARACTERISTIC FaultManager.SensVoltRangeLow.Action_1_Condition "Fault manager configuration.  Select up to 4 actions for each fault." VALUE 0x800035B1 RecordLayout_3 0 CompuMethod_108 0 65535 /end CHARACTERISTIC
/begin CHARACTERISTIC FaultManager.SensVoltRangeLow.Action_2 "Fault manager configuration.  Select up to 4 actions for each fault." VALUE 0x800035B3 RecordLayout_3 0 CompuMethod_107 0 65535 /end CHARACTERISTIC
/begin CHARACTERISTIC FaultManager.SensVoltRangeLow.Action_2_Condition "Fault manager configuration.  Select up to 4 actions for each fault." VALUE 0x800035B5 RecordLayout_3 0 CompuMethod_108 0 65535 /end CHARACTERISTIC
/begin CHARACTERISTIC FaultManager.SensVoltRangeLow.Action_3 "Fault manager configuration.  Select up to 4 actions for each fault." VALUE 0x800035B7 RecordLayout_3 0 CompuMethod_107 0 65535 /end CHARACTERISTIC
/begin CHARACTERISTIC FaultManager.SensVoltRangeLow.Action_3_Condition "Fault manager configuration.  Select up to 4 actions for each fault." VALUE 0x800035B9 RecordLayout_3 0 CompuMethod_108 0 65535 /end CHARACTERISTIC
/begin CHARACTERISTIC FaultManager.SensVoltRangeLow.Action_4 "Fault manager configuration.  Select up to 4 actions for each fault." VALUE 0x800035BB RecordLayout_3 0 CompuMethod_107 0 65535 /end CHARACTERISTIC
/begin CHARACTERISTIC FaultManager.SensVoltRangeLow.Action_4_Condition "Fault manager configuration.  Select up to 4 actions for each fault." VALUE 0x800035BD RecordLayout_3 0 CompuMethod_108 0 65535 /end CHARACTERISTIC
/begin CHARACTERISTIC FaultManager.SoftOverBoost_Fault.Mode "Fault manager configuration.  Select up to 4 actions for each fault." VALUE 0x800035BF RecordLayout_3 0 CompuMethod_105 0 65535 /end CHARACTERISTIC
/begin CHARACTERISTIC FaultManager.SoftOverBoost_Fault.ID "Fault manager configuration.  Select up to 4 actions for each fault." VALUE 0x800035C1 RecordLayout_3 0 CompuMethod_1 0 65535 /end CHARACTERISTIC
/begin CHARACTERISTIC FaultManager.SoftOverBoost_Fault.Test "Fault manager configuration.  Select up to 4 actions for each fault." VALUE 0x800035C3 RecordLayout_3 0 CompuMethod_106 0 65535 /end CHARACTERISTIC
/begin CHARACTERISTIC FaultManager.SoftOverBoost_Fault.Faulty_Samples__X_ "Fault manager configuration.  Select up to 4 actions for each fault." VALUE 0x800035C5 RecordLayout_3 0 CompuMethod_1 0 65535 /end CHARACTERISTIC
/begin CHARACTERISTIC FaultManager.SoftOverBoost_Fault.Total_Samples__Y_ "Fault manager configuration.  Select up to 4 actions for each fault." VALUE 0x800035C7 RecordLayout_3 0 CompuMethod_1 0 65535 /end CHARACTERISTIC
/begin CHARACTERISTIC FaultManager.SoftOverBoost_Fault.Action_1 "Fault manager configuration.  Select up to 4 actions for each fault." VALUE 0x800035C9 RecordLayout_3 0 CompuMethod_107 0 65535 /end CHARACTERISTIC
/begin CHARACTERISTIC FaultManager.SoftOverBoost_Fault.Action_1_Condition "Fault manager configuration.  Select up to 4 actions for each fault." VALUE 0x800035CB RecordLayout_3 0 CompuMethod_108 0 65535 /end CHARACTERISTIC
/begin CHARACTERISTIC FaultManager.SoftOverBoost_Fault.Action_2 "Fault manager configuration.  Select up to 4 actions for each fault." VALUE 0x800035CD RecordLayout_3 0 CompuMethod_107 0 65535 /end CHARACTERISTIC
/begin CHARACTERISTIC FaultManager.SoftOverBoost_Fault.Action_2_Condition "Fault manager configuration.  Select up to 4 actions for each fault." VALUE 0x800035CF RecordLayout_3 0 CompuMethod_108 0 65535 /end CHARACTERISTIC
/begin CHARACTERISTIC FaultManager.SoftOverBoost_Fault.Action_3 "Fault manager configuration.  Select up to 4 actions for each fault." VALUE 0x800035D1 RecordLayout_3 0 CompuMethod_107 0 65535 /end CHARACTERISTIC
/begin CHARACTERISTIC FaultManager.SoftOverBoost_Fault.Action_3_Condition "Fault manager configuration.  Select up to 4 actions for each fault." VALUE 0x800035D3 RecordLayout_3 0 CompuMethod_108 0 65535 /end CHARACTERISTIC
/begin CHARACTERISTIC FaultManager.SoftOverBoost_Fault.Action_4 "Fault manager configuration.  Select up to 4 actions for each fault." VALUE 0x800035D5 RecordLayout_3 0 CompuMethod_107 0 65535 /end CHARACTERISTIC
/begin CHARACTERISTIC FaultManager.SoftOverBoost_Fault.Action_4_Condition "Fault manager configuration.  Select up to 4 actions for each fault." VALUE 0x800035D7 RecordLayout_3 0 CompuMethod_108 0 65535 /end CHARACTERISTIC
/begin CHARACTERISTIC FaultManager.SoftOverspeed.Mode "Fault manager configuration.  Select up to 4 actions for each fault." VALUE 0x800035D9 RecordLayout_3 0 CompuMethod_105 0 65535 /end CHARACTERISTIC
/begin CHARACTERISTIC FaultManager.SoftOverspeed.ID "Fault manager configuration.  Select up to 4 actions for each fault." VALUE 0x800035DB RecordLayout_3 0 CompuMethod_1 0 65535 /end CHARACTERISTIC
/begin CHARACTERISTIC FaultManager.SoftOverspeed.Test "Fault manager configuration.  Select up to 4 actions for each fault." VALUE 0x800035DD RecordLayout_3 0 CompuMethod_106 0 65535 /end CHARACTERISTIC
/begin CHARACTERISTIC FaultManager.SoftOverspeed.Faulty_Samples__X_ "Fault manager configuration.  Select up to 4 actions for each fault." VALUE 0x800035DF RecordLayout_3 0 CompuMethod_1 0 65535 /end CHARACTERISTIC
/begin CHARACTERISTIC FaultManager.SoftOverspeed.Total_Samples__Y_ "Fault manager configuration.  Select up to 4 actions for each fault." VALUE 0x800035E1 RecordLayout_3 0 CompuMethod_1 0 65535 /end CHARACTERISTIC
/begin CHARACTERISTIC FaultManager.SoftOverspeed.Action_1 "Fault manager configuration.  Select up to 4 actions for each fault." VALUE 0x800035E3 RecordLayout_3 0 CompuMethod_107 0 65535 /end CHARACTERISTIC
/begin CHARACTERISTIC FaultManager.SoftOverspeed.Action_1_Condition "Fault manager configuration.  Select up to 4 actions for each fault." VALUE 0x800035E5 RecordLayout_3 0 CompuMethod_108 0 65535 /end CHARACTERISTIC
/begin CHARACTERISTIC FaultManager.SoftOverspeed.Action_2 "Fault manager configuration.  Select up to 4 actions for each fault." VALUE 0x800035E7 RecordLayout_3 0 CompuMethod_107 0 65535 /end CHARACTERISTIC
/begin CHARACTERISTIC FaultManager.SoftOverspeed.Action_2_Condition "Fault manager configuration.  Select up to 4 actions for each fault." VALUE 0x800035E9 RecordLayout_3 0 CompuMethod_108 0 65535 /end CHARACTERISTIC
/begin CHARACTERISTIC FaultManager.SoftOverspeed.Action_3 "Fault manager configuration.  Select up to 4 actions for each fault." VALUE 0x800035EB RecordLayout_3 0 CompuMethod_107 0 65535 /end CHARACTERISTIC
/begin CHARACTERISTIC FaultManager.SoftOverspeed.Action_3_Condition "Fault manager configuration.  Select up to 4 actions for each fault." VALUE 0x800035ED RecordLayout_3 0 CompuMethod_108 0 65535 /end CHARACTERISTIC
/begin CHARACTERISTIC FaultManager.SoftOverspeed.Action_4 "Fault manager configuration.  Select up to 4 actions for each fault." VALUE 0x800035EF RecordLayout_3 0 CompuMethod_107 0 65535 /end CHARACTERISTIC
/begin CHARACTERISTIC FaultManager.SoftOverspeed.Action_4_Condition "Fault manager configuration.  Select up to 4 actions for each fault." VALUE 0x800035F1 RecordLayout_3 0 CompuMethod_108 0 65535 /end CHARACTERISTIC
/begin CHARACTERISTIC FaultManager.SysVoltRangeHigh.Mode "Fault manager configuration.  Select up to 4 actions for each fault." VALUE 0x800035F3 RecordLayout_3 0 CompuMethod_105 0 65535 /end CHARACTERISTIC
/begin CHARACTERISTIC FaultManager.SysVoltRangeHigh.ID "Fault manager configuration.  Select up to 4 actions for each fault." VALUE 0x800035F5 RecordLayout_3 0 CompuMethod_1 0 65535 /end CHARACTERISTIC
/begin CHARACTERISTIC FaultManager.SysVoltRangeHigh.Test "Fault manager configuration.  Select up to 4 actions for each fault." VALUE 0x800035F7 RecordLayout_3 0 CompuMethod_106 0 65535 /end CHARACTERISTIC
/begin CHARACTERISTIC FaultManager.SysVoltRangeHigh.Faulty_Samples__X_ "Fault manager configuration.  Select up to 4 actions for each fault." VALUE 0x800035F9 RecordLayout_3 0 CompuMethod_1 0 65535 /end CHARACTERISTIC
/begin CHARACTERISTIC FaultManager.SysVoltRangeHigh.Total_Samples__Y_ "Fault manager configuration.  Select up to 4 actions for each fault." VALUE 0x800035FB RecordLayout_3 0 CompuMethod_1 0 65535 /end CHARACTERISTIC
/begin CHARACTERISTIC FaultManager.SysVoltRangeHigh.Action_1 "Fault manager configuration.  Select up to 4 actions for each fault." VALUE 0x800035FD RecordLayout_3 0 CompuMethod_107 0 65535 /end CHARACTERISTIC
/begin CHARACTERISTIC FaultManager.SysVoltRangeHigh.Action_1_Condition "Fault manager configuration.  Select up to 4 actions for each fault." VALUE 0x800035FF RecordLayout_3 0 CompuMethod_108 0 65535 /end CHARACTERISTIC
/begin CHARACTERISTIC FaultManager.SysVoltRangeHigh.Action_2 "Fault manager configuration.  Select up to 4 actions for each fault." VALUE 0x80003601 RecordLayout_3 0 CompuMethod_107 0 65535 /end CHARACTERISTIC
/begin CHARACTERISTIC FaultManager.SysVoltRangeHigh.Action_2_Condition "Fault manager configuration.  Select up to 4 actions for each fault." VALUE 0x80003603 RecordLayout_3 0 CompuMethod_108 0 65535 /end CHARACTERISTIC
/begin CHARACTERISTIC FaultManager.SysVoltRangeHigh.Action_3 "Fault manager configuration.  Select up to 4 actions for each fault." VALUE 0x80003605 RecordLayout_3 0 CompuMethod_107 0 65535 /end CHARACTERISTIC
/begin CHARACTERISTIC FaultManager.SysVoltRangeHigh.Action_3_Condition "Fault manager configuration.  Select up to 4 actions for each fault." VALUE 0x80003607 RecordLayout_3 0 CompuMethod_108 0 65535 /end CHARACTERISTIC
/begin CHARACTERISTIC FaultManager.SysVoltRangeHigh.Action_4 "Fault manager configuration.  Select up to 4 actions for each fault." VALUE 0x80003609 RecordLayout_3 0 CompuMethod_107 0 65535 /end CHARACTERISTIC
/begin CHARACTERISTIC FaultManager.SysVoltRangeHigh.Action_4_Condition "Fault manager configuration.  Select up to 4 actions for each fault." VALUE 0x8000360B RecordLayout_3 0 CompuMethod_108 0 65535 /end CHARACTERISTIC
/begin CHARACTERISTIC FaultManager.SysVoltRangeLow.Mode "Fault manager configuration.  Select up to 4 actions for each fault." VALUE 0x8000360D RecordLayout_3 0 CompuMethod_105 0 65535 /end CHARACTERISTIC
/begin CHARACTERISTIC FaultManager.SysVoltRangeLow.ID "Fault manager configuration.  Select up to 4 actions for each fault." VALUE 0x8000360F RecordLayout_3 0 CompuMethod_1 0 65535 /end CHARACTERISTIC
/begin CHARACTERISTIC FaultManager.SysVoltRangeLow.Test "Fault manager configuration.  Select up to 4 actions for each fault." VALUE 0x80003611 RecordLayout_3 0 CompuMethod_106 0 65535 /end CHARACTERISTIC
/begin CHARACTERISTIC FaultManager.SysVoltRangeLow.Faulty_Samples__X_ "Fault manager configuration.  Select up to 4 actions for each fault." VALUE 0x80003613 RecordLayout_3 0 CompuMethod_1 0 65535 /end CHARACTERISTIC
/begin CHARACTERISTIC FaultManager.SysVoltRangeLow.Total_Samples__Y_ "Fault manager configuration.  Select up to 4 actions for each fault." VALUE 0x80003615 RecordLayout_3 0 CompuMethod_1 0 65535 /end CHARACTERISTIC
/begin CHARACTERISTIC FaultManager.SysVoltRangeLow.Action_1 "Fault manager configuration.  Select up to 4 actions for each fault." VALUE 0x80003617 RecordLayout_3 0 CompuMethod_107 0 65535 /end CHARACTERISTIC
/begin CHARACTERISTIC FaultManager.SysVoltRangeLow.Action_1_Condition "Fault manager configuration.  Select up to 4 actions for each fault." VALUE 0x80003619 RecordLayout_3 0 CompuMethod_108 0 65535 /end CHARACTERISTIC
/begin CHARACTERISTIC FaultManager.SysVoltRangeLow.Action_2 "Fault manager configuration.  Select up to 4 actions for each fault." VALUE 0x8000361B RecordLayout_3 0 CompuMethod_107 0 65535 /end CHARACTERISTIC
/begin CHARACTERISTIC FaultManager.SysVoltRangeLow.Action_2_Condition "Fault manager configuration.  Select up to 4 actions for each fault." VALUE 0x8000361D RecordLayout_3 0 CompuMethod_108 0 65535 /end CHARACTERISTIC
/begin CHARACTERISTIC FaultManager.SysVoltRangeLow.Action_3 "Fault manager configuration.  Select up to 4 actions for each fault." VALUE 0x8000361F RecordLayout_3 0 CompuMethod_107 0 65535 /end CHARACTERISTIC
/begin CHARACTERISTIC FaultManager.SysVoltRangeLow.Action_3_Condition "Fault manager configuration.  Select up to 4 actions for each fault." VALUE 0x80003621 RecordLayout_3 0 CompuMethod_108 0 65535 /end CHARACTERISTIC
/begin CHARACTERISTIC FaultManager.SysVoltRangeLow.Action_4 "Fault manager configuration.  Select up to 4 actions for each fault." VALUE 0x80003623 RecordLayout_3 0 CompuMethod_107 0 65535 /end CHARACTERISTIC
/begin CHARACTERISTIC FaultManager.SysVoltRangeLow.Action_4_Condition "Fault manager configuration.  Select up to 4 actions for each fault." VALUE 0x80003625 RecordLayout_3 0 CompuMethod_108 0 65535 /end CHARACTERISTIC
/begin CHARACTERISTIC FaultManager.TPS1AdaptHiMax.Mode "Fault manager configuration.  Select up to 4 actions for each fault." VALUE 0x80003627 RecordLayout_3 0 CompuMethod_105 0 65535 /end CHARACTERISTIC
/begin CHARACTERISTIC FaultManager.TPS1AdaptHiMax.ID "Fault manager configuration.  Select up to 4 actions for each fault." VALUE 0x80003629 RecordLayout_3 0 CompuMethod_1 0 65535 /end CHARACTERISTIC
/begin CHARACTERISTIC FaultManager.TPS1AdaptHiMax.Test "Fault manager configuration.  Select up to 4 actions for each fault." VALUE 0x8000362B RecordLayout_3 0 CompuMethod_106 0 65535 /end CHARACTERISTIC
/begin CHARACTERISTIC FaultManager.TPS1AdaptHiMax.Faulty_Samples__X_ "Fault manager configuration.  Select up to 4 actions for each fault." VALUE 0x8000362D RecordLayout_3 0 CompuMethod_1 0 65535 /end CHARACTERISTIC
/begin CHARACTERISTIC FaultManager.TPS1AdaptHiMax.Total_Samples__Y_ "Fault manager configuration.  Select up to 4 actions for each fault." VALUE 0x8000362F RecordLayout_3 0 CompuMethod_1 0 65535 /end CHARACTERISTIC
/begin CHARACTERISTIC FaultManager.TPS1AdaptHiMax.Action_1 "Fault manager configuration.  Select up to 4 actions for each fault." VALUE 0x80003631 RecordLayout_3 0 CompuMethod_107 0 65535 /end CHARACTERISTIC
/begin CHARACTERISTIC FaultManager.TPS1AdaptHiMax.Action_1_Condition "Fault manager configuration.  Select up to 4 actions for each fault." VALUE 0x80003633 RecordLayout_3 0 CompuMethod_108 0 65535 /end CHARACTERISTIC
/begin CHARACTERISTIC FaultManager.TPS1AdaptHiMax.Action_2 "Fault manager configuration.  Select up to 4 actions for each fault." VALUE 0x80003635 RecordLayout_3 0 CompuMethod_107 0 65535 /end CHARACTERISTIC
/begin CHARACTERISTIC FaultManager.TPS1AdaptHiMax.Action_2_Condition "Fault manager configuration.  Select up to 4 actions for each fault." VALUE 0x80003637 RecordLayout_3 0 CompuMethod_108 0 65535 /end CHARACTERISTIC
/begin CHARACTERISTIC FaultManager.TPS1AdaptHiMax.Action_3 "Fault manager configuration.  Select up to 4 actions for each fault." VALUE 0x80003639 RecordLayout_3 0 CompuMethod_107 0 65535 /end CHARACTERISTIC
/begin CHARACTERISTIC FaultManager.TPS1AdaptHiMax.Action_3_Condition "Fault manager configuration.  Select up to 4 actions for each fault." VALUE 0x8000363B RecordLayout_3 0 CompuMethod_108 0 65535 /end CHARACTERISTIC
/begin CHARACTERISTIC FaultManager.TPS1AdaptHiMax.Action_4 "Fault manager configuration.  Select up to 4 actions for each fault." VALUE 0x8000363D RecordLayout_3 0 CompuMethod_107 0 65535 /end CHARACTERISTIC
/begin CHARACTERISTIC FaultManager.TPS1AdaptHiMax.Action_4_Condition "Fault manager configuration.  Select up to 4 actions for each fault." VALUE 0x8000363F RecordLayout_3 0 CompuMethod_108 0 65535 /end CHARACTERISTIC
/begin CHARACTERISTIC FaultManager.TPS1AdaptHiMin.Mode "Fault manager configuration.  Select up to 4 actions for each fault." VALUE 0x80003641 RecordLayout_3 0 CompuMethod_105 0 65535 /end CHARACTERISTIC
/begin CHARACTERISTIC FaultManager.TPS1AdaptHiMin.ID "Fault manager configuration.  Select up to 4 actions for each fault." VALUE 0x80003643 RecordLayout_3 0 CompuMethod_1 0 65535 /end CHARACTERISTIC
/begin CHARACTERISTIC FaultManager.TPS1AdaptHiMin.Test "Fault manager configuration.  Select up to 4 actions for each fault." VALUE 0x80003645 RecordLayout_3 0 CompuMethod_106 0 65535 /end CHARACTERISTIC
/begin CHARACTERISTIC FaultManager.TPS1AdaptHiMin.Faulty_Samples__X_ "Fault manager configuration.  Select up to 4 actions for each fault." VALUE 0x80003647 RecordLayout_3 0 CompuMethod_1 0 65535 /end CHARACTERISTIC
/begin CHARACTERISTIC FaultManager.TPS1AdaptHiMin.Total_Samples__Y_ "Fault manager configuration.  Select up to 4 actions for each fault." VALUE 0x80003649 RecordLayout_3 0 CompuMethod_1 0 65535 /end CHARACTERISTIC
/begin CHARACTERISTIC FaultManager.TPS1AdaptHiMin.Action_1 "Fault manager configuration.  Select up to 4 actions for each fault." VALUE 0x8000364B RecordLayout_3 0 CompuMethod_107 0 65535 /end CHARACTERISTIC
/begin CHARACTERISTIC FaultManager.TPS1AdaptHiMin.Action_1_Condition "Fault manager configuration.  Select up to 4 actions for each fault." VALUE 0x8000364D RecordLayout_3 0 CompuMethod_108 0 65535 /end CHARACTERISTIC
/begin CHARACTERISTIC FaultManager.TPS1AdaptHiMin.Action_2 "Fault manager configuration.  Select up to 4 actions for each fault." VALUE 0x8000364F RecordLayout_3 0 CompuMethod_107 0 65535 /end CHARACTERISTIC
/begin CHARACTERISTIC FaultManager.TPS1AdaptHiMin.Action_2_Condition "Fault manager configuration.  Select up to 4 actions for each fault." VALUE 0x80003651 RecordLayout_3 0 CompuMethod_108 0 65535 /end CHARACTERISTIC
/begin CHARACTERISTIC FaultManager.TPS1AdaptHiMin.Action_3 "Fault manager configuration.  Select up to 4 actions for each fault." VALUE 0x80003653 RecordLayout_3 0 CompuMethod_107 0 65535 /end CHARACTERISTIC
/begin CHARACTERISTIC FaultManager.TPS1AdaptHiMin.Action_3_Condition "Fault manager configuration.  Select up to 4 actions for each fault." VALUE 0x80003655 RecordLayout_3 0 CompuMethod_108 0 65535 /end CHARACTERISTIC
/begin CHARACTERISTIC FaultManager.TPS1AdaptHiMin.Action_4 "Fault manager configuration.  Select up to 4 actions for each fault." VALUE 0x80003657 RecordLayout_3 0 CompuMethod_107 0 65535 /end CHARACTERISTIC
/begin CHARACTERISTIC FaultManager.TPS1AdaptHiMin.Action_4_Condition "Fault manager configuration.  Select up to 4 actions for each fault." VALUE 0x80003659 RecordLayout_3 0 CompuMethod_108 0 65535 /end CHARACTERISTIC
/begin CHARACTERISTIC FaultManager.TPS1AdaptLoMax.Mode "Fault manager configuration.  Select up to 4 actions for each fault." VALUE 0x8000365B RecordLayout_3 0 CompuMethod_105 0 65535 /end CHARACTERISTIC
/begin CHARACTERISTIC FaultManager.TPS1AdaptLoMax.ID "Fault manager configuration.  Select up to 4 actions for each fault." VALUE 0x8000365D RecordLayout_3 0 CompuMethod_1 0 65535 /end CHARACTERISTIC
/begin CHARACTERISTIC FaultManager.TPS1AdaptLoMax.Test "Fault manager configuration.  Select up to 4 actions for each fault." VALUE 0x8000365F RecordLayout_3 0 CompuMethod_106 0 65535 /end CHARACTERISTIC
/begin CHARACTERISTIC FaultManager.TPS1AdaptLoMax.Faulty_Samples__X_ "Fault manager configuration.  Select up to 4 actions for each fault." VALUE 0x80003661 RecordLayout_3 0 CompuMethod_1 0 65535 /end CHARACTERISTIC
/begin CHARACTERISTIC FaultManager.TPS1AdaptLoMax.Total_Samples__Y_ "Fault manager configuration.  Select up to 4 actions for each fault." VALUE 0x80003663 RecordLayout_3 0 CompuMethod_1 0 65535 /end CHARACTERISTIC
/begin CHARACTERISTIC FaultManager.TPS1AdaptLoMax.Action_1 "Fault manager configuration.  Select up to 4 actions for each fault." VALUE 0x80003665 RecordLayout_3 0 CompuMethod_107 0 65535 /end CHARACTERISTIC
/begin CHARACTERISTIC FaultManager.TPS1AdaptLoMax.Action_1_Condition "Fault manager configuration.  Select up to 4 actions for each fault." VALUE 0x80003667 RecordLayout_3 0 CompuMethod_108 0 65535 /end CHARACTERISTIC
/begin CHARACTERISTIC FaultManager.TPS1AdaptLoMax.Action_2 "Fault manager configuration.  Select up to 4 actions for each fault." VALUE 0x80003669 RecordLayout_3 0 CompuMethod_107 0 65535 /end CHARACTERISTIC
/begin CHARACTERISTIC FaultManager.TPS1AdaptLoMax.Action_2_Condition "Fault manager configuration.  Select up to 4 actions for each fault." VALUE 0x8000366B RecordLayout_3 0 CompuMethod_108 0 65535 /end CHARACTERISTIC
/begin CHARACTERISTIC FaultManager.TPS1AdaptLoMax.Action_3 "Fault manager configuration.  Select up to 4 actions for each fault." VALUE 0x8000366D RecordLayout_3 0 CompuMethod_107 0 65535 /end CHARACTERISTIC
/begin CHARACTERISTIC FaultManager.TPS1AdaptLoMax.Action_3_Condition "Fault manager configuration.  Select up to 4 actions for each fault." VALUE 0x8000366F RecordLayout_3 0 CompuMethod_108 0 65535 /end CHARACTERISTIC
/begin CHARACTERISTIC FaultManager.TPS1AdaptLoMax.Action_4 "Fault manager configuration.  Select up to 4 actions for each fault." VALUE 0x80003671 RecordLayout_3 0 CompuMethod_107 0 65535 /end CHARACTERISTIC
/begin CHARACTERISTIC FaultManager.TPS1AdaptLoMax.Action_4_Condition "Fault manager configuration.  Select up to 4 actions for each fault." VALUE 0x80003673 RecordLayout_3 0 CompuMethod_108 0 65535 /end CHARACTERISTIC
/begin CHARACTERISTIC FaultManager.TPS1AdaptLoMin.Mode "Fault manager configuration.  Select up to 4 actions for each fault." VALUE 0x80003675 RecordLayout_3 0 CompuMethod_105 0 65535 /end CHARACTERISTIC
/begin CHARACTERISTIC FaultManager.TPS1AdaptLoMin.ID "Fault manager configuration.  Select up to 4 actions for each fault." VALUE 0x80003677 RecordLayout_3 0 CompuMethod_1 0 65535 /end CHARACTERISTIC
/begin CHARACTERISTIC FaultManager.TPS1AdaptLoMin.Test "Fault manager configuration.  Select up to 4 actions for each fault." VALUE 0x80003679 RecordLayout_3 0 CompuMethod_106 0 65535 /end CHARACTERISTIC
/begin CHARACTERISTIC FaultManager.TPS1AdaptLoMin.Faulty_Samples__X_ "Fault manager configuration.  Select up to 4 actions for each fault." VALUE 0x8000367B RecordLayout_3 0 CompuMethod_1 0 65535 /end CHARACTERISTIC
/begin CHARACTERISTIC FaultManager.TPS1AdaptLoMin.Total_Samples__Y_ "Fault manager configuration.  Select up to 4 actions for each fault." VALUE 0x8000367D RecordLayout_3 0 CompuMethod_1 0 65535 /end CHARACTERISTIC
/begin CHARACTERISTIC FaultManager.TPS1AdaptLoMin.Action_1 "Fault manager configuration.  Select up to 4 actions for each fault." VALUE 0x8000367F RecordLayout_3 0 CompuMethod_107 0 65535 /end CHARACTERISTIC
/begin CHARACTERISTIC FaultManager.TPS1AdaptLoMin.Action_1_Condition "Fault manager configuration.  Select up to 4 actions for each fault." VALUE 0x80003681 RecordLayout_3 0 CompuMethod_108 0 65535 /end CHARACTERISTIC
/begin CHARACTERISTIC FaultManager.TPS1AdaptLoMin.Action_2 "Fault manager configuration.  Select up to 4 actions for each fault." VALUE 0x80003683 RecordLayout_3 0 CompuMethod_107 0 65535 /end CHARACTERISTIC
/begin CHARACTERISTIC FaultManager.TPS1AdaptLoMin.Action_2_Condition "Fault manager configuration.  Select up to 4 actions for each fault." VALUE 0x80003685 RecordLayout_3 0 CompuMethod_108 0 65535 /end CHARACTERISTIC
/begin CHARACTERISTIC FaultManager.TPS1AdaptLoMin.Action_3 "Fault manager configuration.  Select up to 4 actions for each fault." VALUE 0x80003687 RecordLayout_3 0 CompuMethod_107 0 65535 /end CHARACTERISTIC
/begin CHARACTERISTIC FaultManager.TPS1AdaptLoMin.Action_3_Condition "Fault manager configuration.  Select up to 4 actions for each fault." VALUE 0x80003689 RecordLayout_3 0 CompuMethod_108 0 65535 /end CHARACTERISTIC
/begin CHARACTERISTIC FaultManager.TPS1AdaptLoMin.Action_4 "Fault manager configuration.  Select up to 4 actions for each fault." VALUE 0x8000368B RecordLayout_3 0 CompuMethod_107 0 65535 /end CHARACTERISTIC
/begin CHARACTERISTIC FaultManager.TPS1AdaptLoMin.Action_4_Condition "Fault manager configuration.  Select up to 4 actions for each fault." VALUE 0x8000368D RecordLayout_3 0 CompuMethod_108 0 65535 /end CHARACTERISTIC
/begin CHARACTERISTIC FaultManager.TPS1RangeHigh.Mode "Fault manager configuration.  Select up to 4 actions for each fault." VALUE 0x8000368F RecordLayout_3 0 CompuMethod_105 0 65535 /end CHARACTERISTIC
/begin CHARACTERISTIC FaultManager.TPS1RangeHigh.ID "Fault manager configuration.  Select up to 4 actions for each fault." VALUE 0x80003691 RecordLayout_3 0 CompuMethod_1 0 65535 /end CHARACTERISTIC
/begin CHARACTERISTIC FaultManager.TPS1RangeHigh.Test "Fault manager configuration.  Select up to 4 actions for each fault." VALUE 0x80003693 RecordLayout_3 0 CompuMethod_106 0 65535 /end CHARACTERISTIC
/begin CHARACTERISTIC FaultManager.TPS1RangeHigh.Faulty_Samples__X_ "Fault manager configuration.  Select up to 4 actions for each fault." VALUE 0x80003695 RecordLayout_3 0 CompuMethod_1 0 65535 /end CHARACTERISTIC
/begin CHARACTERISTIC FaultManager.TPS1RangeHigh.Total_Samples__Y_ "Fault manager configuration.  Select up to 4 actions for each fault." VALUE 0x80003697 RecordLayout_3 0 CompuMethod_1 0 65535 /end CHARACTERISTIC
/begin CHARACTERISTIC FaultManager.TPS1RangeHigh.Action_1 "Fault manager configuration.  Select up to 4 actions for each fault." VALUE 0x80003699 RecordLayout_3 0 CompuMethod_107 0 65535 /end CHARACTERISTIC
/begin CHARACTERISTIC FaultManager.TPS1RangeHigh.Action_1_Condition "Fault manager configuration.  Select up to 4 actions for each fault." VALUE 0x8000369B RecordLayout_3 0 CompuMethod_108 0 65535 /end CHARACTERISTIC
/begin CHARACTERISTIC FaultManager.TPS1RangeHigh.Action_2 "Fault manager configuration.  Select up to 4 actions for each fault." VALUE 0x8000369D RecordLayout_3 0 CompuMethod_107 0 65535 /end CHARACTERISTIC
/begin CHARACTERISTIC FaultManager.TPS1RangeHigh.Action_2_Condition "Fault manager configuration.  Select up to 4 actions for each fault." VALUE 0x8000369F RecordLayout_3 0 CompuMethod_108 0 65535 /end CHARACTERISTIC
/begin CHARACTERISTIC FaultManager.TPS1RangeHigh.Action_3 "Fault manager configuration.  Select up to 4 actions for each fault." VALUE 0x800036A1 RecordLayout_3 0 CompuMethod_107 0 65535 /end CHARACTERISTIC
/begin CHARACTERISTIC FaultManager.TPS1RangeHigh.Action_3_Condition "Fault manager configuration.  Select up to 4 actions for each fault." VALUE 0x800036A3 RecordLayout_3 0 CompuMethod_108 0 65535 /end CHARACTERISTIC
/begin CHARACTERISTIC FaultManager.TPS1RangeHigh.Action_4 "Fault manager configuration.  Select up to 4 actions for each fault." VALUE 0x800036A5 RecordLayout_3 0 CompuMethod_107 0 65535 /end CHARACTERISTIC
/begin CHARACTERISTIC FaultManager.TPS1RangeHigh.Action_4_Condition "Fault manager configuration.  Select up to 4 actions for each fault." VALUE 0x800036A7 RecordLayout_3 0 CompuMethod_108 0 65535 /end CHARACTERISTIC
/begin CHARACTERISTIC FaultManager.TPS1RangeLow.Mode "Fault manager configuration.  Select up to 4 actions for each fault." VALUE 0x800036A9 RecordLayout_3 0 CompuMethod_105 0 65535 /end CHARACTERISTIC
/begin CHARACTERISTIC FaultManager.TPS1RangeLow.ID "Fault manager configuration.  Select up to 4 actions for each fault." VALUE 0x800036AB RecordLayout_3 0 CompuMethod_1 0 65535 /end CHARACTERISTIC
/begin CHARACTERISTIC FaultManager.TPS1RangeLow.Test "Fault manager configuration.  Select up to 4 actions for each fault." VALUE 0x800036AD RecordLayout_3 0 CompuMethod_106 0 65535 /end CHARACTERISTIC
/begin CHARACTERISTIC FaultManager.TPS1RangeLow.Faulty_Samples__X_ "Fault manager configuration.  Select up to 4 actions for each fault." VALUE 0x800036AF RecordLayout_3 0 CompuMethod_1 0 65535 /end CHARACTERISTIC
/begin CHARACTERISTIC FaultManager.TPS1RangeLow.Total_Samples__Y_ "Fault manager configuration.  Select up to 4 actions for each fault." VALUE 0x800036B1 RecordLayout_3 0 CompuMethod_1 0 65535 /end CHARACTERISTIC
/begin CHARACTERISTIC FaultManager.TPS1RangeLow.Action_1 "Fault manager configuration.  Select up to 4 actions for each fault." VALUE 0x800036B3 RecordLayout_3 0 CompuMethod_107 0 65535 /end CHARACTERISTIC
/begin CHARACTERISTIC FaultManager.TPS1RangeLow.Action_1_Condition "Fault manager configuration.  Select up to 4 actions for each fault." VALUE 0x800036B5 RecordLayout_3 0 CompuMethod_108 0 65535 /end CHARACTERISTIC
/begin CHARACTERISTIC FaultManager.TPS1RangeLow.Action_2 "Fault manager configuration.  Select up to 4 actions for each fault." VALUE 0x800036B7 RecordLayout_3 0 CompuMethod_107 0 65535 /end CHARACTERISTIC
/begin CHARACTERISTIC FaultManager.TPS1RangeLow.Action_2_Condition "Fault manager configuration.  Select up to 4 actions for each fault." VALUE 0x800036B9 RecordLayout_3 0 CompuMethod_108 0 65535 /end CHARACTERISTIC
/begin CHARACTERISTIC FaultManager.TPS1RangeLow.Action_3 "Fault manager configuration.  Select up to 4 actions for each fault." VALUE 0x800036BB RecordLayout_3 0 CompuMethod_107 0 65535 /end CHARACTERISTIC
/begin CHARACTERISTIC FaultManager.TPS1RangeLow.Action_3_Condition "Fault manager configuration.  Select up to 4 actions for each fault." VALUE 0x800036BD RecordLayout_3 0 CompuMethod_108 0 65535 /end CHARACTERISTIC
/begin CHARACTERISTIC FaultManager.TPS1RangeLow.Action_4 "Fault manager configuration.  Select up to 4 actions for each fault." VALUE 0x800036BF RecordLayout_3 0 CompuMethod_107 0 65535 /end CHARACTERISTIC
/begin CHARACTERISTIC FaultManager.TPS1RangeLow.Action_4_Condition "Fault manager configuration.  Select up to 4 actions for each fault." VALUE 0x800036C1 RecordLayout_3 0 CompuMethod_108 0 65535 /end CHARACTERISTIC
/begin CHARACTERISTIC FaultManager.TPS2AdaptHiMax.Mode "Fault manager configuration.  Select up to 4 actions for each fault." VALUE 0x800036C3 RecordLayout_3 0 CompuMethod_105 0 65535 /end CHARACTERISTIC
/begin CHARACTERISTIC FaultManager.TPS2AdaptHiMax.ID "Fault manager configuration.  Select up to 4 actions for each fault." VALUE 0x800036C5 RecordLayout_3 0 CompuMethod_1 0 65535 /end CHARACTERISTIC
/begin CHARACTERISTIC FaultManager.TPS2AdaptHiMax.Test "Fault manager configuration.  Select up to 4 actions for each fault." VALUE 0x800036C7 RecordLayout_3 0 CompuMethod_106 0 65535 /end CHARACTERISTIC
/begin CHARACTERISTIC FaultManager.TPS2AdaptHiMax.Faulty_Samples__X_ "Fault manager configuration.  Select up to 4 actions for each fault." VALUE 0x800036C9 RecordLayout_3 0 CompuMethod_1 0 65535 /end CHARACTERISTIC
/begin CHARACTERISTIC FaultManager.TPS2AdaptHiMax.Total_Samples__Y_ "Fault manager configuration.  Select up to 4 actions for each fault." VALUE 0x800036CB RecordLayout_3 0 CompuMethod_1 0 65535 /end CHARACTERISTIC
/begin CHARACTERISTIC FaultManager.TPS2AdaptHiMax.Action_1 "Fault manager configuration.  Select up to 4 actions for each fault." VALUE 0x800036CD RecordLayout_3 0 CompuMethod_107 0 65535 /end CHARACTERISTIC
/begin CHARACTERISTIC FaultManager.TPS2AdaptHiMax.Action_1_Condition "Fault manager configuration.  Select up to 4 actions for each fault." VALUE 0x800036CF RecordLayout_3 0 CompuMethod_108 0 65535 /end CHARACTERISTIC
/begin CHARACTERISTIC FaultManager.TPS2AdaptHiMax.Action_2 "Fault manager configuration.  Select up to 4 actions for each fault." VALUE 0x800036D1 RecordLayout_3 0 CompuMethod_107 0 65535 /end CHARACTERISTIC
/begin CHARACTERISTIC FaultManager.TPS2AdaptHiMax.Action_2_Condition "Fault manager configuration.  Select up to 4 actions for each fault." VALUE 0x800036D3 RecordLayout_3 0 CompuMethod_108 0 65535 /end CHARACTERISTIC
/begin CHARACTERISTIC FaultManager.TPS2AdaptHiMax.Action_3 "Fault manager configuration.  Select up to 4 actions for each fault." VALUE 0x800036D5 RecordLayout_3 0 CompuMethod_107 0 65535 /end CHARACTERISTIC
/begin CHARACTERISTIC FaultManager.TPS2AdaptHiMax.Action_3_Condition "Fault manager configuration.  Select up to 4 actions for each fault." VALUE 0x800036D7 RecordLayout_3 0 CompuMethod_108 0 65535 /end CHARACTERISTIC
/begin CHARACTERISTIC FaultManager.TPS2AdaptHiMax.Action_4 "Fault manager configuration.  Select up to 4 actions for each fault." VALUE 0x800036D9 RecordLayout_3 0 CompuMethod_107 0 65535 /end CHARACTERISTIC
/begin CHARACTERISTIC FaultManager.TPS2AdaptHiMax.Action_4_Condition "Fault manager configuration.  Select up to 4 actions for each fault." VALUE 0x800036DB RecordLayout_3 0 CompuMethod_108 0 65535 /end CHARACTERISTIC
/begin CHARACTERISTIC FaultManager.TPS2AdaptHiMin.Mode "Fault manager configuration.  Select up to 4 actions for each fault." VALUE 0x800036DD RecordLayout_3 0 CompuMethod_105 0 65535 /end CHARACTERISTIC
/begin CHARACTERISTIC FaultManager.TPS2AdaptHiMin.ID "Fault manager configuration.  Select up to 4 actions for each fault." VALUE 0x800036DF RecordLayout_3 0 CompuMethod_1 0 65535 /end CHARACTERISTIC
/begin CHARACTERISTIC FaultManager.TPS2AdaptHiMin.Test "Fault manager configuration.  Select up to 4 actions for each fault." VALUE 0x800036E1 RecordLayout_3 0 CompuMethod_106 0 65535 /end CHARACTERISTIC
/begin CHARACTERISTIC FaultManager.TPS2AdaptHiMin.Faulty_Samples__X_ "Fault manager configuration.  Select up to 4 actions for each fault." VALUE 0x800036E3 RecordLayout_3 0 CompuMethod_1 0 65535 /end CHARACTERISTIC
/begin CHARACTERISTIC FaultManager.TPS2AdaptHiMin.Total_Samples__Y_ "Fault manager configuration.  Select up to 4 actions for each fault." VALUE 0x800036E5 RecordLayout_3 0 CompuMethod_1 0 65535 /end CHARACTERISTIC
/begin CHARACTERISTIC FaultManager.TPS2AdaptHiMin.Action_1 "Fault manager configuration.  Select up to 4 actions for each fault." VALUE 0x800036E7 RecordLayout_3 0 CompuMethod_107 0 65535 /end CHARACTERISTIC
/begin CHARACTERISTIC FaultManager.TPS2AdaptHiMin.Action_1_Condition "Fault manager configuration.  Select up to 4 actions for each fault." VALUE 0x800036E9 RecordLayout_3 0 CompuMethod_108 0 65535 /end CHARACTERISTIC
/begin CHARACTERISTIC FaultManager.TPS2AdaptHiMin.Action_2 "Fault manager configuration.  Select up to 4 actions for each fault." VALUE 0x800036EB RecordLayout_3 0 CompuMethod_107 0 65535 /end CHARACTERISTIC
/begin CHARACTERISTIC FaultManager.TPS2AdaptHiMin.Action_2_Condition "Fault manager configuration.  Select up to 4 actions for each fault." VALUE 0x800036ED RecordLayout_3 0 CompuMethod_108 0 65535 /end CHARACTERISTIC
/begin CHARACTERISTIC FaultManager.TPS2AdaptHiMin.Action_3 "Fault manager configuration.  Select up to 4 actions for each fault." VALUE 0x800036EF RecordLayout_3 0 CompuMethod_107 0 65535 /end CHARACTERISTIC
/begin CHARACTERISTIC FaultManager.TPS2AdaptHiMin.Action_3_Condition "Fault manager configuration.  Select up to 4 actions for each fault." VALUE 0x800036F1 RecordLayout_3 0 CompuMethod_108 0 65535 /end CHARACTERISTIC
/begin CHARACTERISTIC FaultManager.TPS2AdaptHiMin.Action_4 "Fault manager configuration.  Select up to 4 actions for each fault." VALUE 0x800036F3 RecordLayout_3 0 CompuMethod_107 0 65535 /end CHARACTERISTIC
/begin CHARACTERISTIC FaultManager.TPS2AdaptHiMin.Action_4_Condition "Fault manager configuration.  Select up to 4 actions for each fault." VALUE 0x800036F5 RecordLayout_3 0 CompuMethod_108 0 65535 /end CHARACTERISTIC
/begin CHARACTERISTIC FaultManager.TPS2AdaptLoMax.Mode "Fault manager configuration.  Select up to 4 actions for each fault." VALUE 0x800036F7 RecordLayout_3 0 CompuMethod_105 0 65535 /end CHARACTERISTIC
/begin CHARACTERISTIC FaultManager.TPS2AdaptLoMax.ID "Fault manager configuration.  Select up to 4 actions for each fault." VALUE 0x800036F9 RecordLayout_3 0 CompuMethod_1 0 65535 /end CHARACTERISTIC
/begin CHARACTERISTIC FaultManager.TPS2AdaptLoMax.Test "Fault manager configuration.  Select up to 4 actions for each fault." VALUE 0x800036FB RecordLayout_3 0 CompuMethod_106 0 65535 /end CHARACTERISTIC
/begin CHARACTERISTIC FaultManager.TPS2AdaptLoMax.Faulty_Samples__X_ "Fault manager configuration.  Select up to 4 actions for each fault." VALUE 0x800036FD RecordLayout_3 0 CompuMethod_1 0 65535 /end CHARACTERISTIC
/begin CHARACTERISTIC FaultManager.TPS2AdaptLoMax.Total_Samples__Y_ "Fault manager configuration.  Select up to 4 actions for each fault." VALUE 0x800036FF RecordLayout_3 0 CompuMethod_1 0 65535 /end CHARACTERISTIC
/begin CHARACTERISTIC FaultManager.TPS2AdaptLoMax.Action_1 "Fault manager configuration.  Select up to 4 actions for each fault." VALUE 0x80003701 RecordLayout_3 0 CompuMethod_107 0 65535 /end CHARACTERISTIC
/begin CHARACTERISTIC FaultManager.TPS2AdaptLoMax.Action_1_Condition "Fault manager configuration.  Select up to 4 actions for each fault." VALUE 0x80003703 RecordLayout_3 0 CompuMethod_108 0 65535 /end CHARACTERISTIC
/begin CHARACTERISTIC FaultManager.TPS2AdaptLoMax.Action_2 "Fault manager configuration.  Select up to 4 actions for each fault." VALUE 0x80003705 RecordLayout_3 0 CompuMethod_107 0 65535 /end CHARACTERISTIC
/begin CHARACTERISTIC FaultManager.TPS2AdaptLoMax.Action_2_Condition "Fault manager configuration.  Select up to 4 actions for each fault." VALUE 0x80003707 RecordLayout_3 0 CompuMethod_108 0 65535 /end CHARACTERISTIC
/begin CHARACTERISTIC FaultManager.TPS2AdaptLoMax.Action_3 "Fault manager configuration.  Select up to 4 actions for each fault." VALUE 0x80003709 RecordLayout_3 0 CompuMethod_107 0 65535 /end CHARACTERISTIC
/begin CHARACTERISTIC FaultManager.TPS2AdaptLoMax.Action_3_Condition "Fault manager configuration.  Select up to 4 actions for each fault." VALUE 0x8000370B RecordLayout_3 0 CompuMethod_108 0 65535 /end CHARACTERISTIC
/begin CHARACTERISTIC FaultManager.TPS2AdaptLoMax.Action_4 "Fault manager configuration.  Select up to 4 actions for each fault." VALUE 0x8000370D RecordLayout_3 0 CompuMethod_107 0 65535 /end CHARACTERISTIC
/begin CHARACTERISTIC FaultManager.TPS2AdaptLoMax.Action_4_Condition "Fault manager configuration.  Select up to 4 actions for each fault." VALUE 0x8000370F RecordLayout_3 0 CompuMethod_108 0 65535 /end CHARACTERISTIC
/begin CHARACTERISTIC FaultManager.TPS2AdaptLoMin.Mode "Fault manager configuration.  Select up to 4 actions for each fault." VALUE 0x80003711 RecordLayout_3 0 CompuMethod_105 0 65535 /end CHARACTERISTIC
/begin CHARACTERISTIC FaultManager.TPS2AdaptLoMin.ID "Fault manager configuration.  Select up to 4 actions for each fault." VALUE 0x80003713 RecordLayout_3 0 CompuMethod_1 0 65535 /end CHARACTERISTIC
/begin CHARACTERISTIC FaultManager.TPS2AdaptLoMin.Test "Fault manager configuration.  Select up to 4 actions for each fault." VALUE 0x80003715 RecordLayout_3 0 CompuMethod_106 0 65535 /end CHARACTERISTIC
/begin CHARACTERISTIC FaultManager.TPS2AdaptLoMin.Faulty_Samples__X_ "Fault manager configuration.  Select up to 4 actions for each fault." VALUE 0x80003717 RecordLayout_3 0 CompuMethod_1 0 65535 /end CHARACTERISTIC
/begin CHARACTERISTIC FaultManager.TPS2AdaptLoMin.Total_Samples__Y_ "Fault manager configuration.  Select up to 4 actions for each fault." VALUE 0x80003719 RecordLayout_3 0 CompuMethod_1 0 65535 /end CHARACTERISTIC
/begin CHARACTERISTIC FaultManager.TPS2AdaptLoMin.Action_1 "Fault manager configuration.  Select up to 4 actions for each fault." VALUE 0x8000371B RecordLayout_3 0 CompuMethod_107 0 65535 /end CHARACTERISTIC
/begin CHARACTERISTIC FaultManager.TPS2AdaptLoMin.Action_1_Condition "Fault manager configuration.  Select up to 4 actions for each fault." VALUE 0x8000371D RecordLayout_3 0 CompuMethod_108 0 65535 /end CHARACTERISTIC
/begin CHARACTERISTIC FaultManager.TPS2AdaptLoMin.Action_2 "Fault manager configuration.  Select up to 4 actions for each fault." VALUE 0x8000371F RecordLayout_3 0 CompuMethod_107 0 65535 /end CHARACTERISTIC
/begin CHARACTERISTIC FaultManager.TPS2AdaptLoMin.Action_2_Condition "Fault manager configuration.  Select up to 4 actions for each fault." VALUE 0x80003721 RecordLayout_3 0 CompuMethod_108 0 65535 /end CHARACTERISTIC
/begin CHARACTERISTIC FaultManager.TPS2AdaptLoMin.Action_3 "Fault manager configuration.  Select up to 4 actions for each fault." VALUE 0x80003723 RecordLayout_3 0 CompuMethod_107 0 65535 /end CHARACTERISTIC
/begin CHARACTERISTIC FaultManager.TPS2AdaptLoMin.Action_3_Condition "Fault manager configuration.  Select up to 4 actions for each fault." VALUE 0x80003725 RecordLayout_3 0 CompuMethod_108 0 65535 /end CHARACTERISTIC
/begin CHARACTERISTIC FaultManager.TPS2AdaptLoMin.Action_4 "Fault manager configuration.  Select up to 4 actions for each fault." VALUE 0x80003727 RecordLayout_3 0 CompuMethod_107 0 65535 /end CHARACTERISTIC
/begin CHARACTERISTIC FaultManager.TPS2AdaptLoMin.Action_4_Condition "Fault manager configuration.  Select up to 4 actions for each fault." VALUE 0x80003729 RecordLayout_3 0 CompuMethod_108 0 65535 /end CHARACTERISTIC
/begin CHARACTERISTIC FaultManager.TPS2RangeHigh.Mode "Fault manager configuration.  Select up to 4 actions for each fault." VALUE 0x8000372B RecordLayout_3 0 CompuMethod_105 0 65535 /end CHARACTERISTIC
/begin CHARACTERISTIC FaultManager.TPS2RangeHigh.ID "Fault manager configuration.  Select up to 4 actions for each fault." VALUE 0x8000372D RecordLayout_3 0 CompuMethod_1 0 65535 /end CHARACTERISTIC
/begin CHARACTERISTIC FaultManager.TPS2RangeHigh.Test "Fault manager configuration.  Select up to 4 actions for each fault." VALUE 0x8000372F RecordLayout_3 0 CompuMethod_106 0 65535 /end CHARACTERISTIC
/begin CHARACTERISTIC FaultManager.TPS2RangeHigh.Faulty_Samples__X_ "Fault manager configuration.  Select up to 4 actions for each fault." VALUE 0x80003731 RecordLayout_3 0 CompuMethod_1 0 65535 /end CHARACTERISTIC
/begin CHARACTERISTIC FaultManager.TPS2RangeHigh.Total_Samples__Y_ "Fault manager configuration.  Select up to 4 actions for each fault." VALUE 0x80003733 RecordLayout_3 0 CompuMethod_1 0 65535 /end CHARACTERISTIC
/begin CHARACTERISTIC FaultManager.TPS2RangeHigh.Action_1 "Fault manager configuration.  Select up to 4 actions for each fault." VALUE 0x80003735 RecordLayout_3 0 CompuMethod_107 0 65535 /end CHARACTERISTIC
/begin CHARACTERISTIC FaultManager.TPS2RangeHigh.Action_1_Condition "Fault manager configuration.  Select up to 4 actions for each fault." VALUE 0x80003737 RecordLayout_3 0 CompuMethod_108 0 65535 /end CHARACTERISTIC
/begin CHARACTERISTIC FaultManager.TPS2RangeHigh.Action_2 "Fault manager configuration.  Select up to 4 actions for each fault." VALUE 0x80003739 RecordLayout_3 0 CompuMethod_107 0 65535 /end CHARACTERISTIC
/begin CHARACTERISTIC FaultManager.TPS2RangeHigh.Action_2_Condition "Fault manager configuration.  Select up to 4 actions for each fault." VALUE 0x8000373B RecordLayout_3 0 CompuMethod_108 0 65535 /end CHARACTERISTIC
/begin CHARACTERISTIC FaultManager.TPS2RangeHigh.Action_3 "Fault manager configuration.  Select up to 4 actions for each fault." VALUE 0x8000373D RecordLayout_3 0 CompuMethod_107 0 65535 /end CHARACTERISTIC
/begin CHARACTERISTIC FaultManager.TPS2RangeHigh.Action_3_Condition "Fault manager configuration.  Select up to 4 actions for each fault." VALUE 0x8000373F RecordLayout_3 0 CompuMethod_108 0 65535 /end CHARACTERISTIC
/begin CHARACTERISTIC FaultManager.TPS2RangeHigh.Action_4 "Fault manager configuration.  Select up to 4 actions for each fault." VALUE 0x80003741 RecordLayout_3 0 CompuMethod_107 0 65535 /end CHARACTERISTIC
/begin CHARACTERISTIC FaultManager.TPS2RangeHigh.Action_4_Condition "Fault manager configuration.  Select up to 4 actions for each fault." VALUE 0x80003743 RecordLayout_3 0 CompuMethod_108 0 65535 /end CHARACTERISTIC
/begin CHARACTERISTIC FaultManager.TPS2RangeLow.Mode "Fault manager configuration.  Select up to 4 actions for each fault." VALUE 0x80003745 RecordLayout_3 0 CompuMethod_105 0 65535 /end CHARACTERISTIC
/begin CHARACTERISTIC FaultManager.TPS2RangeLow.ID "Fault manager configuration.  Select up to 4 actions for each fault." VALUE 0x80003747 RecordLayout_3 0 CompuMethod_1 0 65535 /end CHARACTERISTIC
/begin CHARACTERISTIC FaultManager.TPS2RangeLow.Test "Fault manager configuration.  Select up to 4 actions for each fault." VALUE 0x80003749 RecordLayout_3 0 CompuMethod_106 0 65535 /end CHARACTERISTIC
/begin CHARACTERISTIC FaultManager.TPS2RangeLow.Faulty_Samples__X_ "Fault manager configuration.  Select up to 4 actions for each fault." VALUE 0x8000374B RecordLayout_3 0 CompuMethod_1 0 65535 /end CHARACTERISTIC
/begin CHARACTERISTIC FaultManager.TPS2RangeLow.Total_Samples__Y_ "Fault manager configuration.  Select up to 4 actions for each fault." VALUE 0x8000374D RecordLayout_3 0 CompuMethod_1 0 65535 /end CHARACTERISTIC
/begin CHARACTERISTIC FaultManager.TPS2RangeLow.Action_1 "Fault manager configuration.  Select up to 4 actions for each fault." VALUE 0x8000374F RecordLayout_3 0 CompuMethod_107 0 65535 /end CHARACTERISTIC
/begin CHARACTERISTIC FaultManager.TPS2RangeLow.Action_1_Condition "Fault manager configuration.  Select up to 4 actions for each fault." VALUE 0x80003751 RecordLayout_3 0 CompuMethod_108 0 65535 /end CHARACTERISTIC
/begin CHARACTERISTIC FaultManager.TPS2RangeLow.Action_2 "Fault manager configuration.  Select up to 4 actions for each fault." VALUE 0x80003753 RecordLayout_3 0 CompuMethod_107 0 65535 /end CHARACTERISTIC
/begin CHARACTERISTIC FaultManager.TPS2RangeLow.Action_2_Condition "Fault manager configuration.  Select up to 4 actions for each fault." VALUE 0x80003755 RecordLayout_3 0 CompuMethod_108 0 65535 /end CHARACTERISTIC
/begin CHARACTERISTIC FaultManager.TPS2RangeLow.Action_3 "Fault manager configuration.  Select up to 4 actions for each fault." VALUE 0x80003757 RecordLayout_3 0 CompuMethod_107 0 65535 /end CHARACTERISTIC
/begin CHARACTERISTIC FaultManager.TPS2RangeLow.Action_3_Condition "Fault manager configuration.  Select up to 4 actions for each fault." VALUE 0x80003759 RecordLayout_3 0 CompuMethod_108 0 65535 /end CHARACTERISTIC
/begin CHARACTERISTIC FaultManager.TPS2RangeLow.Action_4 "Fault manager configuration.  Select up to 4 actions for each fault." VALUE 0x8000375B RecordLayout_3 0 CompuMethod_107 0 65535 /end CHARACTERISTIC
/begin CHARACTERISTIC FaultManager.TPS2RangeLow.Action_4_Condition "Fault manager configuration.  Select up to 4 actions for each fault." VALUE 0x8000375D RecordLayout_3 0 CompuMethod_108 0 65535 /end CHARACTERISTIC
/begin CHARACTERISTIC FaultManager.TPS_Sensors_Conflict.Mode "Fault manager configuration.  Select up to 4 actions for each fault." VALUE 0x8000375F RecordLayout_3 0 CompuMethod_105 0 65535 /end CHARACTERISTIC
/begin CHARACTERISTIC FaultManager.TPS_Sensors_Conflict.ID "Fault manager configuration.  Select up to 4 actions for each fault." VALUE 0x80003761 RecordLayout_3 0 CompuMethod_1 0 65535 /end CHARACTERISTIC
/begin CHARACTERISTIC FaultManager.TPS_Sensors_Conflict.Test "Fault manager configuration.  Select up to 4 actions for each fault." VALUE 0x80003763 RecordLayout_3 0 CompuMethod_106 0 65535 /end CHARACTERISTIC
/begin CHARACTERISTIC FaultManager.TPS_Sensors_Conflict.Faulty_Samples__X_ "Fault manager configuration.  Select up to 4 actions for each fault." VALUE 0x80003765 RecordLayout_3 0 CompuMethod_1 0 65535 /end CHARACTERISTIC
/begin CHARACTERISTIC FaultManager.TPS_Sensors_Conflict.Total_Samples__Y_ "Fault manager configuration.  Select up to 4 actions for each fault." VALUE 0x80003767 RecordLayout_3 0 CompuMethod_1 0 65535 /end CHARACTERISTIC
/begin CHARACTERISTIC FaultManager.TPS_Sensors_Conflict.Action_1 "Fault manager configuration.  Select up to 4 actions for each fault." VALUE 0x80003769 RecordLayout_3 0 CompuMethod_107 0 65535 /end CHARACTERISTIC
/begin CHARACTERISTIC FaultManager.TPS_Sensors_Conflict.Action_1_Condition "Fault manager configuration.  Select up to 4 actions for each fault." VALUE 0x8000376B RecordLayout_3 0 CompuMethod_108 0 65535 /end CHARACTERISTIC
/begin CHARACTERISTIC FaultManager.TPS_Sensors_Conflict.Action_2 "Fault manager configuration.  Select up to 4 actions for each fault." VALUE 0x8000376D RecordLayout_3 0 CompuMethod_107 0 65535 /end CHARACTERISTIC
/begin CHARACTERISTIC FaultManager.TPS_Sensors_Conflict.Action_2_Condition "Fault manager configuration.  Select up to 4 actions for each fault." VALUE 0x8000376F RecordLayout_3 0 CompuMethod_108 0 65535 /end CHARACTERISTIC
/begin CHARACTERISTIC FaultManager.TPS_Sensors_Conflict.Action_3 "Fault manager configuration.  Select up to 4 actions for each fault." VALUE 0x80003771 RecordLayout_3 0 CompuMethod_107 0 65535 /end CHARACTERISTIC
/begin CHARACTERISTIC FaultManager.TPS_Sensors_Conflict.Action_3_Condition "Fault manager configuration.  Select up to 4 actions for each fault." VALUE 0x80003773 RecordLayout_3 0 CompuMethod_108 0 65535 /end CHARACTERISTIC
/begin CHARACTERISTIC FaultManager.TPS_Sensors_Conflict.Action_4 "Fault manager configuration.  Select up to 4 actions for each fault." VALUE 0x80003775 RecordLayout_3 0 CompuMethod_107 0 65535 /end CHARACTERISTIC
/begin CHARACTERISTIC FaultManager.TPS_Sensors_Conflict.Action_4_Condition "Fault manager configuration.  Select up to 4 actions for each fault." VALUE 0x80003777 RecordLayout_3 0 CompuMethod_108 0 65535 /end CHARACTERISTIC
/begin CHARACTERISTIC FaultManager.VSPDRangeHigh.Mode "Fault manager configuration.  Select up to 4 actions for each fault." VALUE 0x80003779 RecordLayout_3 0 CompuMethod_105 0 65535 /end CHARACTERISTIC
/begin CHARACTERISTIC FaultManager.VSPDRangeHigh.ID "Fault manager configuration.  Select up to 4 actions for each fault." VALUE 0x8000377B RecordLayout_3 0 CompuMethod_1 0 65535 /end CHARACTERISTIC
/begin CHARACTERISTIC FaultManager.VSPDRangeHigh.Test "Fault manager configuration.  Select up to 4 actions for each fault." VALUE 0x8000377D RecordLayout_3 0 CompuMethod_106 0 65535 /end CHARACTERISTIC
/begin CHARACTERISTIC FaultManager.VSPDRangeHigh.Faulty_Samples__X_ "Fault manager configuration.  Select up to 4 actions for each fault." VALUE 0x8000377F RecordLayout_3 0 CompuMethod_1 0 65535 /end CHARACTERISTIC
/begin CHARACTERISTIC FaultManager.VSPDRangeHigh.Total_Samples__Y_ "Fault manager configuration.  Select up to 4 actions for each fault." VALUE 0x80003781 RecordLayout_3 0 CompuMethod_1 0 65535 /end CHARACTERISTIC
/begin CHARACTERISTIC FaultManager.VSPDRangeHigh.Action_1 "Fault manager configuration.  Select up to 4 actions for each fault." VALUE 0x80003783 RecordLayout_3 0 CompuMethod_107 0 65535 /end CHARACTERISTIC
/begin CHARACTERISTIC FaultManager.VSPDRangeHigh.Action_1_Condition "Fault manager configuration.  Select up to 4 actions for each fault." VALUE 0x80003785 RecordLayout_3 0 CompuMethod_108 0 65535 /end CHARACTERISTIC
/begin CHARACTERISTIC FaultManager.VSPDRangeHigh.Action_2 "Fault manager configuration.  Select up to 4 actions for each fault." VALUE 0x80003787 RecordLayout_3 0 CompuMethod_107 0 65535 /end CHARACTERISTIC
/begin CHARACTERISTIC FaultManager.VSPDRangeHigh.Action_2_Condition "Fault manager configuration.  Select up to 4 actions for each fault." VALUE 0x80003789 RecordLayout_3 0 CompuMethod_108 0 65535 /end CHARACTERISTIC
/begin CHARACTERISTIC FaultManager.VSPDRangeHigh.Action_3 "Fault manager configuration.  Select up to 4 actions for each fault." VALUE 0x8000378B RecordLayout_3 0 CompuMethod_107 0 65535 /end CHARACTERISTIC
/begin CHARACTERISTIC FaultManager.VSPDRangeHigh.Action_3_Condition "Fault manager configuration.  Select up to 4 actions for each fault." VALUE 0x8000378D RecordLayout_3 0 CompuMethod_108 0 65535 /end CHARACTERISTIC
/begin CHARACTERISTIC FaultManager.VSPDRangeHigh.Action_4 "Fault manager configuration.  Select up to 4 actions for each fault." VALUE 0x8000378F RecordLayout_3 0 CompuMethod_107 0 65535 /end CHARACTERISTIC
/begin CHARACTERISTIC FaultManager.VSPDRangeHigh.Action_4_Condition "Fault manager configuration.  Select up to 4 actions for each fault." VALUE 0x80003791 RecordLayout_3 0 CompuMethod_108 0 65535 /end CHARACTERISTIC
/begin CHARACTERISTIC FaultManager.VSPDRangeLow.Mode "Fault manager configuration.  Select up to 4 actions for each fault." VALUE 0x80003793 RecordLayout_3 0 CompuMethod_105 0 65535 /end CHARACTERISTIC
/begin CHARACTERISTIC FaultManager.VSPDRangeLow.ID "Fault manager configuration.  Select up to 4 actions for each fault." VALUE 0x80003795 RecordLayout_3 0 CompuMethod_1 0 65535 /end CHARACTERISTIC
/begin CHARACTERISTIC FaultManager.VSPDRangeLow.Test "Fault manager configuration.  Select up to 4 actions for each fault." VALUE 0x80003797 RecordLayout_3 0 CompuMethod_106 0 65535 /end CHARACTERISTIC
/begin CHARACTERISTIC FaultManager.VSPDRangeLow.Faulty_Samples__X_ "Fault manager configuration.  Select up to 4 actions for each fault." VALUE 0x80003799 RecordLayout_3 0 CompuMethod_1 0 65535 /end CHARACTERISTIC
/begin CHARACTERISTIC FaultManager.VSPDRangeLow.Total_Samples__Y_ "Fault manager configuration.  Select up to 4 actions for each fault." VALUE 0x8000379B RecordLayout_3 0 CompuMethod_1 0 65535 /end CHARACTERISTIC
/begin CHARACTERISTIC FaultManager.VSPDRangeLow.Action_1 "Fault manager configuration.  Select up to 4 actions for each fault." VALUE 0x8000379D RecordLayout_3 0 CompuMethod_107 0 65535 /end CHARACTERISTIC
/begin CHARACTERISTIC FaultManager.VSPDRangeLow.Action_1_Condition "Fault manager configuration.  Select up to 4 actions for each fault." VALUE 0x8000379F RecordLayout_3 0 CompuMethod_108 0 65535 /end CHARACTERISTIC
/begin CHARACTERISTIC FaultManager.VSPDRangeLow.Action_2 "Fault manager configuration.  Select up to 4 actions for each fault." VALUE 0x800037A1 RecordLayout_3 0 CompuMethod_107 0 65535 /end CHARACTERISTIC
/begin CHARACTERISTIC FaultManager.VSPDRangeLow.Action_2_Condition "Fault manager configuration.  Select up to 4 actions for each fault." VALUE 0x800037A3 RecordLayout_3 0 CompuMethod_108 0 65535 /end CHARACTERISTIC
/begin CHARACTERISTIC FaultManager.VSPDRangeLow.Action_3 "Fault manager configuration.  Select up to 4 actions for each fault." VALUE 0x800037A5 RecordLayout_3 0 CompuMethod_107 0 65535 /end CHARACTERISTIC
/begin CHARACTERISTIC FaultManager.VSPDRangeLow.Action_3_Condition "Fault manager configuration.  Select up to 4 actions for each fault." VALUE 0x800037A7 RecordLayout_3 0 CompuMethod_108 0 65535 /end CHARACTERISTIC
/begin CHARACTERISTIC FaultManager.VSPDRangeLow.Action_4 "Fault manager configuration.  Select up to 4 actions for each fault." VALUE 0x800037A9 RecordLayout_3 0 CompuMethod_107 0 65535 /end CHARACTERISTIC
/begin CHARACTERISTIC FaultManager.VSPDRangeLow.Action_4_Condition "Fault manager configuration.  Select up to 4 actions for each fault." VALUE 0x800037AB RecordLayout_3 0 CompuMethod_108 0 65535 /end CHARACTERISTIC
/begin CHARACTERISTIC FaultManager.VoltLow_Fault.Mode "Fault manager configuration.  Select up to 4 actions for each fault." VALUE 0x800037AD RecordLayout_3 0 CompuMethod_105 0 65535 /end CHARACTERISTIC
/begin CHARACTERISTIC FaultManager.VoltLow_Fault.ID "Fault manager configuration.  Select up to 4 actions for each fault." VALUE 0x800037AF RecordLayout_3 0 CompuMethod_1 0 65535 /end CHARACTERISTIC
/begin CHARACTERISTIC FaultManager.VoltLow_Fault.Test "Fault manager configuration.  Select up to 4 actions for each fault." VALUE 0x800037B1 RecordLayout_3 0 CompuMethod_106 0 65535 /end CHARACTERISTIC
/begin CHARACTERISTIC FaultManager.VoltLow_Fault.Faulty_Samples__X_ "Fault manager configuration.  Select up to 4 actions for each fault." VALUE 0x800037B3 RecordLayout_3 0 CompuMethod_1 0 65535 /end CHARACTERISTIC
/begin CHARACTERISTIC FaultManager.VoltLow_Fault.Total_Samples__Y_ "Fault manager configuration.  Select up to 4 actions for each fault." VALUE 0x800037B5 RecordLayout_3 0 CompuMethod_1 0 65535 /end CHARACTERISTIC
/begin CHARACTERISTIC FaultManager.VoltLow_Fault.Action_1 "Fault manager configuration.  Select up to 4 actions for each fault." VALUE 0x800037B7 RecordLayout_3 0 CompuMethod_107 0 65535 /end CHARACTERISTIC
/begin CHARACTERISTIC FaultManager.VoltLow_Fault.Action_1_Condition "Fault manager configuration.  Select up to 4 actions for each fault." VALUE 0x800037B9 RecordLayout_3 0 CompuMethod_108 0 65535 /end CHARACTERISTIC
/begin CHARACTERISTIC FaultManager.VoltLow_Fault.Action_2 "Fault manager configuration.  Select up to 4 actions for each fault." VALUE 0x800037BB RecordLayout_3 0 CompuMethod_107 0 65535 /end CHARACTERISTIC
/begin CHARACTERISTIC FaultManager.VoltLow_Fault.Action_2_Condition "Fault manager configuration.  Select up to 4 actions for each fault." VALUE 0x800037BD RecordLayout_3 0 CompuMethod_108 0 65535 /end CHARACTERISTIC
/begin CHARACTERISTIC FaultManager.VoltLow_Fault.Action_3 "Fault manager configuration.  Select up to 4 actions for each fault." VALUE 0x800037BF RecordLayout_3 0 CompuMethod_107 0 65535 /end CHARACTERISTIC
/begin CHARACTERISTIC FaultManager.VoltLow_Fault.Action_3_Condition "Fault manager configuration.  Select up to 4 actions for each fault." VALUE 0x800037C1 RecordLayout_3 0 CompuMethod_108 0 65535 /end CHARACTERISTIC
/begin CHARACTERISTIC FaultManager.VoltLow_Fault.Action_4 "Fault manager configuration.  Select up to 4 actions for each fault." VALUE 0x800037C3 RecordLayout_3 0 CompuMethod_107 0 65535 /end CHARACTERISTIC
/begin CHARACTERISTIC FaultManager.VoltLow_Fault.Action_4_Condition "Fault manager configuration.  Select up to 4 actions for each fault." VALUE 0x800037C5 RecordLayout_3 0 CompuMethod_108 0 65535 /end CHARACTERISTIC
/begin CHARACTERISTIC FaultManager.VoltTooHigh_Fault.Mode "Fault manager configuration.  Select up to 4 actions for each fault." VALUE 0x800037C7 RecordLayout_3 0 CompuMethod_105 0 65535 /end CHARACTERISTIC
/begin CHARACTERISTIC FaultManager.VoltTooHigh_Fault.ID "Fault manager configuration.  Select up to 4 actions for each fault." VALUE 0x800037C9 RecordLayout_3 0 CompuMethod_1 0 65535 /end CHARACTERISTIC
/begin CHARACTERISTIC FaultManager.VoltTooHigh_Fault.Test "Fault manager configuration.  Select up to 4 actions for each fault." VALUE 0x800037CB RecordLayout_3 0 CompuMethod_106 0 65535 /end CHARACTERISTIC
/begin CHARACTERISTIC FaultManager.VoltTooHigh_Fault.Faulty_Samples__X_ "Fault manager configuration.  Select up to 4 actions for each fault." VALUE 0x800037CD RecordLayout_3 0 CompuMethod_1 0 65535 /end CHARACTERISTIC
/begin CHARACTERISTIC FaultManager.VoltTooHigh_Fault.Total_Samples__Y_ "Fault manager configuration.  Select up to 4 actions for each fault." VALUE 0x800037CF RecordLayout_3 0 CompuMethod_1 0 65535 /end CHARACTERISTIC
/begin CHARACTERISTIC FaultManager.VoltTooHigh_Fault.Action_1 "Fault manager configuration.  Select up to 4 actions for each fault." VALUE 0x800037D1 RecordLayout_3 0 CompuMethod_107 0 65535 /end CHARACTERISTIC
/begin CHARACTERISTIC FaultManager.VoltTooHigh_Fault.Action_1_Condition "Fault manager configuration.  Select up to 4 actions for each fault." VALUE 0x800037D3 RecordLayout_3 0 CompuMethod_108 0 65535 /end CHARACTERISTIC
/begin CHARACTERISTIC FaultManager.VoltTooHigh_Fault.Action_2 "Fault manager configuration.  Select up to 4 actions for each fault." VALUE 0x800037D5 RecordLayout_3 0 CompuMethod_107 0 65535 /end CHARACTERISTIC
/begin CHARACTERISTIC FaultManager.VoltTooHigh_Fault.Action_2_Condition "Fault manager configuration.  Select up to 4 actions for each fault." VALUE 0x800037D7 RecordLayout_3 0 CompuMethod_108 0 65535 /end CHARACTERISTIC
/begin CHARACTERISTIC FaultManager.VoltTooHigh_Fault.Action_3 "Fault manager configuration.  Select up to 4 actions for each fault." VALUE 0x800037D9 RecordLayout_3 0 CompuMethod_107 0 65535 /end CHARACTERISTIC
/begin CHARACTERISTIC FaultManager.VoltTooHigh_Fault.Action_3_Condition "Fault manager configuration.  Select up to 4 actions for each fault." VALUE 0x800037DB RecordLayout_3 0 CompuMethod_108 0 65535 /end CHARACTERISTIC
/begin CHARACTERISTIC FaultManager.VoltTooHigh_Fault.Action_4 "Fault manager configuration.  Select up to 4 actions for each fault." VALUE 0x800037DD RecordLayout_3 0 CompuMethod_107 0 65535 /end CHARACTERISTIC
/begin CHARACTERISTIC FaultManager.VoltTooHigh_Fault.Action_4_Condition "Fault manager configuration.  Select up to 4 actions for each fault." VALUE 0x800037DF RecordLayout_3 0 CompuMethod_108 0 65535 /end CHARACTERISTIC
/begin CHARACTERISTIC FaultManager.Wastegate_Fault.Mode "Fault manager configuration.  Select up to 4 actions for each fault." VALUE 0x800037E1 RecordLayout_3 0 CompuMethod_105 0 65535 /end CHARACTERISTIC
/begin CHARACTERISTIC FaultManager.Wastegate_Fault.ID "Fault manager configuration.  Select up to 4 actions for each fault." VALUE 0x800037E3 RecordLayout_3 0 CompuMethod_1 0 65535 /end CHARACTERISTIC
/begin CHARACTERISTIC FaultManager.Wastegate_Fault.Test "Fault manager configuration.  Select up to 4 actions for each fault." VALUE 0x800037E5 RecordLayout_3 0 CompuMethod_106 0 65535 /end CHARACTERISTIC
/begin CHARACTERISTIC FaultManager.Wastegate_Fault.Faulty_Samples__X_ "Fault manager configuration.  Select up to 4 actions for each fault." VALUE 0x800037E7 RecordLayout_3 0 CompuMethod_1 0 65535 /end CHARACTERISTIC
/begin CHARACTERISTIC FaultManager.Wastegate_Fault.Total_Samples__Y_ "Fault manager configuration.  Select up to 4 actions for each fault." VALUE 0x800037E9 RecordLayout_3 0 CompuMethod_1 0 65535 /end CHARACTERISTIC
/begin CHARACTERISTIC FaultManager.Wastegate_Fault.Action_1 "Fault manager configuration.  Select up to 4 actions for each fault." VALUE 0x800037EB RecordLayout_3 0 CompuMethod_107 0 65535 /end CHARACTERISTIC
/begin CHARACTERISTIC FaultManager.Wastegate_Fault.Action_1_Condition "Fault manager configuration.  Select up to 4 actions for each fault." VALUE 0x800037ED RecordLayout_3 0 CompuMethod_108 0 65535 /end CHARACTERISTIC
/begin CHARACTERISTIC FaultManager.Wastegate_Fault.Action_2 "Fault manager configuration.  Select up to 4 actions for each fault." VALUE 0x800037EF RecordLayout_3 0 CompuMethod_107 0 65535 /end CHARACTERISTIC
/begin CHARACTERISTIC FaultManager.Wastegate_Fault.Action_2_Condition "Fault manager configuration.  Select up to 4 actions for each fault." VALUE 0x800037F1 RecordLayout_3 0 CompuMethod_108 0 65535 /end CHARACTERISTIC
/begin CHARACTERISTIC FaultManager.Wastegate_Fault.Action_3 "Fault manager configuration.  Select up to 4 actions for each fault." VALUE 0x800037F3 RecordLayout_3 0 CompuMethod_107 0 65535 /end CHARACTERISTIC
/begin CHARACTERISTIC FaultManager.Wastegate_Fault.Action_3_Condition "Fault manager configuration.  Select up to 4 actions for each fault." VALUE 0x800037F5 RecordLayout_3 0 CompuMethod_108 0 65535 /end CHARACTERISTIC
/begin CHARACTERISTIC FaultManager.Wastegate_Fault.Action_4 "Fault manager configuration.  Select up to 4 actions for each fault." VALUE 0x800037F7 RecordLayout_3 0 CompuMethod_107 0 65535 /end CHARACTERISTIC
/begin CHARACTERISTIC FaultManager.Wastegate_Fault.Action_4_Condition "Fault manager configuration.  Select up to 4 actions for each fault." VALUE 0x800037F9 RecordLayout_3 0 CompuMethod_108 0 65535 /end CHARACTERISTIC
/begin RECORD_LAYOUT RecordLayout_2 FNC_VALUES 1 UBYTE ROW_DIR DIRECT /end RECORD_LAYOUT
/begin RECORD_LAYOUT RecordLayout_3 FNC_VALUES 1 UWORD ROW_DIR DIRECT /end RECORD_LAYOUT
/*~~~~~~~~~ 6.3.31 COMPU_METHODs ~~~~~~~~~*/
/begin COMPU_METHOD CompuMethod_1 "" RAT_FUNC "%3.0" "" COEFFS 0 1 0 0 0 1 /end COMPU_METHOD
/begin COMPU_METHOD CompuMethod_6 "" RAT_FUNC "%1.0" "bool" COEFFS 0 1 0 0 0 1 /end COMPU_METHOD
/begin COMPU_METHOD CompuMethod_7 "" TAB_VERB "%1.0" "" COMPU_TAB_REF CompuVtab_2 /end COMPU_METHOD
/begin COMPU_METHOD CompuMethod_105 "" TAB_VERB "%3.0" "" COMPU_TAB_REF CompuVtab_25 /end COMPU_METHOD
/begin COMPU_METHOD CompuMethod_106 "" TAB_VERB "%3.0" "" COMPU_TAB_REF CompuVtab_26 /end COMPU_METHOD
/begin COMPU_METHOD CompuMethod_107 "" TAB_VERB "%3.0" "" COMPU_TAB_REF CompuVtab_27 /end COMPU_METHOD
/begin COMPU_METHOD CompuMethod_108 "" TAB_VERB "%3.0" "" COMPU_TAB_REF CompuVtab_28 /end COMPU_METHOD
/begin COMPU_VTAB CompuVtab_2 "" TAB_VERB 2 0 "Pass-Through" 1 "Override" /end COMPU_VTAB
/begin COMPU_VTAB CompuVtab_25 "" TAB_VERB 6 0 "Disabled" 1 "Enabled" 2 "Sticky" 3 "Enabled - Persistent" 4 "Sticky - Persistent" 5 "Save Occurred" /end COMPU_VTAB
/begin COMPU_VTAB CompuVtab_26 "" TAB_VERB 2 0 "-" 1 "Test" /end COMPU_VTAB
/begin COMPU_VTAB CompuVtab_27 "" TAB_VERB 16 0 "CutThrottle" 1 "DFCODisable" 2 "DelayedEngineShutdown" 3 "DisableAC" 4 "DisableFanRun" 5 "DisableFanStall" 6 "DisableO2Ctrl" 7 "DisableVEAdapt" 8 "DisableWastegate" 9 "EngineProtectLED" 10 "EngineShutdown" 11 "HardRevLimit" 12 "MIL_LED" 13 "MediumRevLimit" 14 "SoftRevLimit" 15 "(None)" /end COMPU_VTAB
/begin COMPU_VTAB CompuVtab_28 "" TAB_VERB 8 0 "(None)" 1 "Suspected" 2 "Active" 3 "Suspected or Active" 4 "Occurred" 5 "Suspected or Occurred" 6 "Active or Occurred" 7 "Suspected or Active or Occurred" /end COMPU_VTAB
/begin FUNCTION BaseEngineController_LS_112 ""
 /begin DEF_CHARACTERISTIC FaultManager.Lambda2HtrOpen_Fault.Action_3_Condition FaultManager.Lambda2HtrOpen_Fault.Action_4 FaultManager.Lambda2HtrOpen_Fault.Action_4_Condition FaultManager.Lambda2HtrShort_Fault.Mode FaultManager.Lambda2HtrShort_Fault.ID FaultManager.Lambda2HtrShort_Fault.Test FaultManager.Lambda2HtrShort_Fault.Faulty_Samples__X_ FaultManager.Lambda2HtrShort_Fault.Total_Samples__Y_ FaultManager.Lambda2HtrShort_Fault.Action_1 FaultManager.Lambda2HtrShort_Fault.Action_1_Condition FaultManager.Lambda2HtrShort_Fault.Action_2 FaultManager.Lambda2HtrShort_Fault.Action_2_Condition FaultManager.Lambda2HtrShort_Fault.Action_3 FaultManager.Lambda2HtrShort_Fault.Action_3_Condition FaultManager.Lambda2HtrShort_Fault.Action_4 FaultManager.Lambda2HtrShort_Fault.Action_4_Condition FaultManager.Lambda2Overcool_Fault.Mode FaultManager.Lambda2Overcool_Fault.ID FaultManager.Lambda2Overcool_Fault.Test FaultManager.Lambda2Overcool_Fault.Faulty_Samples__X_ FaultManager.Lambda2Overcool_Fault.Total_Samples__Y_ FaultManager.Lambda2Overcool_Fault.Action_1 FaultManager.Lambda2Overcool_Fault.Action_1_Condition FaultManager.Lambda2Overcool_Fault.Action_2 FaultManager.Lambda2Overcool_Fault.Action_2_Condition FaultManager.Lambda2Overcool_Fault.Action_3 FaultManager.Lambda2Overcool_Fault.Action_3_Condition FaultManager.Lambda2Overcool_Fault.Action_4 FaultManager.Lambda2Overcool_Fault.Action_4_Condition FaultManager.Lambda2Overheat_Fault.Mode FaultManager.Lambda2Overheat_Fault.ID FaultManager.Lambda2Overheat_Fault.Test FaultManager.Lambda2Overheat_Fault.Faulty_Samples__X_ FaultManager.Lambda2Overheat_Fault.Total_Samples__Y_ FaultManager.Lambda2Overheat_Fault.Action_1 FaultManager.Lambda2Overheat_Fault.Action_1_Condition FaultManager.Lambda2Overheat_Fault.Action_2 FaultManager.Lambda2Overheat_Fault.Action_2_Condition FaultManager.Lambda2Overheat_Fault.Action_3 FaultManager.Lambda2Overheat_Fault.Action_3_Condition FaultManager.Lambda2Overheat_Fault.Action_4 FaultManager.Lambda2Overheat_Fault.Action_4_Condition FaultManager.Lambda2StuckInReset_Fault.Mode FaultManager.Lambda2StuckInReset_Fault.ID FaultManager.Lambda2StuckInReset_Fault.Test FaultManager.Lambda2StuckInReset_Fault.Faulty_Samples__X_ FaultManager.Lambda2StuckInReset_Fault.Total_Samples__Y_ FaultManager.Lambda2StuckInReset_Fault.Action_1 FaultManager.Lambda2StuckInReset_Fault.Action_1_Condition FaultManager.Lambda2StuckInReset_Fault.Action_2 FaultManager.Lambda2StuckInReset_Fault.Action_2_Condition FaultManager.Lambda2StuckInReset_Fault.Action_3 FaultManager.Lambda2StuckInReset_Fault.Action_3_Condition FaultManager.Lambda2StuckInReset_Fault.Action_4 FaultManager.Lambda2StuckInReset_Fault.Action_4_Condition FaultManager.Lambda2StuckInWarmup_Fault.Mode FaultManager.Lambda2StuckInWarmup_Fault.ID FaultManager.Lambda2StuckInWarmup_Fault.Test FaultManager.Lambda2StuckInWarmup_Fault.Faulty_Samples__X_ FaultManager.Lambda2StuckInWarmup_Fault.Total_Samples__Y_ FaultManager.Lambda2StuckInWarmup_Fault.Action_1 FaultManager.Lambda2StuckInWarmup_Fault.Action_1_Condition FaultManager.Lambda2StuckInWarmup_Fault.Action_2 FaultManager.Lambda2StuckInWarmup_Fault.Action_2_Condition FaultManager.Lambda2StuckInWarmup_Fault.Action_3 FaultManager.Lambda2StuckInWarmup_Fault.Action_3_Condition FaultManager.Lambda2StuckInWarmup_Fault.Action_4 FaultManager.Lambda2StuckInWarmup_Fault.Action_4_Condition FaultManager.Lambda2VoltHigh_Fault.Mode FaultManager.Lambda2VoltHigh_Fault.ID FaultManager.Lambda2VoltHigh_Fault.Test FaultManager.Lambda2VoltHigh_Fault.Faulty_Samples__X_ FaultManager.Lambda2VoltHigh_Fault.Total_Samples__Y_ FaultManager.Lambda2VoltHigh_Fault.Action_1 FaultManager.Lambda2VoltHigh_Fault.Action_1_Condition FaultManager.Lambda2VoltHigh_Fault.Action_2 FaultManager.Lambda2VoltHigh_Fault.Action_2_Condition FaultManager.Lambda2VoltHigh_Fault.Action_3 FaultManager.Lambda2VoltHigh_Fault.Action_3_Condition FaultManager.Lambda2VoltHigh_Fault.Action_4 FaultManager.Lambda2VoltHigh_Fault.Action_4_Condition FaultManager.Lambda2VoltLow_Fault.Mode FaultManager.Lambda2VoltLow_Fault.ID FaultManager.Lambda2VoltLow_Fault.Test FaultManager.Lambda2VoltLow_Fault.Faulty_Samples__X_ FaultManager.Lambda2VoltLow_Fault.Total_Samples__Y_ FaultManager.Lambda2VoltLow_Fault.Action_1 FaultManager.Lambda2VoltLow_Fault.Action_1_Condition FaultManager.Lambda2VoltLow_Fault.Action_2 FaultManager.Lambda2VoltLow_Fault.Action_2_Condition FaultManager.Lambda2VoltLow_Fault.Action_3 FaultManager.Lambda2VoltLow_Fault.Action_3_Condition FaultManager.Lambda2VoltLow_Fault.Action_4 FaultManager.Lambda2VoltLow_Fault.Action_4_Condition FaultManager.Lambda_1_Timeout.Mode FaultManager.Lambda_1_Timeout.ID FaultManager.Lambda_1_Timeout.Test FaultManager.Lambda_1_Timeout.Faulty_Samples__X_ FaultManager.Lambda_1_Timeout.Total_Samples__Y_ FaultManager.Lambda_1_Timeout.Action_1 FaultManager.Lambda_1_Timeout.Action_1_Condition FaultManager.Lambda_1_Timeout.Action_2 FaultManager.Lambda_1_Timeout.Action_2_Condition FaultManager.Lambda_1_Timeout.Action_3 FaultManager.Lambda_1_Timeout.Action_3_Condition FaultManager.Lambda_1_Timeout.Action_4 FaultManager.Lambda_1_Timeout.Action_4_Condition FaultManager.Lambda_2_Timeout.Mode FaultManager.Lambda_2_Timeout.ID FaultManager.Lambda_2_Timeout.Test FaultManager.Lambda_2_Timeout.Faulty_Samples__X_ FaultManager.Lambda_2_Timeout.Total_Samples__Y_ FaultManager.Lambda_2_Timeout.Action_1 FaultManager.Lambda_2_Timeout.Action_1_Condition FaultManager.Lambda_2_Timeout.Action_2 FaultManager.Lambda_2_Timeout.Action_2_Condition FaultManager.Lambda_2_Timeout.Action_3 FaultManager.Lambda_2_Timeout.Action_3_Condition FaultManager.Lambda_2_Timeout.Action_4 FaultManager.Lambda_2_Timeout.Action_4_Condition FaultManager.Lambda_Bank2Bank_Fault.Mode FaultManager.Lambda_Bank2Bank_Fault.ID FaultManager.Lambda_Bank2Bank_Fault.Test FaultManager.Lambda_Bank2Bank_Fault.Faulty_Samples__X_ FaultManager.Lambda_Bank2Bank_Fault.Total_Samples__Y_ FaultManager.Lambda_Bank2Bank_Fault.Action_1 FaultManager.Lambda_Bank2Bank_Fault.Action_1_Condition FaultManager.Lambda_Bank2Bank_Fault.Action_2 FaultManager.Lambda_Bank2Bank_Fault.Action_2_Condition FaultManager.Lambda_Bank2Bank_Fault.Action_3 FaultManager.Lambda_Bank2Bank_Fault.Action_3_Condition FaultManager.Lambda_Bank2Bank_Fault.Action_4 FaultManager.Lambda_Bank2Bank_Fault.Action_4_Condition FaultManager.LeanProtect_Fault.Mode FaultManager.LeanProtect_Fault.ID FaultManager.LeanProtect_Fault.Test FaultManager.LeanProtect_Fault.Faulty_Samples__X_ FaultManager.LeanProtect_Fault.Total_Samples__Y_ FaultManager.LeanProtect_Fault.Action_1 FaultManager.LeanProtect_Fault.Action_1_Condition FaultManager.LeanProtect_Fault.Action_2 FaultManager.LeanProtect_Fault.Action_2_Condition FaultManager.LeanProtect_Fault.Action_3 FaultManager.LeanProtect_Fault.Action_3_Condition FaultManager.LeanProtect_Fault.Action_4 FaultManager.LeanProtect_Fault.Action_4_Condition FaultManager.MAFRangeHigh.Mode FaultManager.MAFRangeHigh.ID FaultManager.MAFRangeHigh.Test FaultManager.MAFRangeHigh.Faulty_Samples__X_ FaultManager.MAFRangeHigh.Total_Samples__Y_ FaultManager.MAFRangeHigh.Action_1 FaultManager.MAFRangeHigh.Action_1_Condition FaultManager.MAFRangeHigh.Action_2 FaultManager.MAFRangeHigh.Action_2_Condition FaultManager.MAFRangeHigh.Action_3 FaultManager.MAFRangeHigh.Action_3_Condition FaultManager.MAFRangeHigh.Action_4 FaultManager.MAFRangeHigh.Action_4_Condition FaultManager.MAFRangeLow.Mode FaultManager.MAFRangeLow.ID FaultManager.MAFRangeLow.Test FaultManager.MAFRangeLow.Faulty_Samples__X_ FaultManager.MAFRangeLow.Total_Samples__Y_ FaultManager.MAFRangeLow.Action_1 FaultManager.MAFRangeLow.Action_1_Condition FaultManager.MAFRangeLow.Action_2 FaultManager.MAFRangeLow.Action_2_Condition FaultManager.MAFRangeLow.Action_3 FaultManager.MAFRangeLow.Action_3_Condition FaultManager.MAFRangeLow.Action_4 FaultManager.MAFRangeLow.Action_4_Condition FaultManager.MAPRangeHigh.Mode FaultManager.MAPRangeHigh.ID FaultManager.MAPRangeHigh.Test FaultManager.MAPRangeHigh.Faulty_Samples__X_ FaultManager.MAPRangeHigh.Total_Samples__Y_ FaultManager.MAPRangeHigh.Action_1 FaultManager.MAPRangeHigh.Action_1_Condition FaultManager.MAPRangeHigh.Action_2 FaultManager.MAPRangeHigh.Action_2_Condition FaultManager.MAPRangeHigh.Action_3 FaultManager.MAPRangeHigh.Action_3_Condition FaultManager.MAPRangeHigh.Action_4 FaultManager.MAPRangeHigh.Action_4_Condition FaultManager.MAPRangeLow.Mode FaultManager.MAPRangeLow.ID FaultManager.MAPRangeLow.Test FaultManager.MAPRangeLow.Faulty_Samples__X_ FaultManager.MAPRangeLow.Total_Samples__Y_ FaultManager.MAPRangeLow.Action_1 FaultManager.MAPRangeLow.Action_1_Condition FaultManager.MAPRangeLow.Action_2 FaultManager.MAPRangeLow.Action_2_Condition FaultManager.MAPRangeLow.Action_3 FaultManager.MAPRangeLow.Action_3_Condition FaultManager.MAPRangeLow.Action_4 FaultManager.MAPRangeLow.Action_4_Condition FaultManager.MAPTimeRangeHigh.Mode FaultManager.MAPTimeRangeHigh.ID FaultManager.MAPTimeRangeHigh.Test FaultManager.MAPTimeRangeHigh.Faulty_Samples__X_ FaultManager.MAPTimeRangeHigh.Total_Samples__Y_ FaultManager.MAPTimeRangeHigh.Action_1 FaultManager.MAPTimeRangeHigh.Action_1_Condition FaultManager.MAPTimeRangeHigh.Action_2 FaultManager.MAPTimeRangeHigh.Action_2_Condition FaultManager.MAPTimeRangeHigh.Action_3 FaultManager.MAPTimeRangeHigh.Action_3_Condition FaultManager.MAPTimeRangeHigh.Action_4 FaultManager.MAPTimeRangeHigh.Action_4_Condition FaultManager.MAPTimeRangeLow.Mode FaultManager.MAPTimeRangeLow.ID FaultManager.MAPTimeRangeLow.Test FaultManager.MAPTimeRangeLow.Faulty_Samples__X_ FaultManager.MAPTimeRangeLow.Total_Samples__Y_ FaultManager.MAPTimeRangeLow.Action_1 FaultManager.MAPTimeRangeLow.Action_1_Condition FaultManager.MAPTimeRangeLow.Action_2 FaultManager.MAPTimeRangeLow.Action_2_Condition FaultManager.MAPTimeRangeLow.Action_3 FaultManager.MAPTimeRangeLow.Action_3_Condition FaultManager.MAPTimeRangeLow.Action_4 FaultManager.MAPTimeRangeLow.Action_4_Condition FaultManager.MAP_IR_HI.Mode FaultManager.MAP_IR_HI.ID FaultManager.MAP_IR_HI.Test FaultManager.MAP_IR_HI.Faulty_Samples__X_ FaultManager.MAP_IR_HI.Total_Samples__Y_ FaultManager.MAP_IR_HI.Action_1 FaultManager.MAP_IR_HI.Action_1_Condition FaultManager.MAP_IR_HI.Action_2 FaultManager.MAP_IR_HI.Action_2_Condition FaultManager.MAP_IR_HI.Action_3 FaultManager.MAP_IR_HI.Action_3_Condition FaultManager.MAP_IR_HI.Action_4 FaultManager.MAP_IR_HI.Action_4_Condition FaultManager.MAP_IR_LO.Mode FaultManager.MAP_IR_LO.ID FaultManager.MAP_IR_LO.Test FaultManager.MAP_IR_LO.Faulty_Samples__X_ FaultManager.MAP_IR_LO.Total_Samples__Y_ FaultManager.MAP_IR_LO.Action_1 FaultManager.MAP_IR_LO.Action_1_Condition FaultManager.MAP_IR_LO.Action_2 FaultManager.MAP_IR_LO.Action_2_Condition FaultManager.MAP_IR_LO.Action_3 FaultManager.MAP_IR_LO.Action_3_Condition FaultManager.MAP_IR_LO.Action_4 FaultManager.MAP_IR_LO.Action_4_Condition FaultManager.MAP_STICKING.Mode FaultManager.MAP_STICKING.ID FaultManager.MAP_STICKING.Test FaultManager.MAP_STICKING.Faulty_Samples__X_ FaultManager.MAP_STICKING.Total_Samples__Y_ FaultManager.MAP_STICKING.Action_1 FaultManager.MAP_STICKING.Action_1_Condition FaultManager.MAP_STICKING.Action_2 FaultManager.MAP_STICKING.Action_2_Condition FaultManager.MAP_STICKING.Action_3 FaultManager.MAP_STICKING.Action_3_Condition FaultManager.MAP_STICKING.Action_4 FaultManager.MAP_STICKING.Action_4_Condition FaultManager.MediumOverspeed.Mode FaultManager.MediumOverspeed.ID FaultManager.MediumOverspeed.Test FaultManager.MediumOverspeed.Faulty_Samples__X_ FaultManager.MediumOverspeed.Total_Samples__Y_ FaultManager.MediumOverspeed.Action_1 FaultManager.MediumOverspeed.Action_1_Condition FaultManager.MediumOverspeed.Action_2 FaultManager.MediumOverspeed.Action_2_Condition FaultManager.MediumOverspeed.Action_3 FaultManager.MediumOverspeed.Action_3_Condition FaultManager.MediumOverspeed.Action_4 FaultManager.MediumOverspeed.Action_4_Condition FaultManager.NoOil_Fault.Mode FaultManager.NoOil_Fault.ID FaultManager.NoOil_Fault.Test FaultManager.NoOil_Fault.Faulty_Samples__X_ FaultManager.NoOil_Fault.Total_Samples__Y_ FaultManager.NoOil_Fault.Action_1 FaultManager.NoOil_Fault.Action_1_Condition FaultManager.NoOil_Fault.Action_2 FaultManager.NoOil_Fault.Action_2_Condition FaultManager.NoOil_Fault.Action_3 FaultManager.NoOil_Fault.Action_3_Condition FaultManager.NoOil_Fault.Action_4 FaultManager.NoOil_Fault.Action_4_Condition FaultManager.O2FailedLean_BankA.Mode FaultManager.O2FailedLean_BankA.ID FaultManager.O2FailedLean_BankA.Test FaultManager.O2FailedLean_BankA.Faulty_Samples__X_ FaultManager.O2FailedLean_BankA.Total_Samples__Y_ FaultManager.O2FailedLean_BankA.Action_1 FaultManager.O2FailedLean_BankA.Action_1_Condition FaultManager.O2FailedLean_BankA.Action_2 FaultManager.O2FailedLean_BankA.Action_2_Condition FaultManager.O2FailedLean_BankA.Action_3 FaultManager.O2FailedLean_BankA.Action_3_Condition FaultManager.O2FailedLean_BankA.Action_4 FaultManager.O2FailedLean_BankA.Action_4_Condition FaultManager.O2FailedLean_BankB.Mode FaultManager.O2FailedLean_BankB.ID FaultManager.O2FailedLean_BankB.Test FaultManager.O2FailedLean_BankB.Faulty_Samples__X_ FaultManager.O2FailedLean_BankB.Total_Samples__Y_ FaultManager.O2FailedLean_BankB.Action_1 FaultManager.O2FailedLean_BankB.Action_1_Condition FaultManager.O2FailedLean_BankB.Action_2 FaultManager.O2FailedLean_BankB.Action_2_Condition FaultManager.O2FailedLean_BankB.Action_3 FaultManager.O2FailedLean_BankB.Action_3_Condition FaultManager.O2FailedLean_BankB.Action_4 FaultManager.O2FailedLean_BankB.Action_4_Condition FaultManager.O2FailedRich_BankA.Mode FaultManager.O2FailedRich_BankA.ID FaultManager.O2FailedRich_BankA.Test FaultManager.O2FailedRich_BankA.Faulty_Samples__X_ FaultManager.O2FailedRich_BankA.Total_Samples__Y_ FaultManager.O2FailedRich_BankA.Action_1 FaultManager.O2FailedRich_BankA.Action_1_Condition FaultManager.O2FailedRich_BankA.Action_2 FaultManager.O2FailedRich_BankA.Action_2_Condition FaultManager.O2FailedRich_BankA.Action_3 FaultManager.O2FailedRich_BankA.Action_3_Condition FaultManager.O2FailedRich_BankA.Action_4 FaultManager.O2FailedRich_BankA.Action_4_Condition FaultManager.O2FailedRich_BankB.Mode FaultManager.O2FailedRich_BankB.ID FaultManager.O2FailedRich_BankB.Test FaultManager.O2FailedRich_BankB.Faulty_Samples__X_ FaultManager.O2FailedRich_BankB.Total_Samples__Y_ FaultManager.O2FailedRich_BankB.Action_1 FaultManager.O2FailedRich_BankB.Action_1_Condition FaultManager.O2FailedRich_BankB.Action_2 FaultManager.O2FailedRich_BankB.Action_2_Condition FaultManager.O2FailedRich_BankB.Action_3 FaultManager.O2FailedRich_BankB.Action_3_Condition FaultManager.O2FailedRich_BankB.Action_4 FaultManager.O2FailedRich_BankB.Action_4_Condition FaultManager.O2NotActive_BankA.Mode FaultManager.O2NotActive_BankA.ID FaultManager.O2NotActive_BankA.Test FaultManager.O2NotActive_BankA.Faulty_Samples__X_ FaultManager.O2NotActive_BankA.Total_Samples__Y_ FaultManager.O2NotActive_BankA.Action_1 FaultManager.O2NotActive_BankA.Action_1_Condition FaultManager.O2NotActive_BankA.Action_2 FaultManager.O2NotActive_BankA.Action_2_Condition FaultManager.O2NotActive_BankA.Action_3 FaultManager.O2NotActive_BankA.Action_3_Condition FaultManager.O2NotActive_BankA.Action_4 FaultManager.O2NotActive_BankA.Action_4_Condition FaultManager.O2NotActive_BankB.Mode FaultManager.O2NotActive_BankB.ID FaultManager.O2NotActive_BankB.Test FaultManager.O2NotActive_BankB.Faulty_Samples__X_ FaultManager.O2NotActive_BankB.Total_Samples__Y_ FaultManager.O2NotActive_BankB.Action_1 FaultManager.O2NotActive_BankB.Action_1_Condition FaultManager.O2NotActive_BankB.Action_2 FaultManager.O2NotActive_BankB.Action_2_Condition FaultManager.O2NotActive_BankB.Action_3 FaultManager.O2NotActive_BankB.Action_3_Condition FaultManager.O2NotActive_BankB.Action_4 FaultManager.O2NotActive_BankB.Action_4_Condition FaultManager.OilPresRangeHigh.Mode FaultManager.OilPresRangeHigh.ID FaultManager.OilPresRangeHigh.Test FaultManager.OilPresRangeHigh.Faulty_Samples__X_ FaultManager.OilPresRangeHigh.Total_Samples__Y_ FaultManager.OilPresRangeHigh.Action_1 FaultManager.OilPresRangeHigh.Action_1_Condition FaultManager.OilPresRangeHigh.Action_2 FaultManager.OilPresRangeHigh.Action_2_Condition FaultManager.OilPresRangeHigh.Action_3 FaultManager.OilPresRangeHigh.Action_3_Condition FaultManager.OilPresRangeHigh.Action_4 FaultManager.OilPresRangeHigh.Action_4_Condition FaultManager.OilPresRangeLow.Mode FaultManager.OilPresRangeLow.ID FaultManager.OilPresRangeLow.Test FaultManager.OilPresRangeLow.Faulty_Samples__X_ FaultManager.OilPresRangeLow.Total_Samples__Y_ FaultManager.OilPresRangeLow.Action_1 FaultManager.OilPresRangeLow.Action_1_Condition FaultManager.OilPresRangeLow.Action_2 FaultManager.OilPresRangeLow.Action_2_Condition FaultManager.OilPresRangeLow.Action_3 FaultManager.OilPresRangeLow.Action_3_Condition FaultManager.OilPresRangeLow.Action_4 FaultManager.OilPresRangeLow.Action_4_Condition FaultManager.ScrambleStuckHigh_Fault.Mode FaultManager.ScrambleStuckHigh_Fault.ID FaultManager.ScrambleStuckHigh_Fault.Test FaultManager.ScrambleStuckHigh_Fault.Faulty_Samples__X_ FaultManager.ScrambleStuckHigh_Fault.Total_Samples__Y_ FaultManager.ScrambleStuckHigh_Fault.Action_1 FaultManager.ScrambleStuckHigh_Fault.Action_1_Condition FaultManager.ScrambleStuckHigh_Fault.Action_2 FaultManager.ScrambleStuckHigh_Fault.Action_2_Condition FaultManager.ScrambleStuckHigh_Fault.Action_3 FaultManager.ScrambleStuckHigh_Fault.Action_3_Condition FaultManager.ScrambleStuckHigh_Fault.Action_4 FaultManager.ScrambleStuckHigh_Fault.Action_4_Condition FaultManager.SensVoltRangeHigh.Mode FaultManager.SensVoltRangeHigh.ID FaultManager.SensVoltRangeHigh.Test FaultManager.SensVoltRangeHigh.Faulty_Samples__X_ FaultManager.SensVoltRangeHigh.Total_Samples__Y_ FaultManager.SensVoltRangeHigh.Action_1 FaultManager.SensVoltRangeHigh.Action_1_Condition FaultManager.SensVoltRangeHigh.Action_2 FaultManager.SensVoltRangeHigh.Action_2_Condition FaultManager.SensVoltRangeHigh.Action_3 FaultManager.SensVoltRangeHigh.Action_3_Condition FaultManager.SensVoltRangeHigh.Action_4 FaultManager.SensVoltRangeHigh.Action_4_Condition FaultManager.SensVoltRangeLow.Mode FaultManager.SensVoltRangeLow.ID FaultManager.SensVoltRangeLow.Test FaultManager.SensVoltRangeLow.Faulty_Samples__X_ FaultManager.SensVoltRangeLow.Total_Samples__Y_ FaultManager.SensVoltRangeLow.Action_1 FaultManager.SensVoltRangeLow.Action_1_Condition FaultManager.SensVoltRangeLow.Action_2 FaultManager.SensVoltRangeLow.Action_2_Condition FaultManager.SensVoltRangeLow.Action_3 FaultManager.SensVoltRangeLow.Action_3_Condition FaultManager.SensVoltRangeLow.Action_4 FaultManager.SensVoltRangeLow.Action_4_Condition FaultManager.SoftOverBoost_Fault.Mode FaultManager.SoftOverBoost_Fault.ID FaultManager.SoftOverBoost_Fault.Test FaultManager.SoftOverBoost_Fault.Faulty_Samples__X_ FaultManager.SoftOverBoost_Fault.Total_Samples__Y_ FaultManager.SoftOverBoost_Fault.Action_1 FaultManager.SoftOverBoost_Fault.Action_1_Condition FaultManager.SoftOverBoost_Fault.Action_2 FaultManager.SoftOverBoost_Fault.Action_2_Condition FaultManager.SoftOverBoost_Fault.Action_3 FaultManager.SoftOverBoost_Fault.Action_3_Condition FaultManager.SoftOverBoost_Fault.Action_4 FaultManager.SoftOverBoost_Fault.Action_4_Condition FaultManager.SoftOverspeed.Mode FaultManager.SoftOverspeed.ID FaultManager.SoftOverspeed.Test FaultManager.SoftOverspeed.Faulty_Samples__X_ FaultManager.SoftOverspeed.Total_Samples__Y_ FaultManager.SoftOverspeed.Action_1 FaultManager.SoftOverspeed.Action_1_Condition FaultManager.SoftOverspeed.Action_2 FaultManager.SoftOverspeed.Action_2_Condition FaultManager.SoftOverspeed.Action_3 FaultManager.SoftOverspeed.Action_3_Condition FaultManager.SoftOverspeed.Action_4 FaultManager.SoftOverspeed.Action_4_Condition FaultManager.SysVoltRangeHigh.Mode FaultManager.SysVoltRangeHigh.ID FaultManager.SysVoltRangeHigh.Test FaultManager.SysVoltRangeHigh.Faulty_Samples__X_ FaultManager.SysVoltRangeHigh.Total_Samples__Y_ FaultManager.SysVoltRangeHigh.Action_1 FaultManager.SysVoltRangeHigh.Action_1_Condition FaultManager.SysVoltRangeHigh.Action_2 FaultManager.SysVoltRangeHigh.Action_2_Condition FaultManager.SysVoltRangeHigh.Action_3 FaultManager.SysVoltRangeHigh.Action_3_Condition FaultManager.SysVoltRangeHigh.Action_4 FaultManager.SysVoltRangeHigh.Action_4_Condition FaultManager.SysVoltRangeLow.Mode FaultManager.SysVoltRangeLow.ID FaultManager.SysVoltRangeLow.Test FaultManager.SysVoltRangeLow.Faulty_Samples__X_ FaultManager.SysVoltRangeLow.Total_Samples__Y_ FaultManager.SysVoltRangeLow.Action_1 FaultManager.SysVoltRangeLow.Action_1_Condition FaultManager.SysVoltRangeLow.Action_2 FaultManager.SysVoltRangeLow.Action_2_Condition FaultManager.SysVoltRangeLow.Action_3 FaultManager.SysVoltRangeLow.Action_3_Condition FaultManager.SysVoltRangeLow.Action_4 FaultManager.SysVoltRangeLow.Action_4_Condition FaultManager.TPS1AdaptHiMax.Mode FaultManager.TPS1AdaptHiMax.ID FaultManager.TPS1AdaptHiMax.Test FaultManager.TPS1AdaptHiMax.Faulty_Samples__X_ FaultManager.TPS1AdaptHiMax.Total_Samples__Y_ FaultManager.TPS1AdaptHiMax.Action_1 FaultManager.TPS1AdaptHiMax.Action_1_Condition FaultManager.TPS1AdaptHiMax.Action_2 FaultManager.TPS1AdaptHiMax.Action_2_Condition FaultManager.TPS1AdaptHiMax.Action_3 FaultManager.TPS1AdaptHiMax.Action_3_Condition FaultManager.TPS1AdaptHiMax.Action_4 FaultManager.TPS1AdaptHiMax.Action_4_Condition FaultManager.TPS1AdaptHiMin.Mode FaultManager.TPS1AdaptHiMin.ID FaultManager.TPS1AdaptHiMin.Test FaultManager.TPS1AdaptHiMin.Faulty_Samples__X_ FaultManager.TPS1AdaptHiMin.Total_Samples__Y_ FaultManager.TPS1AdaptHiMin.Action_1 FaultManager.TPS1AdaptHiMin.Action_1_Condition FaultManager.TPS1AdaptHiMin.Action_2 FaultManager.TPS1AdaptHiMin.Action_2_Condition FaultManager.TPS1AdaptHiMin.Action_3 FaultManager.TPS1AdaptHiMin.Action_3_Condition FaultManager.TPS1AdaptHiMin.Action_4 FaultManager.TPS1AdaptHiMin.Action_4_Condition FaultManager.TPS1AdaptLoMax.Mode FaultManager.TPS1AdaptLoMax.ID FaultManager.TPS1AdaptLoMax.Test FaultManager.TPS1AdaptLoMax.Faulty_Samples__X_ FaultManager.TPS1AdaptLoMax.Total_Samples__Y_ FaultManager.TPS1AdaptLoMax.Action_1 FaultManager.TPS1AdaptLoMax.Action_1_Condition FaultManager.TPS1AdaptLoMax.Action_2 FaultManager.TPS1AdaptLoMax.Action_2_Condition FaultManager.TPS1AdaptLoMax.Action_3 FaultManager.TPS1AdaptLoMax.Action_3_Condition FaultManager.TPS1AdaptLoMax.Action_4 FaultManager.TPS1AdaptLoMax.Action_4_Condition FaultManager.TPS1AdaptLoMin.Mode FaultManager.TPS1AdaptLoMin.ID FaultManager.TPS1AdaptLoMin.Test FaultManager.TPS1AdaptLoMin.Faulty_Samples__X_ FaultManager.TPS1AdaptLoMin.Total_Samples__Y_ FaultManager.TPS1AdaptLoMin.Action_1 FaultManager.TPS1AdaptLoMin.Action_1_Condition FaultManager.TPS1AdaptLoMin.Action_2 FaultManager.TPS1AdaptLoMin.Action_2_Condition FaultManager.TPS1AdaptLoMin.Action_3 FaultManager.TPS1AdaptLoMin.Action_3_Condition FaultManager.TPS1AdaptLoMin.Action_4 FaultManager.TPS1AdaptLoMin.Action_4_Condition FaultManager.TPS1RangeHigh.Mode FaultManager.TPS1RangeHigh.ID FaultManager.TPS1RangeHigh.Test FaultManager.TPS1RangeHigh.Faulty_Samples__X_ FaultManager.TPS1RangeHigh.Total_Samples__Y_ FaultManager.TPS1RangeHigh.Action_1 FaultManager.TPS1RangeHigh.Action_1_Condition FaultManager.TPS1RangeHigh.Action_2 FaultManager.TPS1RangeHigh.Action_2_Condition FaultManager.TPS1RangeHigh.Action_3 FaultManager.TPS1RangeHigh.Action_3_Condition FaultManager.TPS1RangeHigh.Action_4 FaultManager.TPS1RangeHigh.Action_4_Condition FaultManager.TPS1RangeLow.Mode FaultManager.TPS1RangeLow.ID FaultManager.TPS1RangeLow.Test FaultManager.TPS1RangeLow.Faulty_Samples__X_ FaultManager.TPS1RangeLow.Total_Samples__Y_ FaultManager.TPS1RangeLow.Action_1 FaultManager.TPS1RangeLow.Action_1_Condition FaultManager.TPS1RangeLow.Action_2 FaultManager.TPS1RangeLow.Action_2_Condition FaultManager.TPS1RangeLow.Action_3 FaultManager.TPS1RangeLow.Action_3_Condition FaultManager.TPS1RangeLow.Action_4 FaultManager.TPS1RangeLow.Action_4_Condition FaultManager.TPS2AdaptHiMax.Mode FaultManager.TPS2AdaptHiMax.ID FaultManager.TPS2AdaptHiMax.Test FaultManager.TPS2AdaptHiMax.Faulty_Samples__X_ FaultManager.TPS2AdaptHiMax.Total_Samples__Y_ FaultManager.TPS2AdaptHiMax.Action_1 FaultManager.TPS2AdaptHiMax.Action_1_Condition FaultManager.TPS2AdaptHiMax.Action_2 FaultManager.TPS2AdaptHiMax.Action_2_Condition FaultManager.TPS2AdaptHiMax.Action_3 FaultManager.TPS2AdaptHiMax.Action_3_Condition FaultManager.TPS2AdaptHiMax.Action_4 FaultManager.TPS2AdaptHiMax.Action_4_Condition FaultManager.TPS2AdaptHiMin.Mode FaultManager.TPS2AdaptHiMin.ID FaultManager.TPS2AdaptHiMin.Test FaultManager.TPS2AdaptHiMin.Faulty_Samples__X_ FaultManager.TPS2AdaptHiMin.Total_Samples__Y_ FaultManager.TPS2AdaptHiMin.Action_1 FaultManager.TPS2AdaptHiMin.Action_1_Condition FaultManager.TPS2AdaptHiMin.Action_2 FaultManager.TPS2AdaptHiMin.Action_2_Condition FaultManager.TPS2AdaptHiMin.Action_3 FaultManager.TPS2AdaptHiMin.Action_3_Condition FaultManager.TPS2AdaptHiMin.Action_4 FaultManager.TPS2AdaptHiMin.Action_4_Condition FaultManager.TPS2AdaptLoMax.Mode FaultManager.TPS2AdaptLoMax.ID FaultManager.TPS2AdaptLoMax.Test FaultManager.TPS2AdaptLoMax.Faulty_Samples__X_ FaultManager.TPS2AdaptLoMax.Total_Samples__Y_ FaultManager.TPS2AdaptLoMax.Action_1 FaultManager.TPS2AdaptLoMax.Action_1_Condition FaultManager.TPS2AdaptLoMax.Action_2 FaultManager.TPS2AdaptLoMax.Action_2_Condition FaultManager.TPS2AdaptLoMax.Action_3 FaultManager.TPS2AdaptLoMax.Action_3_Condition FaultManager.TPS2AdaptLoMax.Action_4 FaultManager.TPS2AdaptLoMax.Action_4_Condition FaultManager.TPS2AdaptLoMin.Mode FaultManager.TPS2AdaptLoMin.ID FaultManager.TPS2AdaptLoMin.Test FaultManager.TPS2AdaptLoMin.Faulty_Samples__X_ FaultManager.TPS2AdaptLoMin.Total_Samples__Y_ FaultManager.TPS2AdaptLoMin.Action_1 FaultManager.TPS2AdaptLoMin.Action_1_Condition FaultManager.TPS2AdaptLoMin.Action_2 FaultManager.TPS2AdaptLoMin.Action_2_Condition FaultManager.TPS2AdaptLoMin.Action_3 FaultManager.TPS2AdaptLoMin.Action_3_Condition FaultManager.TPS2AdaptLoMin.Action_4 FaultManager.TPS2AdaptLoMin.Action_4_Condition FaultManager.TPS2RangeHigh.Mode FaultManager.TPS2RangeHigh.ID FaultManager.TPS2RangeHigh.Test FaultManager.TPS2RangeHigh.Faulty_Samples__X_ FaultManager.TPS2RangeHigh.Total_Samples__Y_ FaultManager.TPS2RangeHigh.Action_1 FaultManager.TPS2RangeHigh.Action_1_Condition FaultManager.TPS2RangeHigh.Action_2 FaultManager.TPS2RangeHigh.Action_2_Condition FaultManager.TPS2RangeHigh.Action_3 FaultManager.TPS2RangeHigh.Action_3_Condition FaultManager.TPS2RangeHigh.Action_4 FaultManager.TPS2RangeHigh.Action_4_Condition FaultManager.TPS2RangeLow.Mode FaultManager.TPS2RangeLow.ID FaultManager.TPS2RangeLow.Test FaultManager.TPS2RangeLow.Faulty_Samples__X_ FaultManager.TPS2RangeLow.Total_Samples__Y_ FaultManager.TPS2RangeLow.Action_1 FaultManager.TPS2RangeLow.Action_1_Condition FaultManager.TPS2RangeLow.Action_2 FaultManager.TPS2RangeLow.Action_2_Condition FaultManager.TPS2RangeLow.Action_3 FaultManager.TPS2RangeLow.Action_3_Condition FaultManager.TPS2RangeLow.Action_4 FaultManager.TPS2RangeLow.Action_4_Condition FaultManager.TPS_Sensors_Conflict.Mode FaultManager.TPS_Sensors_Conflict.ID FaultManager.TPS_Sensors_Conflict.Test FaultManager.TPS_Sensors_Conflict.Faulty_Samples__X_ FaultManager.TPS_Sensors_Conflict.Total_Samples__Y_ FaultManager.TPS_Sensors_Conflict.Action_1 FaultManager.TPS_Sensors_Conflict.Action_1_Condition FaultManager.TPS_Sensors_Conflict.Action_2 FaultManager.TPS_Sensors_Conflict.Action_2_Condition FaultManager.TPS_Sensors_Conflict.Action_3 FaultManager.TPS_Sensors_Conflict.Action_3_Condition FaultManager.TPS_Sensors_Conflict.Action_4 FaultManager.TPS_Sensors_Conflict.Action_4_Condition FaultManager.VSPDRangeHigh.Mode FaultManager.VSPDRangeHigh.ID FaultManager.VSPDRangeHigh.Test FaultManager.VSPDRangeHigh.Faulty_Samples__X_ FaultManager.VSPDRangeHigh.Total_Samples__Y_ FaultManager.VSPDRangeHigh.Action_1 FaultManager.VSPDRangeHigh.Action_1_Condition FaultManager.VSPDRangeHigh.Action_2 FaultManager.VSPDRangeHigh.Action_2_Condition FaultManager.VSPDRangeHigh.Action_3 FaultManager.VSPDRangeHigh.Action_3_Condition FaultManager.VSPDRangeHigh.Action_4 FaultManager.VSPDRangeHigh.Action_4_Condition FaultManager.VSPDRangeLow.Mode FaultManager.VSPDRangeLow.ID FaultManager.VSPDRangeLow.Test FaultManager.VSPDRangeLow.Faulty_Samples__X_ FaultManager.VSPDRangeLow.Total_Samples__Y_ FaultManager.VSPDRangeLow.Action_1 FaultManager.VSPDRangeLow.Action_1_Condition FaultManager.VSPDRangeLow.Action_2 FaultManager.VSPDRangeLow.Action_2_Condition FaultManager.VSPDRangeLow.Action_3 FaultManager.VSPDRangeLow.Action_3_Condition FaultManager.VSPDRangeLow.Action_4 FaultManager.VSPDRangeLow.Action_4_Condition FaultManager.VoltLow_Fault.Mode FaultManager.VoltLow_Fault.ID FaultManager.VoltLow_Fault.Test FaultManager.VoltLow_Fault.Faulty_Samples__X_ FaultManager.VoltLow_Fault.Total_Samples__Y_ FaultManager.VoltLow_Fault.Action_1 FaultManager.VoltLow_Fault.Action_1_Condition FaultManager.VoltLow_Fault.Action_2 FaultManager.VoltLow_Fault.Action_2_Condition FaultManager.VoltLow_Fault.Action_3 FaultManager.VoltLow_Fault.Action_3_Condition FaultManager.VoltLow_Fault.Action_4 FaultManager.VoltLow_Fault.Action_4_Condition FaultManager.VoltTooHigh_Fault.Mode FaultManager.VoltTooHigh_Fault.ID FaultManager.VoltTooHigh_Fault.Test FaultManager.VoltTooHigh_Fault.Faulty_Samples__X_ FaultManager.VoltTooHigh_Fault.Total_Samples__Y_ FaultManager.VoltTooHigh_Fault.Action_1 FaultManager.VoltTooHigh_Fault.Action_1_Condition FaultManager.VoltTooHigh_Fault.Action_2 FaultManager.VoltTooHigh_Fault.Action_2_Condition FaultManager.VoltTooHigh_Fault.Action_3 FaultManager.VoltTooHigh_Fault.Action_3_Condition FaultManager.VoltTooHigh_Fault.Action_4 FaultManager.VoltTooHigh_Fault.Action_4_Condition FaultManager.Wastegate_Fault.Mode FaultManager.Wastegate_Fault.ID FaultManager.Wastegate_Fault.Test FaultManager.Wastegate_Fault.Faulty_Samples__X_ FaultManager.Wastegate_Fault.Total_Samples__Y_ FaultManager.Wastegate_Fault.Action_1 FaultManager.Wastegate_Fault.Action_1_Condition FaultManager.Wastegate_Fault.Action_2 FaultManager.Wastegate_Fault.Action_2_Condition FaultManager.Wastegate_Fault.Action_3 FaultManager.Wastegate_Fault.Action_3_Condition FaultManager.Wastegate_Fault.Action_4 FaultManager.Wastegate_Fault.Action_4_Condition /end DEF_CHARACTERISTIC
/end FUNCTION
/begin FUNCTION AC_Override "" /begin DEF_CHARACTERISTIC AC_new AC_ovr /end DEF_CHARACTERISTIC /end FUNCTION
/begin FUNCTION AC_Config "" /begin DEF_CHARACTERISTIC AC_Polarity /end DEF_CHARACTERISTIC /end FUNCTION
/end MODULE
/end PROJECT
