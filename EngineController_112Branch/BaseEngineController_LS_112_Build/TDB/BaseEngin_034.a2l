ASAP2_VERSION 1 51
/begin PROJECT Project ""
/begin MODULE BaseEngin_034 ""
/begin MOD_COMMON /* MOD_COMMON Comment */ "" BYTE_ORDER MSB_FIRST ALIGNMENT_BYTE 1 ALIGNMENT_FLOAT32_IEEE 1 ALIGNMENT_FLOAT64_IEEE 1 ALIGNMENT_LONG 1 ALIGNMENT_WORD 1 /end MOD_COMMON
/begin CHARACTERISTIC FaultManager.EST3_Open.Mode "Fault manager configuration.  Select up to 4 actions for each fault." VALUE 0x80002C9B RecordLayout_3 0 CompuMethod_105 0 65535 /end CHARACTERISTIC
/begin CHARACTERISTIC FaultManager.EST3_Open.ID "Fault manager configuration.  Select up to 4 actions for each fault." VALUE 0x80002C9D RecordLayout_3 0 CompuMethod_1 0 65535 /end CHARACTERISTIC
/begin CHARACTERISTIC FaultManager.EST3_Open.Test "Fault manager configuration.  Select up to 4 actions for each fault." VALUE 0x80002C9F RecordLayout_3 0 CompuMethod_106 0 65535 /end CHARACTERISTIC
/begin CHARACTERISTIC FaultManager.EST3_Open.Faulty_Samples__X_ "Fault manager configuration.  Select up to 4 actions for each fault." VALUE 0x80002CA1 RecordLayout_3 0 CompuMethod_1 0 65535 /end CHARACTERISTIC
/begin CHARACTERISTIC FaultManager.EST3_Open.Total_Samples__Y_ "Fault manager configuration.  Select up to 4 actions for each fault." VALUE 0x80002CA3 RecordLayout_3 0 CompuMethod_1 0 65535 /end CHARACTERISTIC
/begin CHARACTERISTIC FaultManager.EST3_Open.Action_1 "Fault manager configuration.  Select up to 4 actions for each fault." VALUE 0x80002CA5 RecordLayout_3 0 CompuMethod_107 0 65535 /end CHARACTERISTIC
/begin CHARACTERISTIC FaultManager.EST3_Open.Action_1_Condition "Fault manager configuration.  Select up to 4 actions for each fault." VALUE 0x80002CA7 RecordLayout_3 0 CompuMethod_108 0 65535 /end CHARACTERISTIC
/begin CHARACTERISTIC FaultManager.EST3_Open.Action_2 "Fault manager configuration.  Select up to 4 actions for each fault." VALUE 0x80002CA9 RecordLayout_3 0 CompuMethod_107 0 65535 /end CHARACTERISTIC
/begin CHARACTERISTIC FaultManager.EST3_Open.Action_2_Condition "Fault manager configuration.  Select up to 4 actions for each fault." VALUE 0x80002CAB RecordLayout_3 0 CompuMethod_108 0 65535 /end CHARACTERISTIC
/begin CHARACTERISTIC FaultManager.EST3_Open.Action_3 "Fault manager configuration.  Select up to 4 actions for each fault." VALUE 0x80002CAD RecordLayout_3 0 CompuMethod_107 0 65535 /end CHARACTERISTIC
/begin CHARACTERISTIC FaultManager.EST3_Open.Action_3_Condition "Fault manager configuration.  Select up to 4 actions for each fault." VALUE 0x80002CAF RecordLayout_3 0 CompuMethod_108 0 65535 /end CHARACTERISTIC
/begin CHARACTERISTIC FaultManager.EST3_Open.Action_4 "Fault manager configuration.  Select up to 4 actions for each fault." VALUE 0x80002CB1 RecordLayout_3 0 CompuMethod_107 0 65535 /end CHARACTERISTIC
/begin CHARACTERISTIC FaultManager.EST3_Open.Action_4_Condition "Fault manager configuration.  Select up to 4 actions for each fault." VALUE 0x80002CB3 RecordLayout_3 0 CompuMethod_108 0 65535 /end CHARACTERISTIC
/begin CHARACTERISTIC FaultManager.EST3_Short.Mode "Fault manager configuration.  Select up to 4 actions for each fault." VALUE 0x80002CB5 RecordLayout_3 0 CompuMethod_105 0 65535 /end CHARACTERISTIC
/begin CHARACTERISTIC FaultManager.EST3_Short.ID "Fault manager configuration.  Select up to 4 actions for each fault." VALUE 0x80002CB7 RecordLayout_3 0 CompuMethod_1 0 65535 /end CHARACTERISTIC
/begin CHARACTERISTIC FaultManager.EST3_Short.Test "Fault manager configuration.  Select up to 4 actions for each fault." VALUE 0x80002CB9 RecordLayout_3 0 CompuMethod_106 0 65535 /end CHARACTERISTIC
/begin CHARACTERISTIC FaultManager.EST3_Short.Faulty_Samples__X_ "Fault manager configuration.  Select up to 4 actions for each fault." VALUE 0x80002CBB RecordLayout_3 0 CompuMethod_1 0 65535 /end CHARACTERISTIC
/begin CHARACTERISTIC FaultManager.EST3_Short.Total_Samples__Y_ "Fault manager configuration.  Select up to 4 actions for each fault." VALUE 0x80002CBD RecordLayout_3 0 CompuMethod_1 0 65535 /end CHARACTERISTIC
/begin CHARACTERISTIC FaultManager.EST3_Short.Action_1 "Fault manager configuration.  Select up to 4 actions for each fault." VALUE 0x80002CBF RecordLayout_3 0 CompuMethod_107 0 65535 /end CHARACTERISTIC
/begin CHARACTERISTIC FaultManager.EST3_Short.Action_1_Condition "Fault manager configuration.  Select up to 4 actions for each fault." VALUE 0x80002CC1 RecordLayout_3 0 CompuMethod_108 0 65535 /end CHARACTERISTIC
/begin CHARACTERISTIC FaultManager.EST3_Short.Action_2 "Fault manager configuration.  Select up to 4 actions for each fault." VALUE 0x80002CC3 RecordLayout_3 0 CompuMethod_107 0 65535 /end CHARACTERISTIC
/begin CHARACTERISTIC FaultManager.EST3_Short.Action_2_Condition "Fault manager configuration.  Select up to 4 actions for each fault." VALUE 0x80002CC5 RecordLayout_3 0 CompuMethod_108 0 65535 /end CHARACTERISTIC
/begin CHARACTERISTIC FaultManager.EST3_Short.Action_3 "Fault manager configuration.  Select up to 4 actions for each fault." VALUE 0x80002CC7 RecordLayout_3 0 CompuMethod_107 0 65535 /end CHARACTERISTIC
/begin CHARACTERISTIC FaultManager.EST3_Short.Action_3_Condition "Fault manager configuration.  Select up to 4 actions for each fault." VALUE 0x80002CC9 RecordLayout_3 0 CompuMethod_108 0 65535 /end CHARACTERISTIC
/begin CHARACTERISTIC FaultManager.EST3_Short.Action_4 "Fault manager configuration.  Select up to 4 actions for each fault." VALUE 0x80002CCB RecordLayout_3 0 CompuMethod_107 0 65535 /end CHARACTERISTIC
/begin CHARACTERISTIC FaultManager.EST3_Short.Action_4_Condition "Fault manager configuration.  Select up to 4 actions for each fault." VALUE 0x80002CCD RecordLayout_3 0 CompuMethod_108 0 65535 /end CHARACTERISTIC
/begin CHARACTERISTIC FaultManager.EST4_Open.Mode "Fault manager configuration.  Select up to 4 actions for each fault." VALUE 0x80002CCF RecordLayout_3 0 CompuMethod_105 0 65535 /end CHARACTERISTIC
/begin CHARACTERISTIC FaultManager.EST4_Open.ID "Fault manager configuration.  Select up to 4 actions for each fault." VALUE 0x80002CD1 RecordLayout_3 0 CompuMethod_1 0 65535 /end CHARACTERISTIC
/begin CHARACTERISTIC FaultManager.EST4_Open.Test "Fault manager configuration.  Select up to 4 actions for each fault." VALUE 0x80002CD3 RecordLayout_3 0 CompuMethod_106 0 65535 /end CHARACTERISTIC
/begin CHARACTERISTIC FaultManager.EST4_Open.Faulty_Samples__X_ "Fault manager configuration.  Select up to 4 actions for each fault." VALUE 0x80002CD5 RecordLayout_3 0 CompuMethod_1 0 65535 /end CHARACTERISTIC
/begin CHARACTERISTIC FaultManager.EST4_Open.Total_Samples__Y_ "Fault manager configuration.  Select up to 4 actions for each fault." VALUE 0x80002CD7 RecordLayout_3 0 CompuMethod_1 0 65535 /end CHARACTERISTIC
/begin CHARACTERISTIC FaultManager.EST4_Open.Action_1 "Fault manager configuration.  Select up to 4 actions for each fault." VALUE 0x80002CD9 RecordLayout_3 0 CompuMethod_107 0 65535 /end CHARACTERISTIC
/begin CHARACTERISTIC FaultManager.EST4_Open.Action_1_Condition "Fault manager configuration.  Select up to 4 actions for each fault." VALUE 0x80002CDB RecordLayout_3 0 CompuMethod_108 0 65535 /end CHARACTERISTIC
/begin CHARACTERISTIC FaultManager.EST4_Open.Action_2 "Fault manager configuration.  Select up to 4 actions for each fault." VALUE 0x80002CDD RecordLayout_3 0 CompuMethod_107 0 65535 /end CHARACTERISTIC
/begin CHARACTERISTIC FaultManager.EST4_Open.Action_2_Condition "Fault manager configuration.  Select up to 4 actions for each fault." VALUE 0x80002CDF RecordLayout_3 0 CompuMethod_108 0 65535 /end CHARACTERISTIC
/begin CHARACTERISTIC FaultManager.EST4_Open.Action_3 "Fault manager configuration.  Select up to 4 actions for each fault." VALUE 0x80002CE1 RecordLayout_3 0 CompuMethod_107 0 65535 /end CHARACTERISTIC
/begin CHARACTERISTIC FaultManager.EST4_Open.Action_3_Condition "Fault manager configuration.  Select up to 4 actions for each fault." VALUE 0x80002CE3 RecordLayout_3 0 CompuMethod_108 0 65535 /end CHARACTERISTIC
/begin CHARACTERISTIC FaultManager.EST4_Open.Action_4 "Fault manager configuration.  Select up to 4 actions for each fault." VALUE 0x80002CE5 RecordLayout_3 0 CompuMethod_107 0 65535 /end CHARACTERISTIC
/begin CHARACTERISTIC FaultManager.EST4_Open.Action_4_Condition "Fault manager configuration.  Select up to 4 actions for each fault." VALUE 0x80002CE7 RecordLayout_3 0 CompuMethod_108 0 65535 /end CHARACTERISTIC
/begin CHARACTERISTIC FaultManager.EST4_Short.Mode "Fault manager configuration.  Select up to 4 actions for each fault." VALUE 0x80002CE9 RecordLayout_3 0 CompuMethod_105 0 65535 /end CHARACTERISTIC
/begin CHARACTERISTIC FaultManager.EST4_Short.ID "Fault manager configuration.  Select up to 4 actions for each fault." VALUE 0x80002CEB RecordLayout_3 0 CompuMethod_1 0 65535 /end CHARACTERISTIC
/begin CHARACTERISTIC FaultManager.EST4_Short.Test "Fault manager configuration.  Select up to 4 actions for each fault." VALUE 0x80002CED RecordLayout_3 0 CompuMethod_106 0 65535 /end CHARACTERISTIC
/begin CHARACTERISTIC FaultManager.EST4_Short.Faulty_Samples__X_ "Fault manager configuration.  Select up to 4 actions for each fault." VALUE 0x80002CEF RecordLayout_3 0 CompuMethod_1 0 65535 /end CHARACTERISTIC
/begin CHARACTERISTIC FaultManager.EST4_Short.Total_Samples__Y_ "Fault manager configuration.  Select up to 4 actions for each fault." VALUE 0x80002CF1 RecordLayout_3 0 CompuMethod_1 0 65535 /end CHARACTERISTIC
/begin CHARACTERISTIC FaultManager.EST4_Short.Action_1 "Fault manager configuration.  Select up to 4 actions for each fault." VALUE 0x80002CF3 RecordLayout_3 0 CompuMethod_107 0 65535 /end CHARACTERISTIC
/begin CHARACTERISTIC FaultManager.EST4_Short.Action_1_Condition "Fault manager configuration.  Select up to 4 actions for each fault." VALUE 0x80002CF5 RecordLayout_3 0 CompuMethod_108 0 65535 /end CHARACTERISTIC
/begin CHARACTERISTIC FaultManager.EST4_Short.Action_2 "Fault manager configuration.  Select up to 4 actions for each fault." VALUE 0x80002CF7 RecordLayout_3 0 CompuMethod_107 0 65535 /end CHARACTERISTIC
/begin CHARACTERISTIC FaultManager.EST4_Short.Action_2_Condition "Fault manager configuration.  Select up to 4 actions for each fault." VALUE 0x80002CF9 RecordLayout_3 0 CompuMethod_108 0 65535 /end CHARACTERISTIC
/begin CHARACTERISTIC FaultManager.EST4_Short.Action_3 "Fault manager configuration.  Select up to 4 actions for each fault." VALUE 0x80002CFB RecordLayout_3 0 CompuMethod_107 0 65535 /end CHARACTERISTIC
/begin CHARACTERISTIC FaultManager.EST4_Short.Action_3_Condition "Fault manager configuration.  Select up to 4 actions for each fault." VALUE 0x80002CFD RecordLayout_3 0 CompuMethod_108 0 65535 /end CHARACTERISTIC
/begin CHARACTERISTIC FaultManager.EST4_Short.Action_4 "Fault manager configuration.  Select up to 4 actions for each fault." VALUE 0x80002CFF RecordLayout_3 0 CompuMethod_107 0 65535 /end CHARACTERISTIC
/begin CHARACTERISTIC FaultManager.EST4_Short.Action_4_Condition "Fault manager configuration.  Select up to 4 actions for each fault." VALUE 0x80002D01 RecordLayout_3 0 CompuMethod_108 0 65535 /end CHARACTERISTIC
/begin CHARACTERISTIC FaultManager.EST5_Open.Mode "Fault manager configuration.  Select up to 4 actions for each fault." VALUE 0x80002D03 RecordLayout_3 0 CompuMethod_105 0 65535 /end CHARACTERISTIC
/begin CHARACTERISTIC FaultManager.EST5_Open.ID "Fault manager configuration.  Select up to 4 actions for each fault." VALUE 0x80002D05 RecordLayout_3 0 CompuMethod_1 0 65535 /end CHARACTERISTIC
/begin CHARACTERISTIC FaultManager.EST5_Open.Test "Fault manager configuration.  Select up to 4 actions for each fault." VALUE 0x80002D07 RecordLayout_3 0 CompuMethod_106 0 65535 /end CHARACTERISTIC
/begin CHARACTERISTIC FaultManager.EST5_Open.Faulty_Samples__X_ "Fault manager configuration.  Select up to 4 actions for each fault." VALUE 0x80002D09 RecordLayout_3 0 CompuMethod_1 0 65535 /end CHARACTERISTIC
/begin CHARACTERISTIC FaultManager.EST5_Open.Total_Samples__Y_ "Fault manager configuration.  Select up to 4 actions for each fault." VALUE 0x80002D0B RecordLayout_3 0 CompuMethod_1 0 65535 /end CHARACTERISTIC
/begin CHARACTERISTIC FaultManager.EST5_Open.Action_1 "Fault manager configuration.  Select up to 4 actions for each fault." VALUE 0x80002D0D RecordLayout_3 0 CompuMethod_107 0 65535 /end CHARACTERISTIC
/begin CHARACTERISTIC FaultManager.EST5_Open.Action_1_Condition "Fault manager configuration.  Select up to 4 actions for each fault." VALUE 0x80002D0F RecordLayout_3 0 CompuMethod_108 0 65535 /end CHARACTERISTIC
/begin CHARACTERISTIC FaultManager.EST5_Open.Action_2 "Fault manager configuration.  Select up to 4 actions for each fault." VALUE 0x80002D11 RecordLayout_3 0 CompuMethod_107 0 65535 /end CHARACTERISTIC
/begin CHARACTERISTIC FaultManager.EST5_Open.Action_2_Condition "Fault manager configuration.  Select up to 4 actions for each fault." VALUE 0x80002D13 RecordLayout_3 0 CompuMethod_108 0 65535 /end CHARACTERISTIC
/begin CHARACTERISTIC FaultManager.EST5_Open.Action_3 "Fault manager configuration.  Select up to 4 actions for each fault." VALUE 0x80002D15 RecordLayout_3 0 CompuMethod_107 0 65535 /end CHARACTERISTIC
/begin CHARACTERISTIC FaultManager.EST5_Open.Action_3_Condition "Fault manager configuration.  Select up to 4 actions for each fault." VALUE 0x80002D17 RecordLayout_3 0 CompuMethod_108 0 65535 /end CHARACTERISTIC
/begin CHARACTERISTIC FaultManager.EST5_Open.Action_4 "Fault manager configuration.  Select up to 4 actions for each fault." VALUE 0x80002D19 RecordLayout_3 0 CompuMethod_107 0 65535 /end CHARACTERISTIC
/begin CHARACTERISTIC FaultManager.EST5_Open.Action_4_Condition "Fault manager configuration.  Select up to 4 actions for each fault." VALUE 0x80002D1B RecordLayout_3 0 CompuMethod_108 0 65535 /end CHARACTERISTIC
/begin CHARACTERISTIC FaultManager.EST5_Short.Mode "Fault manager configuration.  Select up to 4 actions for each fault." VALUE 0x80002D1D RecordLayout_3 0 CompuMethod_105 0 65535 /end CHARACTERISTIC
/begin CHARACTERISTIC FaultManager.EST5_Short.ID "Fault manager configuration.  Select up to 4 actions for each fault." VALUE 0x80002D1F RecordLayout_3 0 CompuMethod_1 0 65535 /end CHARACTERISTIC
/begin CHARACTERISTIC FaultManager.EST5_Short.Test "Fault manager configuration.  Select up to 4 actions for each fault." VALUE 0x80002D21 RecordLayout_3 0 CompuMethod_106 0 65535 /end CHARACTERISTIC
/begin CHARACTERISTIC FaultManager.EST5_Short.Faulty_Samples__X_ "Fault manager configuration.  Select up to 4 actions for each fault." VALUE 0x80002D23 RecordLayout_3 0 CompuMethod_1 0 65535 /end CHARACTERISTIC
/begin CHARACTERISTIC FaultManager.EST5_Short.Total_Samples__Y_ "Fault manager configuration.  Select up to 4 actions for each fault." VALUE 0x80002D25 RecordLayout_3 0 CompuMethod_1 0 65535 /end CHARACTERISTIC
/begin CHARACTERISTIC FaultManager.EST5_Short.Action_1 "Fault manager configuration.  Select up to 4 actions for each fault." VALUE 0x80002D27 RecordLayout_3 0 CompuMethod_107 0 65535 /end CHARACTERISTIC
/begin CHARACTERISTIC FaultManager.EST5_Short.Action_1_Condition "Fault manager configuration.  Select up to 4 actions for each fault." VALUE 0x80002D29 RecordLayout_3 0 CompuMethod_108 0 65535 /end CHARACTERISTIC
/begin CHARACTERISTIC FaultManager.EST5_Short.Action_2 "Fault manager configuration.  Select up to 4 actions for each fault." VALUE 0x80002D2B RecordLayout_3 0 CompuMethod_107 0 65535 /end CHARACTERISTIC
/begin CHARACTERISTIC FaultManager.EST5_Short.Action_2_Condition "Fault manager configuration.  Select up to 4 actions for each fault." VALUE 0x80002D2D RecordLayout_3 0 CompuMethod_108 0 65535 /end CHARACTERISTIC
/begin CHARACTERISTIC FaultManager.EST5_Short.Action_3 "Fault manager configuration.  Select up to 4 actions for each fault." VALUE 0x80002D2F RecordLayout_3 0 CompuMethod_107 0 65535 /end CHARACTERISTIC
/begin CHARACTERISTIC FaultManager.EST5_Short.Action_3_Condition "Fault manager configuration.  Select up to 4 actions for each fault." VALUE 0x80002D31 RecordLayout_3 0 CompuMethod_108 0 65535 /end CHARACTERISTIC
/begin CHARACTERISTIC FaultManager.EST5_Short.Action_4 "Fault manager configuration.  Select up to 4 actions for each fault." VALUE 0x80002D33 RecordLayout_3 0 CompuMethod_107 0 65535 /end CHARACTERISTIC
/begin CHARACTERISTIC FaultManager.EST5_Short.Action_4_Condition "Fault manager configuration.  Select up to 4 actions for each fault." VALUE 0x80002D35 RecordLayout_3 0 CompuMethod_108 0 65535 /end CHARACTERISTIC
/begin CHARACTERISTIC FaultManager.EST6_Open.Mode "Fault manager configuration.  Select up to 4 actions for each fault." VALUE 0x80002D37 RecordLayout_3 0 CompuMethod_105 0 65535 /end CHARACTERISTIC
/begin CHARACTERISTIC FaultManager.EST6_Open.ID "Fault manager configuration.  Select up to 4 actions for each fault." VALUE 0x80002D39 RecordLayout_3 0 CompuMethod_1 0 65535 /end CHARACTERISTIC
/begin CHARACTERISTIC FaultManager.EST6_Open.Test "Fault manager configuration.  Select up to 4 actions for each fault." VALUE 0x80002D3B RecordLayout_3 0 CompuMethod_106 0 65535 /end CHARACTERISTIC
/begin CHARACTERISTIC FaultManager.EST6_Open.Faulty_Samples__X_ "Fault manager configuration.  Select up to 4 actions for each fault." VALUE 0x80002D3D RecordLayout_3 0 CompuMethod_1 0 65535 /end CHARACTERISTIC
/begin CHARACTERISTIC FaultManager.EST6_Open.Total_Samples__Y_ "Fault manager configuration.  Select up to 4 actions for each fault." VALUE 0x80002D3F RecordLayout_3 0 CompuMethod_1 0 65535 /end CHARACTERISTIC
/begin CHARACTERISTIC FaultManager.EST6_Open.Action_1 "Fault manager configuration.  Select up to 4 actions for each fault." VALUE 0x80002D41 RecordLayout_3 0 CompuMethod_107 0 65535 /end CHARACTERISTIC
/begin CHARACTERISTIC FaultManager.EST6_Open.Action_1_Condition "Fault manager configuration.  Select up to 4 actions for each fault." VALUE 0x80002D43 RecordLayout_3 0 CompuMethod_108 0 65535 /end CHARACTERISTIC
/begin CHARACTERISTIC FaultManager.EST6_Open.Action_2 "Fault manager configuration.  Select up to 4 actions for each fault." VALUE 0x80002D45 RecordLayout_3 0 CompuMethod_107 0 65535 /end CHARACTERISTIC
/begin CHARACTERISTIC FaultManager.EST6_Open.Action_2_Condition "Fault manager configuration.  Select up to 4 actions for each fault." VALUE 0x80002D47 RecordLayout_3 0 CompuMethod_108 0 65535 /end CHARACTERISTIC
/begin CHARACTERISTIC FaultManager.EST6_Open.Action_3 "Fault manager configuration.  Select up to 4 actions for each fault." VALUE 0x80002D49 RecordLayout_3 0 CompuMethod_107 0 65535 /end CHARACTERISTIC
/begin CHARACTERISTIC FaultManager.EST6_Open.Action_3_Condition "Fault manager configuration.  Select up to 4 actions for each fault." VALUE 0x80002D4B RecordLayout_3 0 CompuMethod_108 0 65535 /end CHARACTERISTIC
/begin CHARACTERISTIC FaultManager.EST6_Open.Action_4 "Fault manager configuration.  Select up to 4 actions for each fault." VALUE 0x80002D4D RecordLayout_3 0 CompuMethod_107 0 65535 /end CHARACTERISTIC
/begin CHARACTERISTIC FaultManager.EST6_Open.Action_4_Condition "Fault manager configuration.  Select up to 4 actions for each fault." VALUE 0x80002D4F RecordLayout_3 0 CompuMethod_108 0 65535 /end CHARACTERISTIC
/begin CHARACTERISTIC FaultManager.EST6_Short.Mode "Fault manager configuration.  Select up to 4 actions for each fault." VALUE 0x80002D51 RecordLayout_3 0 CompuMethod_105 0 65535 /end CHARACTERISTIC
/begin CHARACTERISTIC FaultManager.EST6_Short.ID "Fault manager configuration.  Select up to 4 actions for each fault." VALUE 0x80002D53 RecordLayout_3 0 CompuMethod_1 0 65535 /end CHARACTERISTIC
/begin CHARACTERISTIC FaultManager.EST6_Short.Test "Fault manager configuration.  Select up to 4 actions for each fault." VALUE 0x80002D55 RecordLayout_3 0 CompuMethod_106 0 65535 /end CHARACTERISTIC
/begin CHARACTERISTIC FaultManager.EST6_Short.Faulty_Samples__X_ "Fault manager configuration.  Select up to 4 actions for each fault." VALUE 0x80002D57 RecordLayout_3 0 CompuMethod_1 0 65535 /end CHARACTERISTIC
/begin CHARACTERISTIC FaultManager.EST6_Short.Total_Samples__Y_ "Fault manager configuration.  Select up to 4 actions for each fault." VALUE 0x80002D59 RecordLayout_3 0 CompuMethod_1 0 65535 /end CHARACTERISTIC
/begin CHARACTERISTIC FaultManager.EST6_Short.Action_1 "Fault manager configuration.  Select up to 4 actions for each fault." VALUE 0x80002D5B RecordLayout_3 0 CompuMethod_107 0 65535 /end CHARACTERISTIC
/begin CHARACTERISTIC FaultManager.EST6_Short.Action_1_Condition "Fault manager configuration.  Select up to 4 actions for each fault." VALUE 0x80002D5D RecordLayout_3 0 CompuMethod_108 0 65535 /end CHARACTERISTIC
/begin CHARACTERISTIC FaultManager.EST6_Short.Action_2 "Fault manager configuration.  Select up to 4 actions for each fault." VALUE 0x80002D5F RecordLayout_3 0 CompuMethod_107 0 65535 /end CHARACTERISTIC
/begin CHARACTERISTIC FaultManager.EST6_Short.Action_2_Condition "Fault manager configuration.  Select up to 4 actions for each fault." VALUE 0x80002D61 RecordLayout_3 0 CompuMethod_108 0 65535 /end CHARACTERISTIC
/begin CHARACTERISTIC FaultManager.EST6_Short.Action_3 "Fault manager configuration.  Select up to 4 actions for each fault." VALUE 0x80002D63 RecordLayout_3 0 CompuMethod_107 0 65535 /end CHARACTERISTIC
/begin CHARACTERISTIC FaultManager.EST6_Short.Action_3_Condition "Fault manager configuration.  Select up to 4 actions for each fault." VALUE 0x80002D65 RecordLayout_3 0 CompuMethod_108 0 65535 /end CHARACTERISTIC
/begin CHARACTERISTIC FaultManager.EST6_Short.Action_4 "Fault manager configuration.  Select up to 4 actions for each fault." VALUE 0x80002D67 RecordLayout_3 0 CompuMethod_107 0 65535 /end CHARACTERISTIC
/begin CHARACTERISTIC FaultManager.EST6_Short.Action_4_Condition "Fault manager configuration.  Select up to 4 actions for each fault." VALUE 0x80002D69 RecordLayout_3 0 CompuMethod_108 0 65535 /end CHARACTERISTIC
/begin CHARACTERISTIC FaultManager.EST7_Open.Mode "Fault manager configuration.  Select up to 4 actions for each fault." VALUE 0x80002D6B RecordLayout_3 0 CompuMethod_105 0 65535 /end CHARACTERISTIC
/begin CHARACTERISTIC FaultManager.EST7_Open.ID "Fault manager configuration.  Select up to 4 actions for each fault." VALUE 0x80002D6D RecordLayout_3 0 CompuMethod_1 0 65535 /end CHARACTERISTIC
/begin CHARACTERISTIC FaultManager.EST7_Open.Test "Fault manager configuration.  Select up to 4 actions for each fault." VALUE 0x80002D6F RecordLayout_3 0 CompuMethod_106 0 65535 /end CHARACTERISTIC
/begin CHARACTERISTIC FaultManager.EST7_Open.Faulty_Samples__X_ "Fault manager configuration.  Select up to 4 actions for each fault." VALUE 0x80002D71 RecordLayout_3 0 CompuMethod_1 0 65535 /end CHARACTERISTIC
/begin CHARACTERISTIC FaultManager.EST7_Open.Total_Samples__Y_ "Fault manager configuration.  Select up to 4 actions for each fault." VALUE 0x80002D73 RecordLayout_3 0 CompuMethod_1 0 65535 /end CHARACTERISTIC
/begin CHARACTERISTIC FaultManager.EST7_Open.Action_1 "Fault manager configuration.  Select up to 4 actions for each fault." VALUE 0x80002D75 RecordLayout_3 0 CompuMethod_107 0 65535 /end CHARACTERISTIC
/begin CHARACTERISTIC FaultManager.EST7_Open.Action_1_Condition "Fault manager configuration.  Select up to 4 actions for each fault." VALUE 0x80002D77 RecordLayout_3 0 CompuMethod_108 0 65535 /end CHARACTERISTIC
/begin CHARACTERISTIC FaultManager.EST7_Open.Action_2 "Fault manager configuration.  Select up to 4 actions for each fault." VALUE 0x80002D79 RecordLayout_3 0 CompuMethod_107 0 65535 /end CHARACTERISTIC
/begin CHARACTERISTIC FaultManager.EST7_Open.Action_2_Condition "Fault manager configuration.  Select up to 4 actions for each fault." VALUE 0x80002D7B RecordLayout_3 0 CompuMethod_108 0 65535 /end CHARACTERISTIC
/begin CHARACTERISTIC FaultManager.EST7_Open.Action_3 "Fault manager configuration.  Select up to 4 actions for each fault." VALUE 0x80002D7D RecordLayout_3 0 CompuMethod_107 0 65535 /end CHARACTERISTIC
/begin CHARACTERISTIC FaultManager.EST7_Open.Action_3_Condition "Fault manager configuration.  Select up to 4 actions for each fault." VALUE 0x80002D7F RecordLayout_3 0 CompuMethod_108 0 65535 /end CHARACTERISTIC
/begin CHARACTERISTIC FaultManager.EST7_Open.Action_4 "Fault manager configuration.  Select up to 4 actions for each fault." VALUE 0x80002D81 RecordLayout_3 0 CompuMethod_107 0 65535 /end CHARACTERISTIC
/begin CHARACTERISTIC FaultManager.EST7_Open.Action_4_Condition "Fault manager configuration.  Select up to 4 actions for each fault." VALUE 0x80002D83 RecordLayout_3 0 CompuMethod_108 0 65535 /end CHARACTERISTIC
/begin CHARACTERISTIC FaultManager.EST7_Short.Mode "Fault manager configuration.  Select up to 4 actions for each fault." VALUE 0x80002D85 RecordLayout_3 0 CompuMethod_105 0 65535 /end CHARACTERISTIC
/begin CHARACTERISTIC FaultManager.EST7_Short.ID "Fault manager configuration.  Select up to 4 actions for each fault." VALUE 0x80002D87 RecordLayout_3 0 CompuMethod_1 0 65535 /end CHARACTERISTIC
/begin CHARACTERISTIC FaultManager.EST7_Short.Test "Fault manager configuration.  Select up to 4 actions for each fault." VALUE 0x80002D89 RecordLayout_3 0 CompuMethod_106 0 65535 /end CHARACTERISTIC
/begin CHARACTERISTIC FaultManager.EST7_Short.Faulty_Samples__X_ "Fault manager configuration.  Select up to 4 actions for each fault." VALUE 0x80002D8B RecordLayout_3 0 CompuMethod_1 0 65535 /end CHARACTERISTIC
/begin CHARACTERISTIC FaultManager.EST7_Short.Total_Samples__Y_ "Fault manager configuration.  Select up to 4 actions for each fault." VALUE 0x80002D8D RecordLayout_3 0 CompuMethod_1 0 65535 /end CHARACTERISTIC
/begin CHARACTERISTIC FaultManager.EST7_Short.Action_1 "Fault manager configuration.  Select up to 4 actions for each fault." VALUE 0x80002D8F RecordLayout_3 0 CompuMethod_107 0 65535 /end CHARACTERISTIC
/begin CHARACTERISTIC FaultManager.EST7_Short.Action_1_Condition "Fault manager configuration.  Select up to 4 actions for each fault." VALUE 0x80002D91 RecordLayout_3 0 CompuMethod_108 0 65535 /end CHARACTERISTIC
/begin CHARACTERISTIC FaultManager.EST7_Short.Action_2 "Fault manager configuration.  Select up to 4 actions for each fault." VALUE 0x80002D93 RecordLayout_3 0 CompuMethod_107 0 65535 /end CHARACTERISTIC
/begin CHARACTERISTIC FaultManager.EST7_Short.Action_2_Condition "Fault manager configuration.  Select up to 4 actions for each fault." VALUE 0x80002D95 RecordLayout_3 0 CompuMethod_108 0 65535 /end CHARACTERISTIC
/begin CHARACTERISTIC FaultManager.EST7_Short.Action_3 "Fault manager configuration.  Select up to 4 actions for each fault." VALUE 0x80002D97 RecordLayout_3 0 CompuMethod_107 0 65535 /end CHARACTERISTIC
/begin CHARACTERISTIC FaultManager.EST7_Short.Action_3_Condition "Fault manager configuration.  Select up to 4 actions for each fault." VALUE 0x80002D99 RecordLayout_3 0 CompuMethod_108 0 65535 /end CHARACTERISTIC
/begin CHARACTERISTIC FaultManager.EST7_Short.Action_4 "Fault manager configuration.  Select up to 4 actions for each fault." VALUE 0x80002D9B RecordLayout_3 0 CompuMethod_107 0 65535 /end CHARACTERISTIC
/begin CHARACTERISTIC FaultManager.EST7_Short.Action_4_Condition "Fault manager configuration.  Select up to 4 actions for each fault." VALUE 0x80002D9D RecordLayout_3 0 CompuMethod_108 0 65535 /end CHARACTERISTIC
/begin CHARACTERISTIC FaultManager.EST8_Open.Mode "Fault manager configuration.  Select up to 4 actions for each fault." VALUE 0x80002D9F RecordLayout_3 0 CompuMethod_105 0 65535 /end CHARACTERISTIC
/begin CHARACTERISTIC FaultManager.EST8_Open.ID "Fault manager configuration.  Select up to 4 actions for each fault." VALUE 0x80002DA1 RecordLayout_3 0 CompuMethod_1 0 65535 /end CHARACTERISTIC
/begin CHARACTERISTIC FaultManager.EST8_Open.Test "Fault manager configuration.  Select up to 4 actions for each fault." VALUE 0x80002DA3 RecordLayout_3 0 CompuMethod_106 0 65535 /end CHARACTERISTIC
/begin CHARACTERISTIC FaultManager.EST8_Open.Faulty_Samples__X_ "Fault manager configuration.  Select up to 4 actions for each fault." VALUE 0x80002DA5 RecordLayout_3 0 CompuMethod_1 0 65535 /end CHARACTERISTIC
/begin CHARACTERISTIC FaultManager.EST8_Open.Total_Samples__Y_ "Fault manager configuration.  Select up to 4 actions for each fault." VALUE 0x80002DA7 RecordLayout_3 0 CompuMethod_1 0 65535 /end CHARACTERISTIC
/begin CHARACTERISTIC FaultManager.EST8_Open.Action_1 "Fault manager configuration.  Select up to 4 actions for each fault." VALUE 0x80002DA9 RecordLayout_3 0 CompuMethod_107 0 65535 /end CHARACTERISTIC
/begin CHARACTERISTIC FaultManager.EST8_Open.Action_1_Condition "Fault manager configuration.  Select up to 4 actions for each fault." VALUE 0x80002DAB RecordLayout_3 0 CompuMethod_108 0 65535 /end CHARACTERISTIC
/begin CHARACTERISTIC FaultManager.EST8_Open.Action_2 "Fault manager configuration.  Select up to 4 actions for each fault." VALUE 0x80002DAD RecordLayout_3 0 CompuMethod_107 0 65535 /end CHARACTERISTIC
/begin CHARACTERISTIC FaultManager.EST8_Open.Action_2_Condition "Fault manager configuration.  Select up to 4 actions for each fault." VALUE 0x80002DAF RecordLayout_3 0 CompuMethod_108 0 65535 /end CHARACTERISTIC
/begin CHARACTERISTIC FaultManager.EST8_Open.Action_3 "Fault manager configuration.  Select up to 4 actions for each fault." VALUE 0x80002DB1 RecordLayout_3 0 CompuMethod_107 0 65535 /end CHARACTERISTIC
/begin CHARACTERISTIC FaultManager.EST8_Open.Action_3_Condition "Fault manager configuration.  Select up to 4 actions for each fault." VALUE 0x80002DB3 RecordLayout_3 0 CompuMethod_108 0 65535 /end CHARACTERISTIC
/begin CHARACTERISTIC FaultManager.EST8_Open.Action_4 "Fault manager configuration.  Select up to 4 actions for each fault." VALUE 0x80002DB5 RecordLayout_3 0 CompuMethod_107 0 65535 /end CHARACTERISTIC
/begin CHARACTERISTIC FaultManager.EST8_Open.Action_4_Condition "Fault manager configuration.  Select up to 4 actions for each fault." VALUE 0x80002DB7 RecordLayout_3 0 CompuMethod_108 0 65535 /end CHARACTERISTIC
/begin CHARACTERISTIC FaultManager.EST8_Short.Mode "Fault manager configuration.  Select up to 4 actions for each fault." VALUE 0x80002DB9 RecordLayout_3 0 CompuMethod_105 0 65535 /end CHARACTERISTIC
/begin CHARACTERISTIC FaultManager.EST8_Short.ID "Fault manager configuration.  Select up to 4 actions for each fault." VALUE 0x80002DBB RecordLayout_3 0 CompuMethod_1 0 65535 /end CHARACTERISTIC
/begin CHARACTERISTIC FaultManager.EST8_Short.Test "Fault manager configuration.  Select up to 4 actions for each fault." VALUE 0x80002DBD RecordLayout_3 0 CompuMethod_106 0 65535 /end CHARACTERISTIC
/begin CHARACTERISTIC FaultManager.EST8_Short.Faulty_Samples__X_ "Fault manager configuration.  Select up to 4 actions for each fault." VALUE 0x80002DBF RecordLayout_3 0 CompuMethod_1 0 65535 /end CHARACTERISTIC
/begin CHARACTERISTIC FaultManager.EST8_Short.Total_Samples__Y_ "Fault manager configuration.  Select up to 4 actions for each fault." VALUE 0x80002DC1 RecordLayout_3 0 CompuMethod_1 0 65535 /end CHARACTERISTIC
/begin CHARACTERISTIC FaultManager.EST8_Short.Action_1 "Fault manager configuration.  Select up to 4 actions for each fault." VALUE 0x80002DC3 RecordLayout_3 0 CompuMethod_107 0 65535 /end CHARACTERISTIC
/begin CHARACTERISTIC FaultManager.EST8_Short.Action_1_Condition "Fault manager configuration.  Select up to 4 actions for each fault." VALUE 0x80002DC5 RecordLayout_3 0 CompuMethod_108 0 65535 /end CHARACTERISTIC
/begin CHARACTERISTIC FaultManager.EST8_Short.Action_2 "Fault manager configuration.  Select up to 4 actions for each fault." VALUE 0x80002DC7 RecordLayout_3 0 CompuMethod_107 0 65535 /end CHARACTERISTIC
/begin CHARACTERISTIC FaultManager.EST8_Short.Action_2_Condition "Fault manager configuration.  Select up to 4 actions for each fault." VALUE 0x80002DC9 RecordLayout_3 0 CompuMethod_108 0 65535 /end CHARACTERISTIC
/begin CHARACTERISTIC FaultManager.EST8_Short.Action_3 "Fault manager configuration.  Select up to 4 actions for each fault." VALUE 0x80002DCB RecordLayout_3 0 CompuMethod_107 0 65535 /end CHARACTERISTIC
/begin CHARACTERISTIC FaultManager.EST8_Short.Action_3_Condition "Fault manager configuration.  Select up to 4 actions for each fault." VALUE 0x80002DCD RecordLayout_3 0 CompuMethod_108 0 65535 /end CHARACTERISTIC
/begin CHARACTERISTIC FaultManager.EST8_Short.Action_4 "Fault manager configuration.  Select up to 4 actions for each fault." VALUE 0x80002DCF RecordLayout_3 0 CompuMethod_107 0 65535 /end CHARACTERISTIC
/begin CHARACTERISTIC FaultManager.EST8_Short.Action_4_Condition "Fault manager configuration.  Select up to 4 actions for each fault." VALUE 0x80002DD1 RecordLayout_3 0 CompuMethod_108 0 65535 /end CHARACTERISTIC
/begin CHARACTERISTIC FaultManager.ETCSpringTest.Mode "Fault manager configuration.  Select up to 4 actions for each fault." VALUE 0x80002DD3 RecordLayout_3 0 CompuMethod_105 0 65535 /end CHARACTERISTIC
/begin CHARACTERISTIC FaultManager.ETCSpringTest.ID "Fault manager configuration.  Select up to 4 actions for each fault." VALUE 0x80002DD5 RecordLayout_3 0 CompuMethod_1 0 65535 /end CHARACTERISTIC
/begin CHARACTERISTIC FaultManager.ETCSpringTest.Test "Fault manager configuration.  Select up to 4 actions for each fault." VALUE 0x80002DD7 RecordLayout_3 0 CompuMethod_106 0 65535 /end CHARACTERISTIC
/begin CHARACTERISTIC FaultManager.ETCSpringTest.Faulty_Samples__X_ "Fault manager configuration.  Select up to 4 actions for each fault." VALUE 0x80002DD9 RecordLayout_3 0 CompuMethod_1 0 65535 /end CHARACTERISTIC
/begin CHARACTERISTIC FaultManager.ETCSpringTest.Total_Samples__Y_ "Fault manager configuration.  Select up to 4 actions for each fault." VALUE 0x80002DDB RecordLayout_3 0 CompuMethod_1 0 65535 /end CHARACTERISTIC
/begin CHARACTERISTIC FaultManager.ETCSpringTest.Action_1 "Fault manager configuration.  Select up to 4 actions for each fault." VALUE 0x80002DDD RecordLayout_3 0 CompuMethod_107 0 65535 /end CHARACTERISTIC
/begin CHARACTERISTIC FaultManager.ETCSpringTest.Action_1_Condition "Fault manager configuration.  Select up to 4 actions for each fault." VALUE 0x80002DDF RecordLayout_3 0 CompuMethod_108 0 65535 /end CHARACTERISTIC
/begin CHARACTERISTIC FaultManager.ETCSpringTest.Action_2 "Fault manager configuration.  Select up to 4 actions for each fault." VALUE 0x80002DE1 RecordLayout_3 0 CompuMethod_107 0 65535 /end CHARACTERISTIC
/begin CHARACTERISTIC FaultManager.ETCSpringTest.Action_2_Condition "Fault manager configuration.  Select up to 4 actions for each fault." VALUE 0x80002DE3 RecordLayout_3 0 CompuMethod_108 0 65535 /end CHARACTERISTIC
/begin CHARACTERISTIC FaultManager.ETCSpringTest.Action_3 "Fault manager configuration.  Select up to 4 actions for each fault." VALUE 0x80002DE5 RecordLayout_3 0 CompuMethod_107 0 65535 /end CHARACTERISTIC
/begin CHARACTERISTIC FaultManager.ETCSpringTest.Action_3_Condition "Fault manager configuration.  Select up to 4 actions for each fault." VALUE 0x80002DE7 RecordLayout_3 0 CompuMethod_108 0 65535 /end CHARACTERISTIC
/begin CHARACTERISTIC FaultManager.ETCSpringTest.Action_4 "Fault manager configuration.  Select up to 4 actions for each fault." VALUE 0x80002DE9 RecordLayout_3 0 CompuMethod_107 0 65535 /end CHARACTERISTIC
/begin CHARACTERISTIC FaultManager.ETCSpringTest.Action_4_Condition "Fault manager configuration.  Select up to 4 actions for each fault." VALUE 0x80002DEB RecordLayout_3 0 CompuMethod_108 0 65535 /end CHARACTERISTIC
/begin CHARACTERISTIC FaultManager.ETC_Open_Fault.Mode "Fault manager configuration.  Select up to 4 actions for each fault." VALUE 0x80002DED RecordLayout_3 0 CompuMethod_105 0 65535 /end CHARACTERISTIC
/begin CHARACTERISTIC FaultManager.ETC_Open_Fault.ID "Fault manager configuration.  Select up to 4 actions for each fault." VALUE 0x80002DEF RecordLayout_3 0 CompuMethod_1 0 65535 /end CHARACTERISTIC
/begin CHARACTERISTIC FaultManager.ETC_Open_Fault.Test "Fault manager configuration.  Select up to 4 actions for each fault." VALUE 0x80002DF1 RecordLayout_3 0 CompuMethod_106 0 65535 /end CHARACTERISTIC
/begin CHARACTERISTIC FaultManager.ETC_Open_Fault.Faulty_Samples__X_ "Fault manager configuration.  Select up to 4 actions for each fault." VALUE 0x80002DF3 RecordLayout_3 0 CompuMethod_1 0 65535 /end CHARACTERISTIC
/begin CHARACTERISTIC FaultManager.ETC_Open_Fault.Total_Samples__Y_ "Fault manager configuration.  Select up to 4 actions for each fault." VALUE 0x80002DF5 RecordLayout_3 0 CompuMethod_1 0 65535 /end CHARACTERISTIC
/begin CHARACTERISTIC FaultManager.ETC_Open_Fault.Action_1 "Fault manager configuration.  Select up to 4 actions for each fault." VALUE 0x80002DF7 RecordLayout_3 0 CompuMethod_107 0 65535 /end CHARACTERISTIC
/begin CHARACTERISTIC FaultManager.ETC_Open_Fault.Action_1_Condition "Fault manager configuration.  Select up to 4 actions for each fault." VALUE 0x80002DF9 RecordLayout_3 0 CompuMethod_108 0 65535 /end CHARACTERISTIC
/begin CHARACTERISTIC FaultManager.ETC_Open_Fault.Action_2 "Fault manager configuration.  Select up to 4 actions for each fault." VALUE 0x80002DFB RecordLayout_3 0 CompuMethod_107 0 65535 /end CHARACTERISTIC
/begin CHARACTERISTIC FaultManager.ETC_Open_Fault.Action_2_Condition "Fault manager configuration.  Select up to 4 actions for each fault." VALUE 0x80002DFD RecordLayout_3 0 CompuMethod_108 0 65535 /end CHARACTERISTIC
/begin CHARACTERISTIC FaultManager.ETC_Open_Fault.Action_3 "Fault manager configuration.  Select up to 4 actions for each fault." VALUE 0x80002DFF RecordLayout_3 0 CompuMethod_107 0 65535 /end CHARACTERISTIC
/begin CHARACTERISTIC FaultManager.ETC_Open_Fault.Action_3_Condition "Fault manager configuration.  Select up to 4 actions for each fault." VALUE 0x80002E01 RecordLayout_3 0 CompuMethod_108 0 65535 /end CHARACTERISTIC
/begin CHARACTERISTIC FaultManager.ETC_Open_Fault.Action_4 "Fault manager configuration.  Select up to 4 actions for each fault." VALUE 0x80002E03 RecordLayout_3 0 CompuMethod_107 0 65535 /end CHARACTERISTIC
/begin CHARACTERISTIC FaultManager.ETC_Open_Fault.Action_4_Condition "Fault manager configuration.  Select up to 4 actions for each fault." VALUE 0x80002E05 RecordLayout_3 0 CompuMethod_108 0 65535 /end CHARACTERISTIC
/begin CHARACTERISTIC FaultManager.ETC_Sticking.Mode "Fault manager configuration.  Select up to 4 actions for each fault." VALUE 0x80002E07 RecordLayout_3 0 CompuMethod_105 0 65535 /end CHARACTERISTIC
/begin CHARACTERISTIC FaultManager.ETC_Sticking.ID "Fault manager configuration.  Select up to 4 actions for each fault." VALUE 0x80002E09 RecordLayout_3 0 CompuMethod_1 0 65535 /end CHARACTERISTIC
/begin CHARACTERISTIC FaultManager.ETC_Sticking.Test "Fault manager configuration.  Select up to 4 actions for each fault." VALUE 0x80002E0B RecordLayout_3 0 CompuMethod_106 0 65535 /end CHARACTERISTIC
/begin CHARACTERISTIC FaultManager.ETC_Sticking.Faulty_Samples__X_ "Fault manager configuration.  Select up to 4 actions for each fault." VALUE 0x80002E0D RecordLayout_3 0 CompuMethod_1 0 65535 /end CHARACTERISTIC
/begin CHARACTERISTIC FaultManager.ETC_Sticking.Total_Samples__Y_ "Fault manager configuration.  Select up to 4 actions for each fault." VALUE 0x80002E0F RecordLayout_3 0 CompuMethod_1 0 65535 /end CHARACTERISTIC
/begin CHARACTERISTIC FaultManager.ETC_Sticking.Action_1 "Fault manager configuration.  Select up to 4 actions for each fault." VALUE 0x80002E11 RecordLayout_3 0 CompuMethod_107 0 65535 /end CHARACTERISTIC
/begin CHARACTERISTIC FaultManager.ETC_Sticking.Action_1_Condition "Fault manager configuration.  Select up to 4 actions for each fault." VALUE 0x80002E13 RecordLayout_3 0 CompuMethod_108 0 65535 /end CHARACTERISTIC
/begin CHARACTERISTIC FaultManager.ETC_Sticking.Action_2 "Fault manager configuration.  Select up to 4 actions for each fault." VALUE 0x80002E15 RecordLayout_3 0 CompuMethod_107 0 65535 /end CHARACTERISTIC
/begin CHARACTERISTIC FaultManager.ETC_Sticking.Action_2_Condition "Fault manager configuration.  Select up to 4 actions for each fault." VALUE 0x80002E17 RecordLayout_3 0 CompuMethod_108 0 65535 /end CHARACTERISTIC
/begin CHARACTERISTIC FaultManager.ETC_Sticking.Action_3 "Fault manager configuration.  Select up to 4 actions for each fault." VALUE 0x80002E19 RecordLayout_3 0 CompuMethod_107 0 65535 /end CHARACTERISTIC
/begin CHARACTERISTIC FaultManager.ETC_Sticking.Action_3_Condition "Fault manager configuration.  Select up to 4 actions for each fault." VALUE 0x80002E1B RecordLayout_3 0 CompuMethod_108 0 65535 /end CHARACTERISTIC
/begin CHARACTERISTIC FaultManager.ETC_Sticking.Action_4 "Fault manager configuration.  Select up to 4 actions for each fault." VALUE 0x80002E1D RecordLayout_3 0 CompuMethod_107 0 65535 /end CHARACTERISTIC
/begin CHARACTERISTIC FaultManager.ETC_Sticking.Action_4_Condition "Fault manager configuration.  Select up to 4 actions for each fault." VALUE 0x80002E1F RecordLayout_3 0 CompuMethod_108 0 65535 /end CHARACTERISTIC
/begin CHARACTERISTIC FaultManager.EVAPRangeHigh.Mode "Fault manager configuration.  Select up to 4 actions for each fault." VALUE 0x80002E21 RecordLayout_3 0 CompuMethod_105 0 65535 /end CHARACTERISTIC
/begin CHARACTERISTIC FaultManager.EVAPRangeHigh.ID "Fault manager configuration.  Select up to 4 actions for each fault." VALUE 0x80002E23 RecordLayout_3 0 CompuMethod_1 0 65535 /end CHARACTERISTIC
/begin CHARACTERISTIC FaultManager.EVAPRangeHigh.Test "Fault manager configuration.  Select up to 4 actions for each fault." VALUE 0x80002E25 RecordLayout_3 0 CompuMethod_106 0 65535 /end CHARACTERISTIC
/begin CHARACTERISTIC FaultManager.EVAPRangeHigh.Faulty_Samples__X_ "Fault manager configuration.  Select up to 4 actions for each fault." VALUE 0x80002E27 RecordLayout_3 0 CompuMethod_1 0 65535 /end CHARACTERISTIC
/begin CHARACTERISTIC FaultManager.EVAPRangeHigh.Total_Samples__Y_ "Fault manager configuration.  Select up to 4 actions for each fault." VALUE 0x80002E29 RecordLayout_3 0 CompuMethod_1 0 65535 /end CHARACTERISTIC
/begin CHARACTERISTIC FaultManager.EVAPRangeHigh.Action_1 "Fault manager configuration.  Select up to 4 actions for each fault." VALUE 0x80002E2B RecordLayout_3 0 CompuMethod_107 0 65535 /end CHARACTERISTIC
/begin CHARACTERISTIC FaultManager.EVAPRangeHigh.Action_1_Condition "Fault manager configuration.  Select up to 4 actions for each fault." VALUE 0x80002E2D RecordLayout_3 0 CompuMethod_108 0 65535 /end CHARACTERISTIC
/begin CHARACTERISTIC FaultManager.EVAPRangeHigh.Action_2 "Fault manager configuration.  Select up to 4 actions for each fault." VALUE 0x80002E2F RecordLayout_3 0 CompuMethod_107 0 65535 /end CHARACTERISTIC
/begin CHARACTERISTIC FaultManager.EVAPRangeHigh.Action_2_Condition "Fault manager configuration.  Select up to 4 actions for each fault." VALUE 0x80002E31 RecordLayout_3 0 CompuMethod_108 0 65535 /end CHARACTERISTIC
/begin CHARACTERISTIC FaultManager.EVAPRangeHigh.Action_3 "Fault manager configuration.  Select up to 4 actions for each fault." VALUE 0x80002E33 RecordLayout_3 0 CompuMethod_107 0 65535 /end CHARACTERISTIC
/begin CHARACTERISTIC FaultManager.EVAPRangeHigh.Action_3_Condition "Fault manager configuration.  Select up to 4 actions for each fault." VALUE 0x80002E35 RecordLayout_3 0 CompuMethod_108 0 65535 /end CHARACTERISTIC
/begin CHARACTERISTIC FaultManager.EVAPRangeHigh.Action_4 "Fault manager configuration.  Select up to 4 actions for each fault." VALUE 0x80002E37 RecordLayout_3 0 CompuMethod_107 0 65535 /end CHARACTERISTIC
/begin CHARACTERISTIC FaultManager.EVAPRangeHigh.Action_4_Condition "Fault manager configuration.  Select up to 4 actions for each fault." VALUE 0x80002E39 RecordLayout_3 0 CompuMethod_108 0 65535 /end CHARACTERISTIC
/begin CHARACTERISTIC FaultManager.EVAPRangeLow.Mode "Fault manager configuration.  Select up to 4 actions for each fault." VALUE 0x80002E3B RecordLayout_3 0 CompuMethod_105 0 65535 /end CHARACTERISTIC
/begin CHARACTERISTIC FaultManager.EVAPRangeLow.ID "Fault manager configuration.  Select up to 4 actions for each fault." VALUE 0x80002E3D RecordLayout_3 0 CompuMethod_1 0 65535 /end CHARACTERISTIC
/begin CHARACTERISTIC FaultManager.EVAPRangeLow.Test "Fault manager configuration.  Select up to 4 actions for each fault." VALUE 0x80002E3F RecordLayout_3 0 CompuMethod_106 0 65535 /end CHARACTERISTIC
/begin CHARACTERISTIC FaultManager.EVAPRangeLow.Faulty_Samples__X_ "Fault manager configuration.  Select up to 4 actions for each fault." VALUE 0x80002E41 RecordLayout_3 0 CompuMethod_1 0 65535 /end CHARACTERISTIC
/begin CHARACTERISTIC FaultManager.EVAPRangeLow.Total_Samples__Y_ "Fault manager configuration.  Select up to 4 actions for each fault." VALUE 0x80002E43 RecordLayout_3 0 CompuMethod_1 0 65535 /end CHARACTERISTIC
/begin CHARACTERISTIC FaultManager.EVAPRangeLow.Action_1 "Fault manager configuration.  Select up to 4 actions for each fault." VALUE 0x80002E45 RecordLayout_3 0 CompuMethod_107 0 65535 /end CHARACTERISTIC
/begin CHARACTERISTIC FaultManager.EVAPRangeLow.Action_1_Condition "Fault manager configuration.  Select up to 4 actions for each fault." VALUE 0x80002E47 RecordLayout_3 0 CompuMethod_108 0 65535 /end CHARACTERISTIC
/begin CHARACTERISTIC FaultManager.EVAPRangeLow.Action_2 "Fault manager configuration.  Select up to 4 actions for each fault." VALUE 0x80002E49 RecordLayout_3 0 CompuMethod_107 0 65535 /end CHARACTERISTIC
/begin CHARACTERISTIC FaultManager.EVAPRangeLow.Action_2_Condition "Fault manager configuration.  Select up to 4 actions for each fault." VALUE 0x80002E4B RecordLayout_3 0 CompuMethod_108 0 65535 /end CHARACTERISTIC
/begin CHARACTERISTIC FaultManager.EVAPRangeLow.Action_3 "Fault manager configuration.  Select up to 4 actions for each fault." VALUE 0x80002E4D RecordLayout_3 0 CompuMethod_107 0 65535 /end CHARACTERISTIC
/begin CHARACTERISTIC FaultManager.EVAPRangeLow.Action_3_Condition "Fault manager configuration.  Select up to 4 actions for each fault." VALUE 0x80002E4F RecordLayout_3 0 CompuMethod_108 0 65535 /end CHARACTERISTIC
/begin CHARACTERISTIC FaultManager.EVAPRangeLow.Action_4 "Fault manager configuration.  Select up to 4 actions for each fault." VALUE 0x80002E51 RecordLayout_3 0 CompuMethod_107 0 65535 /end CHARACTERISTIC
/begin CHARACTERISTIC FaultManager.EVAPRangeLow.Action_4_Condition "Fault manager configuration.  Select up to 4 actions for each fault." VALUE 0x80002E53 RecordLayout_3 0 CompuMethod_108 0 65535 /end CHARACTERISTIC
/begin CHARACTERISTIC FaultManager.FuelAdaptRangeHi_BankA.Mode "Fault manager configuration.  Select up to 4 actions for each fault." VALUE 0x80002E55 RecordLayout_3 0 CompuMethod_105 0 65535 /end CHARACTERISTIC
/begin CHARACTERISTIC FaultManager.FuelAdaptRangeHi_BankA.ID "Fault manager configuration.  Select up to 4 actions for each fault." VALUE 0x80002E57 RecordLayout_3 0 CompuMethod_1 0 65535 /end CHARACTERISTIC
/begin CHARACTERISTIC FaultManager.FuelAdaptRangeHi_BankA.Test "Fault manager configuration.  Select up to 4 actions for each fault." VALUE 0x80002E59 RecordLayout_3 0 CompuMethod_106 0 65535 /end CHARACTERISTIC
/begin CHARACTERISTIC FaultManager.FuelAdaptRangeHi_BankA.Faulty_Samples__X_ "Fault manager configuration.  Select up to 4 actions for each fault." VALUE 0x80002E5B RecordLayout_3 0 CompuMethod_1 0 65535 /end CHARACTERISTIC
/begin CHARACTERISTIC FaultManager.FuelAdaptRangeHi_BankA.Total_Samples__Y_ "Fault manager configuration.  Select up to 4 actions for each fault." VALUE 0x80002E5D RecordLayout_3 0 CompuMethod_1 0 65535 /end CHARACTERISTIC
/begin CHARACTERISTIC FaultManager.FuelAdaptRangeHi_BankA.Action_1 "Fault manager configuration.  Select up to 4 actions for each fault." VALUE 0x80002E5F RecordLayout_3 0 CompuMethod_107 0 65535 /end CHARACTERISTIC
/begin CHARACTERISTIC FaultManager.FuelAdaptRangeHi_BankA.Action_1_Condition "Fault manager configuration.  Select up to 4 actions for each fault." VALUE 0x80002E61 RecordLayout_3 0 CompuMethod_108 0 65535 /end CHARACTERISTIC
/begin CHARACTERISTIC FaultManager.FuelAdaptRangeHi_BankA.Action_2 "Fault manager configuration.  Select up to 4 actions for each fault." VALUE 0x80002E63 RecordLayout_3 0 CompuMethod_107 0 65535 /end CHARACTERISTIC
/begin CHARACTERISTIC FaultManager.FuelAdaptRangeHi_BankA.Action_2_Condition "Fault manager configuration.  Select up to 4 actions for each fault." VALUE 0x80002E65 RecordLayout_3 0 CompuMethod_108 0 65535 /end CHARACTERISTIC
/begin CHARACTERISTIC FaultManager.FuelAdaptRangeHi_BankA.Action_3 "Fault manager configuration.  Select up to 4 actions for each fault." VALUE 0x80002E67 RecordLayout_3 0 CompuMethod_107 0 65535 /end CHARACTERISTIC
/begin CHARACTERISTIC FaultManager.FuelAdaptRangeHi_BankA.Action_3_Condition "Fault manager configuration.  Select up to 4 actions for each fault." VALUE 0x80002E69 RecordLayout_3 0 CompuMethod_108 0 65535 /end CHARACTERISTIC
/begin CHARACTERISTIC FaultManager.FuelAdaptRangeHi_BankA.Action_4 "Fault manager configuration.  Select up to 4 actions for each fault." VALUE 0x80002E6B RecordLayout_3 0 CompuMethod_107 0 65535 /end CHARACTERISTIC
/begin CHARACTERISTIC FaultManager.FuelAdaptRangeHi_BankA.Action_4_Condition "Fault manager configuration.  Select up to 4 actions for each fault." VALUE 0x80002E6D RecordLayout_3 0 CompuMethod_108 0 65535 /end CHARACTERISTIC
/begin CHARACTERISTIC FaultManager.FuelAdaptRangeHi_BankB.Mode "Fault manager configuration.  Select up to 4 actions for each fault." VALUE 0x80002E6F RecordLayout_3 0 CompuMethod_105 0 65535 /end CHARACTERISTIC
/begin CHARACTERISTIC FaultManager.FuelAdaptRangeHi_BankB.ID "Fault manager configuration.  Select up to 4 actions for each fault." VALUE 0x80002E71 RecordLayout_3 0 CompuMethod_1 0 65535 /end CHARACTERISTIC
/begin CHARACTERISTIC FaultManager.FuelAdaptRangeHi_BankB.Test "Fault manager configuration.  Select up to 4 actions for each fault." VALUE 0x80002E73 RecordLayout_3 0 CompuMethod_106 0 65535 /end CHARACTERISTIC
/begin CHARACTERISTIC FaultManager.FuelAdaptRangeHi_BankB.Faulty_Samples__X_ "Fault manager configuration.  Select up to 4 actions for each fault." VALUE 0x80002E75 RecordLayout_3 0 CompuMethod_1 0 65535 /end CHARACTERISTIC
/begin CHARACTERISTIC FaultManager.FuelAdaptRangeHi_BankB.Total_Samples__Y_ "Fault manager configuration.  Select up to 4 actions for each fault." VALUE 0x80002E77 RecordLayout_3 0 CompuMethod_1 0 65535 /end CHARACTERISTIC
/begin CHARACTERISTIC FaultManager.FuelAdaptRangeHi_BankB.Action_1 "Fault manager configuration.  Select up to 4 actions for each fault." VALUE 0x80002E79 RecordLayout_3 0 CompuMethod_107 0 65535 /end CHARACTERISTIC
/begin CHARACTERISTIC FaultManager.FuelAdaptRangeHi_BankB.Action_1_Condition "Fault manager configuration.  Select up to 4 actions for each fault." VALUE 0x80002E7B RecordLayout_3 0 CompuMethod_108 0 65535 /end CHARACTERISTIC
/begin CHARACTERISTIC FaultManager.FuelAdaptRangeHi_BankB.Action_2 "Fault manager configuration.  Select up to 4 actions for each fault." VALUE 0x80002E7D RecordLayout_3 0 CompuMethod_107 0 65535 /end CHARACTERISTIC
/begin CHARACTERISTIC FaultManager.FuelAdaptRangeHi_BankB.Action_2_Condition "Fault manager configuration.  Select up to 4 actions for each fault." VALUE 0x80002E7F RecordLayout_3 0 CompuMethod_108 0 65535 /end CHARACTERISTIC
/begin CHARACTERISTIC FaultManager.FuelAdaptRangeHi_BankB.Action_3 "Fault manager configuration.  Select up to 4 actions for each fault." VALUE 0x80002E81 RecordLayout_3 0 CompuMethod_107 0 65535 /end CHARACTERISTIC
/begin CHARACTERISTIC FaultManager.FuelAdaptRangeHi_BankB.Action_3_Condition "Fault manager configuration.  Select up to 4 actions for each fault." VALUE 0x80002E83 RecordLayout_3 0 CompuMethod_108 0 65535 /end CHARACTERISTIC
/begin CHARACTERISTIC FaultManager.FuelAdaptRangeHi_BankB.Action_4 "Fault manager configuration.  Select up to 4 actions for each fault." VALUE 0x80002E85 RecordLayout_3 0 CompuMethod_107 0 65535 /end CHARACTERISTIC
/begin CHARACTERISTIC FaultManager.FuelAdaptRangeHi_BankB.Action_4_Condition "Fault manager configuration.  Select up to 4 actions for each fault." VALUE 0x80002E87 RecordLayout_3 0 CompuMethod_108 0 65535 /end CHARACTERISTIC
/begin CHARACTERISTIC FaultManager.FuelAdaptRangeLow_BankA.Mode "Fault manager configuration.  Select up to 4 actions for each fault." VALUE 0x80002E89 RecordLayout_3 0 CompuMethod_105 0 65535 /end CHARACTERISTIC
/begin CHARACTERISTIC FaultManager.FuelAdaptRangeLow_BankA.ID "Fault manager configuration.  Select up to 4 actions for each fault." VALUE 0x80002E8B RecordLayout_3 0 CompuMethod_1 0 65535 /end CHARACTERISTIC
/begin CHARACTERISTIC FaultManager.FuelAdaptRangeLow_BankA.Test "Fault manager configuration.  Select up to 4 actions for each fault." VALUE 0x80002E8D RecordLayout_3 0 CompuMethod_106 0 65535 /end CHARACTERISTIC
/begin CHARACTERISTIC FaultManager.FuelAdaptRangeLow_BankA.Faulty_Samples__X_ "Fault manager configuration.  Select up to 4 actions for each fault." VALUE 0x80002E8F RecordLayout_3 0 CompuMethod_1 0 65535 /end CHARACTERISTIC
/begin CHARACTERISTIC FaultManager.FuelAdaptRangeLow_BankA.Total_Samples__Y_ "Fault manager configuration.  Select up to 4 actions for each fault." VALUE 0x80002E91 RecordLayout_3 0 CompuMethod_1 0 65535 /end CHARACTERISTIC
/begin CHARACTERISTIC FaultManager.FuelAdaptRangeLow_BankA.Action_1 "Fault manager configuration.  Select up to 4 actions for each fault." VALUE 0x80002E93 RecordLayout_3 0 CompuMethod_107 0 65535 /end CHARACTERISTIC
/begin CHARACTERISTIC FaultManager.FuelAdaptRangeLow_BankA.Action_1_Condition "Fault manager configuration.  Select up to 4 actions for each fault." VALUE 0x80002E95 RecordLayout_3 0 CompuMethod_108 0 65535 /end CHARACTERISTIC
/begin CHARACTERISTIC FaultManager.FuelAdaptRangeLow_BankA.Action_2 "Fault manager configuration.  Select up to 4 actions for each fault." VALUE 0x80002E97 RecordLayout_3 0 CompuMethod_107 0 65535 /end CHARACTERISTIC
/begin CHARACTERISTIC FaultManager.FuelAdaptRangeLow_BankA.Action_2_Condition "Fault manager configuration.  Select up to 4 actions for each fault." VALUE 0x80002E99 RecordLayout_3 0 CompuMethod_108 0 65535 /end CHARACTERISTIC
/begin CHARACTERISTIC FaultManager.FuelAdaptRangeLow_BankA.Action_3 "Fault manager configuration.  Select up to 4 actions for each fault." VALUE 0x80002E9B RecordLayout_3 0 CompuMethod_107 0 65535 /end CHARACTERISTIC
/begin CHARACTERISTIC FaultManager.FuelAdaptRangeLow_BankA.Action_3_Condition "Fault manager configuration.  Select up to 4 actions for each fault." VALUE 0x80002E9D RecordLayout_3 0 CompuMethod_108 0 65535 /end CHARACTERISTIC
/begin CHARACTERISTIC FaultManager.FuelAdaptRangeLow_BankA.Action_4 "Fault manager configuration.  Select up to 4 actions for each fault." VALUE 0x80002E9F RecordLayout_3 0 CompuMethod_107 0 65535 /end CHARACTERISTIC
/begin CHARACTERISTIC FaultManager.FuelAdaptRangeLow_BankA.Action_4_Condition "Fault manager configuration.  Select up to 4 actions for each fault." VALUE 0x80002EA1 RecordLayout_3 0 CompuMethod_108 0 65535 /end CHARACTERISTIC
/begin CHARACTERISTIC FaultManager.FuelAdaptRangeLow_BankB.Mode "Fault manager configuration.  Select up to 4 actions for each fault." VALUE 0x80002EA3 RecordLayout_3 0 CompuMethod_105 0 65535 /end CHARACTERISTIC
/begin CHARACTERISTIC FaultManager.FuelAdaptRangeLow_BankB.ID "Fault manager configuration.  Select up to 4 actions for each fault." VALUE 0x80002EA5 RecordLayout_3 0 CompuMethod_1 0 65535 /end CHARACTERISTIC
/begin CHARACTERISTIC FaultManager.FuelAdaptRangeLow_BankB.Test "Fault manager configuration.  Select up to 4 actions for each fault." VALUE 0x80002EA7 RecordLayout_3 0 CompuMethod_106 0 65535 /end CHARACTERISTIC
/begin CHARACTERISTIC FaultManager.FuelAdaptRangeLow_BankB.Faulty_Samples__X_ "Fault manager configuration.  Select up to 4 actions for each fault." VALUE 0x80002EA9 RecordLayout_3 0 CompuMethod_1 0 65535 /end CHARACTERISTIC
/begin CHARACTERISTIC FaultManager.FuelAdaptRangeLow_BankB.Total_Samples__Y_ "Fault manager configuration.  Select up to 4 actions for each fault." VALUE 0x80002EAB RecordLayout_3 0 CompuMethod_1 0 65535 /end CHARACTERISTIC
/begin CHARACTERISTIC FaultManager.FuelAdaptRangeLow_BankB.Action_1 "Fault manager configuration.  Select up to 4 actions for each fault." VALUE 0x80002EAD RecordLayout_3 0 CompuMethod_107 0 65535 /end CHARACTERISTIC
/begin CHARACTERISTIC FaultManager.FuelAdaptRangeLow_BankB.Action_1_Condition "Fault manager configuration.  Select up to 4 actions for each fault." VALUE 0x80002EAF RecordLayout_3 0 CompuMethod_108 0 65535 /end CHARACTERISTIC
/begin CHARACTERISTIC FaultManager.FuelAdaptRangeLow_BankB.Action_2 "Fault manager configuration.  Select up to 4 actions for each fault." VALUE 0x80002EB1 RecordLayout_3 0 CompuMethod_107 0 65535 /end CHARACTERISTIC
/begin CHARACTERISTIC FaultManager.FuelAdaptRangeLow_BankB.Action_2_Condition "Fault manager configuration.  Select up to 4 actions for each fault." VALUE 0x80002EB3 RecordLayout_3 0 CompuMethod_108 0 65535 /end CHARACTERISTIC
/begin CHARACTERISTIC FaultManager.FuelAdaptRangeLow_BankB.Action_3 "Fault manager configuration.  Select up to 4 actions for each fault." VALUE 0x80002EB5 RecordLayout_3 0 CompuMethod_107 0 65535 /end CHARACTERISTIC
/begin CHARACTERISTIC FaultManager.FuelAdaptRangeLow_BankB.Action_3_Condition "Fault manager configuration.  Select up to 4 actions for each fault." VALUE 0x80002EB7 RecordLayout_3 0 CompuMethod_108 0 65535 /end CHARACTERISTIC
/begin CHARACTERISTIC FaultManager.FuelAdaptRangeLow_BankB.Action_4 "Fault manager configuration.  Select up to 4 actions for each fault." VALUE 0x80002EB9 RecordLayout_3 0 CompuMethod_107 0 65535 /end CHARACTERISTIC
/begin CHARACTERISTIC FaultManager.FuelAdaptRangeLow_BankB.Action_4_Condition "Fault manager configuration.  Select up to 4 actions for each fault." VALUE 0x80002EBB RecordLayout_3 0 CompuMethod_108 0 65535 /end CHARACTERISTIC
/begin CHARACTERISTIC FaultManager.FuelPresHigh_Fault.Mode "Fault manager configuration.  Select up to 4 actions for each fault." VALUE 0x80002EBD RecordLayout_3 0 CompuMethod_105 0 65535 /end CHARACTERISTIC
/begin CHARACTERISTIC FaultManager.FuelPresHigh_Fault.ID "Fault manager configuration.  Select up to 4 actions for each fault." VALUE 0x80002EBF RecordLayout_3 0 CompuMethod_1 0 65535 /end CHARACTERISTIC
/begin CHARACTERISTIC FaultManager.FuelPresHigh_Fault.Test "Fault manager configuration.  Select up to 4 actions for each fault." VALUE 0x80002EC1 RecordLayout_3 0 CompuMethod_106 0 65535 /end CHARACTERISTIC
/begin CHARACTERISTIC FaultManager.FuelPresHigh_Fault.Faulty_Samples__X_ "Fault manager configuration.  Select up to 4 actions for each fault." VALUE 0x80002EC3 RecordLayout_3 0 CompuMethod_1 0 65535 /end CHARACTERISTIC
/begin CHARACTERISTIC FaultManager.FuelPresHigh_Fault.Total_Samples__Y_ "Fault manager configuration.  Select up to 4 actions for each fault." VALUE 0x80002EC5 RecordLayout_3 0 CompuMethod_1 0 65535 /end CHARACTERISTIC
/begin CHARACTERISTIC FaultManager.FuelPresHigh_Fault.Action_1 "Fault manager configuration.  Select up to 4 actions for each fault." VALUE 0x80002EC7 RecordLayout_3 0 CompuMethod_107 0 65535 /end CHARACTERISTIC
/begin CHARACTERISTIC FaultManager.FuelPresHigh_Fault.Action_1_Condition "Fault manager configuration.  Select up to 4 actions for each fault." VALUE 0x80002EC9 RecordLayout_3 0 CompuMethod_108 0 65535 /end CHARACTERISTIC
/begin CHARACTERISTIC FaultManager.FuelPresHigh_Fault.Action_2 "Fault manager configuration.  Select up to 4 actions for each fault." VALUE 0x80002ECB RecordLayout_3 0 CompuMethod_107 0 65535 /end CHARACTERISTIC
/begin CHARACTERISTIC FaultManager.FuelPresHigh_Fault.Action_2_Condition "Fault manager configuration.  Select up to 4 actions for each fault." VALUE 0x80002ECD RecordLayout_3 0 CompuMethod_108 0 65535 /end CHARACTERISTIC
/begin CHARACTERISTIC FaultManager.FuelPresHigh_Fault.Action_3 "Fault manager configuration.  Select up to 4 actions for each fault." VALUE 0x80002ECF RecordLayout_3 0 CompuMethod_107 0 65535 /end CHARACTERISTIC
/begin CHARACTERISTIC FaultManager.FuelPresHigh_Fault.Action_3_Condition "Fault manager configuration.  Select up to 4 actions for each fault." VALUE 0x80002ED1 RecordLayout_3 0 CompuMethod_108 0 65535 /end CHARACTERISTIC
/begin CHARACTERISTIC FaultManager.FuelPresHigh_Fault.Action_4 "Fault manager configuration.  Select up to 4 actions for each fault." VALUE 0x80002ED3 RecordLayout_3 0 CompuMethod_107 0 65535 /end CHARACTERISTIC
/begin CHARACTERISTIC FaultManager.FuelPresHigh_Fault.Action_4_Condition "Fault manager configuration.  Select up to 4 actions for each fault." VALUE 0x80002ED5 RecordLayout_3 0 CompuMethod_108 0 65535 /end CHARACTERISTIC
/begin CHARACTERISTIC FaultManager.FuelPresLow_Fault.Mode "Fault manager configuration.  Select up to 4 actions for each fault." VALUE 0x80002ED7 RecordLayout_3 0 CompuMethod_105 0 65535 /end CHARACTERISTIC
/begin CHARACTERISTIC FaultManager.FuelPresLow_Fault.ID "Fault manager configuration.  Select up to 4 actions for each fault." VALUE 0x80002ED9 RecordLayout_3 0 CompuMethod_1 0 65535 /end CHARACTERISTIC
/begin CHARACTERISTIC FaultManager.FuelPresLow_Fault.Test "Fault manager configuration.  Select up to 4 actions for each fault." VALUE 0x80002EDB RecordLayout_3 0 CompuMethod_106 0 65535 /end CHARACTERISTIC
/begin CHARACTERISTIC FaultManager.FuelPresLow_Fault.Faulty_Samples__X_ "Fault manager configuration.  Select up to 4 actions for each fault." VALUE 0x80002EDD RecordLayout_3 0 CompuMethod_1 0 65535 /end CHARACTERISTIC
/begin CHARACTERISTIC FaultManager.FuelPresLow_Fault.Total_Samples__Y_ "Fault manager configuration.  Select up to 4 actions for each fault." VALUE 0x80002EDF RecordLayout_3 0 CompuMethod_1 0 65535 /end CHARACTERISTIC
/begin CHARACTERISTIC FaultManager.FuelPresLow_Fault.Action_1 "Fault manager configuration.  Select up to 4 actions for each fault." VALUE 0x80002EE1 RecordLayout_3 0 CompuMethod_107 0 65535 /end CHARACTERISTIC
/begin CHARACTERISTIC FaultManager.FuelPresLow_Fault.Action_1_Condition "Fault manager configuration.  Select up to 4 actions for each fault." VALUE 0x80002EE3 RecordLayout_3 0 CompuMethod_108 0 65535 /end CHARACTERISTIC
/begin CHARACTERISTIC FaultManager.FuelPresLow_Fault.Action_2 "Fault manager configuration.  Select up to 4 actions for each fault." VALUE 0x80002EE5 RecordLayout_3 0 CompuMethod_107 0 65535 /end CHARACTERISTIC
/begin CHARACTERISTIC FaultManager.FuelPresLow_Fault.Action_2_Condition "Fault manager configuration.  Select up to 4 actions for each fault." VALUE 0x80002EE7 RecordLayout_3 0 CompuMethod_108 0 65535 /end CHARACTERISTIC
/begin CHARACTERISTIC FaultManager.FuelPresLow_Fault.Action_3 "Fault manager configuration.  Select up to 4 actions for each fault." VALUE 0x80002EE9 RecordLayout_3 0 CompuMethod_107 0 65535 /end CHARACTERISTIC
/begin CHARACTERISTIC FaultManager.FuelPresLow_Fault.Action_3_Condition "Fault manager configuration.  Select up to 4 actions for each fault." VALUE 0x80002EEB RecordLayout_3 0 CompuMethod_108 0 65535 /end CHARACTERISTIC
/begin CHARACTERISTIC FaultManager.FuelPresLow_Fault.Action_4 "Fault manager configuration.  Select up to 4 actions for each fault." VALUE 0x80002EED RecordLayout_3 0 CompuMethod_107 0 65535 /end CHARACTERISTIC
/begin CHARACTERISTIC FaultManager.FuelPresLow_Fault.Action_4_Condition "Fault manager configuration.  Select up to 4 actions for each fault." VALUE 0x80002EEF RecordLayout_3 0 CompuMethod_108 0 65535 /end CHARACTERISTIC
/begin CHARACTERISTIC FaultManager.FuelPresRangeHigh.Mode "Fault manager configuration.  Select up to 4 actions for each fault." VALUE 0x80002EF1 RecordLayout_3 0 CompuMethod_105 0 65535 /end CHARACTERISTIC
/begin CHARACTERISTIC FaultManager.FuelPresRangeHigh.ID "Fault manager configuration.  Select up to 4 actions for each fault." VALUE 0x80002EF3 RecordLayout_3 0 CompuMethod_1 0 65535 /end CHARACTERISTIC
/begin CHARACTERISTIC FaultManager.FuelPresRangeHigh.Test "Fault manager configuration.  Select up to 4 actions for each fault." VALUE 0x80002EF5 RecordLayout_3 0 CompuMethod_106 0 65535 /end CHARACTERISTIC
/begin CHARACTERISTIC FaultManager.FuelPresRangeHigh.Faulty_Samples__X_ "Fault manager configuration.  Select up to 4 actions for each fault." VALUE 0x80002EF7 RecordLayout_3 0 CompuMethod_1 0 65535 /end CHARACTERISTIC
/begin CHARACTERISTIC FaultManager.FuelPresRangeHigh.Total_Samples__Y_ "Fault manager configuration.  Select up to 4 actions for each fault." VALUE 0x80002EF9 RecordLayout_3 0 CompuMethod_1 0 65535 /end CHARACTERISTIC
/begin CHARACTERISTIC FaultManager.FuelPresRangeHigh.Action_1 "Fault manager configuration.  Select up to 4 actions for each fault." VALUE 0x80002EFB RecordLayout_3 0 CompuMethod_107 0 65535 /end CHARACTERISTIC
/begin CHARACTERISTIC FaultManager.FuelPresRangeHigh.Action_1_Condition "Fault manager configuration.  Select up to 4 actions for each fault." VALUE 0x80002EFD RecordLayout_3 0 CompuMethod_108 0 65535 /end CHARACTERISTIC
/begin CHARACTERISTIC FaultManager.FuelPresRangeHigh.Action_2 "Fault manager configuration.  Select up to 4 actions for each fault." VALUE 0x80002EFF RecordLayout_3 0 CompuMethod_107 0 65535 /end CHARACTERISTIC
/begin CHARACTERISTIC FaultManager.FuelPresRangeHigh.Action_2_Condition "Fault manager configuration.  Select up to 4 actions for each fault." VALUE 0x80002F01 RecordLayout_3 0 CompuMethod_108 0 65535 /end CHARACTERISTIC
/begin CHARACTERISTIC FaultManager.FuelPresRangeHigh.Action_3 "Fault manager configuration.  Select up to 4 actions for each fault." VALUE 0x80002F03 RecordLayout_3 0 CompuMethod_107 0 65535 /end CHARACTERISTIC
/begin CHARACTERISTIC FaultManager.FuelPresRangeHigh.Action_3_Condition "Fault manager configuration.  Select up to 4 actions for each fault." VALUE 0x80002F05 RecordLayout_3 0 CompuMethod_108 0 65535 /end CHARACTERISTIC
/begin CHARACTERISTIC FaultManager.FuelPresRangeHigh.Action_4 "Fault manager configuration.  Select up to 4 actions for each fault." VALUE 0x80002F07 RecordLayout_3 0 CompuMethod_107 0 65535 /end CHARACTERISTIC
/begin CHARACTERISTIC FaultManager.FuelPresRangeHigh.Action_4_Condition "Fault manager configuration.  Select up to 4 actions for each fault." VALUE 0x80002F09 RecordLayout_3 0 CompuMethod_108 0 65535 /end CHARACTERISTIC
/begin CHARACTERISTIC FaultManager.FuelPresRangeLow.Mode "Fault manager configuration.  Select up to 4 actions for each fault." VALUE 0x80002F0B RecordLayout_3 0 CompuMethod_105 0 65535 /end CHARACTERISTIC
/begin CHARACTERISTIC FaultManager.FuelPresRangeLow.ID "Fault manager configuration.  Select up to 4 actions for each fault." VALUE 0x80002F0D RecordLayout_3 0 CompuMethod_1 0 65535 /end CHARACTERISTIC
/begin CHARACTERISTIC FaultManager.FuelPresRangeLow.Test "Fault manager configuration.  Select up to 4 actions for each fault." VALUE 0x80002F0F RecordLayout_3 0 CompuMethod_106 0 65535 /end CHARACTERISTIC
/begin CHARACTERISTIC FaultManager.FuelPresRangeLow.Faulty_Samples__X_ "Fault manager configuration.  Select up to 4 actions for each fault." VALUE 0x80002F11 RecordLayout_3 0 CompuMethod_1 0 65535 /end CHARACTERISTIC
/begin CHARACTERISTIC FaultManager.FuelPresRangeLow.Total_Samples__Y_ "Fault manager configuration.  Select up to 4 actions for each fault." VALUE 0x80002F13 RecordLayout_3 0 CompuMethod_1 0 65535 /end CHARACTERISTIC
/begin CHARACTERISTIC FaultManager.FuelPresRangeLow.Action_1 "Fault manager configuration.  Select up to 4 actions for each fault." VALUE 0x80002F15 RecordLayout_3 0 CompuMethod_107 0 65535 /end CHARACTERISTIC
/begin CHARACTERISTIC FaultManager.FuelPresRangeLow.Action_1_Condition "Fault manager configuration.  Select up to 4 actions for each fault." VALUE 0x80002F17 RecordLayout_3 0 CompuMethod_108 0 65535 /end CHARACTERISTIC
/begin CHARACTERISTIC FaultManager.FuelPresRangeLow.Action_2 "Fault manager configuration.  Select up to 4 actions for each fault." VALUE 0x80002F19 RecordLayout_3 0 CompuMethod_107 0 65535 /end CHARACTERISTIC
/begin CHARACTERISTIC FaultManager.FuelPresRangeLow.Action_2_Condition "Fault manager configuration.  Select up to 4 actions for each fault." VALUE 0x80002F1B RecordLayout_3 0 CompuMethod_108 0 65535 /end CHARACTERISTIC
/begin CHARACTERISTIC FaultManager.FuelPresRangeLow.Action_3 "Fault manager configuration.  Select up to 4 actions for each fault." VALUE 0x80002F1D RecordLayout_3 0 CompuMethod_107 0 65535 /end CHARACTERISTIC
/begin CHARACTERISTIC FaultManager.FuelPresRangeLow.Action_3_Condition "Fault manager configuration.  Select up to 4 actions for each fault." VALUE 0x80002F1F RecordLayout_3 0 CompuMethod_108 0 65535 /end CHARACTERISTIC
/begin CHARACTERISTIC FaultManager.FuelPresRangeLow.Action_4 "Fault manager configuration.  Select up to 4 actions for each fault." VALUE 0x80002F21 RecordLayout_3 0 CompuMethod_107 0 65535 /end CHARACTERISTIC
/begin CHARACTERISTIC FaultManager.FuelPresRangeLow.Action_4_Condition "Fault manager configuration.  Select up to 4 actions for each fault." VALUE 0x80002F23 RecordLayout_3 0 CompuMethod_108 0 65535 /end CHARACTERISTIC
/begin CHARACTERISTIC FaultManager.FuelSensRangeHigh.Mode "Fault manager configuration.  Select up to 4 actions for each fault." VALUE 0x80002F25 RecordLayout_3 0 CompuMethod_105 0 65535 /end CHARACTERISTIC
/begin CHARACTERISTIC FaultManager.FuelSensRangeHigh.ID "Fault manager configuration.  Select up to 4 actions for each fault." VALUE 0x80002F27 RecordLayout_3 0 CompuMethod_1 0 65535 /end CHARACTERISTIC
/begin CHARACTERISTIC FaultManager.FuelSensRangeHigh.Test "Fault manager configuration.  Select up to 4 actions for each fault." VALUE 0x80002F29 RecordLayout_3 0 CompuMethod_106 0 65535 /end CHARACTERISTIC
/begin CHARACTERISTIC FaultManager.FuelSensRangeHigh.Faulty_Samples__X_ "Fault manager configuration.  Select up to 4 actions for each fault." VALUE 0x80002F2B RecordLayout_3 0 CompuMethod_1 0 65535 /end CHARACTERISTIC
/begin CHARACTERISTIC FaultManager.FuelSensRangeHigh.Total_Samples__Y_ "Fault manager configuration.  Select up to 4 actions for each fault." VALUE 0x80002F2D RecordLayout_3 0 CompuMethod_1 0 65535 /end CHARACTERISTIC
/begin CHARACTERISTIC FaultManager.FuelSensRangeHigh.Action_1 "Fault manager configuration.  Select up to 4 actions for each fault." VALUE 0x80002F2F RecordLayout_3 0 CompuMethod_107 0 65535 /end CHARACTERISTIC
/begin CHARACTERISTIC FaultManager.FuelSensRangeHigh.Action_1_Condition "Fault manager configuration.  Select up to 4 actions for each fault." VALUE 0x80002F31 RecordLayout_3 0 CompuMethod_108 0 65535 /end CHARACTERISTIC
/begin CHARACTERISTIC FaultManager.FuelSensRangeHigh.Action_2 "Fault manager configuration.  Select up to 4 actions for each fault." VALUE 0x80002F33 RecordLayout_3 0 CompuMethod_107 0 65535 /end CHARACTERISTIC
/begin CHARACTERISTIC FaultManager.FuelSensRangeHigh.Action_2_Condition "Fault manager configuration.  Select up to 4 actions for each fault." VALUE 0x80002F35 RecordLayout_3 0 CompuMethod_108 0 65535 /end CHARACTERISTIC
/begin CHARACTERISTIC FaultManager.FuelSensRangeHigh.Action_3 "Fault manager configuration.  Select up to 4 actions for each fault." VALUE 0x80002F37 RecordLayout_3 0 CompuMethod_107 0 65535 /end CHARACTERISTIC
/begin CHARACTERISTIC FaultManager.FuelSensRangeHigh.Action_3_Condition "Fault manager configuration.  Select up to 4 actions for each fault." VALUE 0x80002F39 RecordLayout_3 0 CompuMethod_108 0 65535 /end CHARACTERISTIC
/begin CHARACTERISTIC FaultManager.FuelSensRangeHigh.Action_4 "Fault manager configuration.  Select up to 4 actions for each fault." VALUE 0x80002F3B RecordLayout_3 0 CompuMethod_107 0 65535 /end CHARACTERISTIC
/begin CHARACTERISTIC FaultManager.FuelSensRangeHigh.Action_4_Condition "Fault manager configuration.  Select up to 4 actions for each fault." VALUE 0x80002F3D RecordLayout_3 0 CompuMethod_108 0 65535 /end CHARACTERISTIC
/begin CHARACTERISTIC FaultManager.FuelSensRangeLow.Mode "Fault manager configuration.  Select up to 4 actions for each fault." VALUE 0x80002F3F RecordLayout_3 0 CompuMethod_105 0 65535 /end CHARACTERISTIC
/begin CHARACTERISTIC FaultManager.FuelSensRangeLow.ID "Fault manager configuration.  Select up to 4 actions for each fault." VALUE 0x80002F41 RecordLayout_3 0 CompuMethod_1 0 65535 /end CHARACTERISTIC
/begin CHARACTERISTIC FaultManager.FuelSensRangeLow.Test "Fault manager configuration.  Select up to 4 actions for each fault." VALUE 0x80002F43 RecordLayout_3 0 CompuMethod_106 0 65535 /end CHARACTERISTIC
/begin CHARACTERISTIC FaultManager.FuelSensRangeLow.Faulty_Samples__X_ "Fault manager configuration.  Select up to 4 actions for each fault." VALUE 0x80002F45 RecordLayout_3 0 CompuMethod_1 0 65535 /end CHARACTERISTIC
/begin CHARACTERISTIC FaultManager.FuelSensRangeLow.Total_Samples__Y_ "Fault manager configuration.  Select up to 4 actions for each fault." VALUE 0x80002F47 RecordLayout_3 0 CompuMethod_1 0 65535 /end CHARACTERISTIC
/begin CHARACTERISTIC FaultManager.FuelSensRangeLow.Action_1 "Fault manager configuration.  Select up to 4 actions for each fault." VALUE 0x80002F49 RecordLayout_3 0 CompuMethod_107 0 65535 /end CHARACTERISTIC
/begin CHARACTERISTIC FaultManager.FuelSensRangeLow.Action_1_Condition "Fault manager configuration.  Select up to 4 actions for each fault." VALUE 0x80002F4B RecordLayout_3 0 CompuMethod_108 0 65535 /end CHARACTERISTIC
/begin CHARACTERISTIC FaultManager.FuelSensRangeLow.Action_2 "Fault manager configuration.  Select up to 4 actions for each fault." VALUE 0x80002F4D RecordLayout_3 0 CompuMethod_107 0 65535 /end CHARACTERISTIC
/begin CHARACTERISTIC FaultManager.FuelSensRangeLow.Action_2_Condition "Fault manager configuration.  Select up to 4 actions for each fault." VALUE 0x80002F4F RecordLayout_3 0 CompuMethod_108 0 65535 /end CHARACTERISTIC
/begin CHARACTERISTIC FaultManager.FuelSensRangeLow.Action_3 "Fault manager configuration.  Select up to 4 actions for each fault." VALUE 0x80002F51 RecordLayout_3 0 CompuMethod_107 0 65535 /end CHARACTERISTIC
/begin CHARACTERISTIC FaultManager.FuelSensRangeLow.Action_3_Condition "Fault manager configuration.  Select up to 4 actions for each fault." VALUE 0x80002F53 RecordLayout_3 0 CompuMethod_108 0 65535 /end CHARACTERISTIC
/begin CHARACTERISTIC FaultManager.FuelSensRangeLow.Action_4 "Fault manager configuration.  Select up to 4 actions for each fault." VALUE 0x80002F55 RecordLayout_3 0 CompuMethod_107 0 65535 /end CHARACTERISTIC
/begin CHARACTERISTIC FaultManager.FuelSensRangeLow.Action_4_Condition "Fault manager configuration.  Select up to 4 actions for each fault." VALUE 0x80002F57 RecordLayout_3 0 CompuMethod_108 0 65535 /end CHARACTERISTIC
/begin CHARACTERISTIC FaultManager.Fuel_LvlRangeHigh.Mode "Fault manager configuration.  Select up to 4 actions for each fault." VALUE 0x80002F59 RecordLayout_3 0 CompuMethod_105 0 65535 /end CHARACTERISTIC
/begin CHARACTERISTIC FaultManager.Fuel_LvlRangeHigh.ID "Fault manager configuration.  Select up to 4 actions for each fault." VALUE 0x80002F5B RecordLayout_3 0 CompuMethod_1 0 65535 /end CHARACTERISTIC
/begin CHARACTERISTIC FaultManager.Fuel_LvlRangeHigh.Test "Fault manager configuration.  Select up to 4 actions for each fault." VALUE 0x80002F5D RecordLayout_3 0 CompuMethod_106 0 65535 /end CHARACTERISTIC
/begin CHARACTERISTIC FaultManager.Fuel_LvlRangeHigh.Faulty_Samples__X_ "Fault manager configuration.  Select up to 4 actions for each fault." VALUE 0x80002F5F RecordLayout_3 0 CompuMethod_1 0 65535 /end CHARACTERISTIC
/begin CHARACTERISTIC FaultManager.Fuel_LvlRangeHigh.Total_Samples__Y_ "Fault manager configuration.  Select up to 4 actions for each fault." VALUE 0x80002F61 RecordLayout_3 0 CompuMethod_1 0 65535 /end CHARACTERISTIC
/begin CHARACTERISTIC FaultManager.Fuel_LvlRangeHigh.Action_1 "Fault manager configuration.  Select up to 4 actions for each fault." VALUE 0x80002F63 RecordLayout_3 0 CompuMethod_107 0 65535 /end CHARACTERISTIC
/begin CHARACTERISTIC FaultManager.Fuel_LvlRangeHigh.Action_1_Condition "Fault manager configuration.  Select up to 4 actions for each fault." VALUE 0x80002F65 RecordLayout_3 0 CompuMethod_108 0 65535 /end CHARACTERISTIC
/begin CHARACTERISTIC FaultManager.Fuel_LvlRangeHigh.Action_2 "Fault manager configuration.  Select up to 4 actions for each fault." VALUE 0x80002F67 RecordLayout_3 0 CompuMethod_107 0 65535 /end CHARACTERISTIC
/begin CHARACTERISTIC FaultManager.Fuel_LvlRangeHigh.Action_2_Condition "Fault manager configuration.  Select up to 4 actions for each fault." VALUE 0x80002F69 RecordLayout_3 0 CompuMethod_108 0 65535 /end CHARACTERISTIC
/begin CHARACTERISTIC FaultManager.Fuel_LvlRangeHigh.Action_3 "Fault manager configuration.  Select up to 4 actions for each fault." VALUE 0x80002F6B RecordLayout_3 0 CompuMethod_107 0 65535 /end CHARACTERISTIC
/begin CHARACTERISTIC FaultManager.Fuel_LvlRangeHigh.Action_3_Condition "Fault manager configuration.  Select up to 4 actions for each fault." VALUE 0x80002F6D RecordLayout_3 0 CompuMethod_108 0 65535 /end CHARACTERISTIC
/begin CHARACTERISTIC FaultManager.Fuel_LvlRangeHigh.Action_4 "Fault manager configuration.  Select up to 4 actions for each fault." VALUE 0x80002F6F RecordLayout_3 0 CompuMethod_107 0 65535 /end CHARACTERISTIC
/begin CHARACTERISTIC FaultManager.Fuel_LvlRangeHigh.Action_4_Condition "Fault manager configuration.  Select up to 4 actions for each fault." VALUE 0x80002F71 RecordLayout_3 0 CompuMethod_108 0 65535 /end CHARACTERISTIC
/begin CHARACTERISTIC FaultManager.Fuel_LvlRangeLow.Mode "Fault manager configuration.  Select up to 4 actions for each fault." VALUE 0x80002F73 RecordLayout_3 0 CompuMethod_105 0 65535 /end CHARACTERISTIC
/begin CHARACTERISTIC FaultManager.Fuel_LvlRangeLow.ID "Fault manager configuration.  Select up to 4 actions for each fault." VALUE 0x80002F75 RecordLayout_3 0 CompuMethod_1 0 65535 /end CHARACTERISTIC
/begin CHARACTERISTIC FaultManager.Fuel_LvlRangeLow.Test "Fault manager configuration.  Select up to 4 actions for each fault." VALUE 0x80002F77 RecordLayout_3 0 CompuMethod_106 0 65535 /end CHARACTERISTIC
/begin CHARACTERISTIC FaultManager.Fuel_LvlRangeLow.Faulty_Samples__X_ "Fault manager configuration.  Select up to 4 actions for each fault." VALUE 0x80002F79 RecordLayout_3 0 CompuMethod_1 0 65535 /end CHARACTERISTIC
/begin CHARACTERISTIC FaultManager.Fuel_LvlRangeLow.Total_Samples__Y_ "Fault manager configuration.  Select up to 4 actions for each fault." VALUE 0x80002F7B RecordLayout_3 0 CompuMethod_1 0 65535 /end CHARACTERISTIC
/begin CHARACTERISTIC FaultManager.Fuel_LvlRangeLow.Action_1 "Fault manager configuration.  Select up to 4 actions for each fault." VALUE 0x80002F7D RecordLayout_3 0 CompuMethod_107 0 65535 /end CHARACTERISTIC
/begin CHARACTERISTIC FaultManager.Fuel_LvlRangeLow.Action_1_Condition "Fault manager configuration.  Select up to 4 actions for each fault." VALUE 0x80002F7F RecordLayout_3 0 CompuMethod_108 0 65535 /end CHARACTERISTIC
/begin CHARACTERISTIC FaultManager.Fuel_LvlRangeLow.Action_2 "Fault manager configuration.  Select up to 4 actions for each fault." VALUE 0x80002F81 RecordLayout_3 0 CompuMethod_107 0 65535 /end CHARACTERISTIC
/begin CHARACTERISTIC FaultManager.Fuel_LvlRangeLow.Action_2_Condition "Fault manager configuration.  Select up to 4 actions for each fault." VALUE 0x80002F83 RecordLayout_3 0 CompuMethod_108 0 65535 /end CHARACTERISTIC
/begin CHARACTERISTIC FaultManager.Fuel_LvlRangeLow.Action_3 "Fault manager configuration.  Select up to 4 actions for each fault." VALUE 0x80002F85 RecordLayout_3 0 CompuMethod_107 0 65535 /end CHARACTERISTIC
/begin CHARACTERISTIC FaultManager.Fuel_LvlRangeLow.Action_3_Condition "Fault manager configuration.  Select up to 4 actions for each fault." VALUE 0x80002F87 RecordLayout_3 0 CompuMethod_108 0 65535 /end CHARACTERISTIC
/begin CHARACTERISTIC FaultManager.Fuel_LvlRangeLow.Action_4 "Fault manager configuration.  Select up to 4 actions for each fault." VALUE 0x80002F89 RecordLayout_3 0 CompuMethod_107 0 65535 /end CHARACTERISTIC
/begin CHARACTERISTIC FaultManager.Fuel_LvlRangeLow.Action_4_Condition "Fault manager configuration.  Select up to 4 actions for each fault." VALUE 0x80002F8B RecordLayout_3 0 CompuMethod_108 0 65535 /end CHARACTERISTIC
/begin CHARACTERISTIC FaultManager.GPS_DateTime_Timeout.Mode "Fault manager configuration.  Select up to 4 actions for each fault." VALUE 0x80002F8D RecordLayout_3 0 CompuMethod_105 0 65535 /end CHARACTERISTIC
/begin CHARACTERISTIC FaultManager.GPS_DateTime_Timeout.ID "Fault manager configuration.  Select up to 4 actions for each fault." VALUE 0x80002F8F RecordLayout_3 0 CompuMethod_1 0 65535 /end CHARACTERISTIC
/begin CHARACTERISTIC FaultManager.GPS_DateTime_Timeout.Test "Fault manager configuration.  Select up to 4 actions for each fault." VALUE 0x80002F91 RecordLayout_3 0 CompuMethod_106 0 65535 /end CHARACTERISTIC
/begin CHARACTERISTIC FaultManager.GPS_DateTime_Timeout.Faulty_Samples__X_ "Fault manager configuration.  Select up to 4 actions for each fault." VALUE 0x80002F93 RecordLayout_3 0 CompuMethod_1 0 65535 /end CHARACTERISTIC
/begin CHARACTERISTIC FaultManager.GPS_DateTime_Timeout.Total_Samples__Y_ "Fault manager configuration.  Select up to 4 actions for each fault." VALUE 0x80002F95 RecordLayout_3 0 CompuMethod_1 0 65535 /end CHARACTERISTIC
/begin CHARACTERISTIC FaultManager.GPS_DateTime_Timeout.Action_1 "Fault manager configuration.  Select up to 4 actions for each fault." VALUE 0x80002F97 RecordLayout_3 0 CompuMethod_107 0 65535 /end CHARACTERISTIC
/begin CHARACTERISTIC FaultManager.GPS_DateTime_Timeout.Action_1_Condition "Fault manager configuration.  Select up to 4 actions for each fault." VALUE 0x80002F99 RecordLayout_3 0 CompuMethod_108 0 65535 /end CHARACTERISTIC
/begin CHARACTERISTIC FaultManager.GPS_DateTime_Timeout.Action_2 "Fault manager configuration.  Select up to 4 actions for each fault." VALUE 0x80002F9B RecordLayout_3 0 CompuMethod_107 0 65535 /end CHARACTERISTIC
/begin CHARACTERISTIC FaultManager.GPS_DateTime_Timeout.Action_2_Condition "Fault manager configuration.  Select up to 4 actions for each fault." VALUE 0x80002F9D RecordLayout_3 0 CompuMethod_108 0 65535 /end CHARACTERISTIC
/begin CHARACTERISTIC FaultManager.GPS_DateTime_Timeout.Action_3 "Fault manager configuration.  Select up to 4 actions for each fault." VALUE 0x80002F9F RecordLayout_3 0 CompuMethod_107 0 65535 /end CHARACTERISTIC
/begin CHARACTERISTIC FaultManager.GPS_DateTime_Timeout.Action_3_Condition "Fault manager configuration.  Select up to 4 actions for each fault." VALUE 0x80002FA1 RecordLayout_3 0 CompuMethod_108 0 65535 /end CHARACTERISTIC
/begin CHARACTERISTIC FaultManager.GPS_DateTime_Timeout.Action_4 "Fault manager configuration.  Select up to 4 actions for each fault." VALUE 0x80002FA3 RecordLayout_3 0 CompuMethod_107 0 65535 /end CHARACTERISTIC
/begin CHARACTERISTIC FaultManager.GPS_DateTime_Timeout.Action_4_Condition "Fault manager configuration.  Select up to 4 actions for each fault." VALUE 0x80002FA5 RecordLayout_3 0 CompuMethod_108 0 65535 /end CHARACTERISTIC
/begin CHARACTERISTIC FaultManager.GPS_LatLong_Timeout.Mode "Fault manager configuration.  Select up to 4 actions for each fault." VALUE 0x80002FA7 RecordLayout_3 0 CompuMethod_105 0 65535 /end CHARACTERISTIC
/begin CHARACTERISTIC FaultManager.GPS_LatLong_Timeout.ID "Fault manager configuration.  Select up to 4 actions for each fault." VALUE 0x80002FA9 RecordLayout_3 0 CompuMethod_1 0 65535 /end CHARACTERISTIC
/begin CHARACTERISTIC FaultManager.GPS_LatLong_Timeout.Test "Fault manager configuration.  Select up to 4 actions for each fault." VALUE 0x80002FAB RecordLayout_3 0 CompuMethod_106 0 65535 /end CHARACTERISTIC
/begin CHARACTERISTIC FaultManager.GPS_LatLong_Timeout.Faulty_Samples__X_ "Fault manager configuration.  Select up to 4 actions for each fault." VALUE 0x80002FAD RecordLayout_3 0 CompuMethod_1 0 65535 /end CHARACTERISTIC
/begin CHARACTERISTIC FaultManager.GPS_LatLong_Timeout.Total_Samples__Y_ "Fault manager configuration.  Select up to 4 actions for each fault." VALUE 0x80002FAF RecordLayout_3 0 CompuMethod_1 0 65535 /end CHARACTERISTIC
/begin CHARACTERISTIC FaultManager.GPS_LatLong_Timeout.Action_1 "Fault manager configuration.  Select up to 4 actions for each fault." VALUE 0x80002FB1 RecordLayout_3 0 CompuMethod_107 0 65535 /end CHARACTERISTIC
/begin CHARACTERISTIC FaultManager.GPS_LatLong_Timeout.Action_1_Condition "Fault manager configuration.  Select up to 4 actions for each fault." VALUE 0x80002FB3 RecordLayout_3 0 CompuMethod_108 0 65535 /end CHARACTERISTIC
/begin CHARACTERISTIC FaultManager.GPS_LatLong_Timeout.Action_2 "Fault manager configuration.  Select up to 4 actions for each fault." VALUE 0x80002FB5 RecordLayout_3 0 CompuMethod_107 0 65535 /end CHARACTERISTIC
/begin CHARACTERISTIC FaultManager.GPS_LatLong_Timeout.Action_2_Condition "Fault manager configuration.  Select up to 4 actions for each fault." VALUE 0x80002FB7 RecordLayout_3 0 CompuMethod_108 0 65535 /end CHARACTERISTIC
/begin CHARACTERISTIC FaultManager.GPS_LatLong_Timeout.Action_3 "Fault manager configuration.  Select up to 4 actions for each fault." VALUE 0x80002FB9 RecordLayout_3 0 CompuMethod_107 0 65535 /end CHARACTERISTIC
/begin CHARACTERISTIC FaultManager.GPS_LatLong_Timeout.Action_3_Condition "Fault manager configuration.  Select up to 4 actions for each fault." VALUE 0x80002FBB RecordLayout_3 0 CompuMethod_108 0 65535 /end CHARACTERISTIC
/begin CHARACTERISTIC FaultManager.GPS_LatLong_Timeout.Action_4 "Fault manager configuration.  Select up to 4 actions for each fault." VALUE 0x80002FBD RecordLayout_3 0 CompuMethod_107 0 65535 /end CHARACTERISTIC
/begin CHARACTERISTIC FaultManager.GPS_LatLong_Timeout.Action_4_Condition "Fault manager configuration.  Select up to 4 actions for each fault." VALUE 0x80002FBF RecordLayout_3 0 CompuMethod_108 0 65535 /end CHARACTERISTIC
/begin CHARACTERISTIC FaultManager.GPS_SpeedDir_Timeout.Mode "Fault manager configuration.  Select up to 4 actions for each fault." VALUE 0x80002FC1 RecordLayout_3 0 CompuMethod_105 0 65535 /end CHARACTERISTIC
/begin CHARACTERISTIC FaultManager.GPS_SpeedDir_Timeout.ID "Fault manager configuration.  Select up to 4 actions for each fault." VALUE 0x80002FC3 RecordLayout_3 0 CompuMethod_1 0 65535 /end CHARACTERISTIC
/begin CHARACTERISTIC FaultManager.GPS_SpeedDir_Timeout.Test "Fault manager configuration.  Select up to 4 actions for each fault." VALUE 0x80002FC5 RecordLayout_3 0 CompuMethod_106 0 65535 /end CHARACTERISTIC
/begin CHARACTERISTIC FaultManager.GPS_SpeedDir_Timeout.Faulty_Samples__X_ "Fault manager configuration.  Select up to 4 actions for each fault." VALUE 0x80002FC7 RecordLayout_3 0 CompuMethod_1 0 65535 /end CHARACTERISTIC
/begin CHARACTERISTIC FaultManager.GPS_SpeedDir_Timeout.Total_Samples__Y_ "Fault manager configuration.  Select up to 4 actions for each fault." VALUE 0x80002FC9 RecordLayout_3 0 CompuMethod_1 0 65535 /end CHARACTERISTIC
/begin CHARACTERISTIC FaultManager.GPS_SpeedDir_Timeout.Action_1 "Fault manager configuration.  Select up to 4 actions for each fault." VALUE 0x80002FCB RecordLayout_3 0 CompuMethod_107 0 65535 /end CHARACTERISTIC
/begin CHARACTERISTIC FaultManager.GPS_SpeedDir_Timeout.Action_1_Condition "Fault manager configuration.  Select up to 4 actions for each fault." VALUE 0x80002FCD RecordLayout_3 0 CompuMethod_108 0 65535 /end CHARACTERISTIC
/begin CHARACTERISTIC FaultManager.GPS_SpeedDir_Timeout.Action_2 "Fault manager configuration.  Select up to 4 actions for each fault." VALUE 0x80002FCF RecordLayout_3 0 CompuMethod_107 0 65535 /end CHARACTERISTIC
/begin CHARACTERISTIC FaultManager.GPS_SpeedDir_Timeout.Action_2_Condition "Fault manager configuration.  Select up to 4 actions for each fault." VALUE 0x80002FD1 RecordLayout_3 0 CompuMethod_108 0 65535 /end CHARACTERISTIC
/begin CHARACTERISTIC FaultManager.GPS_SpeedDir_Timeout.Action_3 "Fault manager configuration.  Select up to 4 actions for each fault." VALUE 0x80002FD3 RecordLayout_3 0 CompuMethod_107 0 65535 /end CHARACTERISTIC
/begin CHARACTERISTIC FaultManager.GPS_SpeedDir_Timeout.Action_3_Condition "Fault manager configuration.  Select up to 4 actions for each fault." VALUE 0x80002FD5 RecordLayout_3 0 CompuMethod_108 0 65535 /end CHARACTERISTIC
/begin CHARACTERISTIC FaultManager.GPS_SpeedDir_Timeout.Action_4 "Fault manager configuration.  Select up to 4 actions for each fault." VALUE 0x80002FD7 RecordLayout_3 0 CompuMethod_107 0 65535 /end CHARACTERISTIC
/begin CHARACTERISTIC FaultManager.GPS_SpeedDir_Timeout.Action_4_Condition "Fault manager configuration.  Select up to 4 actions for each fault." VALUE 0x80002FD9 RecordLayout_3 0 CompuMethod_108 0 65535 /end CHARACTERISTIC
/begin CHARACTERISTIC FaultManager.HardOverBoost_Fault.Mode "Fault manager configuration.  Select up to 4 actions for each fault." VALUE 0x80002FDB RecordLayout_3 0 CompuMethod_105 0 65535 /end CHARACTERISTIC
/begin CHARACTERISTIC FaultManager.HardOverBoost_Fault.ID "Fault manager configuration.  Select up to 4 actions for each fault." VALUE 0x80002FDD RecordLayout_3 0 CompuMethod_1 0 65535 /end CHARACTERISTIC
/begin CHARACTERISTIC FaultManager.HardOverBoost_Fault.Test "Fault manager configuration.  Select up to 4 actions for each fault." VALUE 0x80002FDF RecordLayout_3 0 CompuMethod_106 0 65535 /end CHARACTERISTIC
/begin CHARACTERISTIC FaultManager.HardOverBoost_Fault.Faulty_Samples__X_ "Fault manager configuration.  Select up to 4 actions for each fault." VALUE 0x80002FE1 RecordLayout_3 0 CompuMethod_1 0 65535 /end CHARACTERISTIC
/begin CHARACTERISTIC FaultManager.HardOverBoost_Fault.Total_Samples__Y_ "Fault manager configuration.  Select up to 4 actions for each fault." VALUE 0x80002FE3 RecordLayout_3 0 CompuMethod_1 0 65535 /end CHARACTERISTIC
/begin CHARACTERISTIC FaultManager.HardOverBoost_Fault.Action_1 "Fault manager configuration.  Select up to 4 actions for each fault." VALUE 0x80002FE5 RecordLayout_3 0 CompuMethod_107 0 65535 /end CHARACTERISTIC
/begin CHARACTERISTIC FaultManager.HardOverBoost_Fault.Action_1_Condition "Fault manager configuration.  Select up to 4 actions for each fault." VALUE 0x80002FE7 RecordLayout_3 0 CompuMethod_108 0 65535 /end CHARACTERISTIC
/begin CHARACTERISTIC FaultManager.HardOverBoost_Fault.Action_2 "Fault manager configuration.  Select up to 4 actions for each fault." VALUE 0x80002FE9 RecordLayout_3 0 CompuMethod_107 0 65535 /end CHARACTERISTIC
/begin CHARACTERISTIC FaultManager.HardOverBoost_Fault.Action_2_Condition "Fault manager configuration.  Select up to 4 actions for each fault." VALUE 0x80002FEB RecordLayout_3 0 CompuMethod_108 0 65535 /end CHARACTERISTIC
/begin CHARACTERISTIC FaultManager.HardOverBoost_Fault.Action_3 "Fault manager configuration.  Select up to 4 actions for each fault." VALUE 0x80002FED RecordLayout_3 0 CompuMethod_107 0 65535 /end CHARACTERISTIC
/begin CHARACTERISTIC FaultManager.HardOverBoost_Fault.Action_3_Condition "Fault manager configuration.  Select up to 4 actions for each fault." VALUE 0x80002FEF RecordLayout_3 0 CompuMethod_108 0 65535 /end CHARACTERISTIC
/begin CHARACTERISTIC FaultManager.HardOverBoost_Fault.Action_4 "Fault manager configuration.  Select up to 4 actions for each fault." VALUE 0x80002FF1 RecordLayout_3 0 CompuMethod_107 0 65535 /end CHARACTERISTIC
/begin CHARACTERISTIC FaultManager.HardOverBoost_Fault.Action_4_Condition "Fault manager configuration.  Select up to 4 actions for each fault." VALUE 0x80002FF3 RecordLayout_3 0 CompuMethod_108 0 65535 /end CHARACTERISTIC
/begin CHARACTERISTIC FaultManager.HardOverspeed.Mode "Fault manager configuration.  Select up to 4 actions for each fault." VALUE 0x80002FF5 RecordLayout_3 0 CompuMethod_105 0 65535 /end CHARACTERISTIC
/begin CHARACTERISTIC FaultManager.HardOverspeed.ID "Fault manager configuration.  Select up to 4 actions for each fault." VALUE 0x80002FF7 RecordLayout_3 0 CompuMethod_1 0 65535 /end CHARACTERISTIC
/begin CHARACTERISTIC FaultManager.HardOverspeed.Test "Fault manager configuration.  Select up to 4 actions for each fault." VALUE 0x80002FF9 RecordLayout_3 0 CompuMethod_106 0 65535 /end CHARACTERISTIC
/begin CHARACTERISTIC FaultManager.HardOverspeed.Faulty_Samples__X_ "Fault manager configuration.  Select up to 4 actions for each fault." VALUE 0x80002FFB RecordLayout_3 0 CompuMethod_1 0 65535 /end CHARACTERISTIC
/begin CHARACTERISTIC FaultManager.HardOverspeed.Total_Samples__Y_ "Fault manager configuration.  Select up to 4 actions for each fault." VALUE 0x80002FFD RecordLayout_3 0 CompuMethod_1 0 65535 /end CHARACTERISTIC
/begin CHARACTERISTIC FaultManager.HardOverspeed.Action_1 "Fault manager configuration.  Select up to 4 actions for each fault." VALUE 0x80002FFF RecordLayout_3 0 CompuMethod_107 0 65535 /end CHARACTERISTIC
/begin CHARACTERISTIC FaultManager.HardOverspeed.Action_1_Condition "Fault manager configuration.  Select up to 4 actions for each fault." VALUE 0x80003001 RecordLayout_3 0 CompuMethod_108 0 65535 /end CHARACTERISTIC
/begin CHARACTERISTIC FaultManager.HardOverspeed.Action_2 "Fault manager configuration.  Select up to 4 actions for each fault." VALUE 0x80003003 RecordLayout_3 0 CompuMethod_107 0 65535 /end CHARACTERISTIC
/begin CHARACTERISTIC FaultManager.HardOverspeed.Action_2_Condition "Fault manager configuration.  Select up to 4 actions for each fault." VALUE 0x80003005 RecordLayout_3 0 CompuMethod_108 0 65535 /end CHARACTERISTIC
/begin CHARACTERISTIC FaultManager.HardOverspeed.Action_3 "Fault manager configuration.  Select up to 4 actions for each fault." VALUE 0x80003007 RecordLayout_3 0 CompuMethod_107 0 65535 /end CHARACTERISTIC
/begin CHARACTERISTIC FaultManager.HardOverspeed.Action_3_Condition "Fault manager configuration.  Select up to 4 actions for each fault." VALUE 0x80003009 RecordLayout_3 0 CompuMethod_108 0 65535 /end CHARACTERISTIC
/begin CHARACTERISTIC FaultManager.HardOverspeed.Action_4 "Fault manager configuration.  Select up to 4 actions for each fault." VALUE 0x8000300B RecordLayout_3 0 CompuMethod_107 0 65535 /end CHARACTERISTIC
/begin CHARACTERISTIC FaultManager.HardOverspeed.Action_4_Condition "Fault manager configuration.  Select up to 4 actions for each fault." VALUE 0x8000300D RecordLayout_3 0 CompuMethod_108 0 65535 /end CHARACTERISTIC
/begin CHARACTERISTIC FaultManager.IATRangeHigh.Mode "Fault manager configuration.  Select up to 4 actions for each fault." VALUE 0x8000300F RecordLayout_3 0 CompuMethod_105 0 65535 /end CHARACTERISTIC
/begin CHARACTERISTIC FaultManager.IATRangeHigh.ID "Fault manager configuration.  Select up to 4 actions for each fault." VALUE 0x80003011 RecordLayout_3 0 CompuMethod_1 0 65535 /end CHARACTERISTIC
/begin CHARACTERISTIC FaultManager.IATRangeHigh.Test "Fault manager configuration.  Select up to 4 actions for each fault." VALUE 0x80003013 RecordLayout_3 0 CompuMethod_106 0 65535 /end CHARACTERISTIC
/begin CHARACTERISTIC FaultManager.IATRangeHigh.Faulty_Samples__X_ "Fault manager configuration.  Select up to 4 actions for each fault." VALUE 0x80003015 RecordLayout_3 0 CompuMethod_1 0 65535 /end CHARACTERISTIC
/begin CHARACTERISTIC FaultManager.IATRangeHigh.Total_Samples__Y_ "Fault manager configuration.  Select up to 4 actions for each fault." VALUE 0x80003017 RecordLayout_3 0 CompuMethod_1 0 65535 /end CHARACTERISTIC
/begin CHARACTERISTIC FaultManager.IATRangeHigh.Action_1 "Fault manager configuration.  Select up to 4 actions for each fault." VALUE 0x80003019 RecordLayout_3 0 CompuMethod_107 0 65535 /end CHARACTERISTIC
/begin CHARACTERISTIC FaultManager.IATRangeHigh.Action_1_Condition "Fault manager configuration.  Select up to 4 actions for each fault." VALUE 0x8000301B RecordLayout_3 0 CompuMethod_108 0 65535 /end CHARACTERISTIC
/begin CHARACTERISTIC FaultManager.IATRangeHigh.Action_2 "Fault manager configuration.  Select up to 4 actions for each fault." VALUE 0x8000301D RecordLayout_3 0 CompuMethod_107 0 65535 /end CHARACTERISTIC
/begin CHARACTERISTIC FaultManager.IATRangeHigh.Action_2_Condition "Fault manager configuration.  Select up to 4 actions for each fault." VALUE 0x8000301F RecordLayout_3 0 CompuMethod_108 0 65535 /end CHARACTERISTIC
/begin CHARACTERISTIC FaultManager.IATRangeHigh.Action_3 "Fault manager configuration.  Select up to 4 actions for each fault." VALUE 0x80003021 RecordLayout_3 0 CompuMethod_107 0 65535 /end CHARACTERISTIC
/begin CHARACTERISTIC FaultManager.IATRangeHigh.Action_3_Condition "Fault manager configuration.  Select up to 4 actions for each fault." VALUE 0x80003023 RecordLayout_3 0 CompuMethod_108 0 65535 /end CHARACTERISTIC
/begin CHARACTERISTIC FaultManager.IATRangeHigh.Action_4 "Fault manager configuration.  Select up to 4 actions for each fault." VALUE 0x80003025 RecordLayout_3 0 CompuMethod_107 0 65535 /end CHARACTERISTIC
/begin CHARACTERISTIC FaultManager.IATRangeHigh.Action_4_Condition "Fault manager configuration.  Select up to 4 actions for each fault." VALUE 0x80003027 RecordLayout_3 0 CompuMethod_108 0 65535 /end CHARACTERISTIC
/begin CHARACTERISTIC FaultManager.IATRangeLow.Mode "Fault manager configuration.  Select up to 4 actions for each fault." VALUE 0x80003029 RecordLayout_3 0 CompuMethod_105 0 65535 /end CHARACTERISTIC
/begin CHARACTERISTIC FaultManager.IATRangeLow.ID "Fault manager configuration.  Select up to 4 actions for each fault." VALUE 0x8000302B RecordLayout_3 0 CompuMethod_1 0 65535 /end CHARACTERISTIC
/begin CHARACTERISTIC FaultManager.IATRangeLow.Test "Fault manager configuration.  Select up to 4 actions for each fault." VALUE 0x8000302D RecordLayout_3 0 CompuMethod_106 0 65535 /end CHARACTERISTIC
/begin CHARACTERISTIC FaultManager.IATRangeLow.Faulty_Samples__X_ "Fault manager configuration.  Select up to 4 actions for each fault." VALUE 0x8000302F RecordLayout_3 0 CompuMethod_1 0 65535 /end CHARACTERISTIC
/begin CHARACTERISTIC FaultManager.IATRangeLow.Total_Samples__Y_ "Fault manager configuration.  Select up to 4 actions for each fault." VALUE 0x80003031 RecordLayout_3 0 CompuMethod_1 0 65535 /end CHARACTERISTIC
/begin CHARACTERISTIC FaultManager.IATRangeLow.Action_1 "Fault manager configuration.  Select up to 4 actions for each fault." VALUE 0x80003033 RecordLayout_3 0 CompuMethod_107 0 65535 /end CHARACTERISTIC
/begin CHARACTERISTIC FaultManager.IATRangeLow.Action_1_Condition "Fault manager configuration.  Select up to 4 actions for each fault." VALUE 0x80003035 RecordLayout_3 0 CompuMethod_108 0 65535 /end CHARACTERISTIC
/begin CHARACTERISTIC FaultManager.IATRangeLow.Action_2 "Fault manager configuration.  Select up to 4 actions for each fault." VALUE 0x80003037 RecordLayout_3 0 CompuMethod_107 0 65535 /end CHARACTERISTIC
/begin CHARACTERISTIC FaultManager.IATRangeLow.Action_2_Condition "Fault manager configuration.  Select up to 4 actions for each fault." VALUE 0x80003039 RecordLayout_3 0 CompuMethod_108 0 65535 /end CHARACTERISTIC
/begin CHARACTERISTIC FaultManager.IATRangeLow.Action_3 "Fault manager configuration.  Select up to 4 actions for each fault." VALUE 0x8000303B RecordLayout_3 0 CompuMethod_107 0 65535 /end CHARACTERISTIC
/begin CHARACTERISTIC FaultManager.IATRangeLow.Action_3_Condition "Fault manager configuration.  Select up to 4 actions for each fault." VALUE 0x8000303D RecordLayout_3 0 CompuMethod_108 0 65535 /end CHARACTERISTIC
/begin CHARACTERISTIC FaultManager.IATRangeLow.Action_4 "Fault manager configuration.  Select up to 4 actions for each fault." VALUE 0x8000303F RecordLayout_3 0 CompuMethod_107 0 65535 /end CHARACTERISTIC
/begin CHARACTERISTIC FaultManager.IATRangeLow.Action_4_Condition "Fault manager configuration.  Select up to 4 actions for each fault." VALUE 0x80003041 RecordLayout_3 0 CompuMethod_108 0 65535 /end CHARACTERISTIC
/begin CHARACTERISTIC FaultManager.Inj1Open.Mode "Fault manager configuration.  Select up to 4 actions for each fault." VALUE 0x80003043 RecordLayout_3 0 CompuMethod_105 0 65535 /end CHARACTERISTIC
/begin CHARACTERISTIC FaultManager.Inj1Open.ID "Fault manager configuration.  Select up to 4 actions for each fault." VALUE 0x80003045 RecordLayout_3 0 CompuMethod_1 0 65535 /end CHARACTERISTIC
/begin CHARACTERISTIC FaultManager.Inj1Open.Test "Fault manager configuration.  Select up to 4 actions for each fault." VALUE 0x80003047 RecordLayout_3 0 CompuMethod_106 0 65535 /end CHARACTERISTIC
/begin CHARACTERISTIC FaultManager.Inj1Open.Faulty_Samples__X_ "Fault manager configuration.  Select up to 4 actions for each fault." VALUE 0x80003049 RecordLayout_3 0 CompuMethod_1 0 65535 /end CHARACTERISTIC
/begin CHARACTERISTIC FaultManager.Inj1Open.Total_Samples__Y_ "Fault manager configuration.  Select up to 4 actions for each fault." VALUE 0x8000304B RecordLayout_3 0 CompuMethod_1 0 65535 /end CHARACTERISTIC
/begin CHARACTERISTIC FaultManager.Inj1Open.Action_1 "Fault manager configuration.  Select up to 4 actions for each fault." VALUE 0x8000304D RecordLayout_3 0 CompuMethod_107 0 65535 /end CHARACTERISTIC
/begin CHARACTERISTIC FaultManager.Inj1Open.Action_1_Condition "Fault manager configuration.  Select up to 4 actions for each fault." VALUE 0x8000304F RecordLayout_3 0 CompuMethod_108 0 65535 /end CHARACTERISTIC
/begin CHARACTERISTIC FaultManager.Inj1Open.Action_2 "Fault manager configuration.  Select up to 4 actions for each fault." VALUE 0x80003051 RecordLayout_3 0 CompuMethod_107 0 65535 /end CHARACTERISTIC
/begin CHARACTERISTIC FaultManager.Inj1Open.Action_2_Condition "Fault manager configuration.  Select up to 4 actions for each fault." VALUE 0x80003053 RecordLayout_3 0 CompuMethod_108 0 65535 /end CHARACTERISTIC
/begin CHARACTERISTIC FaultManager.Inj1Open.Action_3 "Fault manager configuration.  Select up to 4 actions for each fault." VALUE 0x80003055 RecordLayout_3 0 CompuMethod_107 0 65535 /end CHARACTERISTIC
/begin CHARACTERISTIC FaultManager.Inj1Open.Action_3_Condition "Fault manager configuration.  Select up to 4 actions for each fault." VALUE 0x80003057 RecordLayout_3 0 CompuMethod_108 0 65535 /end CHARACTERISTIC
/begin CHARACTERISTIC FaultManager.Inj1Open.Action_4 "Fault manager configuration.  Select up to 4 actions for each fault." VALUE 0x80003059 RecordLayout_3 0 CompuMethod_107 0 65535 /end CHARACTERISTIC
/begin CHARACTERISTIC FaultManager.Inj1Open.Action_4_Condition "Fault manager configuration.  Select up to 4 actions for each fault." VALUE 0x8000305B RecordLayout_3 0 CompuMethod_108 0 65535 /end CHARACTERISTIC
/begin CHARACTERISTIC FaultManager.Inj2Open.Mode "Fault manager configuration.  Select up to 4 actions for each fault." VALUE 0x8000305D RecordLayout_3 0 CompuMethod_105 0 65535 /end CHARACTERISTIC
/begin CHARACTERISTIC FaultManager.Inj2Open.ID "Fault manager configuration.  Select up to 4 actions for each fault." VALUE 0x8000305F RecordLayout_3 0 CompuMethod_1 0 65535 /end CHARACTERISTIC
/begin CHARACTERISTIC FaultManager.Inj2Open.Test "Fault manager configuration.  Select up to 4 actions for each fault." VALUE 0x80003061 RecordLayout_3 0 CompuMethod_106 0 65535 /end CHARACTERISTIC
/begin CHARACTERISTIC FaultManager.Inj2Open.Faulty_Samples__X_ "Fault manager configuration.  Select up to 4 actions for each fault." VALUE 0x80003063 RecordLayout_3 0 CompuMethod_1 0 65535 /end CHARACTERISTIC
/begin CHARACTERISTIC FaultManager.Inj2Open.Total_Samples__Y_ "Fault manager configuration.  Select up to 4 actions for each fault." VALUE 0x80003065 RecordLayout_3 0 CompuMethod_1 0 65535 /end CHARACTERISTIC
/begin CHARACTERISTIC FaultManager.Inj2Open.Action_1 "Fault manager configuration.  Select up to 4 actions for each fault." VALUE 0x80003067 RecordLayout_3 0 CompuMethod_107 0 65535 /end CHARACTERISTIC
/begin CHARACTERISTIC FaultManager.Inj2Open.Action_1_Condition "Fault manager configuration.  Select up to 4 actions for each fault." VALUE 0x80003069 RecordLayout_3 0 CompuMethod_108 0 65535 /end CHARACTERISTIC
/begin CHARACTERISTIC FaultManager.Inj2Open.Action_2 "Fault manager configuration.  Select up to 4 actions for each fault." VALUE 0x8000306B RecordLayout_3 0 CompuMethod_107 0 65535 /end CHARACTERISTIC
/begin CHARACTERISTIC FaultManager.Inj2Open.Action_2_Condition "Fault manager configuration.  Select up to 4 actions for each fault." VALUE 0x8000306D RecordLayout_3 0 CompuMethod_108 0 65535 /end CHARACTERISTIC
/begin CHARACTERISTIC FaultManager.Inj2Open.Action_3 "Fault manager configuration.  Select up to 4 actions for each fault." VALUE 0x8000306F RecordLayout_3 0 CompuMethod_107 0 65535 /end CHARACTERISTIC
/begin CHARACTERISTIC FaultManager.Inj2Open.Action_3_Condition "Fault manager configuration.  Select up to 4 actions for each fault." VALUE 0x80003071 RecordLayout_3 0 CompuMethod_108 0 65535 /end CHARACTERISTIC
/begin CHARACTERISTIC FaultManager.Inj2Open.Action_4 "Fault manager configuration.  Select up to 4 actions for each fault." VALUE 0x80003073 RecordLayout_3 0 CompuMethod_107 0 65535 /end CHARACTERISTIC
/begin CHARACTERISTIC FaultManager.Inj2Open.Action_4_Condition "Fault manager configuration.  Select up to 4 actions for each fault." VALUE 0x80003075 RecordLayout_3 0 CompuMethod_108 0 65535 /end CHARACTERISTIC
/begin CHARACTERISTIC FaultManager.Inj3Open.Mode "Fault manager configuration.  Select up to 4 actions for each fault." VALUE 0x80003077 RecordLayout_3 0 CompuMethod_105 0 65535 /end CHARACTERISTIC
/begin CHARACTERISTIC FaultManager.Inj3Open.ID "Fault manager configuration.  Select up to 4 actions for each fault." VALUE 0x80003079 RecordLayout_3 0 CompuMethod_1 0 65535 /end CHARACTERISTIC
/begin CHARACTERISTIC FaultManager.Inj3Open.Test "Fault manager configuration.  Select up to 4 actions for each fault." VALUE 0x8000307B RecordLayout_3 0 CompuMethod_106 0 65535 /end CHARACTERISTIC
/begin CHARACTERISTIC FaultManager.Inj3Open.Faulty_Samples__X_ "Fault manager configuration.  Select up to 4 actions for each fault." VALUE 0x8000307D RecordLayout_3 0 CompuMethod_1 0 65535 /end CHARACTERISTIC
/begin CHARACTERISTIC FaultManager.Inj3Open.Total_Samples__Y_ "Fault manager configuration.  Select up to 4 actions for each fault." VALUE 0x8000307F RecordLayout_3 0 CompuMethod_1 0 65535 /end CHARACTERISTIC
/begin CHARACTERISTIC FaultManager.Inj3Open.Action_1 "Fault manager configuration.  Select up to 4 actions for each fault." VALUE 0x80003081 RecordLayout_3 0 CompuMethod_107 0 65535 /end CHARACTERISTIC
/begin CHARACTERISTIC FaultManager.Inj3Open.Action_1_Condition "Fault manager configuration.  Select up to 4 actions for each fault." VALUE 0x80003083 RecordLayout_3 0 CompuMethod_108 0 65535 /end CHARACTERISTIC
/begin CHARACTERISTIC FaultManager.Inj3Open.Action_2 "Fault manager configuration.  Select up to 4 actions for each fault." VALUE 0x80003085 RecordLayout_3 0 CompuMethod_107 0 65535 /end CHARACTERISTIC
/begin CHARACTERISTIC FaultManager.Inj3Open.Action_2_Condition "Fault manager configuration.  Select up to 4 actions for each fault." VALUE 0x80003087 RecordLayout_3 0 CompuMethod_108 0 65535 /end CHARACTERISTIC
/begin CHARACTERISTIC FaultManager.Inj3Open.Action_3 "Fault manager configuration.  Select up to 4 actions for each fault." VALUE 0x80003089 RecordLayout_3 0 CompuMethod_107 0 65535 /end CHARACTERISTIC
/begin CHARACTERISTIC FaultManager.Inj3Open.Action_3_Condition "Fault manager configuration.  Select up to 4 actions for each fault." VALUE 0x8000308B RecordLayout_3 0 CompuMethod_108 0 65535 /end CHARACTERISTIC
/begin CHARACTERISTIC FaultManager.Inj3Open.Action_4 "Fault manager configuration.  Select up to 4 actions for each fault." VALUE 0x8000308D RecordLayout_3 0 CompuMethod_107 0 65535 /end CHARACTERISTIC
/begin CHARACTERISTIC FaultManager.Inj3Open.Action_4_Condition "Fault manager configuration.  Select up to 4 actions for each fault." VALUE 0x8000308F RecordLayout_3 0 CompuMethod_108 0 65535 /end CHARACTERISTIC
/begin CHARACTERISTIC FaultManager.Inj4Open.Mode "Fault manager configuration.  Select up to 4 actions for each fault." VALUE 0x80003091 RecordLayout_3 0 CompuMethod_105 0 65535 /end CHARACTERISTIC
/begin CHARACTERISTIC FaultManager.Inj4Open.ID "Fault manager configuration.  Select up to 4 actions for each fault." VALUE 0x80003093 RecordLayout_3 0 CompuMethod_1 0 65535 /end CHARACTERISTIC
/begin CHARACTERISTIC FaultManager.Inj4Open.Test "Fault manager configuration.  Select up to 4 actions for each fault." VALUE 0x80003095 RecordLayout_3 0 CompuMethod_106 0 65535 /end CHARACTERISTIC
/begin CHARACTERISTIC FaultManager.Inj4Open.Faulty_Samples__X_ "Fault manager configuration.  Select up to 4 actions for each fault." VALUE 0x80003097 RecordLayout_3 0 CompuMethod_1 0 65535 /end CHARACTERISTIC
/begin CHARACTERISTIC FaultManager.Inj4Open.Total_Samples__Y_ "Fault manager configuration.  Select up to 4 actions for each fault." VALUE 0x80003099 RecordLayout_3 0 CompuMethod_1 0 65535 /end CHARACTERISTIC
/begin CHARACTERISTIC FaultManager.Inj4Open.Action_1 "Fault manager configuration.  Select up to 4 actions for each fault." VALUE 0x8000309B RecordLayout_3 0 CompuMethod_107 0 65535 /end CHARACTERISTIC
/begin CHARACTERISTIC FaultManager.Inj4Open.Action_1_Condition "Fault manager configuration.  Select up to 4 actions for each fault." VALUE 0x8000309D RecordLayout_3 0 CompuMethod_108 0 65535 /end CHARACTERISTIC
/begin CHARACTERISTIC FaultManager.Inj4Open.Action_2 "Fault manager configuration.  Select up to 4 actions for each fault." VALUE 0x8000309F RecordLayout_3 0 CompuMethod_107 0 65535 /end CHARACTERISTIC
/begin CHARACTERISTIC FaultManager.Inj4Open.Action_2_Condition "Fault manager configuration.  Select up to 4 actions for each fault." VALUE 0x800030A1 RecordLayout_3 0 CompuMethod_108 0 65535 /end CHARACTERISTIC
/begin CHARACTERISTIC FaultManager.Inj4Open.Action_3 "Fault manager configuration.  Select up to 4 actions for each fault." VALUE 0x800030A3 RecordLayout_3 0 CompuMethod_107 0 65535 /end CHARACTERISTIC
/begin CHARACTERISTIC FaultManager.Inj4Open.Action_3_Condition "Fault manager configuration.  Select up to 4 actions for each fault." VALUE 0x800030A5 RecordLayout_3 0 CompuMethod_108 0 65535 /end CHARACTERISTIC
/begin CHARACTERISTIC FaultManager.Inj4Open.Action_4 "Fault manager configuration.  Select up to 4 actions for each fault." VALUE 0x800030A7 RecordLayout_3 0 CompuMethod_107 0 65535 /end CHARACTERISTIC
/begin CHARACTERISTIC FaultManager.Inj4Open.Action_4_Condition "Fault manager configuration.  Select up to 4 actions for each fault." VALUE 0x800030A9 RecordLayout_3 0 CompuMethod_108 0 65535 /end CHARACTERISTIC
/begin CHARACTERISTIC FaultManager.Inj5Open.Mode "Fault manager configuration.  Select up to 4 actions for each fault." VALUE 0x800030AB RecordLayout_3 0 CompuMethod_105 0 65535 /end CHARACTERISTIC
/begin CHARACTERISTIC FaultManager.Inj5Open.ID "Fault manager configuration.  Select up to 4 actions for each fault." VALUE 0x800030AD RecordLayout_3 0 CompuMethod_1 0 65535 /end CHARACTERISTIC
/begin CHARACTERISTIC FaultManager.Inj5Open.Test "Fault manager configuration.  Select up to 4 actions for each fault." VALUE 0x800030AF RecordLayout_3 0 CompuMethod_106 0 65535 /end CHARACTERISTIC
/begin CHARACTERISTIC FaultManager.Inj5Open.Faulty_Samples__X_ "Fault manager configuration.  Select up to 4 actions for each fault." VALUE 0x800030B1 RecordLayout_3 0 CompuMethod_1 0 65535 /end CHARACTERISTIC
/begin CHARACTERISTIC FaultManager.Inj5Open.Total_Samples__Y_ "Fault manager configuration.  Select up to 4 actions for each fault." VALUE 0x800030B3 RecordLayout_3 0 CompuMethod_1 0 65535 /end CHARACTERISTIC
/begin CHARACTERISTIC FaultManager.Inj5Open.Action_1 "Fault manager configuration.  Select up to 4 actions for each fault." VALUE 0x800030B5 RecordLayout_3 0 CompuMethod_107 0 65535 /end CHARACTERISTIC
/begin CHARACTERISTIC FaultManager.Inj5Open.Action_1_Condition "Fault manager configuration.  Select up to 4 actions for each fault." VALUE 0x800030B7 RecordLayout_3 0 CompuMethod_108 0 65535 /end CHARACTERISTIC
/begin CHARACTERISTIC FaultManager.Inj5Open.Action_2 "Fault manager configuration.  Select up to 4 actions for each fault." VALUE 0x800030B9 RecordLayout_3 0 CompuMethod_107 0 65535 /end CHARACTERISTIC
/begin CHARACTERISTIC FaultManager.Inj5Open.Action_2_Condition "Fault manager configuration.  Select up to 4 actions for each fault." VALUE 0x800030BB RecordLayout_3 0 CompuMethod_108 0 65535 /end CHARACTERISTIC
/begin CHARACTERISTIC FaultManager.Inj5Open.Action_3 "Fault manager configuration.  Select up to 4 actions for each fault." VALUE 0x800030BD RecordLayout_3 0 CompuMethod_107 0 65535 /end CHARACTERISTIC
/begin CHARACTERISTIC FaultManager.Inj5Open.Action_3_Condition "Fault manager configuration.  Select up to 4 actions for each fault." VALUE 0x800030BF RecordLayout_3 0 CompuMethod_108 0 65535 /end CHARACTERISTIC
/begin CHARACTERISTIC FaultManager.Inj5Open.Action_4 "Fault manager configuration.  Select up to 4 actions for each fault." VALUE 0x800030C1 RecordLayout_3 0 CompuMethod_107 0 65535 /end CHARACTERISTIC
/begin CHARACTERISTIC FaultManager.Inj5Open.Action_4_Condition "Fault manager configuration.  Select up to 4 actions for each fault." VALUE 0x800030C3 RecordLayout_3 0 CompuMethod_108 0 65535 /end CHARACTERISTIC
/begin CHARACTERISTIC FaultManager.Inj6Open.Mode "Fault manager configuration.  Select up to 4 actions for each fault." VALUE 0x800030C5 RecordLayout_3 0 CompuMethod_105 0 65535 /end CHARACTERISTIC
/begin CHARACTERISTIC FaultManager.Inj6Open.ID "Fault manager configuration.  Select up to 4 actions for each fault." VALUE 0x800030C7 RecordLayout_3 0 CompuMethod_1 0 65535 /end CHARACTERISTIC
/begin CHARACTERISTIC FaultManager.Inj6Open.Test "Fault manager configuration.  Select up to 4 actions for each fault." VALUE 0x800030C9 RecordLayout_3 0 CompuMethod_106 0 65535 /end CHARACTERISTIC
/begin CHARACTERISTIC FaultManager.Inj6Open.Faulty_Samples__X_ "Fault manager configuration.  Select up to 4 actions for each fault." VALUE 0x800030CB RecordLayout_3 0 CompuMethod_1 0 65535 /end CHARACTERISTIC
/begin CHARACTERISTIC FaultManager.Inj6Open.Total_Samples__Y_ "Fault manager configuration.  Select up to 4 actions for each fault." VALUE 0x800030CD RecordLayout_3 0 CompuMethod_1 0 65535 /end CHARACTERISTIC
/begin CHARACTERISTIC FaultManager.Inj6Open.Action_1 "Fault manager configuration.  Select up to 4 actions for each fault." VALUE 0x800030CF RecordLayout_3 0 CompuMethod_107 0 65535 /end CHARACTERISTIC
/begin CHARACTERISTIC FaultManager.Inj6Open.Action_1_Condition "Fault manager configuration.  Select up to 4 actions for each fault." VALUE 0x800030D1 RecordLayout_3 0 CompuMethod_108 0 65535 /end CHARACTERISTIC
/begin CHARACTERISTIC FaultManager.Inj6Open.Action_2 "Fault manager configuration.  Select up to 4 actions for each fault." VALUE 0x800030D3 RecordLayout_3 0 CompuMethod_107 0 65535 /end CHARACTERISTIC
/begin CHARACTERISTIC FaultManager.Inj6Open.Action_2_Condition "Fault manager configuration.  Select up to 4 actions for each fault." VALUE 0x800030D5 RecordLayout_3 0 CompuMethod_108 0 65535 /end CHARACTERISTIC
/begin CHARACTERISTIC FaultManager.Inj6Open.Action_3 "Fault manager configuration.  Select up to 4 actions for each fault." VALUE 0x800030D7 RecordLayout_3 0 CompuMethod_107 0 65535 /end CHARACTERISTIC
/begin CHARACTERISTIC FaultManager.Inj6Open.Action_3_Condition "Fault manager configuration.  Select up to 4 actions for each fault." VALUE 0x800030D9 RecordLayout_3 0 CompuMethod_108 0 65535 /end CHARACTERISTIC
/begin CHARACTERISTIC FaultManager.Inj6Open.Action_4 "Fault manager configuration.  Select up to 4 actions for each fault." VALUE 0x800030DB RecordLayout_3 0 CompuMethod_107 0 65535 /end CHARACTERISTIC
/begin CHARACTERISTIC FaultManager.Inj6Open.Action_4_Condition "Fault manager configuration.  Select up to 4 actions for each fault." VALUE 0x800030DD RecordLayout_3 0 CompuMethod_108 0 65535 /end CHARACTERISTIC
/begin CHARACTERISTIC FaultManager.Inj7Open.Mode "Fault manager configuration.  Select up to 4 actions for each fault." VALUE 0x800030DF RecordLayout_3 0 CompuMethod_105 0 65535 /end CHARACTERISTIC
/begin CHARACTERISTIC FaultManager.Inj7Open.ID "Fault manager configuration.  Select up to 4 actions for each fault." VALUE 0x800030E1 RecordLayout_3 0 CompuMethod_1 0 65535 /end CHARACTERISTIC
/begin CHARACTERISTIC FaultManager.Inj7Open.Test "Fault manager configuration.  Select up to 4 actions for each fault." VALUE 0x800030E3 RecordLayout_3 0 CompuMethod_106 0 65535 /end CHARACTERISTIC
/begin CHARACTERISTIC FaultManager.Inj7Open.Faulty_Samples__X_ "Fault manager configuration.  Select up to 4 actions for each fault." VALUE 0x800030E5 RecordLayout_3 0 CompuMethod_1 0 65535 /end CHARACTERISTIC
/begin CHARACTERISTIC FaultManager.Inj7Open.Total_Samples__Y_ "Fault manager configuration.  Select up to 4 actions for each fault." VALUE 0x800030E7 RecordLayout_3 0 CompuMethod_1 0 65535 /end CHARACTERISTIC
/begin CHARACTERISTIC FaultManager.Inj7Open.Action_1 "Fault manager configuration.  Select up to 4 actions for each fault." VALUE 0x800030E9 RecordLayout_3 0 CompuMethod_107 0 65535 /end CHARACTERISTIC
/begin CHARACTERISTIC FaultManager.Inj7Open.Action_1_Condition "Fault manager configuration.  Select up to 4 actions for each fault." VALUE 0x800030EB RecordLayout_3 0 CompuMethod_108 0 65535 /end CHARACTERISTIC
/begin CHARACTERISTIC FaultManager.Inj7Open.Action_2 "Fault manager configuration.  Select up to 4 actions for each fault." VALUE 0x800030ED RecordLayout_3 0 CompuMethod_107 0 65535 /end CHARACTERISTIC
/begin CHARACTERISTIC FaultManager.Inj7Open.Action_2_Condition "Fault manager configuration.  Select up to 4 actions for each fault." VALUE 0x800030EF RecordLayout_3 0 CompuMethod_108 0 65535 /end CHARACTERISTIC
/begin CHARACTERISTIC FaultManager.Inj7Open.Action_3 "Fault manager configuration.  Select up to 4 actions for each fault." VALUE 0x800030F1 RecordLayout_3 0 CompuMethod_107 0 65535 /end CHARACTERISTIC
/begin CHARACTERISTIC FaultManager.Inj7Open.Action_3_Condition "Fault manager configuration.  Select up to 4 actions for each fault." VALUE 0x800030F3 RecordLayout_3 0 CompuMethod_108 0 65535 /end CHARACTERISTIC
/begin CHARACTERISTIC FaultManager.Inj7Open.Action_4 "Fault manager configuration.  Select up to 4 actions for each fault." VALUE 0x800030F5 RecordLayout_3 0 CompuMethod_107 0 65535 /end CHARACTERISTIC
/begin CHARACTERISTIC FaultManager.Inj7Open.Action_4_Condition "Fault manager configuration.  Select up to 4 actions for each fault." VALUE 0x800030F7 RecordLayout_3 0 CompuMethod_108 0 65535 /end CHARACTERISTIC
/begin CHARACTERISTIC FaultManager.Inj8Open.Mode "Fault manager configuration.  Select up to 4 actions for each fault." VALUE 0x800030F9 RecordLayout_3 0 CompuMethod_105 0 65535 /end CHARACTERISTIC
/begin CHARACTERISTIC FaultManager.Inj8Open.ID "Fault manager configuration.  Select up to 4 actions for each fault." VALUE 0x800030FB RecordLayout_3 0 CompuMethod_1 0 65535 /end CHARACTERISTIC
/begin CHARACTERISTIC FaultManager.Inj8Open.Test "Fault manager configuration.  Select up to 4 actions for each fault." VALUE 0x800030FD RecordLayout_3 0 CompuMethod_106 0 65535 /end CHARACTERISTIC
/begin CHARACTERISTIC FaultManager.Inj8Open.Faulty_Samples__X_ "Fault manager configuration.  Select up to 4 actions for each fault." VALUE 0x800030FF RecordLayout_3 0 CompuMethod_1 0 65535 /end CHARACTERISTIC
/begin CHARACTERISTIC FaultManager.Inj8Open.Total_Samples__Y_ "Fault manager configuration.  Select up to 4 actions for each fault." VALUE 0x80003101 RecordLayout_3 0 CompuMethod_1 0 65535 /end CHARACTERISTIC
/begin CHARACTERISTIC FaultManager.Inj8Open.Action_1 "Fault manager configuration.  Select up to 4 actions for each fault." VALUE 0x80003103 RecordLayout_3 0 CompuMethod_107 0 65535 /end CHARACTERISTIC
/begin CHARACTERISTIC FaultManager.Inj8Open.Action_1_Condition "Fault manager configuration.  Select up to 4 actions for each fault." VALUE 0x80003105 RecordLayout_3 0 CompuMethod_108 0 65535 /end CHARACTERISTIC
/begin CHARACTERISTIC FaultManager.Inj8Open.Action_2 "Fault manager configuration.  Select up to 4 actions for each fault." VALUE 0x80003107 RecordLayout_3 0 CompuMethod_107 0 65535 /end CHARACTERISTIC
/begin CHARACTERISTIC FaultManager.Inj8Open.Action_2_Condition "Fault manager configuration.  Select up to 4 actions for each fault." VALUE 0x80003109 RecordLayout_3 0 CompuMethod_108 0 65535 /end CHARACTERISTIC
/begin CHARACTERISTIC FaultManager.Inj8Open.Action_3 "Fault manager configuration.  Select up to 4 actions for each fault." VALUE 0x8000310B RecordLayout_3 0 CompuMethod_107 0 65535 /end CHARACTERISTIC
/begin CHARACTERISTIC FaultManager.Inj8Open.Action_3_Condition "Fault manager configuration.  Select up to 4 actions for each fault." VALUE 0x8000310D RecordLayout_3 0 CompuMethod_108 0 65535 /end CHARACTERISTIC
/begin CHARACTERISTIC FaultManager.Inj8Open.Action_4 "Fault manager configuration.  Select up to 4 actions for each fault." VALUE 0x8000310F RecordLayout_3 0 CompuMethod_107 0 65535 /end CHARACTERISTIC
/begin CHARACTERISTIC FaultManager.Inj8Open.Action_4_Condition "Fault manager configuration.  Select up to 4 actions for each fault." VALUE 0x80003111 RecordLayout_3 0 CompuMethod_108 0 65535 /end CHARACTERISTIC
/begin CHARACTERISTIC FaultManager.Lambda1Error_Fault.Mode "Fault manager configuration.  Select up to 4 actions for each fault." VALUE 0x80003113 RecordLayout_3 0 CompuMethod_105 0 65535 /end CHARACTERISTIC
/begin CHARACTERISTIC FaultManager.Lambda1Error_Fault.ID "Fault manager configuration.  Select up to 4 actions for each fault." VALUE 0x80003115 RecordLayout_3 0 CompuMethod_1 0 65535 /end CHARACTERISTIC
/begin CHARACTERISTIC FaultManager.Lambda1Error_Fault.Test "Fault manager configuration.  Select up to 4 actions for each fault." VALUE 0x80003117 RecordLayout_3 0 CompuMethod_106 0 65535 /end CHARACTERISTIC
/begin CHARACTERISTIC FaultManager.Lambda1Error_Fault.Faulty_Samples__X_ "Fault manager configuration.  Select up to 4 actions for each fault." VALUE 0x80003119 RecordLayout_3 0 CompuMethod_1 0 65535 /end CHARACTERISTIC
/begin CHARACTERISTIC FaultManager.Lambda1Error_Fault.Total_Samples__Y_ "Fault manager configuration.  Select up to 4 actions for each fault." VALUE 0x8000311B RecordLayout_3 0 CompuMethod_1 0 65535 /end CHARACTERISTIC
/begin CHARACTERISTIC FaultManager.Lambda1Error_Fault.Action_1 "Fault manager configuration.  Select up to 4 actions for each fault." VALUE 0x8000311D RecordLayout_3 0 CompuMethod_107 0 65535 /end CHARACTERISTIC
/begin CHARACTERISTIC FaultManager.Lambda1Error_Fault.Action_1_Condition "Fault manager configuration.  Select up to 4 actions for each fault." VALUE 0x8000311F RecordLayout_3 0 CompuMethod_108 0 65535 /end CHARACTERISTIC
/begin CHARACTERISTIC FaultManager.Lambda1Error_Fault.Action_2 "Fault manager configuration.  Select up to 4 actions for each fault." VALUE 0x80003121 RecordLayout_3 0 CompuMethod_107 0 65535 /end CHARACTERISTIC
/begin CHARACTERISTIC FaultManager.Lambda1Error_Fault.Action_2_Condition "Fault manager configuration.  Select up to 4 actions for each fault." VALUE 0x80003123 RecordLayout_3 0 CompuMethod_108 0 65535 /end CHARACTERISTIC
/begin CHARACTERISTIC FaultManager.Lambda1Error_Fault.Action_3 "Fault manager configuration.  Select up to 4 actions for each fault." VALUE 0x80003125 RecordLayout_3 0 CompuMethod_107 0 65535 /end CHARACTERISTIC
/begin CHARACTERISTIC FaultManager.Lambda1Error_Fault.Action_3_Condition "Fault manager configuration.  Select up to 4 actions for each fault." VALUE 0x80003127 RecordLayout_3 0 CompuMethod_108 0 65535 /end CHARACTERISTIC
/begin CHARACTERISTIC FaultManager.Lambda1Error_Fault.Action_4 "Fault manager configuration.  Select up to 4 actions for each fault." VALUE 0x80003129 RecordLayout_3 0 CompuMethod_107 0 65535 /end CHARACTERISTIC
/begin CHARACTERISTIC FaultManager.Lambda1Error_Fault.Action_4_Condition "Fault manager configuration.  Select up to 4 actions for each fault." VALUE 0x8000312B RecordLayout_3 0 CompuMethod_108 0 65535 /end CHARACTERISTIC
/begin CHARACTERISTIC FaultManager.Lambda1Fault_Fault.Mode "Fault manager configuration.  Select up to 4 actions for each fault." VALUE 0x8000312D RecordLayout_3 0 CompuMethod_105 0 65535 /end CHARACTERISTIC
/begin CHARACTERISTIC FaultManager.Lambda1Fault_Fault.ID "Fault manager configuration.  Select up to 4 actions for each fault." VALUE 0x8000312F RecordLayout_3 0 CompuMethod_1 0 65535 /end CHARACTERISTIC
/begin CHARACTERISTIC FaultManager.Lambda1Fault_Fault.Test "Fault manager configuration.  Select up to 4 actions for each fault." VALUE 0x80003131 RecordLayout_3 0 CompuMethod_106 0 65535 /end CHARACTERISTIC
/begin CHARACTERISTIC FaultManager.Lambda1Fault_Fault.Faulty_Samples__X_ "Fault manager configuration.  Select up to 4 actions for each fault." VALUE 0x80003133 RecordLayout_3 0 CompuMethod_1 0 65535 /end CHARACTERISTIC
/begin CHARACTERISTIC FaultManager.Lambda1Fault_Fault.Total_Samples__Y_ "Fault manager configuration.  Select up to 4 actions for each fault." VALUE 0x80003135 RecordLayout_3 0 CompuMethod_1 0 65535 /end CHARACTERISTIC
/begin CHARACTERISTIC FaultManager.Lambda1Fault_Fault.Action_1 "Fault manager configuration.  Select up to 4 actions for each fault." VALUE 0x80003137 RecordLayout_3 0 CompuMethod_107 0 65535 /end CHARACTERISTIC
/begin CHARACTERISTIC FaultManager.Lambda1Fault_Fault.Action_1_Condition "Fault manager configuration.  Select up to 4 actions for each fault." VALUE 0x80003139 RecordLayout_3 0 CompuMethod_108 0 65535 /end CHARACTERISTIC
/begin CHARACTERISTIC FaultManager.Lambda1Fault_Fault.Action_2 "Fault manager configuration.  Select up to 4 actions for each fault." VALUE 0x8000313B RecordLayout_3 0 CompuMethod_107 0 65535 /end CHARACTERISTIC
/begin CHARACTERISTIC FaultManager.Lambda1Fault_Fault.Action_2_Condition "Fault manager configuration.  Select up to 4 actions for each fault." VALUE 0x8000313D RecordLayout_3 0 CompuMethod_108 0 65535 /end CHARACTERISTIC
/begin CHARACTERISTIC FaultManager.Lambda1Fault_Fault.Action_3 "Fault manager configuration.  Select up to 4 actions for each fault." VALUE 0x8000313F RecordLayout_3 0 CompuMethod_107 0 65535 /end CHARACTERISTIC
/begin CHARACTERISTIC FaultManager.Lambda1Fault_Fault.Action_3_Condition "Fault manager configuration.  Select up to 4 actions for each fault." VALUE 0x80003141 RecordLayout_3 0 CompuMethod_108 0 65535 /end CHARACTERISTIC
/begin CHARACTERISTIC FaultManager.Lambda1Fault_Fault.Action_4 "Fault manager configuration.  Select up to 4 actions for each fault." VALUE 0x80003143 RecordLayout_3 0 CompuMethod_107 0 65535 /end CHARACTERISTIC
/begin CHARACTERISTIC FaultManager.Lambda1Fault_Fault.Action_4_Condition "Fault manager configuration.  Select up to 4 actions for each fault." VALUE 0x80003145 RecordLayout_3 0 CompuMethod_108 0 65535 /end CHARACTERISTIC
/begin CHARACTERISTIC FaultManager.Lambda1HtrOpen_Fault.Mode "Fault manager configuration.  Select up to 4 actions for each fault." VALUE 0x80003147 RecordLayout_3 0 CompuMethod_105 0 65535 /end CHARACTERISTIC
/begin CHARACTERISTIC FaultManager.Lambda1HtrOpen_Fault.ID "Fault manager configuration.  Select up to 4 actions for each fault." VALUE 0x80003149 RecordLayout_3 0 CompuMethod_1 0 65535 /end CHARACTERISTIC
/begin CHARACTERISTIC FaultManager.Lambda1HtrOpen_Fault.Test "Fault manager configuration.  Select up to 4 actions for each fault." VALUE 0x8000314B RecordLayout_3 0 CompuMethod_106 0 65535 /end CHARACTERISTIC
/begin CHARACTERISTIC FaultManager.Lambda1HtrOpen_Fault.Faulty_Samples__X_ "Fault manager configuration.  Select up to 4 actions for each fault." VALUE 0x8000314D RecordLayout_3 0 CompuMethod_1 0 65535 /end CHARACTERISTIC
/begin CHARACTERISTIC FaultManager.Lambda1HtrOpen_Fault.Total_Samples__Y_ "Fault manager configuration.  Select up to 4 actions for each fault." VALUE 0x8000314F RecordLayout_3 0 CompuMethod_1 0 65535 /end CHARACTERISTIC
/begin CHARACTERISTIC FaultManager.Lambda1HtrOpen_Fault.Action_1 "Fault manager configuration.  Select up to 4 actions for each fault." VALUE 0x80003151 RecordLayout_3 0 CompuMethod_107 0 65535 /end CHARACTERISTIC
/begin CHARACTERISTIC FaultManager.Lambda1HtrOpen_Fault.Action_1_Condition "Fault manager configuration.  Select up to 4 actions for each fault." VALUE 0x80003153 RecordLayout_3 0 CompuMethod_108 0 65535 /end CHARACTERISTIC
/begin CHARACTERISTIC FaultManager.Lambda1HtrOpen_Fault.Action_2 "Fault manager configuration.  Select up to 4 actions for each fault." VALUE 0x80003155 RecordLayout_3 0 CompuMethod_107 0 65535 /end CHARACTERISTIC
/begin CHARACTERISTIC FaultManager.Lambda1HtrOpen_Fault.Action_2_Condition "Fault manager configuration.  Select up to 4 actions for each fault." VALUE 0x80003157 RecordLayout_3 0 CompuMethod_108 0 65535 /end CHARACTERISTIC
/begin CHARACTERISTIC FaultManager.Lambda1HtrOpen_Fault.Action_3 "Fault manager configuration.  Select up to 4 actions for each fault." VALUE 0x80003159 RecordLayout_3 0 CompuMethod_107 0 65535 /end CHARACTERISTIC
/begin CHARACTERISTIC FaultManager.Lambda1HtrOpen_Fault.Action_3_Condition "Fault manager configuration.  Select up to 4 actions for each fault." VALUE 0x8000315B RecordLayout_3 0 CompuMethod_108 0 65535 /end CHARACTERISTIC
/begin CHARACTERISTIC FaultManager.Lambda1HtrOpen_Fault.Action_4 "Fault manager configuration.  Select up to 4 actions for each fault." VALUE 0x8000315D RecordLayout_3 0 CompuMethod_107 0 65535 /end CHARACTERISTIC
/begin CHARACTERISTIC FaultManager.Lambda1HtrOpen_Fault.Action_4_Condition "Fault manager configuration.  Select up to 4 actions for each fault." VALUE 0x8000315F RecordLayout_3 0 CompuMethod_108 0 65535 /end CHARACTERISTIC
/begin CHARACTERISTIC FaultManager.Lambda1HtrShort_Fault.Mode "Fault manager configuration.  Select up to 4 actions for each fault." VALUE 0x80003161 RecordLayout_3 0 CompuMethod_105 0 65535 /end CHARACTERISTIC
/begin CHARACTERISTIC FaultManager.Lambda1HtrShort_Fault.ID "Fault manager configuration.  Select up to 4 actions for each fault." VALUE 0x80003163 RecordLayout_3 0 CompuMethod_1 0 65535 /end CHARACTERISTIC
/begin CHARACTERISTIC FaultManager.Lambda1HtrShort_Fault.Test "Fault manager configuration.  Select up to 4 actions for each fault." VALUE 0x80003165 RecordLayout_3 0 CompuMethod_106 0 65535 /end CHARACTERISTIC
/begin CHARACTERISTIC FaultManager.Lambda1HtrShort_Fault.Faulty_Samples__X_ "Fault manager configuration.  Select up to 4 actions for each fault." VALUE 0x80003167 RecordLayout_3 0 CompuMethod_1 0 65535 /end CHARACTERISTIC
/begin CHARACTERISTIC FaultManager.Lambda1HtrShort_Fault.Total_Samples__Y_ "Fault manager configuration.  Select up to 4 actions for each fault." VALUE 0x80003169 RecordLayout_3 0 CompuMethod_1 0 65535 /end CHARACTERISTIC
/begin CHARACTERISTIC FaultManager.Lambda1HtrShort_Fault.Action_1 "Fault manager configuration.  Select up to 4 actions for each fault." VALUE 0x8000316B RecordLayout_3 0 CompuMethod_107 0 65535 /end CHARACTERISTIC
/begin CHARACTERISTIC FaultManager.Lambda1HtrShort_Fault.Action_1_Condition "Fault manager configuration.  Select up to 4 actions for each fault." VALUE 0x8000316D RecordLayout_3 0 CompuMethod_108 0 65535 /end CHARACTERISTIC
/begin CHARACTERISTIC FaultManager.Lambda1HtrShort_Fault.Action_2 "Fault manager configuration.  Select up to 4 actions for each fault." VALUE 0x8000316F RecordLayout_3 0 CompuMethod_107 0 65535 /end CHARACTERISTIC
/begin CHARACTERISTIC FaultManager.Lambda1HtrShort_Fault.Action_2_Condition "Fault manager configuration.  Select up to 4 actions for each fault." VALUE 0x80003171 RecordLayout_3 0 CompuMethod_108 0 65535 /end CHARACTERISTIC
/begin CHARACTERISTIC FaultManager.Lambda1HtrShort_Fault.Action_3 "Fault manager configuration.  Select up to 4 actions for each fault." VALUE 0x80003173 RecordLayout_3 0 CompuMethod_107 0 65535 /end CHARACTERISTIC
/begin CHARACTERISTIC FaultManager.Lambda1HtrShort_Fault.Action_3_Condition "Fault manager configuration.  Select up to 4 actions for each fault." VALUE 0x80003175 RecordLayout_3 0 CompuMethod_108 0 65535 /end CHARACTERISTIC
/begin CHARACTERISTIC FaultManager.Lambda1HtrShort_Fault.Action_4 "Fault manager configuration.  Select up to 4 actions for each fault." VALUE 0x80003177 RecordLayout_3 0 CompuMethod_107 0 65535 /end CHARACTERISTIC
/begin CHARACTERISTIC FaultManager.Lambda1HtrShort_Fault.Action_4_Condition "Fault manager configuration.  Select up to 4 actions for each fault." VALUE 0x80003179 RecordLayout_3 0 CompuMethod_108 0 65535 /end CHARACTERISTIC
/begin CHARACTERISTIC FaultManager.Lambda1Overcool_Fault.Mode "Fault manager configuration.  Select up to 4 actions for each fault." VALUE 0x8000317B RecordLayout_3 0 CompuMethod_105 0 65535 /end CHARACTERISTIC
/begin CHARACTERISTIC FaultManager.Lambda1Overcool_Fault.ID "Fault manager configuration.  Select up to 4 actions for each fault." VALUE 0x8000317D RecordLayout_3 0 CompuMethod_1 0 65535 /end CHARACTERISTIC
/begin CHARACTERISTIC FaultManager.Lambda1Overcool_Fault.Test "Fault manager configuration.  Select up to 4 actions for each fault." VALUE 0x8000317F RecordLayout_3 0 CompuMethod_106 0 65535 /end CHARACTERISTIC
/begin CHARACTERISTIC FaultManager.Lambda1Overcool_Fault.Faulty_Samples__X_ "Fault manager configuration.  Select up to 4 actions for each fault." VALUE 0x80003181 RecordLayout_3 0 CompuMethod_1 0 65535 /end CHARACTERISTIC
/begin CHARACTERISTIC FaultManager.Lambda1Overcool_Fault.Total_Samples__Y_ "Fault manager configuration.  Select up to 4 actions for each fault." VALUE 0x80003183 RecordLayout_3 0 CompuMethod_1 0 65535 /end CHARACTERISTIC
/begin CHARACTERISTIC FaultManager.Lambda1Overcool_Fault.Action_1 "Fault manager configuration.  Select up to 4 actions for each fault." VALUE 0x80003185 RecordLayout_3 0 CompuMethod_107 0 65535 /end CHARACTERISTIC
/begin CHARACTERISTIC FaultManager.Lambda1Overcool_Fault.Action_1_Condition "Fault manager configuration.  Select up to 4 actions for each fault." VALUE 0x80003187 RecordLayout_3 0 CompuMethod_108 0 65535 /end CHARACTERISTIC
/begin CHARACTERISTIC FaultManager.Lambda1Overcool_Fault.Action_2 "Fault manager configuration.  Select up to 4 actions for each fault." VALUE 0x80003189 RecordLayout_3 0 CompuMethod_107 0 65535 /end CHARACTERISTIC
/begin CHARACTERISTIC FaultManager.Lambda1Overcool_Fault.Action_2_Condition "Fault manager configuration.  Select up to 4 actions for each fault." VALUE 0x8000318B RecordLayout_3 0 CompuMethod_108 0 65535 /end CHARACTERISTIC
/begin CHARACTERISTIC FaultManager.Lambda1Overcool_Fault.Action_3 "Fault manager configuration.  Select up to 4 actions for each fault." VALUE 0x8000318D RecordLayout_3 0 CompuMethod_107 0 65535 /end CHARACTERISTIC
/begin CHARACTERISTIC FaultManager.Lambda1Overcool_Fault.Action_3_Condition "Fault manager configuration.  Select up to 4 actions for each fault." VALUE 0x8000318F RecordLayout_3 0 CompuMethod_108 0 65535 /end CHARACTERISTIC
/begin CHARACTERISTIC FaultManager.Lambda1Overcool_Fault.Action_4 "Fault manager configuration.  Select up to 4 actions for each fault." VALUE 0x80003191 RecordLayout_3 0 CompuMethod_107 0 65535 /end CHARACTERISTIC
/begin CHARACTERISTIC FaultManager.Lambda1Overcool_Fault.Action_4_Condition "Fault manager configuration.  Select up to 4 actions for each fault." VALUE 0x80003193 RecordLayout_3 0 CompuMethod_108 0 65535 /end CHARACTERISTIC
/begin CHARACTERISTIC FaultManager.Lambda1Overheat_Fault.Mode "Fault manager configuration.  Select up to 4 actions for each fault." VALUE 0x80003195 RecordLayout_3 0 CompuMethod_105 0 65535 /end CHARACTERISTIC
/begin CHARACTERISTIC FaultManager.Lambda1Overheat_Fault.ID "Fault manager configuration.  Select up to 4 actions for each fault." VALUE 0x80003197 RecordLayout_3 0 CompuMethod_1 0 65535 /end CHARACTERISTIC
/begin CHARACTERISTIC FaultManager.Lambda1Overheat_Fault.Test "Fault manager configuration.  Select up to 4 actions for each fault." VALUE 0x80003199 RecordLayout_3 0 CompuMethod_106 0 65535 /end CHARACTERISTIC
/begin CHARACTERISTIC FaultManager.Lambda1Overheat_Fault.Faulty_Samples__X_ "Fault manager configuration.  Select up to 4 actions for each fault." VALUE 0x8000319B RecordLayout_3 0 CompuMethod_1 0 65535 /end CHARACTERISTIC
/begin CHARACTERISTIC FaultManager.Lambda1Overheat_Fault.Total_Samples__Y_ "Fault manager configuration.  Select up to 4 actions for each fault." VALUE 0x8000319D RecordLayout_3 0 CompuMethod_1 0 65535 /end CHARACTERISTIC
/begin CHARACTERISTIC FaultManager.Lambda1Overheat_Fault.Action_1 "Fault manager configuration.  Select up to 4 actions for each fault." VALUE 0x8000319F RecordLayout_3 0 CompuMethod_107 0 65535 /end CHARACTERISTIC
/begin CHARACTERISTIC FaultManager.Lambda1Overheat_Fault.Action_1_Condition "Fault manager configuration.  Select up to 4 actions for each fault." VALUE 0x800031A1 RecordLayout_3 0 CompuMethod_108 0 65535 /end CHARACTERISTIC
/begin CHARACTERISTIC FaultManager.Lambda1Overheat_Fault.Action_2 "Fault manager configuration.  Select up to 4 actions for each fault." VALUE 0x800031A3 RecordLayout_3 0 CompuMethod_107 0 65535 /end CHARACTERISTIC
/begin CHARACTERISTIC FaultManager.Lambda1Overheat_Fault.Action_2_Condition "Fault manager configuration.  Select up to 4 actions for each fault." VALUE 0x800031A5 RecordLayout_3 0 CompuMethod_108 0 65535 /end CHARACTERISTIC
/begin CHARACTERISTIC FaultManager.Lambda1Overheat_Fault.Action_3 "Fault manager configuration.  Select up to 4 actions for each fault." VALUE 0x800031A7 RecordLayout_3 0 CompuMethod_107 0 65535 /end CHARACTERISTIC
/begin CHARACTERISTIC FaultManager.Lambda1Overheat_Fault.Action_3_Condition "Fault manager configuration.  Select up to 4 actions for each fault." VALUE 0x800031A9 RecordLayout_3 0 CompuMethod_108 0 65535 /end CHARACTERISTIC
/begin CHARACTERISTIC FaultManager.Lambda1Overheat_Fault.Action_4 "Fault manager configuration.  Select up to 4 actions for each fault." VALUE 0x800031AB RecordLayout_3 0 CompuMethod_107 0 65535 /end CHARACTERISTIC
/begin CHARACTERISTIC FaultManager.Lambda1Overheat_Fault.Action_4_Condition "Fault manager configuration.  Select up to 4 actions for each fault." VALUE 0x800031AD RecordLayout_3 0 CompuMethod_108 0 65535 /end CHARACTERISTIC
/begin CHARACTERISTIC FaultManager.Lambda1StuckInReset_Fault.Mode "Fault manager configuration.  Select up to 4 actions for each fault." VALUE 0x800031AF RecordLayout_3 0 CompuMethod_105 0 65535 /end CHARACTERISTIC
/begin CHARACTERISTIC FaultManager.Lambda1StuckInReset_Fault.ID "Fault manager configuration.  Select up to 4 actions for each fault." VALUE 0x800031B1 RecordLayout_3 0 CompuMethod_1 0 65535 /end CHARACTERISTIC
/begin CHARACTERISTIC FaultManager.Lambda1StuckInReset_Fault.Test "Fault manager configuration.  Select up to 4 actions for each fault." VALUE 0x800031B3 RecordLayout_3 0 CompuMethod_106 0 65535 /end CHARACTERISTIC
/begin CHARACTERISTIC FaultManager.Lambda1StuckInReset_Fault.Faulty_Samples__X_ "Fault manager configuration.  Select up to 4 actions for each fault." VALUE 0x800031B5 RecordLayout_3 0 CompuMethod_1 0 65535 /end CHARACTERISTIC
/begin CHARACTERISTIC FaultManager.Lambda1StuckInReset_Fault.Total_Samples__Y_ "Fault manager configuration.  Select up to 4 actions for each fault." VALUE 0x800031B7 RecordLayout_3 0 CompuMethod_1 0 65535 /end CHARACTERISTIC
/begin CHARACTERISTIC FaultManager.Lambda1StuckInReset_Fault.Action_1 "Fault manager configuration.  Select up to 4 actions for each fault." VALUE 0x800031B9 RecordLayout_3 0 CompuMethod_107 0 65535 /end CHARACTERISTIC
/begin CHARACTERISTIC FaultManager.Lambda1StuckInReset_Fault.Action_1_Condition "Fault manager configuration.  Select up to 4 actions for each fault." VALUE 0x800031BB RecordLayout_3 0 CompuMethod_108 0 65535 /end CHARACTERISTIC
/begin CHARACTERISTIC FaultManager.Lambda1StuckInReset_Fault.Action_2 "Fault manager configuration.  Select up to 4 actions for each fault." VALUE 0x800031BD RecordLayout_3 0 CompuMethod_107 0 65535 /end CHARACTERISTIC
/begin CHARACTERISTIC FaultManager.Lambda1StuckInReset_Fault.Action_2_Condition "Fault manager configuration.  Select up to 4 actions for each fault." VALUE 0x800031BF RecordLayout_3 0 CompuMethod_108 0 65535 /end CHARACTERISTIC
/begin CHARACTERISTIC FaultManager.Lambda1StuckInReset_Fault.Action_3 "Fault manager configuration.  Select up to 4 actions for each fault." VALUE 0x800031C1 RecordLayout_3 0 CompuMethod_107 0 65535 /end CHARACTERISTIC
/begin CHARACTERISTIC FaultManager.Lambda1StuckInReset_Fault.Action_3_Condition "Fault manager configuration.  Select up to 4 actions for each fault." VALUE 0x800031C3 RecordLayout_3 0 CompuMethod_108 0 65535 /end CHARACTERISTIC
/begin CHARACTERISTIC FaultManager.Lambda1StuckInReset_Fault.Action_4 "Fault manager configuration.  Select up to 4 actions for each fault." VALUE 0x800031C5 RecordLayout_3 0 CompuMethod_107 0 65535 /end CHARACTERISTIC
/begin CHARACTERISTIC FaultManager.Lambda1StuckInReset_Fault.Action_4_Condition "Fault manager configuration.  Select up to 4 actions for each fault." VALUE 0x800031C7 RecordLayout_3 0 CompuMethod_108 0 65535 /end CHARACTERISTIC
/begin CHARACTERISTIC FaultManager.Lambda1StuckInWarmup_Fault.Mode "Fault manager configuration.  Select up to 4 actions for each fault." VALUE 0x800031C9 RecordLayout_3 0 CompuMethod_105 0 65535 /end CHARACTERISTIC
/begin CHARACTERISTIC FaultManager.Lambda1StuckInWarmup_Fault.ID "Fault manager configuration.  Select up to 4 actions for each fault." VALUE 0x800031CB RecordLayout_3 0 CompuMethod_1 0 65535 /end CHARACTERISTIC
/begin CHARACTERISTIC FaultManager.Lambda1StuckInWarmup_Fault.Test "Fault manager configuration.  Select up to 4 actions for each fault." VALUE 0x800031CD RecordLayout_3 0 CompuMethod_106 0 65535 /end CHARACTERISTIC
/begin CHARACTERISTIC FaultManager.Lambda1StuckInWarmup_Fault.Faulty_Samples__X_ "Fault manager configuration.  Select up to 4 actions for each fault." VALUE 0x800031CF RecordLayout_3 0 CompuMethod_1 0 65535 /end CHARACTERISTIC
/begin CHARACTERISTIC FaultManager.Lambda1StuckInWarmup_Fault.Total_Samples__Y_ "Fault manager configuration.  Select up to 4 actions for each fault." VALUE 0x800031D1 RecordLayout_3 0 CompuMethod_1 0 65535 /end CHARACTERISTIC
/begin CHARACTERISTIC FaultManager.Lambda1StuckInWarmup_Fault.Action_1 "Fault manager configuration.  Select up to 4 actions for each fault." VALUE 0x800031D3 RecordLayout_3 0 CompuMethod_107 0 65535 /end CHARACTERISTIC
/begin CHARACTERISTIC FaultManager.Lambda1StuckInWarmup_Fault.Action_1_Condition "Fault manager configuration.  Select up to 4 actions for each fault." VALUE 0x800031D5 RecordLayout_3 0 CompuMethod_108 0 65535 /end CHARACTERISTIC
/begin CHARACTERISTIC FaultManager.Lambda1StuckInWarmup_Fault.Action_2 "Fault manager configuration.  Select up to 4 actions for each fault." VALUE 0x800031D7 RecordLayout_3 0 CompuMethod_107 0 65535 /end CHARACTERISTIC
/begin CHARACTERISTIC FaultManager.Lambda1StuckInWarmup_Fault.Action_2_Condition "Fault manager configuration.  Select up to 4 actions for each fault." VALUE 0x800031D9 RecordLayout_3 0 CompuMethod_108 0 65535 /end CHARACTERISTIC
/begin CHARACTERISTIC FaultManager.Lambda1StuckInWarmup_Fault.Action_3 "Fault manager configuration.  Select up to 4 actions for each fault." VALUE 0x800031DB RecordLayout_3 0 CompuMethod_107 0 65535 /end CHARACTERISTIC
/begin CHARACTERISTIC FaultManager.Lambda1StuckInWarmup_Fault.Action_3_Condition "Fault manager configuration.  Select up to 4 actions for each fault." VALUE 0x800031DD RecordLayout_3 0 CompuMethod_108 0 65535 /end CHARACTERISTIC
/begin CHARACTERISTIC FaultManager.Lambda1StuckInWarmup_Fault.Action_4 "Fault manager configuration.  Select up to 4 actions for each fault." VALUE 0x800031DF RecordLayout_3 0 CompuMethod_107 0 65535 /end CHARACTERISTIC
/begin CHARACTERISTIC FaultManager.Lambda1StuckInWarmup_Fault.Action_4_Condition "Fault manager configuration.  Select up to 4 actions for each fault." VALUE 0x800031E1 RecordLayout_3 0 CompuMethod_108 0 65535 /end CHARACTERISTIC
/begin CHARACTERISTIC FaultManager.Lambda1VoltHigh_Fault.Mode "Fault manager configuration.  Select up to 4 actions for each fault." VALUE 0x800031E3 RecordLayout_3 0 CompuMethod_105 0 65535 /end CHARACTERISTIC
/begin CHARACTERISTIC FaultManager.Lambda1VoltHigh_Fault.ID "Fault manager configuration.  Select up to 4 actions for each fault." VALUE 0x800031E5 RecordLayout_3 0 CompuMethod_1 0 65535 /end CHARACTERISTIC
/begin CHARACTERISTIC FaultManager.Lambda1VoltHigh_Fault.Test "Fault manager configuration.  Select up to 4 actions for each fault." VALUE 0x800031E7 RecordLayout_3 0 CompuMethod_106 0 65535 /end CHARACTERISTIC
/begin CHARACTERISTIC FaultManager.Lambda1VoltHigh_Fault.Faulty_Samples__X_ "Fault manager configuration.  Select up to 4 actions for each fault." VALUE 0x800031E9 RecordLayout_3 0 CompuMethod_1 0 65535 /end CHARACTERISTIC
/begin CHARACTERISTIC FaultManager.Lambda1VoltHigh_Fault.Total_Samples__Y_ "Fault manager configuration.  Select up to 4 actions for each fault." VALUE 0x800031EB RecordLayout_3 0 CompuMethod_1 0 65535 /end CHARACTERISTIC
/begin CHARACTERISTIC FaultManager.Lambda1VoltHigh_Fault.Action_1 "Fault manager configuration.  Select up to 4 actions for each fault." VALUE 0x800031ED RecordLayout_3 0 CompuMethod_107 0 65535 /end CHARACTERISTIC
/begin CHARACTERISTIC FaultManager.Lambda1VoltHigh_Fault.Action_1_Condition "Fault manager configuration.  Select up to 4 actions for each fault." VALUE 0x800031EF RecordLayout_3 0 CompuMethod_108 0 65535 /end CHARACTERISTIC
/begin CHARACTERISTIC FaultManager.Lambda1VoltHigh_Fault.Action_2 "Fault manager configuration.  Select up to 4 actions for each fault." VALUE 0x800031F1 RecordLayout_3 0 CompuMethod_107 0 65535 /end CHARACTERISTIC
/begin CHARACTERISTIC FaultManager.Lambda1VoltHigh_Fault.Action_2_Condition "Fault manager configuration.  Select up to 4 actions for each fault." VALUE 0x800031F3 RecordLayout_3 0 CompuMethod_108 0 65535 /end CHARACTERISTIC
/begin CHARACTERISTIC FaultManager.Lambda1VoltHigh_Fault.Action_3 "Fault manager configuration.  Select up to 4 actions for each fault." VALUE 0x800031F5 RecordLayout_3 0 CompuMethod_107 0 65535 /end CHARACTERISTIC
/begin CHARACTERISTIC FaultManager.Lambda1VoltHigh_Fault.Action_3_Condition "Fault manager configuration.  Select up to 4 actions for each fault." VALUE 0x800031F7 RecordLayout_3 0 CompuMethod_108 0 65535 /end CHARACTERISTIC
/begin CHARACTERISTIC FaultManager.Lambda1VoltHigh_Fault.Action_4 "Fault manager configuration.  Select up to 4 actions for each fault." VALUE 0x800031F9 RecordLayout_3 0 CompuMethod_107 0 65535 /end CHARACTERISTIC
/begin CHARACTERISTIC FaultManager.Lambda1VoltHigh_Fault.Action_4_Condition "Fault manager configuration.  Select up to 4 actions for each fault." VALUE 0x800031FB RecordLayout_3 0 CompuMethod_108 0 65535 /end CHARACTERISTIC
/begin CHARACTERISTIC FaultManager.Lambda1VoltLow_Fault.Mode "Fault manager configuration.  Select up to 4 actions for each fault." VALUE 0x800031FD RecordLayout_3 0 CompuMethod_105 0 65535 /end CHARACTERISTIC
/begin CHARACTERISTIC FaultManager.Lambda1VoltLow_Fault.ID "Fault manager configuration.  Select up to 4 actions for each fault." VALUE 0x800031FF RecordLayout_3 0 CompuMethod_1 0 65535 /end CHARACTERISTIC
/begin CHARACTERISTIC FaultManager.Lambda1VoltLow_Fault.Test "Fault manager configuration.  Select up to 4 actions for each fault." VALUE 0x80003201 RecordLayout_3 0 CompuMethod_106 0 65535 /end CHARACTERISTIC
/begin CHARACTERISTIC FaultManager.Lambda1VoltLow_Fault.Faulty_Samples__X_ "Fault manager configuration.  Select up to 4 actions for each fault." VALUE 0x80003203 RecordLayout_3 0 CompuMethod_1 0 65535 /end CHARACTERISTIC
/begin CHARACTERISTIC FaultManager.Lambda1VoltLow_Fault.Total_Samples__Y_ "Fault manager configuration.  Select up to 4 actions for each fault." VALUE 0x80003205 RecordLayout_3 0 CompuMethod_1 0 65535 /end CHARACTERISTIC
/begin CHARACTERISTIC FaultManager.Lambda1VoltLow_Fault.Action_1 "Fault manager configuration.  Select up to 4 actions for each fault." VALUE 0x80003207 RecordLayout_3 0 CompuMethod_107 0 65535 /end CHARACTERISTIC
/begin CHARACTERISTIC FaultManager.Lambda1VoltLow_Fault.Action_1_Condition "Fault manager configuration.  Select up to 4 actions for each fault." VALUE 0x80003209 RecordLayout_3 0 CompuMethod_108 0 65535 /end CHARACTERISTIC
/begin CHARACTERISTIC FaultManager.Lambda1VoltLow_Fault.Action_2 "Fault manager configuration.  Select up to 4 actions for each fault." VALUE 0x8000320B RecordLayout_3 0 CompuMethod_107 0 65535 /end CHARACTERISTIC
/begin CHARACTERISTIC FaultManager.Lambda1VoltLow_Fault.Action_2_Condition "Fault manager configuration.  Select up to 4 actions for each fault." VALUE 0x8000320D RecordLayout_3 0 CompuMethod_108 0 65535 /end CHARACTERISTIC
/begin CHARACTERISTIC FaultManager.Lambda1VoltLow_Fault.Action_3 "Fault manager configuration.  Select up to 4 actions for each fault." VALUE 0x8000320F RecordLayout_3 0 CompuMethod_107 0 65535 /end CHARACTERISTIC
/begin CHARACTERISTIC FaultManager.Lambda1VoltLow_Fault.Action_3_Condition "Fault manager configuration.  Select up to 4 actions for each fault." VALUE 0x80003211 RecordLayout_3 0 CompuMethod_108 0 65535 /end CHARACTERISTIC
/begin CHARACTERISTIC FaultManager.Lambda1VoltLow_Fault.Action_4 "Fault manager configuration.  Select up to 4 actions for each fault." VALUE 0x80003213 RecordLayout_3 0 CompuMethod_107 0 65535 /end CHARACTERISTIC
/begin CHARACTERISTIC FaultManager.Lambda1VoltLow_Fault.Action_4_Condition "Fault manager configuration.  Select up to 4 actions for each fault." VALUE 0x80003215 RecordLayout_3 0 CompuMethod_108 0 65535 /end CHARACTERISTIC
/begin CHARACTERISTIC FaultManager.Lambda2Error_Fault.Mode "Fault manager configuration.  Select up to 4 actions for each fault." VALUE 0x80003217 RecordLayout_3 0 CompuMethod_105 0 65535 /end CHARACTERISTIC
/begin CHARACTERISTIC FaultManager.Lambda2Error_Fault.ID "Fault manager configuration.  Select up to 4 actions for each fault." VALUE 0x80003219 RecordLayout_3 0 CompuMethod_1 0 65535 /end CHARACTERISTIC
/begin CHARACTERISTIC FaultManager.Lambda2Error_Fault.Test "Fault manager configuration.  Select up to 4 actions for each fault." VALUE 0x8000321B RecordLayout_3 0 CompuMethod_106 0 65535 /end CHARACTERISTIC
/begin CHARACTERISTIC FaultManager.Lambda2Error_Fault.Faulty_Samples__X_ "Fault manager configuration.  Select up to 4 actions for each fault." VALUE 0x8000321D RecordLayout_3 0 CompuMethod_1 0 65535 /end CHARACTERISTIC
/begin CHARACTERISTIC FaultManager.Lambda2Error_Fault.Total_Samples__Y_ "Fault manager configuration.  Select up to 4 actions for each fault." VALUE 0x8000321F RecordLayout_3 0 CompuMethod_1 0 65535 /end CHARACTERISTIC
/begin CHARACTERISTIC FaultManager.Lambda2Error_Fault.Action_1 "Fault manager configuration.  Select up to 4 actions for each fault." VALUE 0x80003221 RecordLayout_3 0 CompuMethod_107 0 65535 /end CHARACTERISTIC
/begin CHARACTERISTIC FaultManager.Lambda2Error_Fault.Action_1_Condition "Fault manager configuration.  Select up to 4 actions for each fault." VALUE 0x80003223 RecordLayout_3 0 CompuMethod_108 0 65535 /end CHARACTERISTIC
/begin CHARACTERISTIC FaultManager.Lambda2Error_Fault.Action_2 "Fault manager configuration.  Select up to 4 actions for each fault." VALUE 0x80003225 RecordLayout_3 0 CompuMethod_107 0 65535 /end CHARACTERISTIC
/begin CHARACTERISTIC FaultManager.Lambda2Error_Fault.Action_2_Condition "Fault manager configuration.  Select up to 4 actions for each fault." VALUE 0x80003227 RecordLayout_3 0 CompuMethod_108 0 65535 /end CHARACTERISTIC
/begin CHARACTERISTIC FaultManager.Lambda2Error_Fault.Action_3 "Fault manager configuration.  Select up to 4 actions for each fault." VALUE 0x80003229 RecordLayout_3 0 CompuMethod_107 0 65535 /end CHARACTERISTIC
/begin CHARACTERISTIC FaultManager.Lambda2Error_Fault.Action_3_Condition "Fault manager configuration.  Select up to 4 actions for each fault." VALUE 0x8000322B RecordLayout_3 0 CompuMethod_108 0 65535 /end CHARACTERISTIC
/begin CHARACTERISTIC FaultManager.Lambda2Error_Fault.Action_4 "Fault manager configuration.  Select up to 4 actions for each fault." VALUE 0x8000322D RecordLayout_3 0 CompuMethod_107 0 65535 /end CHARACTERISTIC
/begin CHARACTERISTIC FaultManager.Lambda2Error_Fault.Action_4_Condition "Fault manager configuration.  Select up to 4 actions for each fault." VALUE 0x8000322F RecordLayout_3 0 CompuMethod_108 0 65535 /end CHARACTERISTIC
/begin CHARACTERISTIC FaultManager.Lambda2Fault_Fault.Mode "Fault manager configuration.  Select up to 4 actions for each fault." VALUE 0x80003231 RecordLayout_3 0 CompuMethod_105 0 65535 /end CHARACTERISTIC
/begin CHARACTERISTIC FaultManager.Lambda2Fault_Fault.ID "Fault manager configuration.  Select up to 4 actions for each fault." VALUE 0x80003233 RecordLayout_3 0 CompuMethod_1 0 65535 /end CHARACTERISTIC
/begin CHARACTERISTIC FaultManager.Lambda2Fault_Fault.Test "Fault manager configuration.  Select up to 4 actions for each fault." VALUE 0x80003235 RecordLayout_3 0 CompuMethod_106 0 65535 /end CHARACTERISTIC
/begin CHARACTERISTIC FaultManager.Lambda2Fault_Fault.Faulty_Samples__X_ "Fault manager configuration.  Select up to 4 actions for each fault." VALUE 0x80003237 RecordLayout_3 0 CompuMethod_1 0 65535 /end CHARACTERISTIC
/begin CHARACTERISTIC FaultManager.Lambda2Fault_Fault.Total_Samples__Y_ "Fault manager configuration.  Select up to 4 actions for each fault." VALUE 0x80003239 RecordLayout_3 0 CompuMethod_1 0 65535 /end CHARACTERISTIC
/begin CHARACTERISTIC FaultManager.Lambda2Fault_Fault.Action_1 "Fault manager configuration.  Select up to 4 actions for each fault." VALUE 0x8000323B RecordLayout_3 0 CompuMethod_107 0 65535 /end CHARACTERISTIC
/begin CHARACTERISTIC FaultManager.Lambda2Fault_Fault.Action_1_Condition "Fault manager configuration.  Select up to 4 actions for each fault." VALUE 0x8000323D RecordLayout_3 0 CompuMethod_108 0 65535 /end CHARACTERISTIC
/begin CHARACTERISTIC FaultManager.Lambda2Fault_Fault.Action_2 "Fault manager configuration.  Select up to 4 actions for each fault." VALUE 0x8000323F RecordLayout_3 0 CompuMethod_107 0 65535 /end CHARACTERISTIC
/begin CHARACTERISTIC FaultManager.Lambda2Fault_Fault.Action_2_Condition "Fault manager configuration.  Select up to 4 actions for each fault." VALUE 0x80003241 RecordLayout_3 0 CompuMethod_108 0 65535 /end CHARACTERISTIC
/begin CHARACTERISTIC FaultManager.Lambda2Fault_Fault.Action_3 "Fault manager configuration.  Select up to 4 actions for each fault." VALUE 0x80003243 RecordLayout_3 0 CompuMethod_107 0 65535 /end CHARACTERISTIC
/begin CHARACTERISTIC FaultManager.Lambda2Fault_Fault.Action_3_Condition "Fault manager configuration.  Select up to 4 actions for each fault." VALUE 0x80003245 RecordLayout_3 0 CompuMethod_108 0 65535 /end CHARACTERISTIC
/begin CHARACTERISTIC FaultManager.Lambda2Fault_Fault.Action_4 "Fault manager configuration.  Select up to 4 actions for each fault." VALUE 0x80003247 RecordLayout_3 0 CompuMethod_107 0 65535 /end CHARACTERISTIC
/begin CHARACTERISTIC FaultManager.Lambda2Fault_Fault.Action_4_Condition "Fault manager configuration.  Select up to 4 actions for each fault." VALUE 0x80003249 RecordLayout_3 0 CompuMethod_108 0 65535 /end CHARACTERISTIC
/begin CHARACTERISTIC FaultManager.Lambda2HtrOpen_Fault.Mode "Fault manager configuration.  Select up to 4 actions for each fault." VALUE 0x8000324B RecordLayout_3 0 CompuMethod_105 0 65535 /end CHARACTERISTIC
/begin CHARACTERISTIC FaultManager.Lambda2HtrOpen_Fault.ID "Fault manager configuration.  Select up to 4 actions for each fault." VALUE 0x8000324D RecordLayout_3 0 CompuMethod_1 0 65535 /end CHARACTERISTIC
/begin CHARACTERISTIC FaultManager.Lambda2HtrOpen_Fault.Test "Fault manager configuration.  Select up to 4 actions for each fault." VALUE 0x8000324F RecordLayout_3 0 CompuMethod_106 0 65535 /end CHARACTERISTIC
/begin CHARACTERISTIC FaultManager.Lambda2HtrOpen_Fault.Faulty_Samples__X_ "Fault manager configuration.  Select up to 4 actions for each fault." VALUE 0x80003251 RecordLayout_3 0 CompuMethod_1 0 65535 /end CHARACTERISTIC
/begin CHARACTERISTIC FaultManager.Lambda2HtrOpen_Fault.Total_Samples__Y_ "Fault manager configuration.  Select up to 4 actions for each fault." VALUE 0x80003253 RecordLayout_3 0 CompuMethod_1 0 65535 /end CHARACTERISTIC
/begin CHARACTERISTIC FaultManager.Lambda2HtrOpen_Fault.Action_1 "Fault manager configuration.  Select up to 4 actions for each fault." VALUE 0x80003255 RecordLayout_3 0 CompuMethod_107 0 65535 /end CHARACTERISTIC
/begin CHARACTERISTIC FaultManager.Lambda2HtrOpen_Fault.Action_1_Condition "Fault manager configuration.  Select up to 4 actions for each fault." VALUE 0x80003257 RecordLayout_3 0 CompuMethod_108 0 65535 /end CHARACTERISTIC
/begin CHARACTERISTIC FaultManager.Lambda2HtrOpen_Fault.Action_2 "Fault manager configuration.  Select up to 4 actions for each fault." VALUE 0x80003259 RecordLayout_3 0 CompuMethod_107 0 65535 /end CHARACTERISTIC
/begin CHARACTERISTIC FaultManager.Lambda2HtrOpen_Fault.Action_2_Condition "Fault manager configuration.  Select up to 4 actions for each fault." VALUE 0x8000325B RecordLayout_3 0 CompuMethod_108 0 65535 /end CHARACTERISTIC
/begin CHARACTERISTIC FaultManager.Lambda2HtrOpen_Fault.Action_3 "Fault manager configuration.  Select up to 4 actions for each fault." VALUE 0x8000325D RecordLayout_3 0 CompuMethod_107 0 65535 /end CHARACTERISTIC
/begin RECORD_LAYOUT RecordLayout_3 FNC_VALUES 1 UWORD ROW_DIR DIRECT /end RECORD_LAYOUT
/*~~~~~~~~~ 6.3.31 COMPU_METHODs ~~~~~~~~~*/
/begin COMPU_METHOD CompuMethod_1 "" RAT_FUNC "%3.0" "" COEFFS 0 1 0 0 0 1 /end COMPU_METHOD
/begin COMPU_METHOD CompuMethod_105 "" TAB_VERB "%3.0" "" COMPU_TAB_REF CompuVtab_25 /end COMPU_METHOD
/begin COMPU_METHOD CompuMethod_106 "" TAB_VERB "%3.0" "" COMPU_TAB_REF CompuVtab_26 /end COMPU_METHOD
/begin COMPU_METHOD CompuMethod_107 "" TAB_VERB "%3.0" "" COMPU_TAB_REF CompuVtab_27 /end COMPU_METHOD
/begin COMPU_METHOD CompuMethod_108 "" TAB_VERB "%3.0" "" COMPU_TAB_REF CompuVtab_28 /end COMPU_METHOD
/begin COMPU_VTAB CompuVtab_25 "" TAB_VERB 6 0 "Disabled" 1 "Enabled" 2 "Sticky" 3 "Enabled - Persistent" 4 "Sticky - Persistent" 5 "Save Occurred" /end COMPU_VTAB
/begin COMPU_VTAB CompuVtab_26 "" TAB_VERB 2 0 "-" 1 "Test" /end COMPU_VTAB
/begin COMPU_VTAB CompuVtab_27 "" TAB_VERB 16 0 "CutThrottle" 1 "DFCODisable" 2 "DelayedEngineShutdown" 3 "DisableAC" 4 "DisableFanRun" 5 "DisableFanStall" 6 "DisableO2Ctrl" 7 "DisableVEAdapt" 8 "DisableWastegate" 9 "EngineProtectLED" 10 "EngineShutdown" 11 "HardRevLimit" 12 "MIL_LED" 13 "MediumRevLimit" 14 "SoftRevLimit" 15 "(None)" /end COMPU_VTAB
/begin COMPU_VTAB CompuVtab_28 "" TAB_VERB 8 0 "(None)" 1 "Suspected" 2 "Active" 3 "Suspected or Active" 4 "Occurred" 5 "Suspected or Occurred" 6 "Active or Occurred" 7 "Suspected or Active or Occurred" /end COMPU_VTAB
/begin FUNCTION BaseEngineController_LS_112 ""
 /begin DEF_CHARACTERISTIC FaultManager.EST3_Open.Mode FaultManager.EST3_Open.ID FaultManager.EST3_Open.Test FaultManager.EST3_Open.Faulty_Samples__X_ FaultManager.EST3_Open.Total_Samples__Y_ FaultManager.EST3_Open.Action_1 FaultManager.EST3_Open.Action_1_Condition FaultManager.EST3_Open.Action_2 FaultManager.EST3_Open.Action_2_Condition FaultManager.EST3_Open.Action_3 FaultManager.EST3_Open.Action_3_Condition FaultManager.EST3_Open.Action_4 FaultManager.EST3_Open.Action_4_Condition FaultManager.EST3_Short.Mode FaultManager.EST3_Short.ID FaultManager.EST3_Short.Test FaultManager.EST3_Short.Faulty_Samples__X_ FaultManager.EST3_Short.Total_Samples__Y_ FaultManager.EST3_Short.Action_1 FaultManager.EST3_Short.Action_1_Condition FaultManager.EST3_Short.Action_2 FaultManager.EST3_Short.Action_2_Condition FaultManager.EST3_Short.Action_3 FaultManager.EST3_Short.Action_3_Condition FaultManager.EST3_Short.Action_4 FaultManager.EST3_Short.Action_4_Condition FaultManager.EST4_Open.Mode FaultManager.EST4_Open.ID FaultManager.EST4_Open.Test FaultManager.EST4_Open.Faulty_Samples__X_ FaultManager.EST4_Open.Total_Samples__Y_ FaultManager.EST4_Open.Action_1 FaultManager.EST4_Open.Action_1_Condition FaultManager.EST4_Open.Action_2 FaultManager.EST4_Open.Action_2_Condition FaultManager.EST4_Open.Action_3 FaultManager.EST4_Open.Action_3_Condition FaultManager.EST4_Open.Action_4 FaultManager.EST4_Open.Action_4_Condition FaultManager.EST4_Short.Mode FaultManager.EST4_Short.ID FaultManager.EST4_Short.Test FaultManager.EST4_Short.Faulty_Samples__X_ FaultManager.EST4_Short.Total_Samples__Y_ FaultManager.EST4_Short.Action_1 FaultManager.EST4_Short.Action_1_Condition FaultManager.EST4_Short.Action_2 FaultManager.EST4_Short.Action_2_Condition FaultManager.EST4_Short.Action_3 FaultManager.EST4_Short.Action_3_Condition FaultManager.EST4_Short.Action_4 FaultManager.EST4_Short.Action_4_Condition FaultManager.EST5_Open.Mode FaultManager.EST5_Open.ID FaultManager.EST5_Open.Test FaultManager.EST5_Open.Faulty_Samples__X_ FaultManager.EST5_Open.Total_Samples__Y_ FaultManager.EST5_Open.Action_1 FaultManager.EST5_Open.Action_1_Condition FaultManager.EST5_Open.Action_2 FaultManager.EST5_Open.Action_2_Condition FaultManager.EST5_Open.Action_3 FaultManager.EST5_Open.Action_3_Condition FaultManager.EST5_Open.Action_4 FaultManager.EST5_Open.Action_4_Condition FaultManager.EST5_Short.Mode FaultManager.EST5_Short.ID FaultManager.EST5_Short.Test FaultManager.EST5_Short.Faulty_Samples__X_ FaultManager.EST5_Short.Total_Samples__Y_ FaultManager.EST5_Short.Action_1 FaultManager.EST5_Short.Action_1_Condition FaultManager.EST5_Short.Action_2 FaultManager.EST5_Short.Action_2_Condition FaultManager.EST5_Short.Action_3 FaultManager.EST5_Short.Action_3_Condition FaultManager.EST5_Short.Action_4 FaultManager.EST5_Short.Action_4_Condition FaultManager.EST6_Open.Mode FaultManager.EST6_Open.ID FaultManager.EST6_Open.Test FaultManager.EST6_Open.Faulty_Samples__X_ FaultManager.EST6_Open.Total_Samples__Y_ FaultManager.EST6_Open.Action_1 FaultManager.EST6_Open.Action_1_Condition FaultManager.EST6_Open.Action_2 FaultManager.EST6_Open.Action_2_Condition FaultManager.EST6_Open.Action_3 FaultManager.EST6_Open.Action_3_Condition FaultManager.EST6_Open.Action_4 FaultManager.EST6_Open.Action_4_Condition FaultManager.EST6_Short.Mode FaultManager.EST6_Short.ID FaultManager.EST6_Short.Test FaultManager.EST6_Short.Faulty_Samples__X_ FaultManager.EST6_Short.Total_Samples__Y_ FaultManager.EST6_Short.Action_1 FaultManager.EST6_Short.Action_1_Condition FaultManager.EST6_Short.Action_2 FaultManager.EST6_Short.Action_2_Condition FaultManager.EST6_Short.Action_3 FaultManager.EST6_Short.Action_3_Condition FaultManager.EST6_Short.Action_4 FaultManager.EST6_Short.Action_4_Condition FaultManager.EST7_Open.Mode FaultManager.EST7_Open.ID FaultManager.EST7_Open.Test FaultManager.EST7_Open.Faulty_Samples__X_ FaultManager.EST7_Open.Total_Samples__Y_ FaultManager.EST7_Open.Action_1 FaultManager.EST7_Open.Action_1_Condition FaultManager.EST7_Open.Action_2 FaultManager.EST7_Open.Action_2_Condition FaultManager.EST7_Open.Action_3 FaultManager.EST7_Open.Action_3_Condition FaultManager.EST7_Open.Action_4 FaultManager.EST7_Open.Action_4_Condition FaultManager.EST7_Short.Mode FaultManager.EST7_Short.ID FaultManager.EST7_Short.Test FaultManager.EST7_Short.Faulty_Samples__X_ FaultManager.EST7_Short.Total_Samples__Y_ FaultManager.EST7_Short.Action_1 FaultManager.EST7_Short.Action_1_Condition FaultManager.EST7_Short.Action_2 FaultManager.EST7_Short.Action_2_Condition FaultManager.EST7_Short.Action_3 FaultManager.EST7_Short.Action_3_Condition FaultManager.EST7_Short.Action_4 FaultManager.EST7_Short.Action_4_Condition FaultManager.EST8_Open.Mode FaultManager.EST8_Open.ID FaultManager.EST8_Open.Test FaultManager.EST8_Open.Faulty_Samples__X_ FaultManager.EST8_Open.Total_Samples__Y_ FaultManager.EST8_Open.Action_1 FaultManager.EST8_Open.Action_1_Condition FaultManager.EST8_Open.Action_2 FaultManager.EST8_Open.Action_2_Condition FaultManager.EST8_Open.Action_3 FaultManager.EST8_Open.Action_3_Condition FaultManager.EST8_Open.Action_4 FaultManager.EST8_Open.Action_4_Condition FaultManager.EST8_Short.Mode FaultManager.EST8_Short.ID FaultManager.EST8_Short.Test FaultManager.EST8_Short.Faulty_Samples__X_ FaultManager.EST8_Short.Total_Samples__Y_ FaultManager.EST8_Short.Action_1 FaultManager.EST8_Short.Action_1_Condition FaultManager.EST8_Short.Action_2 FaultManager.EST8_Short.Action_2_Condition FaultManager.EST8_Short.Action_3 FaultManager.EST8_Short.Action_3_Condition FaultManager.EST8_Short.Action_4 FaultManager.EST8_Short.Action_4_Condition FaultManager.ETCSpringTest.Mode FaultManager.ETCSpringTest.ID FaultManager.ETCSpringTest.Test FaultManager.ETCSpringTest.Faulty_Samples__X_ FaultManager.ETCSpringTest.Total_Samples__Y_ FaultManager.ETCSpringTest.Action_1 FaultManager.ETCSpringTest.Action_1_Condition FaultManager.ETCSpringTest.Action_2 FaultManager.ETCSpringTest.Action_2_Condition FaultManager.ETCSpringTest.Action_3 FaultManager.ETCSpringTest.Action_3_Condition FaultManager.ETCSpringTest.Action_4 FaultManager.ETCSpringTest.Action_4_Condition FaultManager.ETC_Open_Fault.Mode FaultManager.ETC_Open_Fault.ID FaultManager.ETC_Open_Fault.Test FaultManager.ETC_Open_Fault.Faulty_Samples__X_ FaultManager.ETC_Open_Fault.Total_Samples__Y_ FaultManager.ETC_Open_Fault.Action_1 FaultManager.ETC_Open_Fault.Action_1_Condition FaultManager.ETC_Open_Fault.Action_2 FaultManager.ETC_Open_Fault.Action_2_Condition FaultManager.ETC_Open_Fault.Action_3 FaultManager.ETC_Open_Fault.Action_3_Condition FaultManager.ETC_Open_Fault.Action_4 FaultManager.ETC_Open_Fault.Action_4_Condition FaultManager.ETC_Sticking.Mode FaultManager.ETC_Sticking.ID FaultManager.ETC_Sticking.Test FaultManager.ETC_Sticking.Faulty_Samples__X_ FaultManager.ETC_Sticking.Total_Samples__Y_ FaultManager.ETC_Sticking.Action_1 FaultManager.ETC_Sticking.Action_1_Condition FaultManager.ETC_Sticking.Action_2 FaultManager.ETC_Sticking.Action_2_Condition FaultManager.ETC_Sticking.Action_3 FaultManager.ETC_Sticking.Action_3_Condition FaultManager.ETC_Sticking.Action_4 FaultManager.ETC_Sticking.Action_4_Condition FaultManager.EVAPRangeHigh.Mode FaultManager.EVAPRangeHigh.ID FaultManager.EVAPRangeHigh.Test FaultManager.EVAPRangeHigh.Faulty_Samples__X_ FaultManager.EVAPRangeHigh.Total_Samples__Y_ FaultManager.EVAPRangeHigh.Action_1 FaultManager.EVAPRangeHigh.Action_1_Condition FaultManager.EVAPRangeHigh.Action_2 FaultManager.EVAPRangeHigh.Action_2_Condition FaultManager.EVAPRangeHigh.Action_3 FaultManager.EVAPRangeHigh.Action_3_Condition FaultManager.EVAPRangeHigh.Action_4 FaultManager.EVAPRangeHigh.Action_4_Condition FaultManager.EVAPRangeLow.Mode FaultManager.EVAPRangeLow.ID FaultManager.EVAPRangeLow.Test FaultManager.EVAPRangeLow.Faulty_Samples__X_ FaultManager.EVAPRangeLow.Total_Samples__Y_ FaultManager.EVAPRangeLow.Action_1 FaultManager.EVAPRangeLow.Action_1_Condition FaultManager.EVAPRangeLow.Action_2 FaultManager.EVAPRangeLow.Action_2_Condition FaultManager.EVAPRangeLow.Action_3 FaultManager.EVAPRangeLow.Action_3_Condition FaultManager.EVAPRangeLow.Action_4 FaultManager.EVAPRangeLow.Action_4_Condition FaultManager.FuelAdaptRangeHi_BankA.Mode FaultManager.FuelAdaptRangeHi_BankA.ID FaultManager.FuelAdaptRangeHi_BankA.Test FaultManager.FuelAdaptRangeHi_BankA.Faulty_Samples__X_ FaultManager.FuelAdaptRangeHi_BankA.Total_Samples__Y_ FaultManager.FuelAdaptRangeHi_BankA.Action_1 FaultManager.FuelAdaptRangeHi_BankA.Action_1_Condition FaultManager.FuelAdaptRangeHi_BankA.Action_2 FaultManager.FuelAdaptRangeHi_BankA.Action_2_Condition FaultManager.FuelAdaptRangeHi_BankA.Action_3 FaultManager.FuelAdaptRangeHi_BankA.Action_3_Condition FaultManager.FuelAdaptRangeHi_BankA.Action_4 FaultManager.FuelAdaptRangeHi_BankA.Action_4_Condition FaultManager.FuelAdaptRangeHi_BankB.Mode FaultManager.FuelAdaptRangeHi_BankB.ID FaultManager.FuelAdaptRangeHi_BankB.Test FaultManager.FuelAdaptRangeHi_BankB.Faulty_Samples__X_ FaultManager.FuelAdaptRangeHi_BankB.Total_Samples__Y_ FaultManager.FuelAdaptRangeHi_BankB.Action_1 FaultManager.FuelAdaptRangeHi_BankB.Action_1_Condition FaultManager.FuelAdaptRangeHi_BankB.Action_2 FaultManager.FuelAdaptRangeHi_BankB.Action_2_Condition FaultManager.FuelAdaptRangeHi_BankB.Action_3 FaultManager.FuelAdaptRangeHi_BankB.Action_3_Condition FaultManager.FuelAdaptRangeHi_BankB.Action_4 FaultManager.FuelAdaptRangeHi_BankB.Action_4_Condition FaultManager.FuelAdaptRangeLow_BankA.Mode FaultManager.FuelAdaptRangeLow_BankA.ID FaultManager.FuelAdaptRangeLow_BankA.Test FaultManager.FuelAdaptRangeLow_BankA.Faulty_Samples__X_ FaultManager.FuelAdaptRangeLow_BankA.Total_Samples__Y_ FaultManager.FuelAdaptRangeLow_BankA.Action_1 FaultManager.FuelAdaptRangeLow_BankA.Action_1_Condition FaultManager.FuelAdaptRangeLow_BankA.Action_2 FaultManager.FuelAdaptRangeLow_BankA.Action_2_Condition FaultManager.FuelAdaptRangeLow_BankA.Action_3 FaultManager.FuelAdaptRangeLow_BankA.Action_3_Condition FaultManager.FuelAdaptRangeLow_BankA.Action_4 FaultManager.FuelAdaptRangeLow_BankA.Action_4_Condition FaultManager.FuelAdaptRangeLow_BankB.Mode FaultManager.FuelAdaptRangeLow_BankB.ID FaultManager.FuelAdaptRangeLow_BankB.Test FaultManager.FuelAdaptRangeLow_BankB.Faulty_Samples__X_ FaultManager.FuelAdaptRangeLow_BankB.Total_Samples__Y_ FaultManager.FuelAdaptRangeLow_BankB.Action_1 FaultManager.FuelAdaptRangeLow_BankB.Action_1_Condition FaultManager.FuelAdaptRangeLow_BankB.Action_2 FaultManager.FuelAdaptRangeLow_BankB.Action_2_Condition FaultManager.FuelAdaptRangeLow_BankB.Action_3 FaultManager.FuelAdaptRangeLow_BankB.Action_3_Condition FaultManager.FuelAdaptRangeLow_BankB.Action_4 FaultManager.FuelAdaptRangeLow_BankB.Action_4_Condition FaultManager.FuelPresHigh_Fault.Mode FaultManager.FuelPresHigh_Fault.ID FaultManager.FuelPresHigh_Fault.Test FaultManager.FuelPresHigh_Fault.Faulty_Samples__X_ FaultManager.FuelPresHigh_Fault.Total_Samples__Y_ FaultManager.FuelPresHigh_Fault.Action_1 FaultManager.FuelPresHigh_Fault.Action_1_Condition FaultManager.FuelPresHigh_Fault.Action_2 FaultManager.FuelPresHigh_Fault.Action_2_Condition FaultManager.FuelPresHigh_Fault.Action_3 FaultManager.FuelPresHigh_Fault.Action_3_Condition FaultManager.FuelPresHigh_Fault.Action_4 FaultManager.FuelPresHigh_Fault.Action_4_Condition FaultManager.FuelPresLow_Fault.Mode FaultManager.FuelPresLow_Fault.ID FaultManager.FuelPresLow_Fault.Test FaultManager.FuelPresLow_Fault.Faulty_Samples__X_ FaultManager.FuelPresLow_Fault.Total_Samples__Y_ FaultManager.FuelPresLow_Fault.Action_1 FaultManager.FuelPresLow_Fault.Action_1_Condition FaultManager.FuelPresLow_Fault.Action_2 FaultManager.FuelPresLow_Fault.Action_2_Condition FaultManager.FuelPresLow_Fault.Action_3 FaultManager.FuelPresLow_Fault.Action_3_Condition FaultManager.FuelPresLow_Fault.Action_4 FaultManager.FuelPresLow_Fault.Action_4_Condition FaultManager.FuelPresRangeHigh.Mode FaultManager.FuelPresRangeHigh.ID FaultManager.FuelPresRangeHigh.Test FaultManager.FuelPresRangeHigh.Faulty_Samples__X_ FaultManager.FuelPresRangeHigh.Total_Samples__Y_ FaultManager.FuelPresRangeHigh.Action_1 FaultManager.FuelPresRangeHigh.Action_1_Condition FaultManager.FuelPresRangeHigh.Action_2 FaultManager.FuelPresRangeHigh.Action_2_Condition FaultManager.FuelPresRangeHigh.Action_3 FaultManager.FuelPresRangeHigh.Action_3_Condition FaultManager.FuelPresRangeHigh.Action_4 FaultManager.FuelPresRangeHigh.Action_4_Condition FaultManager.FuelPresRangeLow.Mode FaultManager.FuelPresRangeLow.ID FaultManager.FuelPresRangeLow.Test FaultManager.FuelPresRangeLow.Faulty_Samples__X_ FaultManager.FuelPresRangeLow.Total_Samples__Y_ FaultManager.FuelPresRangeLow.Action_1 FaultManager.FuelPresRangeLow.Action_1_Condition FaultManager.FuelPresRangeLow.Action_2 FaultManager.FuelPresRangeLow.Action_2_Condition FaultManager.FuelPresRangeLow.Action_3 FaultManager.FuelPresRangeLow.Action_3_Condition FaultManager.FuelPresRangeLow.Action_4 FaultManager.FuelPresRangeLow.Action_4_Condition FaultManager.FuelSensRangeHigh.Mode FaultManager.FuelSensRangeHigh.ID FaultManager.FuelSensRangeHigh.Test FaultManager.FuelSensRangeHigh.Faulty_Samples__X_ FaultManager.FuelSensRangeHigh.Total_Samples__Y_ FaultManager.FuelSensRangeHigh.Action_1 FaultManager.FuelSensRangeHigh.Action_1_Condition FaultManager.FuelSensRangeHigh.Action_2 FaultManager.FuelSensRangeHigh.Action_2_Condition FaultManager.FuelSensRangeHigh.Action_3 FaultManager.FuelSensRangeHigh.Action_3_Condition FaultManager.FuelSensRangeHigh.Action_4 FaultManager.FuelSensRangeHigh.Action_4_Condition FaultManager.FuelSensRangeLow.Mode FaultManager.FuelSensRangeLow.ID FaultManager.FuelSensRangeLow.Test FaultManager.FuelSensRangeLow.Faulty_Samples__X_ FaultManager.FuelSensRangeLow.Total_Samples__Y_ FaultManager.FuelSensRangeLow.Action_1 FaultManager.FuelSensRangeLow.Action_1_Condition FaultManager.FuelSensRangeLow.Action_2 FaultManager.FuelSensRangeLow.Action_2_Condition FaultManager.FuelSensRangeLow.Action_3 FaultManager.FuelSensRangeLow.Action_3_Condition FaultManager.FuelSensRangeLow.Action_4 FaultManager.FuelSensRangeLow.Action_4_Condition FaultManager.Fuel_LvlRangeHigh.Mode FaultManager.Fuel_LvlRangeHigh.ID FaultManager.Fuel_LvlRangeHigh.Test FaultManager.Fuel_LvlRangeHigh.Faulty_Samples__X_ FaultManager.Fuel_LvlRangeHigh.Total_Samples__Y_ FaultManager.Fuel_LvlRangeHigh.Action_1 FaultManager.Fuel_LvlRangeHigh.Action_1_Condition FaultManager.Fuel_LvlRangeHigh.Action_2 FaultManager.Fuel_LvlRangeHigh.Action_2_Condition FaultManager.Fuel_LvlRangeHigh.Action_3 FaultManager.Fuel_LvlRangeHigh.Action_3_Condition FaultManager.Fuel_LvlRangeHigh.Action_4 FaultManager.Fuel_LvlRangeHigh.Action_4_Condition FaultManager.Fuel_LvlRangeLow.Mode FaultManager.Fuel_LvlRangeLow.ID FaultManager.Fuel_LvlRangeLow.Test FaultManager.Fuel_LvlRangeLow.Faulty_Samples__X_ FaultManager.Fuel_LvlRangeLow.Total_Samples__Y_ FaultManager.Fuel_LvlRangeLow.Action_1 FaultManager.Fuel_LvlRangeLow.Action_1_Condition FaultManager.Fuel_LvlRangeLow.Action_2 FaultManager.Fuel_LvlRangeLow.Action_2_Condition FaultManager.Fuel_LvlRangeLow.Action_3 FaultManager.Fuel_LvlRangeLow.Action_3_Condition FaultManager.Fuel_LvlRangeLow.Action_4 FaultManager.Fuel_LvlRangeLow.Action_4_Condition FaultManager.GPS_DateTime_Timeout.Mode FaultManager.GPS_DateTime_Timeout.ID FaultManager.GPS_DateTime_Timeout.Test FaultManager.GPS_DateTime_Timeout.Faulty_Samples__X_ FaultManager.GPS_DateTime_Timeout.Total_Samples__Y_ FaultManager.GPS_DateTime_Timeout.Action_1 FaultManager.GPS_DateTime_Timeout.Action_1_Condition FaultManager.GPS_DateTime_Timeout.Action_2 FaultManager.GPS_DateTime_Timeout.Action_2_Condition FaultManager.GPS_DateTime_Timeout.Action_3 FaultManager.GPS_DateTime_Timeout.Action_3_Condition FaultManager.GPS_DateTime_Timeout.Action_4 FaultManager.GPS_DateTime_Timeout.Action_4_Condition FaultManager.GPS_LatLong_Timeout.Mode FaultManager.GPS_LatLong_Timeout.ID FaultManager.GPS_LatLong_Timeout.Test FaultManager.GPS_LatLong_Timeout.Faulty_Samples__X_ FaultManager.GPS_LatLong_Timeout.Total_Samples__Y_ FaultManager.GPS_LatLong_Timeout.Action_1 FaultManager.GPS_LatLong_Timeout.Action_1_Condition FaultManager.GPS_LatLong_Timeout.Action_2 FaultManager.GPS_LatLong_Timeout.Action_2_Condition FaultManager.GPS_LatLong_Timeout.Action_3 FaultManager.GPS_LatLong_Timeout.Action_3_Condition FaultManager.GPS_LatLong_Timeout.Action_4 FaultManager.GPS_LatLong_Timeout.Action_4_Condition FaultManager.GPS_SpeedDir_Timeout.Mode FaultManager.GPS_SpeedDir_Timeout.ID FaultManager.GPS_SpeedDir_Timeout.Test FaultManager.GPS_SpeedDir_Timeout.Faulty_Samples__X_ FaultManager.GPS_SpeedDir_Timeout.Total_Samples__Y_ FaultManager.GPS_SpeedDir_Timeout.Action_1 FaultManager.GPS_SpeedDir_Timeout.Action_1_Condition FaultManager.GPS_SpeedDir_Timeout.Action_2 FaultManager.GPS_SpeedDir_Timeout.Action_2_Condition FaultManager.GPS_SpeedDir_Timeout.Action_3 FaultManager.GPS_SpeedDir_Timeout.Action_3_Condition FaultManager.GPS_SpeedDir_Timeout.Action_4 FaultManager.GPS_SpeedDir_Timeout.Action_4_Condition FaultManager.HardOverBoost_Fault.Mode FaultManager.HardOverBoost_Fault.ID FaultManager.HardOverBoost_Fault.Test FaultManager.HardOverBoost_Fault.Faulty_Samples__X_ FaultManager.HardOverBoost_Fault.Total_Samples__Y_ FaultManager.HardOverBoost_Fault.Action_1 FaultManager.HardOverBoost_Fault.Action_1_Condition FaultManager.HardOverBoost_Fault.Action_2 FaultManager.HardOverBoost_Fault.Action_2_Condition FaultManager.HardOverBoost_Fault.Action_3 FaultManager.HardOverBoost_Fault.Action_3_Condition FaultManager.HardOverBoost_Fault.Action_4 FaultManager.HardOverBoost_Fault.Action_4_Condition FaultManager.HardOverspeed.Mode FaultManager.HardOverspeed.ID FaultManager.HardOverspeed.Test FaultManager.HardOverspeed.Faulty_Samples__X_ FaultManager.HardOverspeed.Total_Samples__Y_ FaultManager.HardOverspeed.Action_1 FaultManager.HardOverspeed.Action_1_Condition FaultManager.HardOverspeed.Action_2 FaultManager.HardOverspeed.Action_2_Condition FaultManager.HardOverspeed.Action_3 FaultManager.HardOverspeed.Action_3_Condition FaultManager.HardOverspeed.Action_4 FaultManager.HardOverspeed.Action_4_Condition FaultManager.IATRangeHigh.Mode FaultManager.IATRangeHigh.ID FaultManager.IATRangeHigh.Test FaultManager.IATRangeHigh.Faulty_Samples__X_ FaultManager.IATRangeHigh.Total_Samples__Y_ FaultManager.IATRangeHigh.Action_1 FaultManager.IATRangeHigh.Action_1_Condition FaultManager.IATRangeHigh.Action_2 FaultManager.IATRangeHigh.Action_2_Condition FaultManager.IATRangeHigh.Action_3 FaultManager.IATRangeHigh.Action_3_Condition FaultManager.IATRangeHigh.Action_4 FaultManager.IATRangeHigh.Action_4_Condition FaultManager.IATRangeLow.Mode FaultManager.IATRangeLow.ID FaultManager.IATRangeLow.Test FaultManager.IATRangeLow.Faulty_Samples__X_ FaultManager.IATRangeLow.Total_Samples__Y_ FaultManager.IATRangeLow.Action_1 FaultManager.IATRangeLow.Action_1_Condition FaultManager.IATRangeLow.Action_2 FaultManager.IATRangeLow.Action_2_Condition FaultManager.IATRangeLow.Action_3 FaultManager.IATRangeLow.Action_3_Condition FaultManager.IATRangeLow.Action_4 FaultManager.IATRangeLow.Action_4_Condition FaultManager.Inj1Open.Mode FaultManager.Inj1Open.ID FaultManager.Inj1Open.Test FaultManager.Inj1Open.Faulty_Samples__X_ FaultManager.Inj1Open.Total_Samples__Y_ FaultManager.Inj1Open.Action_1 FaultManager.Inj1Open.Action_1_Condition FaultManager.Inj1Open.Action_2 FaultManager.Inj1Open.Action_2_Condition FaultManager.Inj1Open.Action_3 FaultManager.Inj1Open.Action_3_Condition FaultManager.Inj1Open.Action_4 FaultManager.Inj1Open.Action_4_Condition FaultManager.Inj2Open.Mode FaultManager.Inj2Open.ID FaultManager.Inj2Open.Test FaultManager.Inj2Open.Faulty_Samples__X_ FaultManager.Inj2Open.Total_Samples__Y_ FaultManager.Inj2Open.Action_1 FaultManager.Inj2Open.Action_1_Condition FaultManager.Inj2Open.Action_2 FaultManager.Inj2Open.Action_2_Condition FaultManager.Inj2Open.Action_3 FaultManager.Inj2Open.Action_3_Condition FaultManager.Inj2Open.Action_4 FaultManager.Inj2Open.Action_4_Condition FaultManager.Inj3Open.Mode FaultManager.Inj3Open.ID FaultManager.Inj3Open.Test FaultManager.Inj3Open.Faulty_Samples__X_ FaultManager.Inj3Open.Total_Samples__Y_ FaultManager.Inj3Open.Action_1 FaultManager.Inj3Open.Action_1_Condition FaultManager.Inj3Open.Action_2 FaultManager.Inj3Open.Action_2_Condition FaultManager.Inj3Open.Action_3 FaultManager.Inj3Open.Action_3_Condition FaultManager.Inj3Open.Action_4 FaultManager.Inj3Open.Action_4_Condition FaultManager.Inj4Open.Mode FaultManager.Inj4Open.ID FaultManager.Inj4Open.Test FaultManager.Inj4Open.Faulty_Samples__X_ FaultManager.Inj4Open.Total_Samples__Y_ FaultManager.Inj4Open.Action_1 FaultManager.Inj4Open.Action_1_Condition FaultManager.Inj4Open.Action_2 FaultManager.Inj4Open.Action_2_Condition FaultManager.Inj4Open.Action_3 FaultManager.Inj4Open.Action_3_Condition FaultManager.Inj4Open.Action_4 FaultManager.Inj4Open.Action_4_Condition FaultManager.Inj5Open.Mode FaultManager.Inj5Open.ID FaultManager.Inj5Open.Test FaultManager.Inj5Open.Faulty_Samples__X_ FaultManager.Inj5Open.Total_Samples__Y_ FaultManager.Inj5Open.Action_1 FaultManager.Inj5Open.Action_1_Condition FaultManager.Inj5Open.Action_2 FaultManager.Inj5Open.Action_2_Condition FaultManager.Inj5Open.Action_3 FaultManager.Inj5Open.Action_3_Condition FaultManager.Inj5Open.Action_4 FaultManager.Inj5Open.Action_4_Condition FaultManager.Inj6Open.Mode FaultManager.Inj6Open.ID FaultManager.Inj6Open.Test FaultManager.Inj6Open.Faulty_Samples__X_ FaultManager.Inj6Open.Total_Samples__Y_ FaultManager.Inj6Open.Action_1 FaultManager.Inj6Open.Action_1_Condition FaultManager.Inj6Open.Action_2 FaultManager.Inj6Open.Action_2_Condition FaultManager.Inj6Open.Action_3 FaultManager.Inj6Open.Action_3_Condition FaultManager.Inj6Open.Action_4 FaultManager.Inj6Open.Action_4_Condition FaultManager.Inj7Open.Mode FaultManager.Inj7Open.ID FaultManager.Inj7Open.Test FaultManager.Inj7Open.Faulty_Samples__X_ FaultManager.Inj7Open.Total_Samples__Y_ FaultManager.Inj7Open.Action_1 FaultManager.Inj7Open.Action_1_Condition FaultManager.Inj7Open.Action_2 FaultManager.Inj7Open.Action_2_Condition FaultManager.Inj7Open.Action_3 FaultManager.Inj7Open.Action_3_Condition FaultManager.Inj7Open.Action_4 FaultManager.Inj7Open.Action_4_Condition FaultManager.Inj8Open.Mode FaultManager.Inj8Open.ID FaultManager.Inj8Open.Test FaultManager.Inj8Open.Faulty_Samples__X_ FaultManager.Inj8Open.Total_Samples__Y_ FaultManager.Inj8Open.Action_1 FaultManager.Inj8Open.Action_1_Condition FaultManager.Inj8Open.Action_2 FaultManager.Inj8Open.Action_2_Condition FaultManager.Inj8Open.Action_3 FaultManager.Inj8Open.Action_3_Condition FaultManager.Inj8Open.Action_4 FaultManager.Inj8Open.Action_4_Condition FaultManager.Lambda1Error_Fault.Mode FaultManager.Lambda1Error_Fault.ID FaultManager.Lambda1Error_Fault.Test FaultManager.Lambda1Error_Fault.Faulty_Samples__X_ FaultManager.Lambda1Error_Fault.Total_Samples__Y_ FaultManager.Lambda1Error_Fault.Action_1 FaultManager.Lambda1Error_Fault.Action_1_Condition FaultManager.Lambda1Error_Fault.Action_2 FaultManager.Lambda1Error_Fault.Action_2_Condition FaultManager.Lambda1Error_Fault.Action_3 FaultManager.Lambda1Error_Fault.Action_3_Condition FaultManager.Lambda1Error_Fault.Action_4 FaultManager.Lambda1Error_Fault.Action_4_Condition FaultManager.Lambda1Fault_Fault.Mode FaultManager.Lambda1Fault_Fault.ID FaultManager.Lambda1Fault_Fault.Test FaultManager.Lambda1Fault_Fault.Faulty_Samples__X_ FaultManager.Lambda1Fault_Fault.Total_Samples__Y_ FaultManager.Lambda1Fault_Fault.Action_1 FaultManager.Lambda1Fault_Fault.Action_1_Condition FaultManager.Lambda1Fault_Fault.Action_2 FaultManager.Lambda1Fault_Fault.Action_2_Condition FaultManager.Lambda1Fault_Fault.Action_3 FaultManager.Lambda1Fault_Fault.Action_3_Condition FaultManager.Lambda1Fault_Fault.Action_4 FaultManager.Lambda1Fault_Fault.Action_4_Condition FaultManager.Lambda1HtrOpen_Fault.Mode FaultManager.Lambda1HtrOpen_Fault.ID FaultManager.Lambda1HtrOpen_Fault.Test FaultManager.Lambda1HtrOpen_Fault.Faulty_Samples__X_ FaultManager.Lambda1HtrOpen_Fault.Total_Samples__Y_ FaultManager.Lambda1HtrOpen_Fault.Action_1 FaultManager.Lambda1HtrOpen_Fault.Action_1_Condition FaultManager.Lambda1HtrOpen_Fault.Action_2 FaultManager.Lambda1HtrOpen_Fault.Action_2_Condition FaultManager.Lambda1HtrOpen_Fault.Action_3 FaultManager.Lambda1HtrOpen_Fault.Action_3_Condition FaultManager.Lambda1HtrOpen_Fault.Action_4 FaultManager.Lambda1HtrOpen_Fault.Action_4_Condition FaultManager.Lambda1HtrShort_Fault.Mode FaultManager.Lambda1HtrShort_Fault.ID FaultManager.Lambda1HtrShort_Fault.Test FaultManager.Lambda1HtrShort_Fault.Faulty_Samples__X_ FaultManager.Lambda1HtrShort_Fault.Total_Samples__Y_ FaultManager.Lambda1HtrShort_Fault.Action_1 FaultManager.Lambda1HtrShort_Fault.Action_1_Condition FaultManager.Lambda1HtrShort_Fault.Action_2 FaultManager.Lambda1HtrShort_Fault.Action_2_Condition FaultManager.Lambda1HtrShort_Fault.Action_3 FaultManager.Lambda1HtrShort_Fault.Action_3_Condition FaultManager.Lambda1HtrShort_Fault.Action_4 FaultManager.Lambda1HtrShort_Fault.Action_4_Condition FaultManager.Lambda1Overcool_Fault.Mode FaultManager.Lambda1Overcool_Fault.ID FaultManager.Lambda1Overcool_Fault.Test FaultManager.Lambda1Overcool_Fault.Faulty_Samples__X_ FaultManager.Lambda1Overcool_Fault.Total_Samples__Y_ FaultManager.Lambda1Overcool_Fault.Action_1 FaultManager.Lambda1Overcool_Fault.Action_1_Condition FaultManager.Lambda1Overcool_Fault.Action_2 FaultManager.Lambda1Overcool_Fault.Action_2_Condition FaultManager.Lambda1Overcool_Fault.Action_3 FaultManager.Lambda1Overcool_Fault.Action_3_Condition FaultManager.Lambda1Overcool_Fault.Action_4 FaultManager.Lambda1Overcool_Fault.Action_4_Condition FaultManager.Lambda1Overheat_Fault.Mode FaultManager.Lambda1Overheat_Fault.ID FaultManager.Lambda1Overheat_Fault.Test FaultManager.Lambda1Overheat_Fault.Faulty_Samples__X_ FaultManager.Lambda1Overheat_Fault.Total_Samples__Y_ FaultManager.Lambda1Overheat_Fault.Action_1 FaultManager.Lambda1Overheat_Fault.Action_1_Condition FaultManager.Lambda1Overheat_Fault.Action_2 FaultManager.Lambda1Overheat_Fault.Action_2_Condition FaultManager.Lambda1Overheat_Fault.Action_3 FaultManager.Lambda1Overheat_Fault.Action_3_Condition FaultManager.Lambda1Overheat_Fault.Action_4 FaultManager.Lambda1Overheat_Fault.Action_4_Condition FaultManager.Lambda1StuckInReset_Fault.Mode FaultManager.Lambda1StuckInReset_Fault.ID FaultManager.Lambda1StuckInReset_Fault.Test FaultManager.Lambda1StuckInReset_Fault.Faulty_Samples__X_ FaultManager.Lambda1StuckInReset_Fault.Total_Samples__Y_ FaultManager.Lambda1StuckInReset_Fault.Action_1 FaultManager.Lambda1StuckInReset_Fault.Action_1_Condition FaultManager.Lambda1StuckInReset_Fault.Action_2 FaultManager.Lambda1StuckInReset_Fault.Action_2_Condition FaultManager.Lambda1StuckInReset_Fault.Action_3 FaultManager.Lambda1StuckInReset_Fault.Action_3_Condition FaultManager.Lambda1StuckInReset_Fault.Action_4 FaultManager.Lambda1StuckInReset_Fault.Action_4_Condition FaultManager.Lambda1StuckInWarmup_Fault.Mode FaultManager.Lambda1StuckInWarmup_Fault.ID FaultManager.Lambda1StuckInWarmup_Fault.Test FaultManager.Lambda1StuckInWarmup_Fault.Faulty_Samples__X_ FaultManager.Lambda1StuckInWarmup_Fault.Total_Samples__Y_ FaultManager.Lambda1StuckInWarmup_Fault.Action_1 FaultManager.Lambda1StuckInWarmup_Fault.Action_1_Condition FaultManager.Lambda1StuckInWarmup_Fault.Action_2 FaultManager.Lambda1StuckInWarmup_Fault.Action_2_Condition FaultManager.Lambda1StuckInWarmup_Fault.Action_3 FaultManager.Lambda1StuckInWarmup_Fault.Action_3_Condition FaultManager.Lambda1StuckInWarmup_Fault.Action_4 FaultManager.Lambda1StuckInWarmup_Fault.Action_4_Condition FaultManager.Lambda1VoltHigh_Fault.Mode FaultManager.Lambda1VoltHigh_Fault.ID FaultManager.Lambda1VoltHigh_Fault.Test FaultManager.Lambda1VoltHigh_Fault.Faulty_Samples__X_ FaultManager.Lambda1VoltHigh_Fault.Total_Samples__Y_ FaultManager.Lambda1VoltHigh_Fault.Action_1 FaultManager.Lambda1VoltHigh_Fault.Action_1_Condition FaultManager.Lambda1VoltHigh_Fault.Action_2 FaultManager.Lambda1VoltHigh_Fault.Action_2_Condition FaultManager.Lambda1VoltHigh_Fault.Action_3 FaultManager.Lambda1VoltHigh_Fault.Action_3_Condition FaultManager.Lambda1VoltHigh_Fault.Action_4 FaultManager.Lambda1VoltHigh_Fault.Action_4_Condition FaultManager.Lambda1VoltLow_Fault.Mode FaultManager.Lambda1VoltLow_Fault.ID FaultManager.Lambda1VoltLow_Fault.Test FaultManager.Lambda1VoltLow_Fault.Faulty_Samples__X_ FaultManager.Lambda1VoltLow_Fault.Total_Samples__Y_ FaultManager.Lambda1VoltLow_Fault.Action_1 FaultManager.Lambda1VoltLow_Fault.Action_1_Condition FaultManager.Lambda1VoltLow_Fault.Action_2 FaultManager.Lambda1VoltLow_Fault.Action_2_Condition FaultManager.Lambda1VoltLow_Fault.Action_3 FaultManager.Lambda1VoltLow_Fault.Action_3_Condition FaultManager.Lambda1VoltLow_Fault.Action_4 FaultManager.Lambda1VoltLow_Fault.Action_4_Condition FaultManager.Lambda2Error_Fault.Mode FaultManager.Lambda2Error_Fault.ID FaultManager.Lambda2Error_Fault.Test FaultManager.Lambda2Error_Fault.Faulty_Samples__X_ FaultManager.Lambda2Error_Fault.Total_Samples__Y_ FaultManager.Lambda2Error_Fault.Action_1 FaultManager.Lambda2Error_Fault.Action_1_Condition FaultManager.Lambda2Error_Fault.Action_2 FaultManager.Lambda2Error_Fault.Action_2_Condition FaultManager.Lambda2Error_Fault.Action_3 FaultManager.Lambda2Error_Fault.Action_3_Condition FaultManager.Lambda2Error_Fault.Action_4 FaultManager.Lambda2Error_Fault.Action_4_Condition FaultManager.Lambda2Fault_Fault.Mode FaultManager.Lambda2Fault_Fault.ID FaultManager.Lambda2Fault_Fault.Test FaultManager.Lambda2Fault_Fault.Faulty_Samples__X_ FaultManager.Lambda2Fault_Fault.Total_Samples__Y_ FaultManager.Lambda2Fault_Fault.Action_1 FaultManager.Lambda2Fault_Fault.Action_1_Condition FaultManager.Lambda2Fault_Fault.Action_2 FaultManager.Lambda2Fault_Fault.Action_2_Condition FaultManager.Lambda2Fault_Fault.Action_3 FaultManager.Lambda2Fault_Fault.Action_3_Condition FaultManager.Lambda2Fault_Fault.Action_4 FaultManager.Lambda2Fault_Fault.Action_4_Condition FaultManager.Lambda2HtrOpen_Fault.Mode FaultManager.Lambda2HtrOpen_Fault.ID FaultManager.Lambda2HtrOpen_Fault.Test FaultManager.Lambda2HtrOpen_Fault.Faulty_Samples__X_ FaultManager.Lambda2HtrOpen_Fault.Total_Samples__Y_ FaultManager.Lambda2HtrOpen_Fault.Action_1 FaultManager.Lambda2HtrOpen_Fault.Action_1_Condition FaultManager.Lambda2HtrOpen_Fault.Action_2 FaultManager.Lambda2HtrOpen_Fault.Action_2_Condition FaultManager.Lambda2HtrOpen_Fault.Action_3 /end DEF_CHARACTERISTIC
/end FUNCTION
/end MODULE
/end PROJECT
