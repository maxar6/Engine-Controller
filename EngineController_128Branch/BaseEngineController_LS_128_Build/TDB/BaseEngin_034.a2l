ASAP2_VERSION 1 51
/begin PROJECT Project ""
/begin MODULE BaseEngin_034 ""
/begin MOD_COMMON /* MOD_COMMON Comment */ "" BYTE_ORDER MSB_FIRST ALIGNMENT_BYTE 1 ALIGNMENT_FLOAT32_IEEE 1 ALIGNMENT_FLOAT64_IEEE 1 ALIGNMENT_LONG 1 ALIGNMENT_WORD 1 /end MOD_COMMON
/begin CHARACTERISTIC FaultManager.EST4_Open.Action_2_Condition "Fault manager configuration.  Select up to 4 actions for each fault." VALUE 0x80002D46 RecordLayout_4 0 CompuMethod_116 0 65535 /end CHARACTERISTIC
/begin CHARACTERISTIC FaultManager.EST4_Open.Action_3 "Fault manager configuration.  Select up to 4 actions for each fault." VALUE 0x80002D48 RecordLayout_4 0 CompuMethod_115 0 65535 /end CHARACTERISTIC
/begin CHARACTERISTIC FaultManager.EST4_Open.Action_3_Condition "Fault manager configuration.  Select up to 4 actions for each fault." VALUE 0x80002D4A RecordLayout_4 0 CompuMethod_116 0 65535 /end CHARACTERISTIC
/begin CHARACTERISTIC FaultManager.EST4_Open.Action_4 "Fault manager configuration.  Select up to 4 actions for each fault." VALUE 0x80002D4C RecordLayout_4 0 CompuMethod_115 0 65535 /end CHARACTERISTIC
/begin CHARACTERISTIC FaultManager.EST4_Open.Action_4_Condition "Fault manager configuration.  Select up to 4 actions for each fault." VALUE 0x80002D4E RecordLayout_4 0 CompuMethod_116 0 65535 /end CHARACTERISTIC
/begin CHARACTERISTIC FaultManager.EST4_Short.Mode "Fault manager configuration.  Select up to 4 actions for each fault." VALUE 0x80002D50 RecordLayout_4 0 CompuMethod_113 0 65535 /end CHARACTERISTIC
/begin CHARACTERISTIC FaultManager.EST4_Short.ID "Fault manager configuration.  Select up to 4 actions for each fault." VALUE 0x80002D52 RecordLayout_4 0 CompuMethod_1 0 65535 /end CHARACTERISTIC
/begin CHARACTERISTIC FaultManager.EST4_Short.Test "Fault manager configuration.  Select up to 4 actions for each fault." VALUE 0x80002D54 RecordLayout_4 0 CompuMethod_114 0 65535 /end CHARACTERISTIC
/begin CHARACTERISTIC FaultManager.EST4_Short.Faulty_Samples__X_ "Fault manager configuration.  Select up to 4 actions for each fault." VALUE 0x80002D56 RecordLayout_4 0 CompuMethod_1 0 65535 /end CHARACTERISTIC
/begin CHARACTERISTIC FaultManager.EST4_Short.Total_Samples__Y_ "Fault manager configuration.  Select up to 4 actions for each fault." VALUE 0x80002D58 RecordLayout_4 0 CompuMethod_1 0 65535 /end CHARACTERISTIC
/begin CHARACTERISTIC FaultManager.EST4_Short.Action_1 "Fault manager configuration.  Select up to 4 actions for each fault." VALUE 0x80002D5A RecordLayout_4 0 CompuMethod_115 0 65535 /end CHARACTERISTIC
/begin CHARACTERISTIC FaultManager.EST4_Short.Action_1_Condition "Fault manager configuration.  Select up to 4 actions for each fault." VALUE 0x80002D5C RecordLayout_4 0 CompuMethod_116 0 65535 /end CHARACTERISTIC
/begin CHARACTERISTIC FaultManager.EST4_Short.Action_2 "Fault manager configuration.  Select up to 4 actions for each fault." VALUE 0x80002D5E RecordLayout_4 0 CompuMethod_115 0 65535 /end CHARACTERISTIC
/begin CHARACTERISTIC FaultManager.EST4_Short.Action_2_Condition "Fault manager configuration.  Select up to 4 actions for each fault." VALUE 0x80002D60 RecordLayout_4 0 CompuMethod_116 0 65535 /end CHARACTERISTIC
/begin CHARACTERISTIC FaultManager.EST4_Short.Action_3 "Fault manager configuration.  Select up to 4 actions for each fault." VALUE 0x80002D62 RecordLayout_4 0 CompuMethod_115 0 65535 /end CHARACTERISTIC
/begin CHARACTERISTIC FaultManager.EST4_Short.Action_3_Condition "Fault manager configuration.  Select up to 4 actions for each fault." VALUE 0x80002D64 RecordLayout_4 0 CompuMethod_116 0 65535 /end CHARACTERISTIC
/begin CHARACTERISTIC FaultManager.EST4_Short.Action_4 "Fault manager configuration.  Select up to 4 actions for each fault." VALUE 0x80002D66 RecordLayout_4 0 CompuMethod_115 0 65535 /end CHARACTERISTIC
/begin CHARACTERISTIC FaultManager.EST4_Short.Action_4_Condition "Fault manager configuration.  Select up to 4 actions for each fault." VALUE 0x80002D68 RecordLayout_4 0 CompuMethod_116 0 65535 /end CHARACTERISTIC
/begin CHARACTERISTIC FaultManager.EST5_Open.Mode "Fault manager configuration.  Select up to 4 actions for each fault." VALUE 0x80002D6A RecordLayout_4 0 CompuMethod_113 0 65535 /end CHARACTERISTIC
/begin CHARACTERISTIC FaultManager.EST5_Open.ID "Fault manager configuration.  Select up to 4 actions for each fault." VALUE 0x80002D6C RecordLayout_4 0 CompuMethod_1 0 65535 /end CHARACTERISTIC
/begin CHARACTERISTIC FaultManager.EST5_Open.Test "Fault manager configuration.  Select up to 4 actions for each fault." VALUE 0x80002D6E RecordLayout_4 0 CompuMethod_114 0 65535 /end CHARACTERISTIC
/begin CHARACTERISTIC FaultManager.EST5_Open.Faulty_Samples__X_ "Fault manager configuration.  Select up to 4 actions for each fault." VALUE 0x80002D70 RecordLayout_4 0 CompuMethod_1 0 65535 /end CHARACTERISTIC
/begin CHARACTERISTIC FaultManager.EST5_Open.Total_Samples__Y_ "Fault manager configuration.  Select up to 4 actions for each fault." VALUE 0x80002D72 RecordLayout_4 0 CompuMethod_1 0 65535 /end CHARACTERISTIC
/begin CHARACTERISTIC FaultManager.EST5_Open.Action_1 "Fault manager configuration.  Select up to 4 actions for each fault." VALUE 0x80002D74 RecordLayout_4 0 CompuMethod_115 0 65535 /end CHARACTERISTIC
/begin CHARACTERISTIC FaultManager.EST5_Open.Action_1_Condition "Fault manager configuration.  Select up to 4 actions for each fault." VALUE 0x80002D76 RecordLayout_4 0 CompuMethod_116 0 65535 /end CHARACTERISTIC
/begin CHARACTERISTIC FaultManager.EST5_Open.Action_2 "Fault manager configuration.  Select up to 4 actions for each fault." VALUE 0x80002D78 RecordLayout_4 0 CompuMethod_115 0 65535 /end CHARACTERISTIC
/begin CHARACTERISTIC FaultManager.EST5_Open.Action_2_Condition "Fault manager configuration.  Select up to 4 actions for each fault." VALUE 0x80002D7A RecordLayout_4 0 CompuMethod_116 0 65535 /end CHARACTERISTIC
/begin CHARACTERISTIC FaultManager.EST5_Open.Action_3 "Fault manager configuration.  Select up to 4 actions for each fault." VALUE 0x80002D7C RecordLayout_4 0 CompuMethod_115 0 65535 /end CHARACTERISTIC
/begin CHARACTERISTIC FaultManager.EST5_Open.Action_3_Condition "Fault manager configuration.  Select up to 4 actions for each fault." VALUE 0x80002D7E RecordLayout_4 0 CompuMethod_116 0 65535 /end CHARACTERISTIC
/begin CHARACTERISTIC FaultManager.EST5_Open.Action_4 "Fault manager configuration.  Select up to 4 actions for each fault." VALUE 0x80002D80 RecordLayout_4 0 CompuMethod_115 0 65535 /end CHARACTERISTIC
/begin CHARACTERISTIC FaultManager.EST5_Open.Action_4_Condition "Fault manager configuration.  Select up to 4 actions for each fault." VALUE 0x80002D82 RecordLayout_4 0 CompuMethod_116 0 65535 /end CHARACTERISTIC
/begin CHARACTERISTIC FaultManager.EST5_Short.Mode "Fault manager configuration.  Select up to 4 actions for each fault." VALUE 0x80002D84 RecordLayout_4 0 CompuMethod_113 0 65535 /end CHARACTERISTIC
/begin CHARACTERISTIC FaultManager.EST5_Short.ID "Fault manager configuration.  Select up to 4 actions for each fault." VALUE 0x80002D86 RecordLayout_4 0 CompuMethod_1 0 65535 /end CHARACTERISTIC
/begin CHARACTERISTIC FaultManager.EST5_Short.Test "Fault manager configuration.  Select up to 4 actions for each fault." VALUE 0x80002D88 RecordLayout_4 0 CompuMethod_114 0 65535 /end CHARACTERISTIC
/begin CHARACTERISTIC FaultManager.EST5_Short.Faulty_Samples__X_ "Fault manager configuration.  Select up to 4 actions for each fault." VALUE 0x80002D8A RecordLayout_4 0 CompuMethod_1 0 65535 /end CHARACTERISTIC
/begin CHARACTERISTIC FaultManager.EST5_Short.Total_Samples__Y_ "Fault manager configuration.  Select up to 4 actions for each fault." VALUE 0x80002D8C RecordLayout_4 0 CompuMethod_1 0 65535 /end CHARACTERISTIC
/begin CHARACTERISTIC FaultManager.EST5_Short.Action_1 "Fault manager configuration.  Select up to 4 actions for each fault." VALUE 0x80002D8E RecordLayout_4 0 CompuMethod_115 0 65535 /end CHARACTERISTIC
/begin CHARACTERISTIC FaultManager.EST5_Short.Action_1_Condition "Fault manager configuration.  Select up to 4 actions for each fault." VALUE 0x80002D90 RecordLayout_4 0 CompuMethod_116 0 65535 /end CHARACTERISTIC
/begin CHARACTERISTIC FaultManager.EST5_Short.Action_2 "Fault manager configuration.  Select up to 4 actions for each fault." VALUE 0x80002D92 RecordLayout_4 0 CompuMethod_115 0 65535 /end CHARACTERISTIC
/begin CHARACTERISTIC FaultManager.EST5_Short.Action_2_Condition "Fault manager configuration.  Select up to 4 actions for each fault." VALUE 0x80002D94 RecordLayout_4 0 CompuMethod_116 0 65535 /end CHARACTERISTIC
/begin CHARACTERISTIC FaultManager.EST5_Short.Action_3 "Fault manager configuration.  Select up to 4 actions for each fault." VALUE 0x80002D96 RecordLayout_4 0 CompuMethod_115 0 65535 /end CHARACTERISTIC
/begin CHARACTERISTIC FaultManager.EST5_Short.Action_3_Condition "Fault manager configuration.  Select up to 4 actions for each fault." VALUE 0x80002D98 RecordLayout_4 0 CompuMethod_116 0 65535 /end CHARACTERISTIC
/begin CHARACTERISTIC FaultManager.EST5_Short.Action_4 "Fault manager configuration.  Select up to 4 actions for each fault." VALUE 0x80002D9A RecordLayout_4 0 CompuMethod_115 0 65535 /end CHARACTERISTIC
/begin CHARACTERISTIC FaultManager.EST5_Short.Action_4_Condition "Fault manager configuration.  Select up to 4 actions for each fault." VALUE 0x80002D9C RecordLayout_4 0 CompuMethod_116 0 65535 /end CHARACTERISTIC
/begin CHARACTERISTIC FaultManager.EST6_Open.Mode "Fault manager configuration.  Select up to 4 actions for each fault." VALUE 0x80002D9E RecordLayout_4 0 CompuMethod_113 0 65535 /end CHARACTERISTIC
/begin CHARACTERISTIC FaultManager.EST6_Open.ID "Fault manager configuration.  Select up to 4 actions for each fault." VALUE 0x80002DA0 RecordLayout_4 0 CompuMethod_1 0 65535 /end CHARACTERISTIC
/begin CHARACTERISTIC FaultManager.EST6_Open.Test "Fault manager configuration.  Select up to 4 actions for each fault." VALUE 0x80002DA2 RecordLayout_4 0 CompuMethod_114 0 65535 /end CHARACTERISTIC
/begin CHARACTERISTIC FaultManager.EST6_Open.Faulty_Samples__X_ "Fault manager configuration.  Select up to 4 actions for each fault." VALUE 0x80002DA4 RecordLayout_4 0 CompuMethod_1 0 65535 /end CHARACTERISTIC
/begin CHARACTERISTIC FaultManager.EST6_Open.Total_Samples__Y_ "Fault manager configuration.  Select up to 4 actions for each fault." VALUE 0x80002DA6 RecordLayout_4 0 CompuMethod_1 0 65535 /end CHARACTERISTIC
/begin CHARACTERISTIC FaultManager.EST6_Open.Action_1 "Fault manager configuration.  Select up to 4 actions for each fault." VALUE 0x80002DA8 RecordLayout_4 0 CompuMethod_115 0 65535 /end CHARACTERISTIC
/begin CHARACTERISTIC FaultManager.EST6_Open.Action_1_Condition "Fault manager configuration.  Select up to 4 actions for each fault." VALUE 0x80002DAA RecordLayout_4 0 CompuMethod_116 0 65535 /end CHARACTERISTIC
/begin CHARACTERISTIC FaultManager.EST6_Open.Action_2 "Fault manager configuration.  Select up to 4 actions for each fault." VALUE 0x80002DAC RecordLayout_4 0 CompuMethod_115 0 65535 /end CHARACTERISTIC
/begin CHARACTERISTIC FaultManager.EST6_Open.Action_2_Condition "Fault manager configuration.  Select up to 4 actions for each fault." VALUE 0x80002DAE RecordLayout_4 0 CompuMethod_116 0 65535 /end CHARACTERISTIC
/begin CHARACTERISTIC FaultManager.EST6_Open.Action_3 "Fault manager configuration.  Select up to 4 actions for each fault." VALUE 0x80002DB0 RecordLayout_4 0 CompuMethod_115 0 65535 /end CHARACTERISTIC
/begin CHARACTERISTIC FaultManager.EST6_Open.Action_3_Condition "Fault manager configuration.  Select up to 4 actions for each fault." VALUE 0x80002DB2 RecordLayout_4 0 CompuMethod_116 0 65535 /end CHARACTERISTIC
/begin CHARACTERISTIC FaultManager.EST6_Open.Action_4 "Fault manager configuration.  Select up to 4 actions for each fault." VALUE 0x80002DB4 RecordLayout_4 0 CompuMethod_115 0 65535 /end CHARACTERISTIC
/begin CHARACTERISTIC FaultManager.EST6_Open.Action_4_Condition "Fault manager configuration.  Select up to 4 actions for each fault." VALUE 0x80002DB6 RecordLayout_4 0 CompuMethod_116 0 65535 /end CHARACTERISTIC
/begin CHARACTERISTIC FaultManager.EST6_Short.Mode "Fault manager configuration.  Select up to 4 actions for each fault." VALUE 0x80002DB8 RecordLayout_4 0 CompuMethod_113 0 65535 /end CHARACTERISTIC
/begin CHARACTERISTIC FaultManager.EST6_Short.ID "Fault manager configuration.  Select up to 4 actions for each fault." VALUE 0x80002DBA RecordLayout_4 0 CompuMethod_1 0 65535 /end CHARACTERISTIC
/begin CHARACTERISTIC FaultManager.EST6_Short.Test "Fault manager configuration.  Select up to 4 actions for each fault." VALUE 0x80002DBC RecordLayout_4 0 CompuMethod_114 0 65535 /end CHARACTERISTIC
/begin CHARACTERISTIC FaultManager.EST6_Short.Faulty_Samples__X_ "Fault manager configuration.  Select up to 4 actions for each fault." VALUE 0x80002DBE RecordLayout_4 0 CompuMethod_1 0 65535 /end CHARACTERISTIC
/begin CHARACTERISTIC FaultManager.EST6_Short.Total_Samples__Y_ "Fault manager configuration.  Select up to 4 actions for each fault." VALUE 0x80002DC0 RecordLayout_4 0 CompuMethod_1 0 65535 /end CHARACTERISTIC
/begin CHARACTERISTIC FaultManager.EST6_Short.Action_1 "Fault manager configuration.  Select up to 4 actions for each fault." VALUE 0x80002DC2 RecordLayout_4 0 CompuMethod_115 0 65535 /end CHARACTERISTIC
/begin CHARACTERISTIC FaultManager.EST6_Short.Action_1_Condition "Fault manager configuration.  Select up to 4 actions for each fault." VALUE 0x80002DC4 RecordLayout_4 0 CompuMethod_116 0 65535 /end CHARACTERISTIC
/begin CHARACTERISTIC FaultManager.EST6_Short.Action_2 "Fault manager configuration.  Select up to 4 actions for each fault." VALUE 0x80002DC6 RecordLayout_4 0 CompuMethod_115 0 65535 /end CHARACTERISTIC
/begin CHARACTERISTIC FaultManager.EST6_Short.Action_2_Condition "Fault manager configuration.  Select up to 4 actions for each fault." VALUE 0x80002DC8 RecordLayout_4 0 CompuMethod_116 0 65535 /end CHARACTERISTIC
/begin CHARACTERISTIC FaultManager.EST6_Short.Action_3 "Fault manager configuration.  Select up to 4 actions for each fault." VALUE 0x80002DCA RecordLayout_4 0 CompuMethod_115 0 65535 /end CHARACTERISTIC
/begin CHARACTERISTIC FaultManager.EST6_Short.Action_3_Condition "Fault manager configuration.  Select up to 4 actions for each fault." VALUE 0x80002DCC RecordLayout_4 0 CompuMethod_116 0 65535 /end CHARACTERISTIC
/begin CHARACTERISTIC FaultManager.EST6_Short.Action_4 "Fault manager configuration.  Select up to 4 actions for each fault." VALUE 0x80002DCE RecordLayout_4 0 CompuMethod_115 0 65535 /end CHARACTERISTIC
/begin CHARACTERISTIC FaultManager.EST6_Short.Action_4_Condition "Fault manager configuration.  Select up to 4 actions for each fault." VALUE 0x80002DD0 RecordLayout_4 0 CompuMethod_116 0 65535 /end CHARACTERISTIC
/begin CHARACTERISTIC FaultManager.EST7_Open.Mode "Fault manager configuration.  Select up to 4 actions for each fault." VALUE 0x80002DD2 RecordLayout_4 0 CompuMethod_113 0 65535 /end CHARACTERISTIC
/begin CHARACTERISTIC FaultManager.EST7_Open.ID "Fault manager configuration.  Select up to 4 actions for each fault." VALUE 0x80002DD4 RecordLayout_4 0 CompuMethod_1 0 65535 /end CHARACTERISTIC
/begin CHARACTERISTIC FaultManager.EST7_Open.Test "Fault manager configuration.  Select up to 4 actions for each fault." VALUE 0x80002DD6 RecordLayout_4 0 CompuMethod_114 0 65535 /end CHARACTERISTIC
/begin CHARACTERISTIC FaultManager.EST7_Open.Faulty_Samples__X_ "Fault manager configuration.  Select up to 4 actions for each fault." VALUE 0x80002DD8 RecordLayout_4 0 CompuMethod_1 0 65535 /end CHARACTERISTIC
/begin CHARACTERISTIC FaultManager.EST7_Open.Total_Samples__Y_ "Fault manager configuration.  Select up to 4 actions for each fault." VALUE 0x80002DDA RecordLayout_4 0 CompuMethod_1 0 65535 /end CHARACTERISTIC
/begin CHARACTERISTIC FaultManager.EST7_Open.Action_1 "Fault manager configuration.  Select up to 4 actions for each fault." VALUE 0x80002DDC RecordLayout_4 0 CompuMethod_115 0 65535 /end CHARACTERISTIC
/begin CHARACTERISTIC FaultManager.EST7_Open.Action_1_Condition "Fault manager configuration.  Select up to 4 actions for each fault." VALUE 0x80002DDE RecordLayout_4 0 CompuMethod_116 0 65535 /end CHARACTERISTIC
/begin CHARACTERISTIC FaultManager.EST7_Open.Action_2 "Fault manager configuration.  Select up to 4 actions for each fault." VALUE 0x80002DE0 RecordLayout_4 0 CompuMethod_115 0 65535 /end CHARACTERISTIC
/begin CHARACTERISTIC FaultManager.EST7_Open.Action_2_Condition "Fault manager configuration.  Select up to 4 actions for each fault." VALUE 0x80002DE2 RecordLayout_4 0 CompuMethod_116 0 65535 /end CHARACTERISTIC
/begin CHARACTERISTIC FaultManager.EST7_Open.Action_3 "Fault manager configuration.  Select up to 4 actions for each fault." VALUE 0x80002DE4 RecordLayout_4 0 CompuMethod_115 0 65535 /end CHARACTERISTIC
/begin CHARACTERISTIC FaultManager.EST7_Open.Action_3_Condition "Fault manager configuration.  Select up to 4 actions for each fault." VALUE 0x80002DE6 RecordLayout_4 0 CompuMethod_116 0 65535 /end CHARACTERISTIC
/begin CHARACTERISTIC FaultManager.EST7_Open.Action_4 "Fault manager configuration.  Select up to 4 actions for each fault." VALUE 0x80002DE8 RecordLayout_4 0 CompuMethod_115 0 65535 /end CHARACTERISTIC
/begin CHARACTERISTIC FaultManager.EST7_Open.Action_4_Condition "Fault manager configuration.  Select up to 4 actions for each fault." VALUE 0x80002DEA RecordLayout_4 0 CompuMethod_116 0 65535 /end CHARACTERISTIC
/begin CHARACTERISTIC FaultManager.EST7_Short.Mode "Fault manager configuration.  Select up to 4 actions for each fault." VALUE 0x80002DEC RecordLayout_4 0 CompuMethod_113 0 65535 /end CHARACTERISTIC
/begin CHARACTERISTIC FaultManager.EST7_Short.ID "Fault manager configuration.  Select up to 4 actions for each fault." VALUE 0x80002DEE RecordLayout_4 0 CompuMethod_1 0 65535 /end CHARACTERISTIC
/begin CHARACTERISTIC FaultManager.EST7_Short.Test "Fault manager configuration.  Select up to 4 actions for each fault." VALUE 0x80002DF0 RecordLayout_4 0 CompuMethod_114 0 65535 /end CHARACTERISTIC
/begin CHARACTERISTIC FaultManager.EST7_Short.Faulty_Samples__X_ "Fault manager configuration.  Select up to 4 actions for each fault." VALUE 0x80002DF2 RecordLayout_4 0 CompuMethod_1 0 65535 /end CHARACTERISTIC
/begin CHARACTERISTIC FaultManager.EST7_Short.Total_Samples__Y_ "Fault manager configuration.  Select up to 4 actions for each fault." VALUE 0x80002DF4 RecordLayout_4 0 CompuMethod_1 0 65535 /end CHARACTERISTIC
/begin CHARACTERISTIC FaultManager.EST7_Short.Action_1 "Fault manager configuration.  Select up to 4 actions for each fault." VALUE 0x80002DF6 RecordLayout_4 0 CompuMethod_115 0 65535 /end CHARACTERISTIC
/begin CHARACTERISTIC FaultManager.EST7_Short.Action_1_Condition "Fault manager configuration.  Select up to 4 actions for each fault." VALUE 0x80002DF8 RecordLayout_4 0 CompuMethod_116 0 65535 /end CHARACTERISTIC
/begin CHARACTERISTIC FaultManager.EST7_Short.Action_2 "Fault manager configuration.  Select up to 4 actions for each fault." VALUE 0x80002DFA RecordLayout_4 0 CompuMethod_115 0 65535 /end CHARACTERISTIC
/begin CHARACTERISTIC FaultManager.EST7_Short.Action_2_Condition "Fault manager configuration.  Select up to 4 actions for each fault." VALUE 0x80002DFC RecordLayout_4 0 CompuMethod_116 0 65535 /end CHARACTERISTIC
/begin CHARACTERISTIC FaultManager.EST7_Short.Action_3 "Fault manager configuration.  Select up to 4 actions for each fault." VALUE 0x80002DFE RecordLayout_4 0 CompuMethod_115 0 65535 /end CHARACTERISTIC
/begin CHARACTERISTIC FaultManager.EST7_Short.Action_3_Condition "Fault manager configuration.  Select up to 4 actions for each fault." VALUE 0x80002E00 RecordLayout_4 0 CompuMethod_116 0 65535 /end CHARACTERISTIC
/begin CHARACTERISTIC FaultManager.EST7_Short.Action_4 "Fault manager configuration.  Select up to 4 actions for each fault." VALUE 0x80002E02 RecordLayout_4 0 CompuMethod_115 0 65535 /end CHARACTERISTIC
/begin CHARACTERISTIC FaultManager.EST7_Short.Action_4_Condition "Fault manager configuration.  Select up to 4 actions for each fault." VALUE 0x80002E04 RecordLayout_4 0 CompuMethod_116 0 65535 /end CHARACTERISTIC
/begin CHARACTERISTIC FaultManager.EST8_Open.Mode "Fault manager configuration.  Select up to 4 actions for each fault." VALUE 0x80002E06 RecordLayout_4 0 CompuMethod_113 0 65535 /end CHARACTERISTIC
/begin CHARACTERISTIC FaultManager.EST8_Open.ID "Fault manager configuration.  Select up to 4 actions for each fault." VALUE 0x80002E08 RecordLayout_4 0 CompuMethod_1 0 65535 /end CHARACTERISTIC
/begin CHARACTERISTIC FaultManager.EST8_Open.Test "Fault manager configuration.  Select up to 4 actions for each fault." VALUE 0x80002E0A RecordLayout_4 0 CompuMethod_114 0 65535 /end CHARACTERISTIC
/begin CHARACTERISTIC FaultManager.EST8_Open.Faulty_Samples__X_ "Fault manager configuration.  Select up to 4 actions for each fault." VALUE 0x80002E0C RecordLayout_4 0 CompuMethod_1 0 65535 /end CHARACTERISTIC
/begin CHARACTERISTIC FaultManager.EST8_Open.Total_Samples__Y_ "Fault manager configuration.  Select up to 4 actions for each fault." VALUE 0x80002E0E RecordLayout_4 0 CompuMethod_1 0 65535 /end CHARACTERISTIC
/begin CHARACTERISTIC FaultManager.EST8_Open.Action_1 "Fault manager configuration.  Select up to 4 actions for each fault." VALUE 0x80002E10 RecordLayout_4 0 CompuMethod_115 0 65535 /end CHARACTERISTIC
/begin CHARACTERISTIC FaultManager.EST8_Open.Action_1_Condition "Fault manager configuration.  Select up to 4 actions for each fault." VALUE 0x80002E12 RecordLayout_4 0 CompuMethod_116 0 65535 /end CHARACTERISTIC
/begin CHARACTERISTIC FaultManager.EST8_Open.Action_2 "Fault manager configuration.  Select up to 4 actions for each fault." VALUE 0x80002E14 RecordLayout_4 0 CompuMethod_115 0 65535 /end CHARACTERISTIC
/begin CHARACTERISTIC FaultManager.EST8_Open.Action_2_Condition "Fault manager configuration.  Select up to 4 actions for each fault." VALUE 0x80002E16 RecordLayout_4 0 CompuMethod_116 0 65535 /end CHARACTERISTIC
/begin CHARACTERISTIC FaultManager.EST8_Open.Action_3 "Fault manager configuration.  Select up to 4 actions for each fault." VALUE 0x80002E18 RecordLayout_4 0 CompuMethod_115 0 65535 /end CHARACTERISTIC
/begin CHARACTERISTIC FaultManager.EST8_Open.Action_3_Condition "Fault manager configuration.  Select up to 4 actions for each fault." VALUE 0x80002E1A RecordLayout_4 0 CompuMethod_116 0 65535 /end CHARACTERISTIC
/begin CHARACTERISTIC FaultManager.EST8_Open.Action_4 "Fault manager configuration.  Select up to 4 actions for each fault." VALUE 0x80002E1C RecordLayout_4 0 CompuMethod_115 0 65535 /end CHARACTERISTIC
/begin CHARACTERISTIC FaultManager.EST8_Open.Action_4_Condition "Fault manager configuration.  Select up to 4 actions for each fault." VALUE 0x80002E1E RecordLayout_4 0 CompuMethod_116 0 65535 /end CHARACTERISTIC
/begin CHARACTERISTIC FaultManager.EST8_Short.Mode "Fault manager configuration.  Select up to 4 actions for each fault." VALUE 0x80002E20 RecordLayout_4 0 CompuMethod_113 0 65535 /end CHARACTERISTIC
/begin CHARACTERISTIC FaultManager.EST8_Short.ID "Fault manager configuration.  Select up to 4 actions for each fault." VALUE 0x80002E22 RecordLayout_4 0 CompuMethod_1 0 65535 /end CHARACTERISTIC
/begin CHARACTERISTIC FaultManager.EST8_Short.Test "Fault manager configuration.  Select up to 4 actions for each fault." VALUE 0x80002E24 RecordLayout_4 0 CompuMethod_114 0 65535 /end CHARACTERISTIC
/begin CHARACTERISTIC FaultManager.EST8_Short.Faulty_Samples__X_ "Fault manager configuration.  Select up to 4 actions for each fault." VALUE 0x80002E26 RecordLayout_4 0 CompuMethod_1 0 65535 /end CHARACTERISTIC
/begin CHARACTERISTIC FaultManager.EST8_Short.Total_Samples__Y_ "Fault manager configuration.  Select up to 4 actions for each fault." VALUE 0x80002E28 RecordLayout_4 0 CompuMethod_1 0 65535 /end CHARACTERISTIC
/begin CHARACTERISTIC FaultManager.EST8_Short.Action_1 "Fault manager configuration.  Select up to 4 actions for each fault." VALUE 0x80002E2A RecordLayout_4 0 CompuMethod_115 0 65535 /end CHARACTERISTIC
/begin CHARACTERISTIC FaultManager.EST8_Short.Action_1_Condition "Fault manager configuration.  Select up to 4 actions for each fault." VALUE 0x80002E2C RecordLayout_4 0 CompuMethod_116 0 65535 /end CHARACTERISTIC
/begin CHARACTERISTIC FaultManager.EST8_Short.Action_2 "Fault manager configuration.  Select up to 4 actions for each fault." VALUE 0x80002E2E RecordLayout_4 0 CompuMethod_115 0 65535 /end CHARACTERISTIC
/begin CHARACTERISTIC FaultManager.EST8_Short.Action_2_Condition "Fault manager configuration.  Select up to 4 actions for each fault." VALUE 0x80002E30 RecordLayout_4 0 CompuMethod_116 0 65535 /end CHARACTERISTIC
/begin CHARACTERISTIC FaultManager.EST8_Short.Action_3 "Fault manager configuration.  Select up to 4 actions for each fault." VALUE 0x80002E32 RecordLayout_4 0 CompuMethod_115 0 65535 /end CHARACTERISTIC
/begin CHARACTERISTIC FaultManager.EST8_Short.Action_3_Condition "Fault manager configuration.  Select up to 4 actions for each fault." VALUE 0x80002E34 RecordLayout_4 0 CompuMethod_116 0 65535 /end CHARACTERISTIC
/begin CHARACTERISTIC FaultManager.EST8_Short.Action_4 "Fault manager configuration.  Select up to 4 actions for each fault." VALUE 0x80002E36 RecordLayout_4 0 CompuMethod_115 0 65535 /end CHARACTERISTIC
/begin CHARACTERISTIC FaultManager.EST8_Short.Action_4_Condition "Fault manager configuration.  Select up to 4 actions for each fault." VALUE 0x80002E38 RecordLayout_4 0 CompuMethod_116 0 65535 /end CHARACTERISTIC
/begin CHARACTERISTIC FaultManager.ETCSpringTest.Mode "Fault manager configuration.  Select up to 4 actions for each fault." VALUE 0x80002E3A RecordLayout_4 0 CompuMethod_113 0 65535 /end CHARACTERISTIC
/begin CHARACTERISTIC FaultManager.ETCSpringTest.ID "Fault manager configuration.  Select up to 4 actions for each fault." VALUE 0x80002E3C RecordLayout_4 0 CompuMethod_1 0 65535 /end CHARACTERISTIC
/begin CHARACTERISTIC FaultManager.ETCSpringTest.Test "Fault manager configuration.  Select up to 4 actions for each fault." VALUE 0x80002E3E RecordLayout_4 0 CompuMethod_114 0 65535 /end CHARACTERISTIC
/begin CHARACTERISTIC FaultManager.ETCSpringTest.Faulty_Samples__X_ "Fault manager configuration.  Select up to 4 actions for each fault." VALUE 0x80002E40 RecordLayout_4 0 CompuMethod_1 0 65535 /end CHARACTERISTIC
/begin CHARACTERISTIC FaultManager.ETCSpringTest.Total_Samples__Y_ "Fault manager configuration.  Select up to 4 actions for each fault." VALUE 0x80002E42 RecordLayout_4 0 CompuMethod_1 0 65535 /end CHARACTERISTIC
/begin CHARACTERISTIC FaultManager.ETCSpringTest.Action_1 "Fault manager configuration.  Select up to 4 actions for each fault." VALUE 0x80002E44 RecordLayout_4 0 CompuMethod_115 0 65535 /end CHARACTERISTIC
/begin CHARACTERISTIC FaultManager.ETCSpringTest.Action_1_Condition "Fault manager configuration.  Select up to 4 actions for each fault." VALUE 0x80002E46 RecordLayout_4 0 CompuMethod_116 0 65535 /end CHARACTERISTIC
/begin CHARACTERISTIC FaultManager.ETCSpringTest.Action_2 "Fault manager configuration.  Select up to 4 actions for each fault." VALUE 0x80002E48 RecordLayout_4 0 CompuMethod_115 0 65535 /end CHARACTERISTIC
/begin CHARACTERISTIC FaultManager.ETCSpringTest.Action_2_Condition "Fault manager configuration.  Select up to 4 actions for each fault." VALUE 0x80002E4A RecordLayout_4 0 CompuMethod_116 0 65535 /end CHARACTERISTIC
/begin CHARACTERISTIC FaultManager.ETCSpringTest.Action_3 "Fault manager configuration.  Select up to 4 actions for each fault." VALUE 0x80002E4C RecordLayout_4 0 CompuMethod_115 0 65535 /end CHARACTERISTIC
/begin CHARACTERISTIC FaultManager.ETCSpringTest.Action_3_Condition "Fault manager configuration.  Select up to 4 actions for each fault." VALUE 0x80002E4E RecordLayout_4 0 CompuMethod_116 0 65535 /end CHARACTERISTIC
/begin CHARACTERISTIC FaultManager.ETCSpringTest.Action_4 "Fault manager configuration.  Select up to 4 actions for each fault." VALUE 0x80002E50 RecordLayout_4 0 CompuMethod_115 0 65535 /end CHARACTERISTIC
/begin CHARACTERISTIC FaultManager.ETCSpringTest.Action_4_Condition "Fault manager configuration.  Select up to 4 actions for each fault." VALUE 0x80002E52 RecordLayout_4 0 CompuMethod_116 0 65535 /end CHARACTERISTIC
/begin CHARACTERISTIC FaultManager.ETC_Open_Fault.Mode "Fault manager configuration.  Select up to 4 actions for each fault." VALUE 0x80002E54 RecordLayout_4 0 CompuMethod_113 0 65535 /end CHARACTERISTIC
/begin CHARACTERISTIC FaultManager.ETC_Open_Fault.ID "Fault manager configuration.  Select up to 4 actions for each fault." VALUE 0x80002E56 RecordLayout_4 0 CompuMethod_1 0 65535 /end CHARACTERISTIC
/begin CHARACTERISTIC FaultManager.ETC_Open_Fault.Test "Fault manager configuration.  Select up to 4 actions for each fault." VALUE 0x80002E58 RecordLayout_4 0 CompuMethod_114 0 65535 /end CHARACTERISTIC
/begin CHARACTERISTIC FaultManager.ETC_Open_Fault.Faulty_Samples__X_ "Fault manager configuration.  Select up to 4 actions for each fault." VALUE 0x80002E5A RecordLayout_4 0 CompuMethod_1 0 65535 /end CHARACTERISTIC
/begin CHARACTERISTIC FaultManager.ETC_Open_Fault.Total_Samples__Y_ "Fault manager configuration.  Select up to 4 actions for each fault." VALUE 0x80002E5C RecordLayout_4 0 CompuMethod_1 0 65535 /end CHARACTERISTIC
/begin CHARACTERISTIC FaultManager.ETC_Open_Fault.Action_1 "Fault manager configuration.  Select up to 4 actions for each fault." VALUE 0x80002E5E RecordLayout_4 0 CompuMethod_115 0 65535 /end CHARACTERISTIC
/begin CHARACTERISTIC FaultManager.ETC_Open_Fault.Action_1_Condition "Fault manager configuration.  Select up to 4 actions for each fault." VALUE 0x80002E60 RecordLayout_4 0 CompuMethod_116 0 65535 /end CHARACTERISTIC
/begin CHARACTERISTIC FaultManager.ETC_Open_Fault.Action_2 "Fault manager configuration.  Select up to 4 actions for each fault." VALUE 0x80002E62 RecordLayout_4 0 CompuMethod_115 0 65535 /end CHARACTERISTIC
/begin CHARACTERISTIC FaultManager.ETC_Open_Fault.Action_2_Condition "Fault manager configuration.  Select up to 4 actions for each fault." VALUE 0x80002E64 RecordLayout_4 0 CompuMethod_116 0 65535 /end CHARACTERISTIC
/begin CHARACTERISTIC FaultManager.ETC_Open_Fault.Action_3 "Fault manager configuration.  Select up to 4 actions for each fault." VALUE 0x80002E66 RecordLayout_4 0 CompuMethod_115 0 65535 /end CHARACTERISTIC
/begin CHARACTERISTIC FaultManager.ETC_Open_Fault.Action_3_Condition "Fault manager configuration.  Select up to 4 actions for each fault." VALUE 0x80002E68 RecordLayout_4 0 CompuMethod_116 0 65535 /end CHARACTERISTIC
/begin CHARACTERISTIC FaultManager.ETC_Open_Fault.Action_4 "Fault manager configuration.  Select up to 4 actions for each fault." VALUE 0x80002E6A RecordLayout_4 0 CompuMethod_115 0 65535 /end CHARACTERISTIC
/begin CHARACTERISTIC FaultManager.ETC_Open_Fault.Action_4_Condition "Fault manager configuration.  Select up to 4 actions for each fault." VALUE 0x80002E6C RecordLayout_4 0 CompuMethod_116 0 65535 /end CHARACTERISTIC
/begin CHARACTERISTIC FaultManager.ETC_Sticking.Mode "Fault manager configuration.  Select up to 4 actions for each fault." VALUE 0x80002E6E RecordLayout_4 0 CompuMethod_113 0 65535 /end CHARACTERISTIC
/begin CHARACTERISTIC FaultManager.ETC_Sticking.ID "Fault manager configuration.  Select up to 4 actions for each fault." VALUE 0x80002E70 RecordLayout_4 0 CompuMethod_1 0 65535 /end CHARACTERISTIC
/begin CHARACTERISTIC FaultManager.ETC_Sticking.Test "Fault manager configuration.  Select up to 4 actions for each fault." VALUE 0x80002E72 RecordLayout_4 0 CompuMethod_114 0 65535 /end CHARACTERISTIC
/begin CHARACTERISTIC FaultManager.ETC_Sticking.Faulty_Samples__X_ "Fault manager configuration.  Select up to 4 actions for each fault." VALUE 0x80002E74 RecordLayout_4 0 CompuMethod_1 0 65535 /end CHARACTERISTIC
/begin CHARACTERISTIC FaultManager.ETC_Sticking.Total_Samples__Y_ "Fault manager configuration.  Select up to 4 actions for each fault." VALUE 0x80002E76 RecordLayout_4 0 CompuMethod_1 0 65535 /end CHARACTERISTIC
/begin CHARACTERISTIC FaultManager.ETC_Sticking.Action_1 "Fault manager configuration.  Select up to 4 actions for each fault." VALUE 0x80002E78 RecordLayout_4 0 CompuMethod_115 0 65535 /end CHARACTERISTIC
/begin CHARACTERISTIC FaultManager.ETC_Sticking.Action_1_Condition "Fault manager configuration.  Select up to 4 actions for each fault." VALUE 0x80002E7A RecordLayout_4 0 CompuMethod_116 0 65535 /end CHARACTERISTIC
/begin CHARACTERISTIC FaultManager.ETC_Sticking.Action_2 "Fault manager configuration.  Select up to 4 actions for each fault." VALUE 0x80002E7C RecordLayout_4 0 CompuMethod_115 0 65535 /end CHARACTERISTIC
/begin CHARACTERISTIC FaultManager.ETC_Sticking.Action_2_Condition "Fault manager configuration.  Select up to 4 actions for each fault." VALUE 0x80002E7E RecordLayout_4 0 CompuMethod_116 0 65535 /end CHARACTERISTIC
/begin CHARACTERISTIC FaultManager.ETC_Sticking.Action_3 "Fault manager configuration.  Select up to 4 actions for each fault." VALUE 0x80002E80 RecordLayout_4 0 CompuMethod_115 0 65535 /end CHARACTERISTIC
/begin CHARACTERISTIC FaultManager.ETC_Sticking.Action_3_Condition "Fault manager configuration.  Select up to 4 actions for each fault." VALUE 0x80002E82 RecordLayout_4 0 CompuMethod_116 0 65535 /end CHARACTERISTIC
/begin CHARACTERISTIC FaultManager.ETC_Sticking.Action_4 "Fault manager configuration.  Select up to 4 actions for each fault." VALUE 0x80002E84 RecordLayout_4 0 CompuMethod_115 0 65535 /end CHARACTERISTIC
/begin CHARACTERISTIC FaultManager.ETC_Sticking.Action_4_Condition "Fault manager configuration.  Select up to 4 actions for each fault." VALUE 0x80002E86 RecordLayout_4 0 CompuMethod_116 0 65535 /end CHARACTERISTIC
/begin CHARACTERISTIC FaultManager.EVAPRangeHigh.Mode "Fault manager configuration.  Select up to 4 actions for each fault." VALUE 0x80002E88 RecordLayout_4 0 CompuMethod_113 0 65535 /end CHARACTERISTIC
/begin CHARACTERISTIC FaultManager.EVAPRangeHigh.ID "Fault manager configuration.  Select up to 4 actions for each fault." VALUE 0x80002E8A RecordLayout_4 0 CompuMethod_1 0 65535 /end CHARACTERISTIC
/begin CHARACTERISTIC FaultManager.EVAPRangeHigh.Test "Fault manager configuration.  Select up to 4 actions for each fault." VALUE 0x80002E8C RecordLayout_4 0 CompuMethod_114 0 65535 /end CHARACTERISTIC
/begin CHARACTERISTIC FaultManager.EVAPRangeHigh.Faulty_Samples__X_ "Fault manager configuration.  Select up to 4 actions for each fault." VALUE 0x80002E8E RecordLayout_4 0 CompuMethod_1 0 65535 /end CHARACTERISTIC
/begin CHARACTERISTIC FaultManager.EVAPRangeHigh.Total_Samples__Y_ "Fault manager configuration.  Select up to 4 actions for each fault." VALUE 0x80002E90 RecordLayout_4 0 CompuMethod_1 0 65535 /end CHARACTERISTIC
/begin CHARACTERISTIC FaultManager.EVAPRangeHigh.Action_1 "Fault manager configuration.  Select up to 4 actions for each fault." VALUE 0x80002E92 RecordLayout_4 0 CompuMethod_115 0 65535 /end CHARACTERISTIC
/begin CHARACTERISTIC FaultManager.EVAPRangeHigh.Action_1_Condition "Fault manager configuration.  Select up to 4 actions for each fault." VALUE 0x80002E94 RecordLayout_4 0 CompuMethod_116 0 65535 /end CHARACTERISTIC
/begin CHARACTERISTIC FaultManager.EVAPRangeHigh.Action_2 "Fault manager configuration.  Select up to 4 actions for each fault." VALUE 0x80002E96 RecordLayout_4 0 CompuMethod_115 0 65535 /end CHARACTERISTIC
/begin CHARACTERISTIC FaultManager.EVAPRangeHigh.Action_2_Condition "Fault manager configuration.  Select up to 4 actions for each fault." VALUE 0x80002E98 RecordLayout_4 0 CompuMethod_116 0 65535 /end CHARACTERISTIC
/begin CHARACTERISTIC FaultManager.EVAPRangeHigh.Action_3 "Fault manager configuration.  Select up to 4 actions for each fault." VALUE 0x80002E9A RecordLayout_4 0 CompuMethod_115 0 65535 /end CHARACTERISTIC
/begin CHARACTERISTIC FaultManager.EVAPRangeHigh.Action_3_Condition "Fault manager configuration.  Select up to 4 actions for each fault." VALUE 0x80002E9C RecordLayout_4 0 CompuMethod_116 0 65535 /end CHARACTERISTIC
/begin CHARACTERISTIC FaultManager.EVAPRangeHigh.Action_4 "Fault manager configuration.  Select up to 4 actions for each fault." VALUE 0x80002E9E RecordLayout_4 0 CompuMethod_115 0 65535 /end CHARACTERISTIC
/begin CHARACTERISTIC FaultManager.EVAPRangeHigh.Action_4_Condition "Fault manager configuration.  Select up to 4 actions for each fault." VALUE 0x80002EA0 RecordLayout_4 0 CompuMethod_116 0 65535 /end CHARACTERISTIC
/begin CHARACTERISTIC FaultManager.EVAPRangeLow.Mode "Fault manager configuration.  Select up to 4 actions for each fault." VALUE 0x80002EA2 RecordLayout_4 0 CompuMethod_113 0 65535 /end CHARACTERISTIC
/begin CHARACTERISTIC FaultManager.EVAPRangeLow.ID "Fault manager configuration.  Select up to 4 actions for each fault." VALUE 0x80002EA4 RecordLayout_4 0 CompuMethod_1 0 65535 /end CHARACTERISTIC
/begin CHARACTERISTIC FaultManager.EVAPRangeLow.Test "Fault manager configuration.  Select up to 4 actions for each fault." VALUE 0x80002EA6 RecordLayout_4 0 CompuMethod_114 0 65535 /end CHARACTERISTIC
/begin CHARACTERISTIC FaultManager.EVAPRangeLow.Faulty_Samples__X_ "Fault manager configuration.  Select up to 4 actions for each fault." VALUE 0x80002EA8 RecordLayout_4 0 CompuMethod_1 0 65535 /end CHARACTERISTIC
/begin CHARACTERISTIC FaultManager.EVAPRangeLow.Total_Samples__Y_ "Fault manager configuration.  Select up to 4 actions for each fault." VALUE 0x80002EAA RecordLayout_4 0 CompuMethod_1 0 65535 /end CHARACTERISTIC
/begin CHARACTERISTIC FaultManager.EVAPRangeLow.Action_1 "Fault manager configuration.  Select up to 4 actions for each fault." VALUE 0x80002EAC RecordLayout_4 0 CompuMethod_115 0 65535 /end CHARACTERISTIC
/begin CHARACTERISTIC FaultManager.EVAPRangeLow.Action_1_Condition "Fault manager configuration.  Select up to 4 actions for each fault." VALUE 0x80002EAE RecordLayout_4 0 CompuMethod_116 0 65535 /end CHARACTERISTIC
/begin CHARACTERISTIC FaultManager.EVAPRangeLow.Action_2 "Fault manager configuration.  Select up to 4 actions for each fault." VALUE 0x80002EB0 RecordLayout_4 0 CompuMethod_115 0 65535 /end CHARACTERISTIC
/begin CHARACTERISTIC FaultManager.EVAPRangeLow.Action_2_Condition "Fault manager configuration.  Select up to 4 actions for each fault." VALUE 0x80002EB2 RecordLayout_4 0 CompuMethod_116 0 65535 /end CHARACTERISTIC
/begin CHARACTERISTIC FaultManager.EVAPRangeLow.Action_3 "Fault manager configuration.  Select up to 4 actions for each fault." VALUE 0x80002EB4 RecordLayout_4 0 CompuMethod_115 0 65535 /end CHARACTERISTIC
/begin CHARACTERISTIC FaultManager.EVAPRangeLow.Action_3_Condition "Fault manager configuration.  Select up to 4 actions for each fault." VALUE 0x80002EB6 RecordLayout_4 0 CompuMethod_116 0 65535 /end CHARACTERISTIC
/begin CHARACTERISTIC FaultManager.EVAPRangeLow.Action_4 "Fault manager configuration.  Select up to 4 actions for each fault." VALUE 0x80002EB8 RecordLayout_4 0 CompuMethod_115 0 65535 /end CHARACTERISTIC
/begin CHARACTERISTIC FaultManager.EVAPRangeLow.Action_4_Condition "Fault manager configuration.  Select up to 4 actions for each fault." VALUE 0x80002EBA RecordLayout_4 0 CompuMethod_116 0 65535 /end CHARACTERISTIC
/begin CHARACTERISTIC FaultManager.FuelAdaptRangeHi_BankA.Mode "Fault manager configuration.  Select up to 4 actions for each fault." VALUE 0x80002EBC RecordLayout_4 0 CompuMethod_113 0 65535 /end CHARACTERISTIC
/begin CHARACTERISTIC FaultManager.FuelAdaptRangeHi_BankA.ID "Fault manager configuration.  Select up to 4 actions for each fault." VALUE 0x80002EBE RecordLayout_4 0 CompuMethod_1 0 65535 /end CHARACTERISTIC
/begin CHARACTERISTIC FaultManager.FuelAdaptRangeHi_BankA.Test "Fault manager configuration.  Select up to 4 actions for each fault." VALUE 0x80002EC0 RecordLayout_4 0 CompuMethod_114 0 65535 /end CHARACTERISTIC
/begin CHARACTERISTIC FaultManager.FuelAdaptRangeHi_BankA.Faulty_Samples__X_ "Fault manager configuration.  Select up to 4 actions for each fault." VALUE 0x80002EC2 RecordLayout_4 0 CompuMethod_1 0 65535 /end CHARACTERISTIC
/begin CHARACTERISTIC FaultManager.FuelAdaptRangeHi_BankA.Total_Samples__Y_ "Fault manager configuration.  Select up to 4 actions for each fault." VALUE 0x80002EC4 RecordLayout_4 0 CompuMethod_1 0 65535 /end CHARACTERISTIC
/begin CHARACTERISTIC FaultManager.FuelAdaptRangeHi_BankA.Action_1 "Fault manager configuration.  Select up to 4 actions for each fault." VALUE 0x80002EC6 RecordLayout_4 0 CompuMethod_115 0 65535 /end CHARACTERISTIC
/begin CHARACTERISTIC FaultManager.FuelAdaptRangeHi_BankA.Action_1_Condition "Fault manager configuration.  Select up to 4 actions for each fault." VALUE 0x80002EC8 RecordLayout_4 0 CompuMethod_116 0 65535 /end CHARACTERISTIC
/begin CHARACTERISTIC FaultManager.FuelAdaptRangeHi_BankA.Action_2 "Fault manager configuration.  Select up to 4 actions for each fault." VALUE 0x80002ECA RecordLayout_4 0 CompuMethod_115 0 65535 /end CHARACTERISTIC
/begin CHARACTERISTIC FaultManager.FuelAdaptRangeHi_BankA.Action_2_Condition "Fault manager configuration.  Select up to 4 actions for each fault." VALUE 0x80002ECC RecordLayout_4 0 CompuMethod_116 0 65535 /end CHARACTERISTIC
/begin CHARACTERISTIC FaultManager.FuelAdaptRangeHi_BankA.Action_3 "Fault manager configuration.  Select up to 4 actions for each fault." VALUE 0x80002ECE RecordLayout_4 0 CompuMethod_115 0 65535 /end CHARACTERISTIC
/begin CHARACTERISTIC FaultManager.FuelAdaptRangeHi_BankA.Action_3_Condition "Fault manager configuration.  Select up to 4 actions for each fault." VALUE 0x80002ED0 RecordLayout_4 0 CompuMethod_116 0 65535 /end CHARACTERISTIC
/begin CHARACTERISTIC FaultManager.FuelAdaptRangeHi_BankA.Action_4 "Fault manager configuration.  Select up to 4 actions for each fault." VALUE 0x80002ED2 RecordLayout_4 0 CompuMethod_115 0 65535 /end CHARACTERISTIC
/begin CHARACTERISTIC FaultManager.FuelAdaptRangeHi_BankA.Action_4_Condition "Fault manager configuration.  Select up to 4 actions for each fault." VALUE 0x80002ED4 RecordLayout_4 0 CompuMethod_116 0 65535 /end CHARACTERISTIC
/begin CHARACTERISTIC FaultManager.FuelAdaptRangeHi_BankB.Mode "Fault manager configuration.  Select up to 4 actions for each fault." VALUE 0x80002ED6 RecordLayout_4 0 CompuMethod_113 0 65535 /end CHARACTERISTIC
/begin CHARACTERISTIC FaultManager.FuelAdaptRangeHi_BankB.ID "Fault manager configuration.  Select up to 4 actions for each fault." VALUE 0x80002ED8 RecordLayout_4 0 CompuMethod_1 0 65535 /end CHARACTERISTIC
/begin CHARACTERISTIC FaultManager.FuelAdaptRangeHi_BankB.Test "Fault manager configuration.  Select up to 4 actions for each fault." VALUE 0x80002EDA RecordLayout_4 0 CompuMethod_114 0 65535 /end CHARACTERISTIC
/begin CHARACTERISTIC FaultManager.FuelAdaptRangeHi_BankB.Faulty_Samples__X_ "Fault manager configuration.  Select up to 4 actions for each fault." VALUE 0x80002EDC RecordLayout_4 0 CompuMethod_1 0 65535 /end CHARACTERISTIC
/begin CHARACTERISTIC FaultManager.FuelAdaptRangeHi_BankB.Total_Samples__Y_ "Fault manager configuration.  Select up to 4 actions for each fault." VALUE 0x80002EDE RecordLayout_4 0 CompuMethod_1 0 65535 /end CHARACTERISTIC
/begin CHARACTERISTIC FaultManager.FuelAdaptRangeHi_BankB.Action_1 "Fault manager configuration.  Select up to 4 actions for each fault." VALUE 0x80002EE0 RecordLayout_4 0 CompuMethod_115 0 65535 /end CHARACTERISTIC
/begin CHARACTERISTIC FaultManager.FuelAdaptRangeHi_BankB.Action_1_Condition "Fault manager configuration.  Select up to 4 actions for each fault." VALUE 0x80002EE2 RecordLayout_4 0 CompuMethod_116 0 65535 /end CHARACTERISTIC
/begin CHARACTERISTIC FaultManager.FuelAdaptRangeHi_BankB.Action_2 "Fault manager configuration.  Select up to 4 actions for each fault." VALUE 0x80002EE4 RecordLayout_4 0 CompuMethod_115 0 65535 /end CHARACTERISTIC
/begin CHARACTERISTIC FaultManager.FuelAdaptRangeHi_BankB.Action_2_Condition "Fault manager configuration.  Select up to 4 actions for each fault." VALUE 0x80002EE6 RecordLayout_4 0 CompuMethod_116 0 65535 /end CHARACTERISTIC
/begin CHARACTERISTIC FaultManager.FuelAdaptRangeHi_BankB.Action_3 "Fault manager configuration.  Select up to 4 actions for each fault." VALUE 0x80002EE8 RecordLayout_4 0 CompuMethod_115 0 65535 /end CHARACTERISTIC
/begin CHARACTERISTIC FaultManager.FuelAdaptRangeHi_BankB.Action_3_Condition "Fault manager configuration.  Select up to 4 actions for each fault." VALUE 0x80002EEA RecordLayout_4 0 CompuMethod_116 0 65535 /end CHARACTERISTIC
/begin CHARACTERISTIC FaultManager.FuelAdaptRangeHi_BankB.Action_4 "Fault manager configuration.  Select up to 4 actions for each fault." VALUE 0x80002EEC RecordLayout_4 0 CompuMethod_115 0 65535 /end CHARACTERISTIC
/begin CHARACTERISTIC FaultManager.FuelAdaptRangeHi_BankB.Action_4_Condition "Fault manager configuration.  Select up to 4 actions for each fault." VALUE 0x80002EEE RecordLayout_4 0 CompuMethod_116 0 65535 /end CHARACTERISTIC
/begin CHARACTERISTIC FaultManager.FuelAdaptRangeLow_BankA.Mode "Fault manager configuration.  Select up to 4 actions for each fault." VALUE 0x80002EF0 RecordLayout_4 0 CompuMethod_113 0 65535 /end CHARACTERISTIC
/begin CHARACTERISTIC FaultManager.FuelAdaptRangeLow_BankA.ID "Fault manager configuration.  Select up to 4 actions for each fault." VALUE 0x80002EF2 RecordLayout_4 0 CompuMethod_1 0 65535 /end CHARACTERISTIC
/begin CHARACTERISTIC FaultManager.FuelAdaptRangeLow_BankA.Test "Fault manager configuration.  Select up to 4 actions for each fault." VALUE 0x80002EF4 RecordLayout_4 0 CompuMethod_114 0 65535 /end CHARACTERISTIC
/begin CHARACTERISTIC FaultManager.FuelAdaptRangeLow_BankA.Faulty_Samples__X_ "Fault manager configuration.  Select up to 4 actions for each fault." VALUE 0x80002EF6 RecordLayout_4 0 CompuMethod_1 0 65535 /end CHARACTERISTIC
/begin CHARACTERISTIC FaultManager.FuelAdaptRangeLow_BankA.Total_Samples__Y_ "Fault manager configuration.  Select up to 4 actions for each fault." VALUE 0x80002EF8 RecordLayout_4 0 CompuMethod_1 0 65535 /end CHARACTERISTIC
/begin CHARACTERISTIC FaultManager.FuelAdaptRangeLow_BankA.Action_1 "Fault manager configuration.  Select up to 4 actions for each fault." VALUE 0x80002EFA RecordLayout_4 0 CompuMethod_115 0 65535 /end CHARACTERISTIC
/begin CHARACTERISTIC FaultManager.FuelAdaptRangeLow_BankA.Action_1_Condition "Fault manager configuration.  Select up to 4 actions for each fault." VALUE 0x80002EFC RecordLayout_4 0 CompuMethod_116 0 65535 /end CHARACTERISTIC
/begin CHARACTERISTIC FaultManager.FuelAdaptRangeLow_BankA.Action_2 "Fault manager configuration.  Select up to 4 actions for each fault." VALUE 0x80002EFE RecordLayout_4 0 CompuMethod_115 0 65535 /end CHARACTERISTIC
/begin CHARACTERISTIC FaultManager.FuelAdaptRangeLow_BankA.Action_2_Condition "Fault manager configuration.  Select up to 4 actions for each fault." VALUE 0x80002F00 RecordLayout_4 0 CompuMethod_116 0 65535 /end CHARACTERISTIC
/begin CHARACTERISTIC FaultManager.FuelAdaptRangeLow_BankA.Action_3 "Fault manager configuration.  Select up to 4 actions for each fault." VALUE 0x80002F02 RecordLayout_4 0 CompuMethod_115 0 65535 /end CHARACTERISTIC
/begin CHARACTERISTIC FaultManager.FuelAdaptRangeLow_BankA.Action_3_Condition "Fault manager configuration.  Select up to 4 actions for each fault." VALUE 0x80002F04 RecordLayout_4 0 CompuMethod_116 0 65535 /end CHARACTERISTIC
/begin CHARACTERISTIC FaultManager.FuelAdaptRangeLow_BankA.Action_4 "Fault manager configuration.  Select up to 4 actions for each fault." VALUE 0x80002F06 RecordLayout_4 0 CompuMethod_115 0 65535 /end CHARACTERISTIC
/begin CHARACTERISTIC FaultManager.FuelAdaptRangeLow_BankA.Action_4_Condition "Fault manager configuration.  Select up to 4 actions for each fault." VALUE 0x80002F08 RecordLayout_4 0 CompuMethod_116 0 65535 /end CHARACTERISTIC
/begin CHARACTERISTIC FaultManager.FuelAdaptRangeLow_BankB.Mode "Fault manager configuration.  Select up to 4 actions for each fault." VALUE 0x80002F0A RecordLayout_4 0 CompuMethod_113 0 65535 /end CHARACTERISTIC
/begin CHARACTERISTIC FaultManager.FuelAdaptRangeLow_BankB.ID "Fault manager configuration.  Select up to 4 actions for each fault." VALUE 0x80002F0C RecordLayout_4 0 CompuMethod_1 0 65535 /end CHARACTERISTIC
/begin CHARACTERISTIC FaultManager.FuelAdaptRangeLow_BankB.Test "Fault manager configuration.  Select up to 4 actions for each fault." VALUE 0x80002F0E RecordLayout_4 0 CompuMethod_114 0 65535 /end CHARACTERISTIC
/begin CHARACTERISTIC FaultManager.FuelAdaptRangeLow_BankB.Faulty_Samples__X_ "Fault manager configuration.  Select up to 4 actions for each fault." VALUE 0x80002F10 RecordLayout_4 0 CompuMethod_1 0 65535 /end CHARACTERISTIC
/begin CHARACTERISTIC FaultManager.FuelAdaptRangeLow_BankB.Total_Samples__Y_ "Fault manager configuration.  Select up to 4 actions for each fault." VALUE 0x80002F12 RecordLayout_4 0 CompuMethod_1 0 65535 /end CHARACTERISTIC
/begin CHARACTERISTIC FaultManager.FuelAdaptRangeLow_BankB.Action_1 "Fault manager configuration.  Select up to 4 actions for each fault." VALUE 0x80002F14 RecordLayout_4 0 CompuMethod_115 0 65535 /end CHARACTERISTIC
/begin CHARACTERISTIC FaultManager.FuelAdaptRangeLow_BankB.Action_1_Condition "Fault manager configuration.  Select up to 4 actions for each fault." VALUE 0x80002F16 RecordLayout_4 0 CompuMethod_116 0 65535 /end CHARACTERISTIC
/begin CHARACTERISTIC FaultManager.FuelAdaptRangeLow_BankB.Action_2 "Fault manager configuration.  Select up to 4 actions for each fault." VALUE 0x80002F18 RecordLayout_4 0 CompuMethod_115 0 65535 /end CHARACTERISTIC
/begin CHARACTERISTIC FaultManager.FuelAdaptRangeLow_BankB.Action_2_Condition "Fault manager configuration.  Select up to 4 actions for each fault." VALUE 0x80002F1A RecordLayout_4 0 CompuMethod_116 0 65535 /end CHARACTERISTIC
/begin CHARACTERISTIC FaultManager.FuelAdaptRangeLow_BankB.Action_3 "Fault manager configuration.  Select up to 4 actions for each fault." VALUE 0x80002F1C RecordLayout_4 0 CompuMethod_115 0 65535 /end CHARACTERISTIC
/begin CHARACTERISTIC FaultManager.FuelAdaptRangeLow_BankB.Action_3_Condition "Fault manager configuration.  Select up to 4 actions for each fault." VALUE 0x80002F1E RecordLayout_4 0 CompuMethod_116 0 65535 /end CHARACTERISTIC
/begin CHARACTERISTIC FaultManager.FuelAdaptRangeLow_BankB.Action_4 "Fault manager configuration.  Select up to 4 actions for each fault." VALUE 0x80002F20 RecordLayout_4 0 CompuMethod_115 0 65535 /end CHARACTERISTIC
/begin CHARACTERISTIC FaultManager.FuelAdaptRangeLow_BankB.Action_4_Condition "Fault manager configuration.  Select up to 4 actions for each fault." VALUE 0x80002F22 RecordLayout_4 0 CompuMethod_116 0 65535 /end CHARACTERISTIC
/begin CHARACTERISTIC FaultManager.FuelPresHigh_Fault.Mode "Fault manager configuration.  Select up to 4 actions for each fault." VALUE 0x80002F24 RecordLayout_4 0 CompuMethod_113 0 65535 /end CHARACTERISTIC
/begin CHARACTERISTIC FaultManager.FuelPresHigh_Fault.ID "Fault manager configuration.  Select up to 4 actions for each fault." VALUE 0x80002F26 RecordLayout_4 0 CompuMethod_1 0 65535 /end CHARACTERISTIC
/begin CHARACTERISTIC FaultManager.FuelPresHigh_Fault.Test "Fault manager configuration.  Select up to 4 actions for each fault." VALUE 0x80002F28 RecordLayout_4 0 CompuMethod_114 0 65535 /end CHARACTERISTIC
/begin CHARACTERISTIC FaultManager.FuelPresHigh_Fault.Faulty_Samples__X_ "Fault manager configuration.  Select up to 4 actions for each fault." VALUE 0x80002F2A RecordLayout_4 0 CompuMethod_1 0 65535 /end CHARACTERISTIC
/begin CHARACTERISTIC FaultManager.FuelPresHigh_Fault.Total_Samples__Y_ "Fault manager configuration.  Select up to 4 actions for each fault." VALUE 0x80002F2C RecordLayout_4 0 CompuMethod_1 0 65535 /end CHARACTERISTIC
/begin CHARACTERISTIC FaultManager.FuelPresHigh_Fault.Action_1 "Fault manager configuration.  Select up to 4 actions for each fault." VALUE 0x80002F2E RecordLayout_4 0 CompuMethod_115 0 65535 /end CHARACTERISTIC
/begin CHARACTERISTIC FaultManager.FuelPresHigh_Fault.Action_1_Condition "Fault manager configuration.  Select up to 4 actions for each fault." VALUE 0x80002F30 RecordLayout_4 0 CompuMethod_116 0 65535 /end CHARACTERISTIC
/begin CHARACTERISTIC FaultManager.FuelPresHigh_Fault.Action_2 "Fault manager configuration.  Select up to 4 actions for each fault." VALUE 0x80002F32 RecordLayout_4 0 CompuMethod_115 0 65535 /end CHARACTERISTIC
/begin CHARACTERISTIC FaultManager.FuelPresHigh_Fault.Action_2_Condition "Fault manager configuration.  Select up to 4 actions for each fault." VALUE 0x80002F34 RecordLayout_4 0 CompuMethod_116 0 65535 /end CHARACTERISTIC
/begin CHARACTERISTIC FaultManager.FuelPresHigh_Fault.Action_3 "Fault manager configuration.  Select up to 4 actions for each fault." VALUE 0x80002F36 RecordLayout_4 0 CompuMethod_115 0 65535 /end CHARACTERISTIC
/begin CHARACTERISTIC FaultManager.FuelPresHigh_Fault.Action_3_Condition "Fault manager configuration.  Select up to 4 actions for each fault." VALUE 0x80002F38 RecordLayout_4 0 CompuMethod_116 0 65535 /end CHARACTERISTIC
/begin CHARACTERISTIC FaultManager.FuelPresHigh_Fault.Action_4 "Fault manager configuration.  Select up to 4 actions for each fault." VALUE 0x80002F3A RecordLayout_4 0 CompuMethod_115 0 65535 /end CHARACTERISTIC
/begin CHARACTERISTIC FaultManager.FuelPresHigh_Fault.Action_4_Condition "Fault manager configuration.  Select up to 4 actions for each fault." VALUE 0x80002F3C RecordLayout_4 0 CompuMethod_116 0 65535 /end CHARACTERISTIC
/begin CHARACTERISTIC FaultManager.FuelPresLow_Fault.Mode "Fault manager configuration.  Select up to 4 actions for each fault." VALUE 0x80002F3E RecordLayout_4 0 CompuMethod_113 0 65535 /end CHARACTERISTIC
/begin CHARACTERISTIC FaultManager.FuelPresLow_Fault.ID "Fault manager configuration.  Select up to 4 actions for each fault." VALUE 0x80002F40 RecordLayout_4 0 CompuMethod_1 0 65535 /end CHARACTERISTIC
/begin CHARACTERISTIC FaultManager.FuelPresLow_Fault.Test "Fault manager configuration.  Select up to 4 actions for each fault." VALUE 0x80002F42 RecordLayout_4 0 CompuMethod_114 0 65535 /end CHARACTERISTIC
/begin CHARACTERISTIC FaultManager.FuelPresLow_Fault.Faulty_Samples__X_ "Fault manager configuration.  Select up to 4 actions for each fault." VALUE 0x80002F44 RecordLayout_4 0 CompuMethod_1 0 65535 /end CHARACTERISTIC
/begin CHARACTERISTIC FaultManager.FuelPresLow_Fault.Total_Samples__Y_ "Fault manager configuration.  Select up to 4 actions for each fault." VALUE 0x80002F46 RecordLayout_4 0 CompuMethod_1 0 65535 /end CHARACTERISTIC
/begin CHARACTERISTIC FaultManager.FuelPresLow_Fault.Action_1 "Fault manager configuration.  Select up to 4 actions for each fault." VALUE 0x80002F48 RecordLayout_4 0 CompuMethod_115 0 65535 /end CHARACTERISTIC
/begin CHARACTERISTIC FaultManager.FuelPresLow_Fault.Action_1_Condition "Fault manager configuration.  Select up to 4 actions for each fault." VALUE 0x80002F4A RecordLayout_4 0 CompuMethod_116 0 65535 /end CHARACTERISTIC
/begin CHARACTERISTIC FaultManager.FuelPresLow_Fault.Action_2 "Fault manager configuration.  Select up to 4 actions for each fault." VALUE 0x80002F4C RecordLayout_4 0 CompuMethod_115 0 65535 /end CHARACTERISTIC
/begin CHARACTERISTIC FaultManager.FuelPresLow_Fault.Action_2_Condition "Fault manager configuration.  Select up to 4 actions for each fault." VALUE 0x80002F4E RecordLayout_4 0 CompuMethod_116 0 65535 /end CHARACTERISTIC
/begin CHARACTERISTIC FaultManager.FuelPresLow_Fault.Action_3 "Fault manager configuration.  Select up to 4 actions for each fault." VALUE 0x80002F50 RecordLayout_4 0 CompuMethod_115 0 65535 /end CHARACTERISTIC
/begin CHARACTERISTIC FaultManager.FuelPresLow_Fault.Action_3_Condition "Fault manager configuration.  Select up to 4 actions for each fault." VALUE 0x80002F52 RecordLayout_4 0 CompuMethod_116 0 65535 /end CHARACTERISTIC
/begin CHARACTERISTIC FaultManager.FuelPresLow_Fault.Action_4 "Fault manager configuration.  Select up to 4 actions for each fault." VALUE 0x80002F54 RecordLayout_4 0 CompuMethod_115 0 65535 /end CHARACTERISTIC
/begin CHARACTERISTIC FaultManager.FuelPresLow_Fault.Action_4_Condition "Fault manager configuration.  Select up to 4 actions for each fault." VALUE 0x80002F56 RecordLayout_4 0 CompuMethod_116 0 65535 /end CHARACTERISTIC
/begin CHARACTERISTIC FaultManager.FuelPresRangeHigh.Mode "Fault manager configuration.  Select up to 4 actions for each fault." VALUE 0x80002F58 RecordLayout_4 0 CompuMethod_113 0 65535 /end CHARACTERISTIC
/begin CHARACTERISTIC FaultManager.FuelPresRangeHigh.ID "Fault manager configuration.  Select up to 4 actions for each fault." VALUE 0x80002F5A RecordLayout_4 0 CompuMethod_1 0 65535 /end CHARACTERISTIC
/begin CHARACTERISTIC FaultManager.FuelPresRangeHigh.Test "Fault manager configuration.  Select up to 4 actions for each fault." VALUE 0x80002F5C RecordLayout_4 0 CompuMethod_114 0 65535 /end CHARACTERISTIC
/begin CHARACTERISTIC FaultManager.FuelPresRangeHigh.Faulty_Samples__X_ "Fault manager configuration.  Select up to 4 actions for each fault." VALUE 0x80002F5E RecordLayout_4 0 CompuMethod_1 0 65535 /end CHARACTERISTIC
/begin CHARACTERISTIC FaultManager.FuelPresRangeHigh.Total_Samples__Y_ "Fault manager configuration.  Select up to 4 actions for each fault." VALUE 0x80002F60 RecordLayout_4 0 CompuMethod_1 0 65535 /end CHARACTERISTIC
/begin CHARACTERISTIC FaultManager.FuelPresRangeHigh.Action_1 "Fault manager configuration.  Select up to 4 actions for each fault." VALUE 0x80002F62 RecordLayout_4 0 CompuMethod_115 0 65535 /end CHARACTERISTIC
/begin CHARACTERISTIC FaultManager.FuelPresRangeHigh.Action_1_Condition "Fault manager configuration.  Select up to 4 actions for each fault." VALUE 0x80002F64 RecordLayout_4 0 CompuMethod_116 0 65535 /end CHARACTERISTIC
/begin CHARACTERISTIC FaultManager.FuelPresRangeHigh.Action_2 "Fault manager configuration.  Select up to 4 actions for each fault." VALUE 0x80002F66 RecordLayout_4 0 CompuMethod_115 0 65535 /end CHARACTERISTIC
/begin CHARACTERISTIC FaultManager.FuelPresRangeHigh.Action_2_Condition "Fault manager configuration.  Select up to 4 actions for each fault." VALUE 0x80002F68 RecordLayout_4 0 CompuMethod_116 0 65535 /end CHARACTERISTIC
/begin CHARACTERISTIC FaultManager.FuelPresRangeHigh.Action_3 "Fault manager configuration.  Select up to 4 actions for each fault." VALUE 0x80002F6A RecordLayout_4 0 CompuMethod_115 0 65535 /end CHARACTERISTIC
/begin CHARACTERISTIC FaultManager.FuelPresRangeHigh.Action_3_Condition "Fault manager configuration.  Select up to 4 actions for each fault." VALUE 0x80002F6C RecordLayout_4 0 CompuMethod_116 0 65535 /end CHARACTERISTIC
/begin CHARACTERISTIC FaultManager.FuelPresRangeHigh.Action_4 "Fault manager configuration.  Select up to 4 actions for each fault." VALUE 0x80002F6E RecordLayout_4 0 CompuMethod_115 0 65535 /end CHARACTERISTIC
/begin CHARACTERISTIC FaultManager.FuelPresRangeHigh.Action_4_Condition "Fault manager configuration.  Select up to 4 actions for each fault." VALUE 0x80002F70 RecordLayout_4 0 CompuMethod_116 0 65535 /end CHARACTERISTIC
/begin CHARACTERISTIC FaultManager.FuelPresRangeLow.Mode "Fault manager configuration.  Select up to 4 actions for each fault." VALUE 0x80002F72 RecordLayout_4 0 CompuMethod_113 0 65535 /end CHARACTERISTIC
/begin CHARACTERISTIC FaultManager.FuelPresRangeLow.ID "Fault manager configuration.  Select up to 4 actions for each fault." VALUE 0x80002F74 RecordLayout_4 0 CompuMethod_1 0 65535 /end CHARACTERISTIC
/begin CHARACTERISTIC FaultManager.FuelPresRangeLow.Test "Fault manager configuration.  Select up to 4 actions for each fault." VALUE 0x80002F76 RecordLayout_4 0 CompuMethod_114 0 65535 /end CHARACTERISTIC
/begin CHARACTERISTIC FaultManager.FuelPresRangeLow.Faulty_Samples__X_ "Fault manager configuration.  Select up to 4 actions for each fault." VALUE 0x80002F78 RecordLayout_4 0 CompuMethod_1 0 65535 /end CHARACTERISTIC
/begin CHARACTERISTIC FaultManager.FuelPresRangeLow.Total_Samples__Y_ "Fault manager configuration.  Select up to 4 actions for each fault." VALUE 0x80002F7A RecordLayout_4 0 CompuMethod_1 0 65535 /end CHARACTERISTIC
/begin CHARACTERISTIC FaultManager.FuelPresRangeLow.Action_1 "Fault manager configuration.  Select up to 4 actions for each fault." VALUE 0x80002F7C RecordLayout_4 0 CompuMethod_115 0 65535 /end CHARACTERISTIC
/begin CHARACTERISTIC FaultManager.FuelPresRangeLow.Action_1_Condition "Fault manager configuration.  Select up to 4 actions for each fault." VALUE 0x80002F7E RecordLayout_4 0 CompuMethod_116 0 65535 /end CHARACTERISTIC
/begin CHARACTERISTIC FaultManager.FuelPresRangeLow.Action_2 "Fault manager configuration.  Select up to 4 actions for each fault." VALUE 0x80002F80 RecordLayout_4 0 CompuMethod_115 0 65535 /end CHARACTERISTIC
/begin CHARACTERISTIC FaultManager.FuelPresRangeLow.Action_2_Condition "Fault manager configuration.  Select up to 4 actions for each fault." VALUE 0x80002F82 RecordLayout_4 0 CompuMethod_116 0 65535 /end CHARACTERISTIC
/begin CHARACTERISTIC FaultManager.FuelPresRangeLow.Action_3 "Fault manager configuration.  Select up to 4 actions for each fault." VALUE 0x80002F84 RecordLayout_4 0 CompuMethod_115 0 65535 /end CHARACTERISTIC
/begin CHARACTERISTIC FaultManager.FuelPresRangeLow.Action_3_Condition "Fault manager configuration.  Select up to 4 actions for each fault." VALUE 0x80002F86 RecordLayout_4 0 CompuMethod_116 0 65535 /end CHARACTERISTIC
/begin CHARACTERISTIC FaultManager.FuelPresRangeLow.Action_4 "Fault manager configuration.  Select up to 4 actions for each fault." VALUE 0x80002F88 RecordLayout_4 0 CompuMethod_115 0 65535 /end CHARACTERISTIC
/begin CHARACTERISTIC FaultManager.FuelPresRangeLow.Action_4_Condition "Fault manager configuration.  Select up to 4 actions for each fault." VALUE 0x80002F8A RecordLayout_4 0 CompuMethod_116 0 65535 /end CHARACTERISTIC
/begin CHARACTERISTIC FaultManager.FuelSensRangeHigh.Mode "Fault manager configuration.  Select up to 4 actions for each fault." VALUE 0x80002F8C RecordLayout_4 0 CompuMethod_113 0 65535 /end CHARACTERISTIC
/begin CHARACTERISTIC FaultManager.FuelSensRangeHigh.ID "Fault manager configuration.  Select up to 4 actions for each fault." VALUE 0x80002F8E RecordLayout_4 0 CompuMethod_1 0 65535 /end CHARACTERISTIC
/begin CHARACTERISTIC FaultManager.FuelSensRangeHigh.Test "Fault manager configuration.  Select up to 4 actions for each fault." VALUE 0x80002F90 RecordLayout_4 0 CompuMethod_114 0 65535 /end CHARACTERISTIC
/begin CHARACTERISTIC FaultManager.FuelSensRangeHigh.Faulty_Samples__X_ "Fault manager configuration.  Select up to 4 actions for each fault." VALUE 0x80002F92 RecordLayout_4 0 CompuMethod_1 0 65535 /end CHARACTERISTIC
/begin CHARACTERISTIC FaultManager.FuelSensRangeHigh.Total_Samples__Y_ "Fault manager configuration.  Select up to 4 actions for each fault." VALUE 0x80002F94 RecordLayout_4 0 CompuMethod_1 0 65535 /end CHARACTERISTIC
/begin CHARACTERISTIC FaultManager.FuelSensRangeHigh.Action_1 "Fault manager configuration.  Select up to 4 actions for each fault." VALUE 0x80002F96 RecordLayout_4 0 CompuMethod_115 0 65535 /end CHARACTERISTIC
/begin CHARACTERISTIC FaultManager.FuelSensRangeHigh.Action_1_Condition "Fault manager configuration.  Select up to 4 actions for each fault." VALUE 0x80002F98 RecordLayout_4 0 CompuMethod_116 0 65535 /end CHARACTERISTIC
/begin CHARACTERISTIC FaultManager.FuelSensRangeHigh.Action_2 "Fault manager configuration.  Select up to 4 actions for each fault." VALUE 0x80002F9A RecordLayout_4 0 CompuMethod_115 0 65535 /end CHARACTERISTIC
/begin CHARACTERISTIC FaultManager.FuelSensRangeHigh.Action_2_Condition "Fault manager configuration.  Select up to 4 actions for each fault." VALUE 0x80002F9C RecordLayout_4 0 CompuMethod_116 0 65535 /end CHARACTERISTIC
/begin CHARACTERISTIC FaultManager.FuelSensRangeHigh.Action_3 "Fault manager configuration.  Select up to 4 actions for each fault." VALUE 0x80002F9E RecordLayout_4 0 CompuMethod_115 0 65535 /end CHARACTERISTIC
/begin CHARACTERISTIC FaultManager.FuelSensRangeHigh.Action_3_Condition "Fault manager configuration.  Select up to 4 actions for each fault." VALUE 0x80002FA0 RecordLayout_4 0 CompuMethod_116 0 65535 /end CHARACTERISTIC
/begin CHARACTERISTIC FaultManager.FuelSensRangeHigh.Action_4 "Fault manager configuration.  Select up to 4 actions for each fault." VALUE 0x80002FA2 RecordLayout_4 0 CompuMethod_115 0 65535 /end CHARACTERISTIC
/begin CHARACTERISTIC FaultManager.FuelSensRangeHigh.Action_4_Condition "Fault manager configuration.  Select up to 4 actions for each fault." VALUE 0x80002FA4 RecordLayout_4 0 CompuMethod_116 0 65535 /end CHARACTERISTIC
/begin CHARACTERISTIC FaultManager.FuelSensRangeLow.Mode "Fault manager configuration.  Select up to 4 actions for each fault." VALUE 0x80002FA6 RecordLayout_4 0 CompuMethod_113 0 65535 /end CHARACTERISTIC
/begin CHARACTERISTIC FaultManager.FuelSensRangeLow.ID "Fault manager configuration.  Select up to 4 actions for each fault." VALUE 0x80002FA8 RecordLayout_4 0 CompuMethod_1 0 65535 /end CHARACTERISTIC
/begin CHARACTERISTIC FaultManager.FuelSensRangeLow.Test "Fault manager configuration.  Select up to 4 actions for each fault." VALUE 0x80002FAA RecordLayout_4 0 CompuMethod_114 0 65535 /end CHARACTERISTIC
/begin CHARACTERISTIC FaultManager.FuelSensRangeLow.Faulty_Samples__X_ "Fault manager configuration.  Select up to 4 actions for each fault." VALUE 0x80002FAC RecordLayout_4 0 CompuMethod_1 0 65535 /end CHARACTERISTIC
/begin CHARACTERISTIC FaultManager.FuelSensRangeLow.Total_Samples__Y_ "Fault manager configuration.  Select up to 4 actions for each fault." VALUE 0x80002FAE RecordLayout_4 0 CompuMethod_1 0 65535 /end CHARACTERISTIC
/begin CHARACTERISTIC FaultManager.FuelSensRangeLow.Action_1 "Fault manager configuration.  Select up to 4 actions for each fault." VALUE 0x80002FB0 RecordLayout_4 0 CompuMethod_115 0 65535 /end CHARACTERISTIC
/begin CHARACTERISTIC FaultManager.FuelSensRangeLow.Action_1_Condition "Fault manager configuration.  Select up to 4 actions for each fault." VALUE 0x80002FB2 RecordLayout_4 0 CompuMethod_116 0 65535 /end CHARACTERISTIC
/begin CHARACTERISTIC FaultManager.FuelSensRangeLow.Action_2 "Fault manager configuration.  Select up to 4 actions for each fault." VALUE 0x80002FB4 RecordLayout_4 0 CompuMethod_115 0 65535 /end CHARACTERISTIC
/begin CHARACTERISTIC FaultManager.FuelSensRangeLow.Action_2_Condition "Fault manager configuration.  Select up to 4 actions for each fault." VALUE 0x80002FB6 RecordLayout_4 0 CompuMethod_116 0 65535 /end CHARACTERISTIC
/begin CHARACTERISTIC FaultManager.FuelSensRangeLow.Action_3 "Fault manager configuration.  Select up to 4 actions for each fault." VALUE 0x80002FB8 RecordLayout_4 0 CompuMethod_115 0 65535 /end CHARACTERISTIC
/begin CHARACTERISTIC FaultManager.FuelSensRangeLow.Action_3_Condition "Fault manager configuration.  Select up to 4 actions for each fault." VALUE 0x80002FBA RecordLayout_4 0 CompuMethod_116 0 65535 /end CHARACTERISTIC
/begin CHARACTERISTIC FaultManager.FuelSensRangeLow.Action_4 "Fault manager configuration.  Select up to 4 actions for each fault." VALUE 0x80002FBC RecordLayout_4 0 CompuMethod_115 0 65535 /end CHARACTERISTIC
/begin CHARACTERISTIC FaultManager.FuelSensRangeLow.Action_4_Condition "Fault manager configuration.  Select up to 4 actions for each fault." VALUE 0x80002FBE RecordLayout_4 0 CompuMethod_116 0 65535 /end CHARACTERISTIC
/begin CHARACTERISTIC FaultManager.Fuel_LvlRangeHigh.Mode "Fault manager configuration.  Select up to 4 actions for each fault." VALUE 0x80002FC0 RecordLayout_4 0 CompuMethod_113 0 65535 /end CHARACTERISTIC
/begin CHARACTERISTIC FaultManager.Fuel_LvlRangeHigh.ID "Fault manager configuration.  Select up to 4 actions for each fault." VALUE 0x80002FC2 RecordLayout_4 0 CompuMethod_1 0 65535 /end CHARACTERISTIC
/begin CHARACTERISTIC FaultManager.Fuel_LvlRangeHigh.Test "Fault manager configuration.  Select up to 4 actions for each fault." VALUE 0x80002FC4 RecordLayout_4 0 CompuMethod_114 0 65535 /end CHARACTERISTIC
/begin CHARACTERISTIC FaultManager.Fuel_LvlRangeHigh.Faulty_Samples__X_ "Fault manager configuration.  Select up to 4 actions for each fault." VALUE 0x80002FC6 RecordLayout_4 0 CompuMethod_1 0 65535 /end CHARACTERISTIC
/begin CHARACTERISTIC FaultManager.Fuel_LvlRangeHigh.Total_Samples__Y_ "Fault manager configuration.  Select up to 4 actions for each fault." VALUE 0x80002FC8 RecordLayout_4 0 CompuMethod_1 0 65535 /end CHARACTERISTIC
/begin CHARACTERISTIC FaultManager.Fuel_LvlRangeHigh.Action_1 "Fault manager configuration.  Select up to 4 actions for each fault." VALUE 0x80002FCA RecordLayout_4 0 CompuMethod_115 0 65535 /end CHARACTERISTIC
/begin CHARACTERISTIC FaultManager.Fuel_LvlRangeHigh.Action_1_Condition "Fault manager configuration.  Select up to 4 actions for each fault." VALUE 0x80002FCC RecordLayout_4 0 CompuMethod_116 0 65535 /end CHARACTERISTIC
/begin CHARACTERISTIC FaultManager.Fuel_LvlRangeHigh.Action_2 "Fault manager configuration.  Select up to 4 actions for each fault." VALUE 0x80002FCE RecordLayout_4 0 CompuMethod_115 0 65535 /end CHARACTERISTIC
/begin CHARACTERISTIC FaultManager.Fuel_LvlRangeHigh.Action_2_Condition "Fault manager configuration.  Select up to 4 actions for each fault." VALUE 0x80002FD0 RecordLayout_4 0 CompuMethod_116 0 65535 /end CHARACTERISTIC
/begin CHARACTERISTIC FaultManager.Fuel_LvlRangeHigh.Action_3 "Fault manager configuration.  Select up to 4 actions for each fault." VALUE 0x80002FD2 RecordLayout_4 0 CompuMethod_115 0 65535 /end CHARACTERISTIC
/begin CHARACTERISTIC FaultManager.Fuel_LvlRangeHigh.Action_3_Condition "Fault manager configuration.  Select up to 4 actions for each fault." VALUE 0x80002FD4 RecordLayout_4 0 CompuMethod_116 0 65535 /end CHARACTERISTIC
/begin CHARACTERISTIC FaultManager.Fuel_LvlRangeHigh.Action_4 "Fault manager configuration.  Select up to 4 actions for each fault." VALUE 0x80002FD6 RecordLayout_4 0 CompuMethod_115 0 65535 /end CHARACTERISTIC
/begin CHARACTERISTIC FaultManager.Fuel_LvlRangeHigh.Action_4_Condition "Fault manager configuration.  Select up to 4 actions for each fault." VALUE 0x80002FD8 RecordLayout_4 0 CompuMethod_116 0 65535 /end CHARACTERISTIC
/begin CHARACTERISTIC FaultManager.Fuel_LvlRangeLow.Mode "Fault manager configuration.  Select up to 4 actions for each fault." VALUE 0x80002FDA RecordLayout_4 0 CompuMethod_113 0 65535 /end CHARACTERISTIC
/begin CHARACTERISTIC FaultManager.Fuel_LvlRangeLow.ID "Fault manager configuration.  Select up to 4 actions for each fault." VALUE 0x80002FDC RecordLayout_4 0 CompuMethod_1 0 65535 /end CHARACTERISTIC
/begin CHARACTERISTIC FaultManager.Fuel_LvlRangeLow.Test "Fault manager configuration.  Select up to 4 actions for each fault." VALUE 0x80002FDE RecordLayout_4 0 CompuMethod_114 0 65535 /end CHARACTERISTIC
/begin CHARACTERISTIC FaultManager.Fuel_LvlRangeLow.Faulty_Samples__X_ "Fault manager configuration.  Select up to 4 actions for each fault." VALUE 0x80002FE0 RecordLayout_4 0 CompuMethod_1 0 65535 /end CHARACTERISTIC
/begin CHARACTERISTIC FaultManager.Fuel_LvlRangeLow.Total_Samples__Y_ "Fault manager configuration.  Select up to 4 actions for each fault." VALUE 0x80002FE2 RecordLayout_4 0 CompuMethod_1 0 65535 /end CHARACTERISTIC
/begin CHARACTERISTIC FaultManager.Fuel_LvlRangeLow.Action_1 "Fault manager configuration.  Select up to 4 actions for each fault." VALUE 0x80002FE4 RecordLayout_4 0 CompuMethod_115 0 65535 /end CHARACTERISTIC
/begin CHARACTERISTIC FaultManager.Fuel_LvlRangeLow.Action_1_Condition "Fault manager configuration.  Select up to 4 actions for each fault." VALUE 0x80002FE6 RecordLayout_4 0 CompuMethod_116 0 65535 /end CHARACTERISTIC
/begin CHARACTERISTIC FaultManager.Fuel_LvlRangeLow.Action_2 "Fault manager configuration.  Select up to 4 actions for each fault." VALUE 0x80002FE8 RecordLayout_4 0 CompuMethod_115 0 65535 /end CHARACTERISTIC
/begin CHARACTERISTIC FaultManager.Fuel_LvlRangeLow.Action_2_Condition "Fault manager configuration.  Select up to 4 actions for each fault." VALUE 0x80002FEA RecordLayout_4 0 CompuMethod_116 0 65535 /end CHARACTERISTIC
/begin CHARACTERISTIC FaultManager.Fuel_LvlRangeLow.Action_3 "Fault manager configuration.  Select up to 4 actions for each fault." VALUE 0x80002FEC RecordLayout_4 0 CompuMethod_115 0 65535 /end CHARACTERISTIC
/begin CHARACTERISTIC FaultManager.Fuel_LvlRangeLow.Action_3_Condition "Fault manager configuration.  Select up to 4 actions for each fault." VALUE 0x80002FEE RecordLayout_4 0 CompuMethod_116 0 65535 /end CHARACTERISTIC
/begin CHARACTERISTIC FaultManager.Fuel_LvlRangeLow.Action_4 "Fault manager configuration.  Select up to 4 actions for each fault." VALUE 0x80002FF0 RecordLayout_4 0 CompuMethod_115 0 65535 /end CHARACTERISTIC
/begin CHARACTERISTIC FaultManager.Fuel_LvlRangeLow.Action_4_Condition "Fault manager configuration.  Select up to 4 actions for each fault." VALUE 0x80002FF2 RecordLayout_4 0 CompuMethod_116 0 65535 /end CHARACTERISTIC
/begin CHARACTERISTIC FaultManager.GPS_DateTime_Timeout.Mode "Fault manager configuration.  Select up to 4 actions for each fault." VALUE 0x80002FF4 RecordLayout_4 0 CompuMethod_113 0 65535 /end CHARACTERISTIC
/begin CHARACTERISTIC FaultManager.GPS_DateTime_Timeout.ID "Fault manager configuration.  Select up to 4 actions for each fault." VALUE 0x80002FF6 RecordLayout_4 0 CompuMethod_1 0 65535 /end CHARACTERISTIC
/begin CHARACTERISTIC FaultManager.GPS_DateTime_Timeout.Test "Fault manager configuration.  Select up to 4 actions for each fault." VALUE 0x80002FF8 RecordLayout_4 0 CompuMethod_114 0 65535 /end CHARACTERISTIC
/begin CHARACTERISTIC FaultManager.GPS_DateTime_Timeout.Faulty_Samples__X_ "Fault manager configuration.  Select up to 4 actions for each fault." VALUE 0x80002FFA RecordLayout_4 0 CompuMethod_1 0 65535 /end CHARACTERISTIC
/begin CHARACTERISTIC FaultManager.GPS_DateTime_Timeout.Total_Samples__Y_ "Fault manager configuration.  Select up to 4 actions for each fault." VALUE 0x80002FFC RecordLayout_4 0 CompuMethod_1 0 65535 /end CHARACTERISTIC
/begin CHARACTERISTIC FaultManager.GPS_DateTime_Timeout.Action_1 "Fault manager configuration.  Select up to 4 actions for each fault." VALUE 0x80002FFE RecordLayout_4 0 CompuMethod_115 0 65535 /end CHARACTERISTIC
/begin CHARACTERISTIC FaultManager.GPS_DateTime_Timeout.Action_1_Condition "Fault manager configuration.  Select up to 4 actions for each fault." VALUE 0x80003000 RecordLayout_4 0 CompuMethod_116 0 65535 /end CHARACTERISTIC
/begin CHARACTERISTIC FaultManager.GPS_DateTime_Timeout.Action_2 "Fault manager configuration.  Select up to 4 actions for each fault." VALUE 0x80003002 RecordLayout_4 0 CompuMethod_115 0 65535 /end CHARACTERISTIC
/begin CHARACTERISTIC FaultManager.GPS_DateTime_Timeout.Action_2_Condition "Fault manager configuration.  Select up to 4 actions for each fault." VALUE 0x80003004 RecordLayout_4 0 CompuMethod_116 0 65535 /end CHARACTERISTIC
/begin CHARACTERISTIC FaultManager.GPS_DateTime_Timeout.Action_3 "Fault manager configuration.  Select up to 4 actions for each fault." VALUE 0x80003006 RecordLayout_4 0 CompuMethod_115 0 65535 /end CHARACTERISTIC
/begin CHARACTERISTIC FaultManager.GPS_DateTime_Timeout.Action_3_Condition "Fault manager configuration.  Select up to 4 actions for each fault." VALUE 0x80003008 RecordLayout_4 0 CompuMethod_116 0 65535 /end CHARACTERISTIC
/begin CHARACTERISTIC FaultManager.GPS_DateTime_Timeout.Action_4 "Fault manager configuration.  Select up to 4 actions for each fault." VALUE 0x8000300A RecordLayout_4 0 CompuMethod_115 0 65535 /end CHARACTERISTIC
/begin CHARACTERISTIC FaultManager.GPS_DateTime_Timeout.Action_4_Condition "Fault manager configuration.  Select up to 4 actions for each fault." VALUE 0x8000300C RecordLayout_4 0 CompuMethod_116 0 65535 /end CHARACTERISTIC
/begin CHARACTERISTIC FaultManager.GPS_LatLong_Timeout.Mode "Fault manager configuration.  Select up to 4 actions for each fault." VALUE 0x8000300E RecordLayout_4 0 CompuMethod_113 0 65535 /end CHARACTERISTIC
/begin CHARACTERISTIC FaultManager.GPS_LatLong_Timeout.ID "Fault manager configuration.  Select up to 4 actions for each fault." VALUE 0x80003010 RecordLayout_4 0 CompuMethod_1 0 65535 /end CHARACTERISTIC
/begin CHARACTERISTIC FaultManager.GPS_LatLong_Timeout.Test "Fault manager configuration.  Select up to 4 actions for each fault." VALUE 0x80003012 RecordLayout_4 0 CompuMethod_114 0 65535 /end CHARACTERISTIC
/begin CHARACTERISTIC FaultManager.GPS_LatLong_Timeout.Faulty_Samples__X_ "Fault manager configuration.  Select up to 4 actions for each fault." VALUE 0x80003014 RecordLayout_4 0 CompuMethod_1 0 65535 /end CHARACTERISTIC
/begin CHARACTERISTIC FaultManager.GPS_LatLong_Timeout.Total_Samples__Y_ "Fault manager configuration.  Select up to 4 actions for each fault." VALUE 0x80003016 RecordLayout_4 0 CompuMethod_1 0 65535 /end CHARACTERISTIC
/begin CHARACTERISTIC FaultManager.GPS_LatLong_Timeout.Action_1 "Fault manager configuration.  Select up to 4 actions for each fault." VALUE 0x80003018 RecordLayout_4 0 CompuMethod_115 0 65535 /end CHARACTERISTIC
/begin CHARACTERISTIC FaultManager.GPS_LatLong_Timeout.Action_1_Condition "Fault manager configuration.  Select up to 4 actions for each fault." VALUE 0x8000301A RecordLayout_4 0 CompuMethod_116 0 65535 /end CHARACTERISTIC
/begin CHARACTERISTIC FaultManager.GPS_LatLong_Timeout.Action_2 "Fault manager configuration.  Select up to 4 actions for each fault." VALUE 0x8000301C RecordLayout_4 0 CompuMethod_115 0 65535 /end CHARACTERISTIC
/begin CHARACTERISTIC FaultManager.GPS_LatLong_Timeout.Action_2_Condition "Fault manager configuration.  Select up to 4 actions for each fault." VALUE 0x8000301E RecordLayout_4 0 CompuMethod_116 0 65535 /end CHARACTERISTIC
/begin CHARACTERISTIC FaultManager.GPS_LatLong_Timeout.Action_3 "Fault manager configuration.  Select up to 4 actions for each fault." VALUE 0x80003020 RecordLayout_4 0 CompuMethod_115 0 65535 /end CHARACTERISTIC
/begin CHARACTERISTIC FaultManager.GPS_LatLong_Timeout.Action_3_Condition "Fault manager configuration.  Select up to 4 actions for each fault." VALUE 0x80003022 RecordLayout_4 0 CompuMethod_116 0 65535 /end CHARACTERISTIC
/begin CHARACTERISTIC FaultManager.GPS_LatLong_Timeout.Action_4 "Fault manager configuration.  Select up to 4 actions for each fault." VALUE 0x80003024 RecordLayout_4 0 CompuMethod_115 0 65535 /end CHARACTERISTIC
/begin CHARACTERISTIC FaultManager.GPS_LatLong_Timeout.Action_4_Condition "Fault manager configuration.  Select up to 4 actions for each fault." VALUE 0x80003026 RecordLayout_4 0 CompuMethod_116 0 65535 /end CHARACTERISTIC
/begin CHARACTERISTIC FaultManager.GPS_SpeedDir_Timeout.Mode "Fault manager configuration.  Select up to 4 actions for each fault." VALUE 0x80003028 RecordLayout_4 0 CompuMethod_113 0 65535 /end CHARACTERISTIC
/begin CHARACTERISTIC FaultManager.GPS_SpeedDir_Timeout.ID "Fault manager configuration.  Select up to 4 actions for each fault." VALUE 0x8000302A RecordLayout_4 0 CompuMethod_1 0 65535 /end CHARACTERISTIC
/begin CHARACTERISTIC FaultManager.GPS_SpeedDir_Timeout.Test "Fault manager configuration.  Select up to 4 actions for each fault." VALUE 0x8000302C RecordLayout_4 0 CompuMethod_114 0 65535 /end CHARACTERISTIC
/begin CHARACTERISTIC FaultManager.GPS_SpeedDir_Timeout.Faulty_Samples__X_ "Fault manager configuration.  Select up to 4 actions for each fault." VALUE 0x8000302E RecordLayout_4 0 CompuMethod_1 0 65535 /end CHARACTERISTIC
/begin CHARACTERISTIC FaultManager.GPS_SpeedDir_Timeout.Total_Samples__Y_ "Fault manager configuration.  Select up to 4 actions for each fault." VALUE 0x80003030 RecordLayout_4 0 CompuMethod_1 0 65535 /end CHARACTERISTIC
/begin CHARACTERISTIC FaultManager.GPS_SpeedDir_Timeout.Action_1 "Fault manager configuration.  Select up to 4 actions for each fault." VALUE 0x80003032 RecordLayout_4 0 CompuMethod_115 0 65535 /end CHARACTERISTIC
/begin CHARACTERISTIC FaultManager.GPS_SpeedDir_Timeout.Action_1_Condition "Fault manager configuration.  Select up to 4 actions for each fault." VALUE 0x80003034 RecordLayout_4 0 CompuMethod_116 0 65535 /end CHARACTERISTIC
/begin CHARACTERISTIC FaultManager.GPS_SpeedDir_Timeout.Action_2 "Fault manager configuration.  Select up to 4 actions for each fault." VALUE 0x80003036 RecordLayout_4 0 CompuMethod_115 0 65535 /end CHARACTERISTIC
/begin CHARACTERISTIC FaultManager.GPS_SpeedDir_Timeout.Action_2_Condition "Fault manager configuration.  Select up to 4 actions for each fault." VALUE 0x80003038 RecordLayout_4 0 CompuMethod_116 0 65535 /end CHARACTERISTIC
/begin CHARACTERISTIC FaultManager.GPS_SpeedDir_Timeout.Action_3 "Fault manager configuration.  Select up to 4 actions for each fault." VALUE 0x8000303A RecordLayout_4 0 CompuMethod_115 0 65535 /end CHARACTERISTIC
/begin CHARACTERISTIC FaultManager.GPS_SpeedDir_Timeout.Action_3_Condition "Fault manager configuration.  Select up to 4 actions for each fault." VALUE 0x8000303C RecordLayout_4 0 CompuMethod_116 0 65535 /end CHARACTERISTIC
/begin CHARACTERISTIC FaultManager.GPS_SpeedDir_Timeout.Action_4 "Fault manager configuration.  Select up to 4 actions for each fault." VALUE 0x8000303E RecordLayout_4 0 CompuMethod_115 0 65535 /end CHARACTERISTIC
/begin CHARACTERISTIC FaultManager.GPS_SpeedDir_Timeout.Action_4_Condition "Fault manager configuration.  Select up to 4 actions for each fault." VALUE 0x80003040 RecordLayout_4 0 CompuMethod_116 0 65535 /end CHARACTERISTIC
/begin CHARACTERISTIC FaultManager.HardOverBoost_Fault.Mode "Fault manager configuration.  Select up to 4 actions for each fault." VALUE 0x80003042 RecordLayout_4 0 CompuMethod_113 0 65535 /end CHARACTERISTIC
/begin CHARACTERISTIC FaultManager.HardOverBoost_Fault.ID "Fault manager configuration.  Select up to 4 actions for each fault." VALUE 0x80003044 RecordLayout_4 0 CompuMethod_1 0 65535 /end CHARACTERISTIC
/begin CHARACTERISTIC FaultManager.HardOverBoost_Fault.Test "Fault manager configuration.  Select up to 4 actions for each fault." VALUE 0x80003046 RecordLayout_4 0 CompuMethod_114 0 65535 /end CHARACTERISTIC
/begin CHARACTERISTIC FaultManager.HardOverBoost_Fault.Faulty_Samples__X_ "Fault manager configuration.  Select up to 4 actions for each fault." VALUE 0x80003048 RecordLayout_4 0 CompuMethod_1 0 65535 /end CHARACTERISTIC
/begin CHARACTERISTIC FaultManager.HardOverBoost_Fault.Total_Samples__Y_ "Fault manager configuration.  Select up to 4 actions for each fault." VALUE 0x8000304A RecordLayout_4 0 CompuMethod_1 0 65535 /end CHARACTERISTIC
/begin CHARACTERISTIC FaultManager.HardOverBoost_Fault.Action_1 "Fault manager configuration.  Select up to 4 actions for each fault." VALUE 0x8000304C RecordLayout_4 0 CompuMethod_115 0 65535 /end CHARACTERISTIC
/begin CHARACTERISTIC FaultManager.HardOverBoost_Fault.Action_1_Condition "Fault manager configuration.  Select up to 4 actions for each fault." VALUE 0x8000304E RecordLayout_4 0 CompuMethod_116 0 65535 /end CHARACTERISTIC
/begin CHARACTERISTIC FaultManager.HardOverBoost_Fault.Action_2 "Fault manager configuration.  Select up to 4 actions for each fault." VALUE 0x80003050 RecordLayout_4 0 CompuMethod_115 0 65535 /end CHARACTERISTIC
/begin CHARACTERISTIC FaultManager.HardOverBoost_Fault.Action_2_Condition "Fault manager configuration.  Select up to 4 actions for each fault." VALUE 0x80003052 RecordLayout_4 0 CompuMethod_116 0 65535 /end CHARACTERISTIC
/begin CHARACTERISTIC FaultManager.HardOverBoost_Fault.Action_3 "Fault manager configuration.  Select up to 4 actions for each fault." VALUE 0x80003054 RecordLayout_4 0 CompuMethod_115 0 65535 /end CHARACTERISTIC
/begin CHARACTERISTIC FaultManager.HardOverBoost_Fault.Action_3_Condition "Fault manager configuration.  Select up to 4 actions for each fault." VALUE 0x80003056 RecordLayout_4 0 CompuMethod_116 0 65535 /end CHARACTERISTIC
/begin CHARACTERISTIC FaultManager.HardOverBoost_Fault.Action_4 "Fault manager configuration.  Select up to 4 actions for each fault." VALUE 0x80003058 RecordLayout_4 0 CompuMethod_115 0 65535 /end CHARACTERISTIC
/begin CHARACTERISTIC FaultManager.HardOverBoost_Fault.Action_4_Condition "Fault manager configuration.  Select up to 4 actions for each fault." VALUE 0x8000305A RecordLayout_4 0 CompuMethod_116 0 65535 /end CHARACTERISTIC
/begin CHARACTERISTIC FaultManager.HardOverspeed.Mode "Fault manager configuration.  Select up to 4 actions for each fault." VALUE 0x8000305C RecordLayout_4 0 CompuMethod_113 0 65535 /end CHARACTERISTIC
/begin CHARACTERISTIC FaultManager.HardOverspeed.ID "Fault manager configuration.  Select up to 4 actions for each fault." VALUE 0x8000305E RecordLayout_4 0 CompuMethod_1 0 65535 /end CHARACTERISTIC
/begin CHARACTERISTIC FaultManager.HardOverspeed.Test "Fault manager configuration.  Select up to 4 actions for each fault." VALUE 0x80003060 RecordLayout_4 0 CompuMethod_114 0 65535 /end CHARACTERISTIC
/begin CHARACTERISTIC FaultManager.HardOverspeed.Faulty_Samples__X_ "Fault manager configuration.  Select up to 4 actions for each fault." VALUE 0x80003062 RecordLayout_4 0 CompuMethod_1 0 65535 /end CHARACTERISTIC
/begin CHARACTERISTIC FaultManager.HardOverspeed.Total_Samples__Y_ "Fault manager configuration.  Select up to 4 actions for each fault." VALUE 0x80003064 RecordLayout_4 0 CompuMethod_1 0 65535 /end CHARACTERISTIC
/begin CHARACTERISTIC FaultManager.HardOverspeed.Action_1 "Fault manager configuration.  Select up to 4 actions for each fault." VALUE 0x80003066 RecordLayout_4 0 CompuMethod_115 0 65535 /end CHARACTERISTIC
/begin CHARACTERISTIC FaultManager.HardOverspeed.Action_1_Condition "Fault manager configuration.  Select up to 4 actions for each fault." VALUE 0x80003068 RecordLayout_4 0 CompuMethod_116 0 65535 /end CHARACTERISTIC
/begin CHARACTERISTIC FaultManager.HardOverspeed.Action_2 "Fault manager configuration.  Select up to 4 actions for each fault." VALUE 0x8000306A RecordLayout_4 0 CompuMethod_115 0 65535 /end CHARACTERISTIC
/begin CHARACTERISTIC FaultManager.HardOverspeed.Action_2_Condition "Fault manager configuration.  Select up to 4 actions for each fault." VALUE 0x8000306C RecordLayout_4 0 CompuMethod_116 0 65535 /end CHARACTERISTIC
/begin CHARACTERISTIC FaultManager.HardOverspeed.Action_3 "Fault manager configuration.  Select up to 4 actions for each fault." VALUE 0x8000306E RecordLayout_4 0 CompuMethod_115 0 65535 /end CHARACTERISTIC
/begin CHARACTERISTIC FaultManager.HardOverspeed.Action_3_Condition "Fault manager configuration.  Select up to 4 actions for each fault." VALUE 0x80003070 RecordLayout_4 0 CompuMethod_116 0 65535 /end CHARACTERISTIC
/begin CHARACTERISTIC FaultManager.HardOverspeed.Action_4 "Fault manager configuration.  Select up to 4 actions for each fault." VALUE 0x80003072 RecordLayout_4 0 CompuMethod_115 0 65535 /end CHARACTERISTIC
/begin CHARACTERISTIC FaultManager.HardOverspeed.Action_4_Condition "Fault manager configuration.  Select up to 4 actions for each fault." VALUE 0x80003074 RecordLayout_4 0 CompuMethod_116 0 65535 /end CHARACTERISTIC
/begin CHARACTERISTIC FaultManager.IATRangeHigh.Mode "Fault manager configuration.  Select up to 4 actions for each fault." VALUE 0x80003076 RecordLayout_4 0 CompuMethod_113 0 65535 /end CHARACTERISTIC
/begin CHARACTERISTIC FaultManager.IATRangeHigh.ID "Fault manager configuration.  Select up to 4 actions for each fault." VALUE 0x80003078 RecordLayout_4 0 CompuMethod_1 0 65535 /end CHARACTERISTIC
/begin CHARACTERISTIC FaultManager.IATRangeHigh.Test "Fault manager configuration.  Select up to 4 actions for each fault." VALUE 0x8000307A RecordLayout_4 0 CompuMethod_114 0 65535 /end CHARACTERISTIC
/begin CHARACTERISTIC FaultManager.IATRangeHigh.Faulty_Samples__X_ "Fault manager configuration.  Select up to 4 actions for each fault." VALUE 0x8000307C RecordLayout_4 0 CompuMethod_1 0 65535 /end CHARACTERISTIC
/begin CHARACTERISTIC FaultManager.IATRangeHigh.Total_Samples__Y_ "Fault manager configuration.  Select up to 4 actions for each fault." VALUE 0x8000307E RecordLayout_4 0 CompuMethod_1 0 65535 /end CHARACTERISTIC
/begin CHARACTERISTIC FaultManager.IATRangeHigh.Action_1 "Fault manager configuration.  Select up to 4 actions for each fault." VALUE 0x80003080 RecordLayout_4 0 CompuMethod_115 0 65535 /end CHARACTERISTIC
/begin CHARACTERISTIC FaultManager.IATRangeHigh.Action_1_Condition "Fault manager configuration.  Select up to 4 actions for each fault." VALUE 0x80003082 RecordLayout_4 0 CompuMethod_116 0 65535 /end CHARACTERISTIC
/begin CHARACTERISTIC FaultManager.IATRangeHigh.Action_2 "Fault manager configuration.  Select up to 4 actions for each fault." VALUE 0x80003084 RecordLayout_4 0 CompuMethod_115 0 65535 /end CHARACTERISTIC
/begin CHARACTERISTIC FaultManager.IATRangeHigh.Action_2_Condition "Fault manager configuration.  Select up to 4 actions for each fault." VALUE 0x80003086 RecordLayout_4 0 CompuMethod_116 0 65535 /end CHARACTERISTIC
/begin CHARACTERISTIC FaultManager.IATRangeHigh.Action_3 "Fault manager configuration.  Select up to 4 actions for each fault." VALUE 0x80003088 RecordLayout_4 0 CompuMethod_115 0 65535 /end CHARACTERISTIC
/begin CHARACTERISTIC FaultManager.IATRangeHigh.Action_3_Condition "Fault manager configuration.  Select up to 4 actions for each fault." VALUE 0x8000308A RecordLayout_4 0 CompuMethod_116 0 65535 /end CHARACTERISTIC
/begin CHARACTERISTIC FaultManager.IATRangeHigh.Action_4 "Fault manager configuration.  Select up to 4 actions for each fault." VALUE 0x8000308C RecordLayout_4 0 CompuMethod_115 0 65535 /end CHARACTERISTIC
/begin CHARACTERISTIC FaultManager.IATRangeHigh.Action_4_Condition "Fault manager configuration.  Select up to 4 actions for each fault." VALUE 0x8000308E RecordLayout_4 0 CompuMethod_116 0 65535 /end CHARACTERISTIC
/begin CHARACTERISTIC FaultManager.IATRangeLow.Mode "Fault manager configuration.  Select up to 4 actions for each fault." VALUE 0x80003090 RecordLayout_4 0 CompuMethod_113 0 65535 /end CHARACTERISTIC
/begin CHARACTERISTIC FaultManager.IATRangeLow.ID "Fault manager configuration.  Select up to 4 actions for each fault." VALUE 0x80003092 RecordLayout_4 0 CompuMethod_1 0 65535 /end CHARACTERISTIC
/begin CHARACTERISTIC FaultManager.IATRangeLow.Test "Fault manager configuration.  Select up to 4 actions for each fault." VALUE 0x80003094 RecordLayout_4 0 CompuMethod_114 0 65535 /end CHARACTERISTIC
/begin CHARACTERISTIC FaultManager.IATRangeLow.Faulty_Samples__X_ "Fault manager configuration.  Select up to 4 actions for each fault." VALUE 0x80003096 RecordLayout_4 0 CompuMethod_1 0 65535 /end CHARACTERISTIC
/begin CHARACTERISTIC FaultManager.IATRangeLow.Total_Samples__Y_ "Fault manager configuration.  Select up to 4 actions for each fault." VALUE 0x80003098 RecordLayout_4 0 CompuMethod_1 0 65535 /end CHARACTERISTIC
/begin CHARACTERISTIC FaultManager.IATRangeLow.Action_1 "Fault manager configuration.  Select up to 4 actions for each fault." VALUE 0x8000309A RecordLayout_4 0 CompuMethod_115 0 65535 /end CHARACTERISTIC
/begin CHARACTERISTIC FaultManager.IATRangeLow.Action_1_Condition "Fault manager configuration.  Select up to 4 actions for each fault." VALUE 0x8000309C RecordLayout_4 0 CompuMethod_116 0 65535 /end CHARACTERISTIC
/begin CHARACTERISTIC FaultManager.IATRangeLow.Action_2 "Fault manager configuration.  Select up to 4 actions for each fault." VALUE 0x8000309E RecordLayout_4 0 CompuMethod_115 0 65535 /end CHARACTERISTIC
/begin CHARACTERISTIC FaultManager.IATRangeLow.Action_2_Condition "Fault manager configuration.  Select up to 4 actions for each fault." VALUE 0x800030A0 RecordLayout_4 0 CompuMethod_116 0 65535 /end CHARACTERISTIC
/begin CHARACTERISTIC FaultManager.IATRangeLow.Action_3 "Fault manager configuration.  Select up to 4 actions for each fault." VALUE 0x800030A2 RecordLayout_4 0 CompuMethod_115 0 65535 /end CHARACTERISTIC
/begin CHARACTERISTIC FaultManager.IATRangeLow.Action_3_Condition "Fault manager configuration.  Select up to 4 actions for each fault." VALUE 0x800030A4 RecordLayout_4 0 CompuMethod_116 0 65535 /end CHARACTERISTIC
/begin CHARACTERISTIC FaultManager.IATRangeLow.Action_4 "Fault manager configuration.  Select up to 4 actions for each fault." VALUE 0x800030A6 RecordLayout_4 0 CompuMethod_115 0 65535 /end CHARACTERISTIC
/begin CHARACTERISTIC FaultManager.IATRangeLow.Action_4_Condition "Fault manager configuration.  Select up to 4 actions for each fault." VALUE 0x800030A8 RecordLayout_4 0 CompuMethod_116 0 65535 /end CHARACTERISTIC
/begin CHARACTERISTIC FaultManager.Inj1Open.Mode "Fault manager configuration.  Select up to 4 actions for each fault." VALUE 0x800030AA RecordLayout_4 0 CompuMethod_113 0 65535 /end CHARACTERISTIC
/begin CHARACTERISTIC FaultManager.Inj1Open.ID "Fault manager configuration.  Select up to 4 actions for each fault." VALUE 0x800030AC RecordLayout_4 0 CompuMethod_1 0 65535 /end CHARACTERISTIC
/begin CHARACTERISTIC FaultManager.Inj1Open.Test "Fault manager configuration.  Select up to 4 actions for each fault." VALUE 0x800030AE RecordLayout_4 0 CompuMethod_114 0 65535 /end CHARACTERISTIC
/begin CHARACTERISTIC FaultManager.Inj1Open.Faulty_Samples__X_ "Fault manager configuration.  Select up to 4 actions for each fault." VALUE 0x800030B0 RecordLayout_4 0 CompuMethod_1 0 65535 /end CHARACTERISTIC
/begin CHARACTERISTIC FaultManager.Inj1Open.Total_Samples__Y_ "Fault manager configuration.  Select up to 4 actions for each fault." VALUE 0x800030B2 RecordLayout_4 0 CompuMethod_1 0 65535 /end CHARACTERISTIC
/begin CHARACTERISTIC FaultManager.Inj1Open.Action_1 "Fault manager configuration.  Select up to 4 actions for each fault." VALUE 0x800030B4 RecordLayout_4 0 CompuMethod_115 0 65535 /end CHARACTERISTIC
/begin CHARACTERISTIC FaultManager.Inj1Open.Action_1_Condition "Fault manager configuration.  Select up to 4 actions for each fault." VALUE 0x800030B6 RecordLayout_4 0 CompuMethod_116 0 65535 /end CHARACTERISTIC
/begin CHARACTERISTIC FaultManager.Inj1Open.Action_2 "Fault manager configuration.  Select up to 4 actions for each fault." VALUE 0x800030B8 RecordLayout_4 0 CompuMethod_115 0 65535 /end CHARACTERISTIC
/begin CHARACTERISTIC FaultManager.Inj1Open.Action_2_Condition "Fault manager configuration.  Select up to 4 actions for each fault." VALUE 0x800030BA RecordLayout_4 0 CompuMethod_116 0 65535 /end CHARACTERISTIC
/begin CHARACTERISTIC FaultManager.Inj1Open.Action_3 "Fault manager configuration.  Select up to 4 actions for each fault." VALUE 0x800030BC RecordLayout_4 0 CompuMethod_115 0 65535 /end CHARACTERISTIC
/begin CHARACTERISTIC FaultManager.Inj1Open.Action_3_Condition "Fault manager configuration.  Select up to 4 actions for each fault." VALUE 0x800030BE RecordLayout_4 0 CompuMethod_116 0 65535 /end CHARACTERISTIC
/begin CHARACTERISTIC FaultManager.Inj1Open.Action_4 "Fault manager configuration.  Select up to 4 actions for each fault." VALUE 0x800030C0 RecordLayout_4 0 CompuMethod_115 0 65535 /end CHARACTERISTIC
/begin CHARACTERISTIC FaultManager.Inj1Open.Action_4_Condition "Fault manager configuration.  Select up to 4 actions for each fault." VALUE 0x800030C2 RecordLayout_4 0 CompuMethod_116 0 65535 /end CHARACTERISTIC
/begin CHARACTERISTIC FaultManager.Inj2Open.Mode "Fault manager configuration.  Select up to 4 actions for each fault." VALUE 0x800030C4 RecordLayout_4 0 CompuMethod_113 0 65535 /end CHARACTERISTIC
/begin CHARACTERISTIC FaultManager.Inj2Open.ID "Fault manager configuration.  Select up to 4 actions for each fault." VALUE 0x800030C6 RecordLayout_4 0 CompuMethod_1 0 65535 /end CHARACTERISTIC
/begin CHARACTERISTIC FaultManager.Inj2Open.Test "Fault manager configuration.  Select up to 4 actions for each fault." VALUE 0x800030C8 RecordLayout_4 0 CompuMethod_114 0 65535 /end CHARACTERISTIC
/begin CHARACTERISTIC FaultManager.Inj2Open.Faulty_Samples__X_ "Fault manager configuration.  Select up to 4 actions for each fault." VALUE 0x800030CA RecordLayout_4 0 CompuMethod_1 0 65535 /end CHARACTERISTIC
/begin CHARACTERISTIC FaultManager.Inj2Open.Total_Samples__Y_ "Fault manager configuration.  Select up to 4 actions for each fault." VALUE 0x800030CC RecordLayout_4 0 CompuMethod_1 0 65535 /end CHARACTERISTIC
/begin CHARACTERISTIC FaultManager.Inj2Open.Action_1 "Fault manager configuration.  Select up to 4 actions for each fault." VALUE 0x800030CE RecordLayout_4 0 CompuMethod_115 0 65535 /end CHARACTERISTIC
/begin CHARACTERISTIC FaultManager.Inj2Open.Action_1_Condition "Fault manager configuration.  Select up to 4 actions for each fault." VALUE 0x800030D0 RecordLayout_4 0 CompuMethod_116 0 65535 /end CHARACTERISTIC
/begin CHARACTERISTIC FaultManager.Inj2Open.Action_2 "Fault manager configuration.  Select up to 4 actions for each fault." VALUE 0x800030D2 RecordLayout_4 0 CompuMethod_115 0 65535 /end CHARACTERISTIC
/begin CHARACTERISTIC FaultManager.Inj2Open.Action_2_Condition "Fault manager configuration.  Select up to 4 actions for each fault." VALUE 0x800030D4 RecordLayout_4 0 CompuMethod_116 0 65535 /end CHARACTERISTIC
/begin CHARACTERISTIC FaultManager.Inj2Open.Action_3 "Fault manager configuration.  Select up to 4 actions for each fault." VALUE 0x800030D6 RecordLayout_4 0 CompuMethod_115 0 65535 /end CHARACTERISTIC
/begin CHARACTERISTIC FaultManager.Inj2Open.Action_3_Condition "Fault manager configuration.  Select up to 4 actions for each fault." VALUE 0x800030D8 RecordLayout_4 0 CompuMethod_116 0 65535 /end CHARACTERISTIC
/begin CHARACTERISTIC FaultManager.Inj2Open.Action_4 "Fault manager configuration.  Select up to 4 actions for each fault." VALUE 0x800030DA RecordLayout_4 0 CompuMethod_115 0 65535 /end CHARACTERISTIC
/begin CHARACTERISTIC FaultManager.Inj2Open.Action_4_Condition "Fault manager configuration.  Select up to 4 actions for each fault." VALUE 0x800030DC RecordLayout_4 0 CompuMethod_116 0 65535 /end CHARACTERISTIC
/begin CHARACTERISTIC FaultManager.Inj3Open.Mode "Fault manager configuration.  Select up to 4 actions for each fault." VALUE 0x800030DE RecordLayout_4 0 CompuMethod_113 0 65535 /end CHARACTERISTIC
/begin CHARACTERISTIC FaultManager.Inj3Open.ID "Fault manager configuration.  Select up to 4 actions for each fault." VALUE 0x800030E0 RecordLayout_4 0 CompuMethod_1 0 65535 /end CHARACTERISTIC
/begin CHARACTERISTIC FaultManager.Inj3Open.Test "Fault manager configuration.  Select up to 4 actions for each fault." VALUE 0x800030E2 RecordLayout_4 0 CompuMethod_114 0 65535 /end CHARACTERISTIC
/begin CHARACTERISTIC FaultManager.Inj3Open.Faulty_Samples__X_ "Fault manager configuration.  Select up to 4 actions for each fault." VALUE 0x800030E4 RecordLayout_4 0 CompuMethod_1 0 65535 /end CHARACTERISTIC
/begin CHARACTERISTIC FaultManager.Inj3Open.Total_Samples__Y_ "Fault manager configuration.  Select up to 4 actions for each fault." VALUE 0x800030E6 RecordLayout_4 0 CompuMethod_1 0 65535 /end CHARACTERISTIC
/begin CHARACTERISTIC FaultManager.Inj3Open.Action_1 "Fault manager configuration.  Select up to 4 actions for each fault." VALUE 0x800030E8 RecordLayout_4 0 CompuMethod_115 0 65535 /end CHARACTERISTIC
/begin CHARACTERISTIC FaultManager.Inj3Open.Action_1_Condition "Fault manager configuration.  Select up to 4 actions for each fault." VALUE 0x800030EA RecordLayout_4 0 CompuMethod_116 0 65535 /end CHARACTERISTIC
/begin CHARACTERISTIC FaultManager.Inj3Open.Action_2 "Fault manager configuration.  Select up to 4 actions for each fault." VALUE 0x800030EC RecordLayout_4 0 CompuMethod_115 0 65535 /end CHARACTERISTIC
/begin CHARACTERISTIC FaultManager.Inj3Open.Action_2_Condition "Fault manager configuration.  Select up to 4 actions for each fault." VALUE 0x800030EE RecordLayout_4 0 CompuMethod_116 0 65535 /end CHARACTERISTIC
/begin CHARACTERISTIC FaultManager.Inj3Open.Action_3 "Fault manager configuration.  Select up to 4 actions for each fault." VALUE 0x800030F0 RecordLayout_4 0 CompuMethod_115 0 65535 /end CHARACTERISTIC
/begin CHARACTERISTIC FaultManager.Inj3Open.Action_3_Condition "Fault manager configuration.  Select up to 4 actions for each fault." VALUE 0x800030F2 RecordLayout_4 0 CompuMethod_116 0 65535 /end CHARACTERISTIC
/begin CHARACTERISTIC FaultManager.Inj3Open.Action_4 "Fault manager configuration.  Select up to 4 actions for each fault." VALUE 0x800030F4 RecordLayout_4 0 CompuMethod_115 0 65535 /end CHARACTERISTIC
/begin CHARACTERISTIC FaultManager.Inj3Open.Action_4_Condition "Fault manager configuration.  Select up to 4 actions for each fault." VALUE 0x800030F6 RecordLayout_4 0 CompuMethod_116 0 65535 /end CHARACTERISTIC
/begin CHARACTERISTIC FaultManager.Inj4Open.Mode "Fault manager configuration.  Select up to 4 actions for each fault." VALUE 0x800030F8 RecordLayout_4 0 CompuMethod_113 0 65535 /end CHARACTERISTIC
/begin CHARACTERISTIC FaultManager.Inj4Open.ID "Fault manager configuration.  Select up to 4 actions for each fault." VALUE 0x800030FA RecordLayout_4 0 CompuMethod_1 0 65535 /end CHARACTERISTIC
/begin CHARACTERISTIC FaultManager.Inj4Open.Test "Fault manager configuration.  Select up to 4 actions for each fault." VALUE 0x800030FC RecordLayout_4 0 CompuMethod_114 0 65535 /end CHARACTERISTIC
/begin CHARACTERISTIC FaultManager.Inj4Open.Faulty_Samples__X_ "Fault manager configuration.  Select up to 4 actions for each fault." VALUE 0x800030FE RecordLayout_4 0 CompuMethod_1 0 65535 /end CHARACTERISTIC
/begin CHARACTERISTIC FaultManager.Inj4Open.Total_Samples__Y_ "Fault manager configuration.  Select up to 4 actions for each fault." VALUE 0x80003100 RecordLayout_4 0 CompuMethod_1 0 65535 /end CHARACTERISTIC
/begin CHARACTERISTIC FaultManager.Inj4Open.Action_1 "Fault manager configuration.  Select up to 4 actions for each fault." VALUE 0x80003102 RecordLayout_4 0 CompuMethod_115 0 65535 /end CHARACTERISTIC
/begin CHARACTERISTIC FaultManager.Inj4Open.Action_1_Condition "Fault manager configuration.  Select up to 4 actions for each fault." VALUE 0x80003104 RecordLayout_4 0 CompuMethod_116 0 65535 /end CHARACTERISTIC
/begin CHARACTERISTIC FaultManager.Inj4Open.Action_2 "Fault manager configuration.  Select up to 4 actions for each fault." VALUE 0x80003106 RecordLayout_4 0 CompuMethod_115 0 65535 /end CHARACTERISTIC
/begin CHARACTERISTIC FaultManager.Inj4Open.Action_2_Condition "Fault manager configuration.  Select up to 4 actions for each fault." VALUE 0x80003108 RecordLayout_4 0 CompuMethod_116 0 65535 /end CHARACTERISTIC
/begin CHARACTERISTIC FaultManager.Inj4Open.Action_3 "Fault manager configuration.  Select up to 4 actions for each fault." VALUE 0x8000310A RecordLayout_4 0 CompuMethod_115 0 65535 /end CHARACTERISTIC
/begin CHARACTERISTIC FaultManager.Inj4Open.Action_3_Condition "Fault manager configuration.  Select up to 4 actions for each fault." VALUE 0x8000310C RecordLayout_4 0 CompuMethod_116 0 65535 /end CHARACTERISTIC
/begin CHARACTERISTIC FaultManager.Inj4Open.Action_4 "Fault manager configuration.  Select up to 4 actions for each fault." VALUE 0x8000310E RecordLayout_4 0 CompuMethod_115 0 65535 /end CHARACTERISTIC
/begin CHARACTERISTIC FaultManager.Inj4Open.Action_4_Condition "Fault manager configuration.  Select up to 4 actions for each fault." VALUE 0x80003110 RecordLayout_4 0 CompuMethod_116 0 65535 /end CHARACTERISTIC
/begin CHARACTERISTIC FaultManager.Inj5Open.Mode "Fault manager configuration.  Select up to 4 actions for each fault." VALUE 0x80003112 RecordLayout_4 0 CompuMethod_113 0 65535 /end CHARACTERISTIC
/begin CHARACTERISTIC FaultManager.Inj5Open.ID "Fault manager configuration.  Select up to 4 actions for each fault." VALUE 0x80003114 RecordLayout_4 0 CompuMethod_1 0 65535 /end CHARACTERISTIC
/begin CHARACTERISTIC FaultManager.Inj5Open.Test "Fault manager configuration.  Select up to 4 actions for each fault." VALUE 0x80003116 RecordLayout_4 0 CompuMethod_114 0 65535 /end CHARACTERISTIC
/begin CHARACTERISTIC FaultManager.Inj5Open.Faulty_Samples__X_ "Fault manager configuration.  Select up to 4 actions for each fault." VALUE 0x80003118 RecordLayout_4 0 CompuMethod_1 0 65535 /end CHARACTERISTIC
/begin CHARACTERISTIC FaultManager.Inj5Open.Total_Samples__Y_ "Fault manager configuration.  Select up to 4 actions for each fault." VALUE 0x8000311A RecordLayout_4 0 CompuMethod_1 0 65535 /end CHARACTERISTIC
/begin CHARACTERISTIC FaultManager.Inj5Open.Action_1 "Fault manager configuration.  Select up to 4 actions for each fault." VALUE 0x8000311C RecordLayout_4 0 CompuMethod_115 0 65535 /end CHARACTERISTIC
/begin CHARACTERISTIC FaultManager.Inj5Open.Action_1_Condition "Fault manager configuration.  Select up to 4 actions for each fault." VALUE 0x8000311E RecordLayout_4 0 CompuMethod_116 0 65535 /end CHARACTERISTIC
/begin CHARACTERISTIC FaultManager.Inj5Open.Action_2 "Fault manager configuration.  Select up to 4 actions for each fault." VALUE 0x80003120 RecordLayout_4 0 CompuMethod_115 0 65535 /end CHARACTERISTIC
/begin CHARACTERISTIC FaultManager.Inj5Open.Action_2_Condition "Fault manager configuration.  Select up to 4 actions for each fault." VALUE 0x80003122 RecordLayout_4 0 CompuMethod_116 0 65535 /end CHARACTERISTIC
/begin CHARACTERISTIC FaultManager.Inj5Open.Action_3 "Fault manager configuration.  Select up to 4 actions for each fault." VALUE 0x80003124 RecordLayout_4 0 CompuMethod_115 0 65535 /end CHARACTERISTIC
/begin CHARACTERISTIC FaultManager.Inj5Open.Action_3_Condition "Fault manager configuration.  Select up to 4 actions for each fault." VALUE 0x80003126 RecordLayout_4 0 CompuMethod_116 0 65535 /end CHARACTERISTIC
/begin CHARACTERISTIC FaultManager.Inj5Open.Action_4 "Fault manager configuration.  Select up to 4 actions for each fault." VALUE 0x80003128 RecordLayout_4 0 CompuMethod_115 0 65535 /end CHARACTERISTIC
/begin CHARACTERISTIC FaultManager.Inj5Open.Action_4_Condition "Fault manager configuration.  Select up to 4 actions for each fault." VALUE 0x8000312A RecordLayout_4 0 CompuMethod_116 0 65535 /end CHARACTERISTIC
/begin CHARACTERISTIC FaultManager.Inj6Open.Mode "Fault manager configuration.  Select up to 4 actions for each fault." VALUE 0x8000312C RecordLayout_4 0 CompuMethod_113 0 65535 /end CHARACTERISTIC
/begin CHARACTERISTIC FaultManager.Inj6Open.ID "Fault manager configuration.  Select up to 4 actions for each fault." VALUE 0x8000312E RecordLayout_4 0 CompuMethod_1 0 65535 /end CHARACTERISTIC
/begin CHARACTERISTIC FaultManager.Inj6Open.Test "Fault manager configuration.  Select up to 4 actions for each fault." VALUE 0x80003130 RecordLayout_4 0 CompuMethod_114 0 65535 /end CHARACTERISTIC
/begin CHARACTERISTIC FaultManager.Inj6Open.Faulty_Samples__X_ "Fault manager configuration.  Select up to 4 actions for each fault." VALUE 0x80003132 RecordLayout_4 0 CompuMethod_1 0 65535 /end CHARACTERISTIC
/begin CHARACTERISTIC FaultManager.Inj6Open.Total_Samples__Y_ "Fault manager configuration.  Select up to 4 actions for each fault." VALUE 0x80003134 RecordLayout_4 0 CompuMethod_1 0 65535 /end CHARACTERISTIC
/begin CHARACTERISTIC FaultManager.Inj6Open.Action_1 "Fault manager configuration.  Select up to 4 actions for each fault." VALUE 0x80003136 RecordLayout_4 0 CompuMethod_115 0 65535 /end CHARACTERISTIC
/begin CHARACTERISTIC FaultManager.Inj6Open.Action_1_Condition "Fault manager configuration.  Select up to 4 actions for each fault." VALUE 0x80003138 RecordLayout_4 0 CompuMethod_116 0 65535 /end CHARACTERISTIC
/begin CHARACTERISTIC FaultManager.Inj6Open.Action_2 "Fault manager configuration.  Select up to 4 actions for each fault." VALUE 0x8000313A RecordLayout_4 0 CompuMethod_115 0 65535 /end CHARACTERISTIC
/begin CHARACTERISTIC FaultManager.Inj6Open.Action_2_Condition "Fault manager configuration.  Select up to 4 actions for each fault." VALUE 0x8000313C RecordLayout_4 0 CompuMethod_116 0 65535 /end CHARACTERISTIC
/begin CHARACTERISTIC FaultManager.Inj6Open.Action_3 "Fault manager configuration.  Select up to 4 actions for each fault." VALUE 0x8000313E RecordLayout_4 0 CompuMethod_115 0 65535 /end CHARACTERISTIC
/begin CHARACTERISTIC FaultManager.Inj6Open.Action_3_Condition "Fault manager configuration.  Select up to 4 actions for each fault." VALUE 0x80003140 RecordLayout_4 0 CompuMethod_116 0 65535 /end CHARACTERISTIC
/begin CHARACTERISTIC FaultManager.Inj6Open.Action_4 "Fault manager configuration.  Select up to 4 actions for each fault." VALUE 0x80003142 RecordLayout_4 0 CompuMethod_115 0 65535 /end CHARACTERISTIC
/begin CHARACTERISTIC FaultManager.Inj6Open.Action_4_Condition "Fault manager configuration.  Select up to 4 actions for each fault." VALUE 0x80003144 RecordLayout_4 0 CompuMethod_116 0 65535 /end CHARACTERISTIC
/begin CHARACTERISTIC FaultManager.Inj7Open.Mode "Fault manager configuration.  Select up to 4 actions for each fault." VALUE 0x80003146 RecordLayout_4 0 CompuMethod_113 0 65535 /end CHARACTERISTIC
/begin CHARACTERISTIC FaultManager.Inj7Open.ID "Fault manager configuration.  Select up to 4 actions for each fault." VALUE 0x80003148 RecordLayout_4 0 CompuMethod_1 0 65535 /end CHARACTERISTIC
/begin CHARACTERISTIC FaultManager.Inj7Open.Test "Fault manager configuration.  Select up to 4 actions for each fault." VALUE 0x8000314A RecordLayout_4 0 CompuMethod_114 0 65535 /end CHARACTERISTIC
/begin CHARACTERISTIC FaultManager.Inj7Open.Faulty_Samples__X_ "Fault manager configuration.  Select up to 4 actions for each fault." VALUE 0x8000314C RecordLayout_4 0 CompuMethod_1 0 65535 /end CHARACTERISTIC
/begin CHARACTERISTIC FaultManager.Inj7Open.Total_Samples__Y_ "Fault manager configuration.  Select up to 4 actions for each fault." VALUE 0x8000314E RecordLayout_4 0 CompuMethod_1 0 65535 /end CHARACTERISTIC
/begin CHARACTERISTIC FaultManager.Inj7Open.Action_1 "Fault manager configuration.  Select up to 4 actions for each fault." VALUE 0x80003150 RecordLayout_4 0 CompuMethod_115 0 65535 /end CHARACTERISTIC
/begin CHARACTERISTIC FaultManager.Inj7Open.Action_1_Condition "Fault manager configuration.  Select up to 4 actions for each fault." VALUE 0x80003152 RecordLayout_4 0 CompuMethod_116 0 65535 /end CHARACTERISTIC
/begin CHARACTERISTIC FaultManager.Inj7Open.Action_2 "Fault manager configuration.  Select up to 4 actions for each fault." VALUE 0x80003154 RecordLayout_4 0 CompuMethod_115 0 65535 /end CHARACTERISTIC
/begin CHARACTERISTIC FaultManager.Inj7Open.Action_2_Condition "Fault manager configuration.  Select up to 4 actions for each fault." VALUE 0x80003156 RecordLayout_4 0 CompuMethod_116 0 65535 /end CHARACTERISTIC
/begin CHARACTERISTIC FaultManager.Inj7Open.Action_3 "Fault manager configuration.  Select up to 4 actions for each fault." VALUE 0x80003158 RecordLayout_4 0 CompuMethod_115 0 65535 /end CHARACTERISTIC
/begin CHARACTERISTIC FaultManager.Inj7Open.Action_3_Condition "Fault manager configuration.  Select up to 4 actions for each fault." VALUE 0x8000315A RecordLayout_4 0 CompuMethod_116 0 65535 /end CHARACTERISTIC
/begin CHARACTERISTIC FaultManager.Inj7Open.Action_4 "Fault manager configuration.  Select up to 4 actions for each fault." VALUE 0x8000315C RecordLayout_4 0 CompuMethod_115 0 65535 /end CHARACTERISTIC
/begin CHARACTERISTIC FaultManager.Inj7Open.Action_4_Condition "Fault manager configuration.  Select up to 4 actions for each fault." VALUE 0x8000315E RecordLayout_4 0 CompuMethod_116 0 65535 /end CHARACTERISTIC
/begin CHARACTERISTIC FaultManager.Inj8Open.Mode "Fault manager configuration.  Select up to 4 actions for each fault." VALUE 0x80003160 RecordLayout_4 0 CompuMethod_113 0 65535 /end CHARACTERISTIC
/begin CHARACTERISTIC FaultManager.Inj8Open.ID "Fault manager configuration.  Select up to 4 actions for each fault." VALUE 0x80003162 RecordLayout_4 0 CompuMethod_1 0 65535 /end CHARACTERISTIC
/begin CHARACTERISTIC FaultManager.Inj8Open.Test "Fault manager configuration.  Select up to 4 actions for each fault." VALUE 0x80003164 RecordLayout_4 0 CompuMethod_114 0 65535 /end CHARACTERISTIC
/begin CHARACTERISTIC FaultManager.Inj8Open.Faulty_Samples__X_ "Fault manager configuration.  Select up to 4 actions for each fault." VALUE 0x80003166 RecordLayout_4 0 CompuMethod_1 0 65535 /end CHARACTERISTIC
/begin CHARACTERISTIC FaultManager.Inj8Open.Total_Samples__Y_ "Fault manager configuration.  Select up to 4 actions for each fault." VALUE 0x80003168 RecordLayout_4 0 CompuMethod_1 0 65535 /end CHARACTERISTIC
/begin CHARACTERISTIC FaultManager.Inj8Open.Action_1 "Fault manager configuration.  Select up to 4 actions for each fault." VALUE 0x8000316A RecordLayout_4 0 CompuMethod_115 0 65535 /end CHARACTERISTIC
/begin CHARACTERISTIC FaultManager.Inj8Open.Action_1_Condition "Fault manager configuration.  Select up to 4 actions for each fault." VALUE 0x8000316C RecordLayout_4 0 CompuMethod_116 0 65535 /end CHARACTERISTIC
/begin CHARACTERISTIC FaultManager.Inj8Open.Action_2 "Fault manager configuration.  Select up to 4 actions for each fault." VALUE 0x8000316E RecordLayout_4 0 CompuMethod_115 0 65535 /end CHARACTERISTIC
/begin CHARACTERISTIC FaultManager.Inj8Open.Action_2_Condition "Fault manager configuration.  Select up to 4 actions for each fault." VALUE 0x80003170 RecordLayout_4 0 CompuMethod_116 0 65535 /end CHARACTERISTIC
/begin CHARACTERISTIC FaultManager.Inj8Open.Action_3 "Fault manager configuration.  Select up to 4 actions for each fault." VALUE 0x80003172 RecordLayout_4 0 CompuMethod_115 0 65535 /end CHARACTERISTIC
/begin CHARACTERISTIC FaultManager.Inj8Open.Action_3_Condition "Fault manager configuration.  Select up to 4 actions for each fault." VALUE 0x80003174 RecordLayout_4 0 CompuMethod_116 0 65535 /end CHARACTERISTIC
/begin CHARACTERISTIC FaultManager.Inj8Open.Action_4 "Fault manager configuration.  Select up to 4 actions for each fault." VALUE 0x80003176 RecordLayout_4 0 CompuMethod_115 0 65535 /end CHARACTERISTIC
/begin CHARACTERISTIC FaultManager.Inj8Open.Action_4_Condition "Fault manager configuration.  Select up to 4 actions for each fault." VALUE 0x80003178 RecordLayout_4 0 CompuMethod_116 0 65535 /end CHARACTERISTIC
/begin CHARACTERISTIC FaultManager.Lambda1Error_Fault.Mode "Fault manager configuration.  Select up to 4 actions for each fault." VALUE 0x8000317A RecordLayout_4 0 CompuMethod_113 0 65535 /end CHARACTERISTIC
/begin CHARACTERISTIC FaultManager.Lambda1Error_Fault.ID "Fault manager configuration.  Select up to 4 actions for each fault." VALUE 0x8000317C RecordLayout_4 0 CompuMethod_1 0 65535 /end CHARACTERISTIC
/begin CHARACTERISTIC FaultManager.Lambda1Error_Fault.Test "Fault manager configuration.  Select up to 4 actions for each fault." VALUE 0x8000317E RecordLayout_4 0 CompuMethod_114 0 65535 /end CHARACTERISTIC
/begin CHARACTERISTIC FaultManager.Lambda1Error_Fault.Faulty_Samples__X_ "Fault manager configuration.  Select up to 4 actions for each fault." VALUE 0x80003180 RecordLayout_4 0 CompuMethod_1 0 65535 /end CHARACTERISTIC
/begin CHARACTERISTIC FaultManager.Lambda1Error_Fault.Total_Samples__Y_ "Fault manager configuration.  Select up to 4 actions for each fault." VALUE 0x80003182 RecordLayout_4 0 CompuMethod_1 0 65535 /end CHARACTERISTIC
/begin CHARACTERISTIC FaultManager.Lambda1Error_Fault.Action_1 "Fault manager configuration.  Select up to 4 actions for each fault." VALUE 0x80003184 RecordLayout_4 0 CompuMethod_115 0 65535 /end CHARACTERISTIC
/begin CHARACTERISTIC FaultManager.Lambda1Error_Fault.Action_1_Condition "Fault manager configuration.  Select up to 4 actions for each fault." VALUE 0x80003186 RecordLayout_4 0 CompuMethod_116 0 65535 /end CHARACTERISTIC
/begin CHARACTERISTIC FaultManager.Lambda1Error_Fault.Action_2 "Fault manager configuration.  Select up to 4 actions for each fault." VALUE 0x80003188 RecordLayout_4 0 CompuMethod_115 0 65535 /end CHARACTERISTIC
/begin CHARACTERISTIC FaultManager.Lambda1Error_Fault.Action_2_Condition "Fault manager configuration.  Select up to 4 actions for each fault." VALUE 0x8000318A RecordLayout_4 0 CompuMethod_116 0 65535 /end CHARACTERISTIC
/begin CHARACTERISTIC FaultManager.Lambda1Error_Fault.Action_3 "Fault manager configuration.  Select up to 4 actions for each fault." VALUE 0x8000318C RecordLayout_4 0 CompuMethod_115 0 65535 /end CHARACTERISTIC
/begin CHARACTERISTIC FaultManager.Lambda1Error_Fault.Action_3_Condition "Fault manager configuration.  Select up to 4 actions for each fault." VALUE 0x8000318E RecordLayout_4 0 CompuMethod_116 0 65535 /end CHARACTERISTIC
/begin CHARACTERISTIC FaultManager.Lambda1Error_Fault.Action_4 "Fault manager configuration.  Select up to 4 actions for each fault." VALUE 0x80003190 RecordLayout_4 0 CompuMethod_115 0 65535 /end CHARACTERISTIC
/begin CHARACTERISTIC FaultManager.Lambda1Error_Fault.Action_4_Condition "Fault manager configuration.  Select up to 4 actions for each fault." VALUE 0x80003192 RecordLayout_4 0 CompuMethod_116 0 65535 /end CHARACTERISTIC
/begin CHARACTERISTIC FaultManager.Lambda1Fault_Fault.Mode "Fault manager configuration.  Select up to 4 actions for each fault." VALUE 0x80003194 RecordLayout_4 0 CompuMethod_113 0 65535 /end CHARACTERISTIC
/begin CHARACTERISTIC FaultManager.Lambda1Fault_Fault.ID "Fault manager configuration.  Select up to 4 actions for each fault." VALUE 0x80003196 RecordLayout_4 0 CompuMethod_1 0 65535 /end CHARACTERISTIC
/begin CHARACTERISTIC FaultManager.Lambda1Fault_Fault.Test "Fault manager configuration.  Select up to 4 actions for each fault." VALUE 0x80003198 RecordLayout_4 0 CompuMethod_114 0 65535 /end CHARACTERISTIC
/begin CHARACTERISTIC FaultManager.Lambda1Fault_Fault.Faulty_Samples__X_ "Fault manager configuration.  Select up to 4 actions for each fault." VALUE 0x8000319A RecordLayout_4 0 CompuMethod_1 0 65535 /end CHARACTERISTIC
/begin CHARACTERISTIC FaultManager.Lambda1Fault_Fault.Total_Samples__Y_ "Fault manager configuration.  Select up to 4 actions for each fault." VALUE 0x8000319C RecordLayout_4 0 CompuMethod_1 0 65535 /end CHARACTERISTIC
/begin CHARACTERISTIC FaultManager.Lambda1Fault_Fault.Action_1 "Fault manager configuration.  Select up to 4 actions for each fault." VALUE 0x8000319E RecordLayout_4 0 CompuMethod_115 0 65535 /end CHARACTERISTIC
/begin CHARACTERISTIC FaultManager.Lambda1Fault_Fault.Action_1_Condition "Fault manager configuration.  Select up to 4 actions for each fault." VALUE 0x800031A0 RecordLayout_4 0 CompuMethod_116 0 65535 /end CHARACTERISTIC
/begin CHARACTERISTIC FaultManager.Lambda1Fault_Fault.Action_2 "Fault manager configuration.  Select up to 4 actions for each fault." VALUE 0x800031A2 RecordLayout_4 0 CompuMethod_115 0 65535 /end CHARACTERISTIC
/begin CHARACTERISTIC FaultManager.Lambda1Fault_Fault.Action_2_Condition "Fault manager configuration.  Select up to 4 actions for each fault." VALUE 0x800031A4 RecordLayout_4 0 CompuMethod_116 0 65535 /end CHARACTERISTIC
/begin CHARACTERISTIC FaultManager.Lambda1Fault_Fault.Action_3 "Fault manager configuration.  Select up to 4 actions for each fault." VALUE 0x800031A6 RecordLayout_4 0 CompuMethod_115 0 65535 /end CHARACTERISTIC
/begin CHARACTERISTIC FaultManager.Lambda1Fault_Fault.Action_3_Condition "Fault manager configuration.  Select up to 4 actions for each fault." VALUE 0x800031A8 RecordLayout_4 0 CompuMethod_116 0 65535 /end CHARACTERISTIC
/begin CHARACTERISTIC FaultManager.Lambda1Fault_Fault.Action_4 "Fault manager configuration.  Select up to 4 actions for each fault." VALUE 0x800031AA RecordLayout_4 0 CompuMethod_115 0 65535 /end CHARACTERISTIC
/begin CHARACTERISTIC FaultManager.Lambda1Fault_Fault.Action_4_Condition "Fault manager configuration.  Select up to 4 actions for each fault." VALUE 0x800031AC RecordLayout_4 0 CompuMethod_116 0 65535 /end CHARACTERISTIC
/begin CHARACTERISTIC FaultManager.Lambda1HtrOpen_Fault.Mode "Fault manager configuration.  Select up to 4 actions for each fault." VALUE 0x800031AE RecordLayout_4 0 CompuMethod_113 0 65535 /end CHARACTERISTIC
/begin CHARACTERISTIC FaultManager.Lambda1HtrOpen_Fault.ID "Fault manager configuration.  Select up to 4 actions for each fault." VALUE 0x800031B0 RecordLayout_4 0 CompuMethod_1 0 65535 /end CHARACTERISTIC
/begin CHARACTERISTIC FaultManager.Lambda1HtrOpen_Fault.Test "Fault manager configuration.  Select up to 4 actions for each fault." VALUE 0x800031B2 RecordLayout_4 0 CompuMethod_114 0 65535 /end CHARACTERISTIC
/begin CHARACTERISTIC FaultManager.Lambda1HtrOpen_Fault.Faulty_Samples__X_ "Fault manager configuration.  Select up to 4 actions for each fault." VALUE 0x800031B4 RecordLayout_4 0 CompuMethod_1 0 65535 /end CHARACTERISTIC
/begin CHARACTERISTIC FaultManager.Lambda1HtrOpen_Fault.Total_Samples__Y_ "Fault manager configuration.  Select up to 4 actions for each fault." VALUE 0x800031B6 RecordLayout_4 0 CompuMethod_1 0 65535 /end CHARACTERISTIC
/begin CHARACTERISTIC FaultManager.Lambda1HtrOpen_Fault.Action_1 "Fault manager configuration.  Select up to 4 actions for each fault." VALUE 0x800031B8 RecordLayout_4 0 CompuMethod_115 0 65535 /end CHARACTERISTIC
/begin CHARACTERISTIC FaultManager.Lambda1HtrOpen_Fault.Action_1_Condition "Fault manager configuration.  Select up to 4 actions for each fault." VALUE 0x800031BA RecordLayout_4 0 CompuMethod_116 0 65535 /end CHARACTERISTIC
/begin CHARACTERISTIC FaultManager.Lambda1HtrOpen_Fault.Action_2 "Fault manager configuration.  Select up to 4 actions for each fault." VALUE 0x800031BC RecordLayout_4 0 CompuMethod_115 0 65535 /end CHARACTERISTIC
/begin CHARACTERISTIC FaultManager.Lambda1HtrOpen_Fault.Action_2_Condition "Fault manager configuration.  Select up to 4 actions for each fault." VALUE 0x800031BE RecordLayout_4 0 CompuMethod_116 0 65535 /end CHARACTERISTIC
/begin CHARACTERISTIC FaultManager.Lambda1HtrOpen_Fault.Action_3 "Fault manager configuration.  Select up to 4 actions for each fault." VALUE 0x800031C0 RecordLayout_4 0 CompuMethod_115 0 65535 /end CHARACTERISTIC
/begin CHARACTERISTIC FaultManager.Lambda1HtrOpen_Fault.Action_3_Condition "Fault manager configuration.  Select up to 4 actions for each fault." VALUE 0x800031C2 RecordLayout_4 0 CompuMethod_116 0 65535 /end CHARACTERISTIC
/begin CHARACTERISTIC FaultManager.Lambda1HtrOpen_Fault.Action_4 "Fault manager configuration.  Select up to 4 actions for each fault." VALUE 0x800031C4 RecordLayout_4 0 CompuMethod_115 0 65535 /end CHARACTERISTIC
/begin CHARACTERISTIC FaultManager.Lambda1HtrOpen_Fault.Action_4_Condition "Fault manager configuration.  Select up to 4 actions for each fault." VALUE 0x800031C6 RecordLayout_4 0 CompuMethod_116 0 65535 /end CHARACTERISTIC
/begin CHARACTERISTIC FaultManager.Lambda1HtrShort_Fault.Mode "Fault manager configuration.  Select up to 4 actions for each fault." VALUE 0x800031C8 RecordLayout_4 0 CompuMethod_113 0 65535 /end CHARACTERISTIC
/begin CHARACTERISTIC FaultManager.Lambda1HtrShort_Fault.ID "Fault manager configuration.  Select up to 4 actions for each fault." VALUE 0x800031CA RecordLayout_4 0 CompuMethod_1 0 65535 /end CHARACTERISTIC
/begin CHARACTERISTIC FaultManager.Lambda1HtrShort_Fault.Test "Fault manager configuration.  Select up to 4 actions for each fault." VALUE 0x800031CC RecordLayout_4 0 CompuMethod_114 0 65535 /end CHARACTERISTIC
/begin CHARACTERISTIC FaultManager.Lambda1HtrShort_Fault.Faulty_Samples__X_ "Fault manager configuration.  Select up to 4 actions for each fault." VALUE 0x800031CE RecordLayout_4 0 CompuMethod_1 0 65535 /end CHARACTERISTIC
/begin CHARACTERISTIC FaultManager.Lambda1HtrShort_Fault.Total_Samples__Y_ "Fault manager configuration.  Select up to 4 actions for each fault." VALUE 0x800031D0 RecordLayout_4 0 CompuMethod_1 0 65535 /end CHARACTERISTIC
/begin CHARACTERISTIC FaultManager.Lambda1HtrShort_Fault.Action_1 "Fault manager configuration.  Select up to 4 actions for each fault." VALUE 0x800031D2 RecordLayout_4 0 CompuMethod_115 0 65535 /end CHARACTERISTIC
/begin CHARACTERISTIC FaultManager.Lambda1HtrShort_Fault.Action_1_Condition "Fault manager configuration.  Select up to 4 actions for each fault." VALUE 0x800031D4 RecordLayout_4 0 CompuMethod_116 0 65535 /end CHARACTERISTIC
/begin CHARACTERISTIC FaultManager.Lambda1HtrShort_Fault.Action_2 "Fault manager configuration.  Select up to 4 actions for each fault." VALUE 0x800031D6 RecordLayout_4 0 CompuMethod_115 0 65535 /end CHARACTERISTIC
/begin CHARACTERISTIC FaultManager.Lambda1HtrShort_Fault.Action_2_Condition "Fault manager configuration.  Select up to 4 actions for each fault." VALUE 0x800031D8 RecordLayout_4 0 CompuMethod_116 0 65535 /end CHARACTERISTIC
/begin CHARACTERISTIC FaultManager.Lambda1HtrShort_Fault.Action_3 "Fault manager configuration.  Select up to 4 actions for each fault." VALUE 0x800031DA RecordLayout_4 0 CompuMethod_115 0 65535 /end CHARACTERISTIC
/begin CHARACTERISTIC FaultManager.Lambda1HtrShort_Fault.Action_3_Condition "Fault manager configuration.  Select up to 4 actions for each fault." VALUE 0x800031DC RecordLayout_4 0 CompuMethod_116 0 65535 /end CHARACTERISTIC
/begin CHARACTERISTIC FaultManager.Lambda1HtrShort_Fault.Action_4 "Fault manager configuration.  Select up to 4 actions for each fault." VALUE 0x800031DE RecordLayout_4 0 CompuMethod_115 0 65535 /end CHARACTERISTIC
/begin CHARACTERISTIC FaultManager.Lambda1HtrShort_Fault.Action_4_Condition "Fault manager configuration.  Select up to 4 actions for each fault." VALUE 0x800031E0 RecordLayout_4 0 CompuMethod_116 0 65535 /end CHARACTERISTIC
/begin CHARACTERISTIC FaultManager.Lambda1Overcool_Fault.Mode "Fault manager configuration.  Select up to 4 actions for each fault." VALUE 0x800031E2 RecordLayout_4 0 CompuMethod_113 0 65535 /end CHARACTERISTIC
/begin CHARACTERISTIC FaultManager.Lambda1Overcool_Fault.ID "Fault manager configuration.  Select up to 4 actions for each fault." VALUE 0x800031E4 RecordLayout_4 0 CompuMethod_1 0 65535 /end CHARACTERISTIC
/begin CHARACTERISTIC FaultManager.Lambda1Overcool_Fault.Test "Fault manager configuration.  Select up to 4 actions for each fault." VALUE 0x800031E6 RecordLayout_4 0 CompuMethod_114 0 65535 /end CHARACTERISTIC
/begin CHARACTERISTIC FaultManager.Lambda1Overcool_Fault.Faulty_Samples__X_ "Fault manager configuration.  Select up to 4 actions for each fault." VALUE 0x800031E8 RecordLayout_4 0 CompuMethod_1 0 65535 /end CHARACTERISTIC
/begin CHARACTERISTIC FaultManager.Lambda1Overcool_Fault.Total_Samples__Y_ "Fault manager configuration.  Select up to 4 actions for each fault." VALUE 0x800031EA RecordLayout_4 0 CompuMethod_1 0 65535 /end CHARACTERISTIC
/begin CHARACTERISTIC FaultManager.Lambda1Overcool_Fault.Action_1 "Fault manager configuration.  Select up to 4 actions for each fault." VALUE 0x800031EC RecordLayout_4 0 CompuMethod_115 0 65535 /end CHARACTERISTIC
/begin CHARACTERISTIC FaultManager.Lambda1Overcool_Fault.Action_1_Condition "Fault manager configuration.  Select up to 4 actions for each fault." VALUE 0x800031EE RecordLayout_4 0 CompuMethod_116 0 65535 /end CHARACTERISTIC
/begin CHARACTERISTIC FaultManager.Lambda1Overcool_Fault.Action_2 "Fault manager configuration.  Select up to 4 actions for each fault." VALUE 0x800031F0 RecordLayout_4 0 CompuMethod_115 0 65535 /end CHARACTERISTIC
/begin CHARACTERISTIC FaultManager.Lambda1Overcool_Fault.Action_2_Condition "Fault manager configuration.  Select up to 4 actions for each fault." VALUE 0x800031F2 RecordLayout_4 0 CompuMethod_116 0 65535 /end CHARACTERISTIC
/begin CHARACTERISTIC FaultManager.Lambda1Overcool_Fault.Action_3 "Fault manager configuration.  Select up to 4 actions for each fault." VALUE 0x800031F4 RecordLayout_4 0 CompuMethod_115 0 65535 /end CHARACTERISTIC
/begin CHARACTERISTIC FaultManager.Lambda1Overcool_Fault.Action_3_Condition "Fault manager configuration.  Select up to 4 actions for each fault." VALUE 0x800031F6 RecordLayout_4 0 CompuMethod_116 0 65535 /end CHARACTERISTIC
/begin CHARACTERISTIC FaultManager.Lambda1Overcool_Fault.Action_4 "Fault manager configuration.  Select up to 4 actions for each fault." VALUE 0x800031F8 RecordLayout_4 0 CompuMethod_115 0 65535 /end CHARACTERISTIC
/begin CHARACTERISTIC FaultManager.Lambda1Overcool_Fault.Action_4_Condition "Fault manager configuration.  Select up to 4 actions for each fault." VALUE 0x800031FA RecordLayout_4 0 CompuMethod_116 0 65535 /end CHARACTERISTIC
/begin CHARACTERISTIC FaultManager.Lambda1Overheat_Fault.Mode "Fault manager configuration.  Select up to 4 actions for each fault." VALUE 0x800031FC RecordLayout_4 0 CompuMethod_113 0 65535 /end CHARACTERISTIC
/begin CHARACTERISTIC FaultManager.Lambda1Overheat_Fault.ID "Fault manager configuration.  Select up to 4 actions for each fault." VALUE 0x800031FE RecordLayout_4 0 CompuMethod_1 0 65535 /end CHARACTERISTIC
/begin CHARACTERISTIC FaultManager.Lambda1Overheat_Fault.Test "Fault manager configuration.  Select up to 4 actions for each fault." VALUE 0x80003200 RecordLayout_4 0 CompuMethod_114 0 65535 /end CHARACTERISTIC
/begin CHARACTERISTIC FaultManager.Lambda1Overheat_Fault.Faulty_Samples__X_ "Fault manager configuration.  Select up to 4 actions for each fault." VALUE 0x80003202 RecordLayout_4 0 CompuMethod_1 0 65535 /end CHARACTERISTIC
/begin CHARACTERISTIC FaultManager.Lambda1Overheat_Fault.Total_Samples__Y_ "Fault manager configuration.  Select up to 4 actions for each fault." VALUE 0x80003204 RecordLayout_4 0 CompuMethod_1 0 65535 /end CHARACTERISTIC
/begin CHARACTERISTIC FaultManager.Lambda1Overheat_Fault.Action_1 "Fault manager configuration.  Select up to 4 actions for each fault." VALUE 0x80003206 RecordLayout_4 0 CompuMethod_115 0 65535 /end CHARACTERISTIC
/begin CHARACTERISTIC FaultManager.Lambda1Overheat_Fault.Action_1_Condition "Fault manager configuration.  Select up to 4 actions for each fault." VALUE 0x80003208 RecordLayout_4 0 CompuMethod_116 0 65535 /end CHARACTERISTIC
/begin CHARACTERISTIC FaultManager.Lambda1Overheat_Fault.Action_2 "Fault manager configuration.  Select up to 4 actions for each fault." VALUE 0x8000320A RecordLayout_4 0 CompuMethod_115 0 65535 /end CHARACTERISTIC
/begin CHARACTERISTIC FaultManager.Lambda1Overheat_Fault.Action_2_Condition "Fault manager configuration.  Select up to 4 actions for each fault." VALUE 0x8000320C RecordLayout_4 0 CompuMethod_116 0 65535 /end CHARACTERISTIC
/begin CHARACTERISTIC FaultManager.Lambda1Overheat_Fault.Action_3 "Fault manager configuration.  Select up to 4 actions for each fault." VALUE 0x8000320E RecordLayout_4 0 CompuMethod_115 0 65535 /end CHARACTERISTIC
/begin CHARACTERISTIC FaultManager.Lambda1Overheat_Fault.Action_3_Condition "Fault manager configuration.  Select up to 4 actions for each fault." VALUE 0x80003210 RecordLayout_4 0 CompuMethod_116 0 65535 /end CHARACTERISTIC
/begin CHARACTERISTIC FaultManager.Lambda1Overheat_Fault.Action_4 "Fault manager configuration.  Select up to 4 actions for each fault." VALUE 0x80003212 RecordLayout_4 0 CompuMethod_115 0 65535 /end CHARACTERISTIC
/begin CHARACTERISTIC FaultManager.Lambda1Overheat_Fault.Action_4_Condition "Fault manager configuration.  Select up to 4 actions for each fault." VALUE 0x80003214 RecordLayout_4 0 CompuMethod_116 0 65535 /end CHARACTERISTIC
/begin CHARACTERISTIC FaultManager.Lambda1StuckInReset_Fault.Mode "Fault manager configuration.  Select up to 4 actions for each fault." VALUE 0x80003216 RecordLayout_4 0 CompuMethod_113 0 65535 /end CHARACTERISTIC
/begin CHARACTERISTIC FaultManager.Lambda1StuckInReset_Fault.ID "Fault manager configuration.  Select up to 4 actions for each fault." VALUE 0x80003218 RecordLayout_4 0 CompuMethod_1 0 65535 /end CHARACTERISTIC
/begin CHARACTERISTIC FaultManager.Lambda1StuckInReset_Fault.Test "Fault manager configuration.  Select up to 4 actions for each fault." VALUE 0x8000321A RecordLayout_4 0 CompuMethod_114 0 65535 /end CHARACTERISTIC
/begin CHARACTERISTIC FaultManager.Lambda1StuckInReset_Fault.Faulty_Samples__X_ "Fault manager configuration.  Select up to 4 actions for each fault." VALUE 0x8000321C RecordLayout_4 0 CompuMethod_1 0 65535 /end CHARACTERISTIC
/begin CHARACTERISTIC FaultManager.Lambda1StuckInReset_Fault.Total_Samples__Y_ "Fault manager configuration.  Select up to 4 actions for each fault." VALUE 0x8000321E RecordLayout_4 0 CompuMethod_1 0 65535 /end CHARACTERISTIC
/begin CHARACTERISTIC FaultManager.Lambda1StuckInReset_Fault.Action_1 "Fault manager configuration.  Select up to 4 actions for each fault." VALUE 0x80003220 RecordLayout_4 0 CompuMethod_115 0 65535 /end CHARACTERISTIC
/begin CHARACTERISTIC FaultManager.Lambda1StuckInReset_Fault.Action_1_Condition "Fault manager configuration.  Select up to 4 actions for each fault." VALUE 0x80003222 RecordLayout_4 0 CompuMethod_116 0 65535 /end CHARACTERISTIC
/begin CHARACTERISTIC FaultManager.Lambda1StuckInReset_Fault.Action_2 "Fault manager configuration.  Select up to 4 actions for each fault." VALUE 0x80003224 RecordLayout_4 0 CompuMethod_115 0 65535 /end CHARACTERISTIC
/begin CHARACTERISTIC FaultManager.Lambda1StuckInReset_Fault.Action_2_Condition "Fault manager configuration.  Select up to 4 actions for each fault." VALUE 0x80003226 RecordLayout_4 0 CompuMethod_116 0 65535 /end CHARACTERISTIC
/begin CHARACTERISTIC FaultManager.Lambda1StuckInReset_Fault.Action_3 "Fault manager configuration.  Select up to 4 actions for each fault." VALUE 0x80003228 RecordLayout_4 0 CompuMethod_115 0 65535 /end CHARACTERISTIC
/begin CHARACTERISTIC FaultManager.Lambda1StuckInReset_Fault.Action_3_Condition "Fault manager configuration.  Select up to 4 actions for each fault." VALUE 0x8000322A RecordLayout_4 0 CompuMethod_116 0 65535 /end CHARACTERISTIC
/begin CHARACTERISTIC FaultManager.Lambda1StuckInReset_Fault.Action_4 "Fault manager configuration.  Select up to 4 actions for each fault." VALUE 0x8000322C RecordLayout_4 0 CompuMethod_115 0 65535 /end CHARACTERISTIC
/begin CHARACTERISTIC FaultManager.Lambda1StuckInReset_Fault.Action_4_Condition "Fault manager configuration.  Select up to 4 actions for each fault." VALUE 0x8000322E RecordLayout_4 0 CompuMethod_116 0 65535 /end CHARACTERISTIC
/begin CHARACTERISTIC FaultManager.Lambda1StuckInWarmup_Fault.Mode "Fault manager configuration.  Select up to 4 actions for each fault." VALUE 0x80003230 RecordLayout_4 0 CompuMethod_113 0 65535 /end CHARACTERISTIC
/begin CHARACTERISTIC FaultManager.Lambda1StuckInWarmup_Fault.ID "Fault manager configuration.  Select up to 4 actions for each fault." VALUE 0x80003232 RecordLayout_4 0 CompuMethod_1 0 65535 /end CHARACTERISTIC
/begin CHARACTERISTIC FaultManager.Lambda1StuckInWarmup_Fault.Test "Fault manager configuration.  Select up to 4 actions for each fault." VALUE 0x80003234 RecordLayout_4 0 CompuMethod_114 0 65535 /end CHARACTERISTIC
/begin CHARACTERISTIC FaultManager.Lambda1StuckInWarmup_Fault.Faulty_Samples__X_ "Fault manager configuration.  Select up to 4 actions for each fault." VALUE 0x80003236 RecordLayout_4 0 CompuMethod_1 0 65535 /end CHARACTERISTIC
/begin CHARACTERISTIC FaultManager.Lambda1StuckInWarmup_Fault.Total_Samples__Y_ "Fault manager configuration.  Select up to 4 actions for each fault." VALUE 0x80003238 RecordLayout_4 0 CompuMethod_1 0 65535 /end CHARACTERISTIC
/begin CHARACTERISTIC FaultManager.Lambda1StuckInWarmup_Fault.Action_1 "Fault manager configuration.  Select up to 4 actions for each fault." VALUE 0x8000323A RecordLayout_4 0 CompuMethod_115 0 65535 /end CHARACTERISTIC
/begin CHARACTERISTIC FaultManager.Lambda1StuckInWarmup_Fault.Action_1_Condition "Fault manager configuration.  Select up to 4 actions for each fault." VALUE 0x8000323C RecordLayout_4 0 CompuMethod_116 0 65535 /end CHARACTERISTIC
/begin CHARACTERISTIC FaultManager.Lambda1StuckInWarmup_Fault.Action_2 "Fault manager configuration.  Select up to 4 actions for each fault." VALUE 0x8000323E RecordLayout_4 0 CompuMethod_115 0 65535 /end CHARACTERISTIC
/begin CHARACTERISTIC FaultManager.Lambda1StuckInWarmup_Fault.Action_2_Condition "Fault manager configuration.  Select up to 4 actions for each fault." VALUE 0x80003240 RecordLayout_4 0 CompuMethod_116 0 65535 /end CHARACTERISTIC
/begin CHARACTERISTIC FaultManager.Lambda1StuckInWarmup_Fault.Action_3 "Fault manager configuration.  Select up to 4 actions for each fault." VALUE 0x80003242 RecordLayout_4 0 CompuMethod_115 0 65535 /end CHARACTERISTIC
/begin CHARACTERISTIC FaultManager.Lambda1StuckInWarmup_Fault.Action_3_Condition "Fault manager configuration.  Select up to 4 actions for each fault." VALUE 0x80003244 RecordLayout_4 0 CompuMethod_116 0 65535 /end CHARACTERISTIC
/begin CHARACTERISTIC FaultManager.Lambda1StuckInWarmup_Fault.Action_4 "Fault manager configuration.  Select up to 4 actions for each fault." VALUE 0x80003246 RecordLayout_4 0 CompuMethod_115 0 65535 /end CHARACTERISTIC
/begin CHARACTERISTIC FaultManager.Lambda1StuckInWarmup_Fault.Action_4_Condition "Fault manager configuration.  Select up to 4 actions for each fault." VALUE 0x80003248 RecordLayout_4 0 CompuMethod_116 0 65535 /end CHARACTERISTIC
/begin CHARACTERISTIC FaultManager.Lambda1VoltHigh_Fault.Mode "Fault manager configuration.  Select up to 4 actions for each fault." VALUE 0x8000324A RecordLayout_4 0 CompuMethod_113 0 65535 /end CHARACTERISTIC
/begin CHARACTERISTIC FaultManager.Lambda1VoltHigh_Fault.ID "Fault manager configuration.  Select up to 4 actions for each fault." VALUE 0x8000324C RecordLayout_4 0 CompuMethod_1 0 65535 /end CHARACTERISTIC
/begin CHARACTERISTIC FaultManager.Lambda1VoltHigh_Fault.Test "Fault manager configuration.  Select up to 4 actions for each fault." VALUE 0x8000324E RecordLayout_4 0 CompuMethod_114 0 65535 /end CHARACTERISTIC
/begin CHARACTERISTIC FaultManager.Lambda1VoltHigh_Fault.Faulty_Samples__X_ "Fault manager configuration.  Select up to 4 actions for each fault." VALUE 0x80003250 RecordLayout_4 0 CompuMethod_1 0 65535 /end CHARACTERISTIC
/begin CHARACTERISTIC FaultManager.Lambda1VoltHigh_Fault.Total_Samples__Y_ "Fault manager configuration.  Select up to 4 actions for each fault." VALUE 0x80003252 RecordLayout_4 0 CompuMethod_1 0 65535 /end CHARACTERISTIC
/begin CHARACTERISTIC FaultManager.Lambda1VoltHigh_Fault.Action_1 "Fault manager configuration.  Select up to 4 actions for each fault." VALUE 0x80003254 RecordLayout_4 0 CompuMethod_115 0 65535 /end CHARACTERISTIC
/begin CHARACTERISTIC FaultManager.Lambda1VoltHigh_Fault.Action_1_Condition "Fault manager configuration.  Select up to 4 actions for each fault." VALUE 0x80003256 RecordLayout_4 0 CompuMethod_116 0 65535 /end CHARACTERISTIC
/begin CHARACTERISTIC FaultManager.Lambda1VoltHigh_Fault.Action_2 "Fault manager configuration.  Select up to 4 actions for each fault." VALUE 0x80003258 RecordLayout_4 0 CompuMethod_115 0 65535 /end CHARACTERISTIC
/begin CHARACTERISTIC FaultManager.Lambda1VoltHigh_Fault.Action_2_Condition "Fault manager configuration.  Select up to 4 actions for each fault." VALUE 0x8000325A RecordLayout_4 0 CompuMethod_116 0 65535 /end CHARACTERISTIC
/begin CHARACTERISTIC FaultManager.Lambda1VoltHigh_Fault.Action_3 "Fault manager configuration.  Select up to 4 actions for each fault." VALUE 0x8000325C RecordLayout_4 0 CompuMethod_115 0 65535 /end CHARACTERISTIC
/begin CHARACTERISTIC FaultManager.Lambda1VoltHigh_Fault.Action_3_Condition "Fault manager configuration.  Select up to 4 actions for each fault." VALUE 0x8000325E RecordLayout_4 0 CompuMethod_116 0 65535 /end CHARACTERISTIC
/begin CHARACTERISTIC FaultManager.Lambda1VoltHigh_Fault.Action_4 "Fault manager configuration.  Select up to 4 actions for each fault." VALUE 0x80003260 RecordLayout_4 0 CompuMethod_115 0 65535 /end CHARACTERISTIC
/begin CHARACTERISTIC FaultManager.Lambda1VoltHigh_Fault.Action_4_Condition "Fault manager configuration.  Select up to 4 actions for each fault." VALUE 0x80003262 RecordLayout_4 0 CompuMethod_116 0 65535 /end CHARACTERISTIC
/begin CHARACTERISTIC FaultManager.Lambda1VoltLow_Fault.Mode "Fault manager configuration.  Select up to 4 actions for each fault." VALUE 0x80003264 RecordLayout_4 0 CompuMethod_113 0 65535 /end CHARACTERISTIC
/begin CHARACTERISTIC FaultManager.Lambda1VoltLow_Fault.ID "Fault manager configuration.  Select up to 4 actions for each fault." VALUE 0x80003266 RecordLayout_4 0 CompuMethod_1 0 65535 /end CHARACTERISTIC
/begin CHARACTERISTIC FaultManager.Lambda1VoltLow_Fault.Test "Fault manager configuration.  Select up to 4 actions for each fault." VALUE 0x80003268 RecordLayout_4 0 CompuMethod_114 0 65535 /end CHARACTERISTIC
/begin CHARACTERISTIC FaultManager.Lambda1VoltLow_Fault.Faulty_Samples__X_ "Fault manager configuration.  Select up to 4 actions for each fault." VALUE 0x8000326A RecordLayout_4 0 CompuMethod_1 0 65535 /end CHARACTERISTIC
/begin CHARACTERISTIC FaultManager.Lambda1VoltLow_Fault.Total_Samples__Y_ "Fault manager configuration.  Select up to 4 actions for each fault." VALUE 0x8000326C RecordLayout_4 0 CompuMethod_1 0 65535 /end CHARACTERISTIC
/begin CHARACTERISTIC FaultManager.Lambda1VoltLow_Fault.Action_1 "Fault manager configuration.  Select up to 4 actions for each fault." VALUE 0x8000326E RecordLayout_4 0 CompuMethod_115 0 65535 /end CHARACTERISTIC
/begin CHARACTERISTIC FaultManager.Lambda1VoltLow_Fault.Action_1_Condition "Fault manager configuration.  Select up to 4 actions for each fault." VALUE 0x80003270 RecordLayout_4 0 CompuMethod_116 0 65535 /end CHARACTERISTIC
/begin CHARACTERISTIC FaultManager.Lambda1VoltLow_Fault.Action_2 "Fault manager configuration.  Select up to 4 actions for each fault." VALUE 0x80003272 RecordLayout_4 0 CompuMethod_115 0 65535 /end CHARACTERISTIC
/begin CHARACTERISTIC FaultManager.Lambda1VoltLow_Fault.Action_2_Condition "Fault manager configuration.  Select up to 4 actions for each fault." VALUE 0x80003274 RecordLayout_4 0 CompuMethod_116 0 65535 /end CHARACTERISTIC
/begin CHARACTERISTIC FaultManager.Lambda1VoltLow_Fault.Action_3 "Fault manager configuration.  Select up to 4 actions for each fault." VALUE 0x80003276 RecordLayout_4 0 CompuMethod_115 0 65535 /end CHARACTERISTIC
/begin CHARACTERISTIC FaultManager.Lambda1VoltLow_Fault.Action_3_Condition "Fault manager configuration.  Select up to 4 actions for each fault." VALUE 0x80003278 RecordLayout_4 0 CompuMethod_116 0 65535 /end CHARACTERISTIC
/begin CHARACTERISTIC FaultManager.Lambda1VoltLow_Fault.Action_4 "Fault manager configuration.  Select up to 4 actions for each fault." VALUE 0x8000327A RecordLayout_4 0 CompuMethod_115 0 65535 /end CHARACTERISTIC
/begin CHARACTERISTIC FaultManager.Lambda1VoltLow_Fault.Action_4_Condition "Fault manager configuration.  Select up to 4 actions for each fault." VALUE 0x8000327C RecordLayout_4 0 CompuMethod_116 0 65535 /end CHARACTERISTIC
/begin CHARACTERISTIC FaultManager.Lambda2Error_Fault.Mode "Fault manager configuration.  Select up to 4 actions for each fault." VALUE 0x8000327E RecordLayout_4 0 CompuMethod_113 0 65535 /end CHARACTERISTIC
/begin CHARACTERISTIC FaultManager.Lambda2Error_Fault.ID "Fault manager configuration.  Select up to 4 actions for each fault." VALUE 0x80003280 RecordLayout_4 0 CompuMethod_1 0 65535 /end CHARACTERISTIC
/begin CHARACTERISTIC FaultManager.Lambda2Error_Fault.Test "Fault manager configuration.  Select up to 4 actions for each fault." VALUE 0x80003282 RecordLayout_4 0 CompuMethod_114 0 65535 /end CHARACTERISTIC
/begin CHARACTERISTIC FaultManager.Lambda2Error_Fault.Faulty_Samples__X_ "Fault manager configuration.  Select up to 4 actions for each fault." VALUE 0x80003284 RecordLayout_4 0 CompuMethod_1 0 65535 /end CHARACTERISTIC
/begin CHARACTERISTIC FaultManager.Lambda2Error_Fault.Total_Samples__Y_ "Fault manager configuration.  Select up to 4 actions for each fault." VALUE 0x80003286 RecordLayout_4 0 CompuMethod_1 0 65535 /end CHARACTERISTIC
/begin CHARACTERISTIC FaultManager.Lambda2Error_Fault.Action_1 "Fault manager configuration.  Select up to 4 actions for each fault." VALUE 0x80003288 RecordLayout_4 0 CompuMethod_115 0 65535 /end CHARACTERISTIC
/begin CHARACTERISTIC FaultManager.Lambda2Error_Fault.Action_1_Condition "Fault manager configuration.  Select up to 4 actions for each fault." VALUE 0x8000328A RecordLayout_4 0 CompuMethod_116 0 65535 /end CHARACTERISTIC
/begin CHARACTERISTIC FaultManager.Lambda2Error_Fault.Action_2 "Fault manager configuration.  Select up to 4 actions for each fault." VALUE 0x8000328C RecordLayout_4 0 CompuMethod_115 0 65535 /end CHARACTERISTIC
/begin CHARACTERISTIC FaultManager.Lambda2Error_Fault.Action_2_Condition "Fault manager configuration.  Select up to 4 actions for each fault." VALUE 0x8000328E RecordLayout_4 0 CompuMethod_116 0 65535 /end CHARACTERISTIC
/begin CHARACTERISTIC FaultManager.Lambda2Error_Fault.Action_3 "Fault manager configuration.  Select up to 4 actions for each fault." VALUE 0x80003290 RecordLayout_4 0 CompuMethod_115 0 65535 /end CHARACTERISTIC
/begin CHARACTERISTIC FaultManager.Lambda2Error_Fault.Action_3_Condition "Fault manager configuration.  Select up to 4 actions for each fault." VALUE 0x80003292 RecordLayout_4 0 CompuMethod_116 0 65535 /end CHARACTERISTIC
/begin CHARACTERISTIC FaultManager.Lambda2Error_Fault.Action_4 "Fault manager configuration.  Select up to 4 actions for each fault." VALUE 0x80003294 RecordLayout_4 0 CompuMethod_115 0 65535 /end CHARACTERISTIC
/begin CHARACTERISTIC FaultManager.Lambda2Error_Fault.Action_4_Condition "Fault manager configuration.  Select up to 4 actions for each fault." VALUE 0x80003296 RecordLayout_4 0 CompuMethod_116 0 65535 /end CHARACTERISTIC
/begin CHARACTERISTIC FaultManager.Lambda2Fault_Fault.Mode "Fault manager configuration.  Select up to 4 actions for each fault." VALUE 0x80003298 RecordLayout_4 0 CompuMethod_113 0 65535 /end CHARACTERISTIC
/begin CHARACTERISTIC FaultManager.Lambda2Fault_Fault.ID "Fault manager configuration.  Select up to 4 actions for each fault." VALUE 0x8000329A RecordLayout_4 0 CompuMethod_1 0 65535 /end CHARACTERISTIC
/begin CHARACTERISTIC FaultManager.Lambda2Fault_Fault.Test "Fault manager configuration.  Select up to 4 actions for each fault." VALUE 0x8000329C RecordLayout_4 0 CompuMethod_114 0 65535 /end CHARACTERISTIC
/begin CHARACTERISTIC FaultManager.Lambda2Fault_Fault.Faulty_Samples__X_ "Fault manager configuration.  Select up to 4 actions for each fault." VALUE 0x8000329E RecordLayout_4 0 CompuMethod_1 0 65535 /end CHARACTERISTIC
/begin CHARACTERISTIC FaultManager.Lambda2Fault_Fault.Total_Samples__Y_ "Fault manager configuration.  Select up to 4 actions for each fault." VALUE 0x800032A0 RecordLayout_4 0 CompuMethod_1 0 65535 /end CHARACTERISTIC
/begin CHARACTERISTIC FaultManager.Lambda2Fault_Fault.Action_1 "Fault manager configuration.  Select up to 4 actions for each fault." VALUE 0x800032A2 RecordLayout_4 0 CompuMethod_115 0 65535 /end CHARACTERISTIC
/begin CHARACTERISTIC FaultManager.Lambda2Fault_Fault.Action_1_Condition "Fault manager configuration.  Select up to 4 actions for each fault." VALUE 0x800032A4 RecordLayout_4 0 CompuMethod_116 0 65535 /end CHARACTERISTIC
/begin CHARACTERISTIC FaultManager.Lambda2Fault_Fault.Action_2 "Fault manager configuration.  Select up to 4 actions for each fault." VALUE 0x800032A6 RecordLayout_4 0 CompuMethod_115 0 65535 /end CHARACTERISTIC
/begin CHARACTERISTIC FaultManager.Lambda2Fault_Fault.Action_2_Condition "Fault manager configuration.  Select up to 4 actions for each fault." VALUE 0x800032A8 RecordLayout_4 0 CompuMethod_116 0 65535 /end CHARACTERISTIC
/begin CHARACTERISTIC FaultManager.Lambda2Fault_Fault.Action_3 "Fault manager configuration.  Select up to 4 actions for each fault." VALUE 0x800032AA RecordLayout_4 0 CompuMethod_115 0 65535 /end CHARACTERISTIC
/begin CHARACTERISTIC FaultManager.Lambda2Fault_Fault.Action_3_Condition "Fault manager configuration.  Select up to 4 actions for each fault." VALUE 0x800032AC RecordLayout_4 0 CompuMethod_116 0 65535 /end CHARACTERISTIC
/begin CHARACTERISTIC FaultManager.Lambda2Fault_Fault.Action_4 "Fault manager configuration.  Select up to 4 actions for each fault." VALUE 0x800032AE RecordLayout_4 0 CompuMethod_115 0 65535 /end CHARACTERISTIC
/begin CHARACTERISTIC FaultManager.Lambda2Fault_Fault.Action_4_Condition "Fault manager configuration.  Select up to 4 actions for each fault." VALUE 0x800032B0 RecordLayout_4 0 CompuMethod_116 0 65535 /end CHARACTERISTIC
/begin CHARACTERISTIC FaultManager.Lambda2HtrOpen_Fault.Mode "Fault manager configuration.  Select up to 4 actions for each fault." VALUE 0x800032B2 RecordLayout_4 0 CompuMethod_113 0 65535 /end CHARACTERISTIC
/begin CHARACTERISTIC FaultManager.Lambda2HtrOpen_Fault.ID "Fault manager configuration.  Select up to 4 actions for each fault." VALUE 0x800032B4 RecordLayout_4 0 CompuMethod_1 0 65535 /end CHARACTERISTIC
/begin CHARACTERISTIC FaultManager.Lambda2HtrOpen_Fault.Test "Fault manager configuration.  Select up to 4 actions for each fault." VALUE 0x800032B6 RecordLayout_4 0 CompuMethod_114 0 65535 /end CHARACTERISTIC
/begin CHARACTERISTIC FaultManager.Lambda2HtrOpen_Fault.Faulty_Samples__X_ "Fault manager configuration.  Select up to 4 actions for each fault." VALUE 0x800032B8 RecordLayout_4 0 CompuMethod_1 0 65535 /end CHARACTERISTIC
/begin CHARACTERISTIC FaultManager.Lambda2HtrOpen_Fault.Total_Samples__Y_ "Fault manager configuration.  Select up to 4 actions for each fault." VALUE 0x800032BA RecordLayout_4 0 CompuMethod_1 0 65535 /end CHARACTERISTIC
/begin CHARACTERISTIC FaultManager.Lambda2HtrOpen_Fault.Action_1 "Fault manager configuration.  Select up to 4 actions for each fault." VALUE 0x800032BC RecordLayout_4 0 CompuMethod_115 0 65535 /end CHARACTERISTIC
/begin CHARACTERISTIC FaultManager.Lambda2HtrOpen_Fault.Action_1_Condition "Fault manager configuration.  Select up to 4 actions for each fault." VALUE 0x800032BE RecordLayout_4 0 CompuMethod_116 0 65535 /end CHARACTERISTIC
/begin CHARACTERISTIC FaultManager.Lambda2HtrOpen_Fault.Action_2 "Fault manager configuration.  Select up to 4 actions for each fault." VALUE 0x800032C0 RecordLayout_4 0 CompuMethod_115 0 65535 /end CHARACTERISTIC
/begin CHARACTERISTIC FaultManager.Lambda2HtrOpen_Fault.Action_2_Condition "Fault manager configuration.  Select up to 4 actions for each fault." VALUE 0x800032C2 RecordLayout_4 0 CompuMethod_116 0 65535 /end CHARACTERISTIC
/begin CHARACTERISTIC FaultManager.Lambda2HtrOpen_Fault.Action_3 "Fault manager configuration.  Select up to 4 actions for each fault." VALUE 0x800032C4 RecordLayout_4 0 CompuMethod_115 0 65535 /end CHARACTERISTIC
/begin CHARACTERISTIC FaultManager.Lambda2HtrOpen_Fault.Action_3_Condition "Fault manager configuration.  Select up to 4 actions for each fault." VALUE 0x800032C6 RecordLayout_4 0 CompuMethod_116 0 65535 /end CHARACTERISTIC
/begin CHARACTERISTIC FaultManager.Lambda2HtrOpen_Fault.Action_4 "Fault manager configuration.  Select up to 4 actions for each fault." VALUE 0x800032C8 RecordLayout_4 0 CompuMethod_115 0 65535 /end CHARACTERISTIC
/begin CHARACTERISTIC FaultManager.Lambda2HtrOpen_Fault.Action_4_Condition "Fault manager configuration.  Select up to 4 actions for each fault." VALUE 0x800032CA RecordLayout_4 0 CompuMethod_116 0 65535 /end CHARACTERISTIC
/begin CHARACTERISTIC FaultManager.Lambda2HtrShort_Fault.Mode "Fault manager configuration.  Select up to 4 actions for each fault." VALUE 0x800032CC RecordLayout_4 0 CompuMethod_113 0 65535 /end CHARACTERISTIC
/begin CHARACTERISTIC FaultManager.Lambda2HtrShort_Fault.ID "Fault manager configuration.  Select up to 4 actions for each fault." VALUE 0x800032CE RecordLayout_4 0 CompuMethod_1 0 65535 /end CHARACTERISTIC
/begin CHARACTERISTIC FaultManager.Lambda2HtrShort_Fault.Test "Fault manager configuration.  Select up to 4 actions for each fault." VALUE 0x800032D0 RecordLayout_4 0 CompuMethod_114 0 65535 /end CHARACTERISTIC
/begin CHARACTERISTIC FaultManager.Lambda2HtrShort_Fault.Faulty_Samples__X_ "Fault manager configuration.  Select up to 4 actions for each fault." VALUE 0x800032D2 RecordLayout_4 0 CompuMethod_1 0 65535 /end CHARACTERISTIC
/begin CHARACTERISTIC FaultManager.Lambda2HtrShort_Fault.Total_Samples__Y_ "Fault manager configuration.  Select up to 4 actions for each fault." VALUE 0x800032D4 RecordLayout_4 0 CompuMethod_1 0 65535 /end CHARACTERISTIC
/begin CHARACTERISTIC FaultManager.Lambda2HtrShort_Fault.Action_1 "Fault manager configuration.  Select up to 4 actions for each fault." VALUE 0x800032D6 RecordLayout_4 0 CompuMethod_115 0 65535 /end CHARACTERISTIC
/begin CHARACTERISTIC FaultManager.Lambda2HtrShort_Fault.Action_1_Condition "Fault manager configuration.  Select up to 4 actions for each fault." VALUE 0x800032D8 RecordLayout_4 0 CompuMethod_116 0 65535 /end CHARACTERISTIC
/begin CHARACTERISTIC FaultManager.Lambda2HtrShort_Fault.Action_2 "Fault manager configuration.  Select up to 4 actions for each fault." VALUE 0x800032DA RecordLayout_4 0 CompuMethod_115 0 65535 /end CHARACTERISTIC
/begin CHARACTERISTIC FaultManager.Lambda2HtrShort_Fault.Action_2_Condition "Fault manager configuration.  Select up to 4 actions for each fault." VALUE 0x800032DC RecordLayout_4 0 CompuMethod_116 0 65535 /end CHARACTERISTIC
/begin CHARACTERISTIC FaultManager.Lambda2HtrShort_Fault.Action_3 "Fault manager configuration.  Select up to 4 actions for each fault." VALUE 0x800032DE RecordLayout_4 0 CompuMethod_115 0 65535 /end CHARACTERISTIC
/begin CHARACTERISTIC FaultManager.Lambda2HtrShort_Fault.Action_3_Condition "Fault manager configuration.  Select up to 4 actions for each fault." VALUE 0x800032E0 RecordLayout_4 0 CompuMethod_116 0 65535 /end CHARACTERISTIC
/begin CHARACTERISTIC FaultManager.Lambda2HtrShort_Fault.Action_4 "Fault manager configuration.  Select up to 4 actions for each fault." VALUE 0x800032E2 RecordLayout_4 0 CompuMethod_115 0 65535 /end CHARACTERISTIC
/begin CHARACTERISTIC FaultManager.Lambda2HtrShort_Fault.Action_4_Condition "Fault manager configuration.  Select up to 4 actions for each fault." VALUE 0x800032E4 RecordLayout_4 0 CompuMethod_116 0 65535 /end CHARACTERISTIC
/begin CHARACTERISTIC FaultManager.Lambda2Overcool_Fault.Mode "Fault manager configuration.  Select up to 4 actions for each fault." VALUE 0x800032E6 RecordLayout_4 0 CompuMethod_113 0 65535 /end CHARACTERISTIC
/begin CHARACTERISTIC FaultManager.Lambda2Overcool_Fault.ID "Fault manager configuration.  Select up to 4 actions for each fault." VALUE 0x800032E8 RecordLayout_4 0 CompuMethod_1 0 65535 /end CHARACTERISTIC
/begin CHARACTERISTIC FaultManager.Lambda2Overcool_Fault.Test "Fault manager configuration.  Select up to 4 actions for each fault." VALUE 0x800032EA RecordLayout_4 0 CompuMethod_114 0 65535 /end CHARACTERISTIC
/begin CHARACTERISTIC FaultManager.Lambda2Overcool_Fault.Faulty_Samples__X_ "Fault manager configuration.  Select up to 4 actions for each fault." VALUE 0x800032EC RecordLayout_4 0 CompuMethod_1 0 65535 /end CHARACTERISTIC
/begin CHARACTERISTIC FaultManager.Lambda2Overcool_Fault.Total_Samples__Y_ "Fault manager configuration.  Select up to 4 actions for each fault." VALUE 0x800032EE RecordLayout_4 0 CompuMethod_1 0 65535 /end CHARACTERISTIC
/begin CHARACTERISTIC FaultManager.Lambda2Overcool_Fault.Action_1 "Fault manager configuration.  Select up to 4 actions for each fault." VALUE 0x800032F0 RecordLayout_4 0 CompuMethod_115 0 65535 /end CHARACTERISTIC
/begin CHARACTERISTIC FaultManager.Lambda2Overcool_Fault.Action_1_Condition "Fault manager configuration.  Select up to 4 actions for each fault." VALUE 0x800032F2 RecordLayout_4 0 CompuMethod_116 0 65535 /end CHARACTERISTIC
/begin CHARACTERISTIC FaultManager.Lambda2Overcool_Fault.Action_2 "Fault manager configuration.  Select up to 4 actions for each fault." VALUE 0x800032F4 RecordLayout_4 0 CompuMethod_115 0 65535 /end CHARACTERISTIC
/begin CHARACTERISTIC FaultManager.Lambda2Overcool_Fault.Action_2_Condition "Fault manager configuration.  Select up to 4 actions for each fault." VALUE 0x800032F6 RecordLayout_4 0 CompuMethod_116 0 65535 /end CHARACTERISTIC
/begin CHARACTERISTIC FaultManager.Lambda2Overcool_Fault.Action_3 "Fault manager configuration.  Select up to 4 actions for each fault." VALUE 0x800032F8 RecordLayout_4 0 CompuMethod_115 0 65535 /end CHARACTERISTIC
/begin CHARACTERISTIC FaultManager.Lambda2Overcool_Fault.Action_3_Condition "Fault manager configuration.  Select up to 4 actions for each fault." VALUE 0x800032FA RecordLayout_4 0 CompuMethod_116 0 65535 /end CHARACTERISTIC
/begin CHARACTERISTIC FaultManager.Lambda2Overcool_Fault.Action_4 "Fault manager configuration.  Select up to 4 actions for each fault." VALUE 0x800032FC RecordLayout_4 0 CompuMethod_115 0 65535 /end CHARACTERISTIC
/begin CHARACTERISTIC FaultManager.Lambda2Overcool_Fault.Action_4_Condition "Fault manager configuration.  Select up to 4 actions for each fault." VALUE 0x800032FE RecordLayout_4 0 CompuMethod_116 0 65535 /end CHARACTERISTIC
/begin CHARACTERISTIC FaultManager.Lambda2Overheat_Fault.Mode "Fault manager configuration.  Select up to 4 actions for each fault." VALUE 0x80003300 RecordLayout_4 0 CompuMethod_113 0 65535 /end CHARACTERISTIC
/begin CHARACTERISTIC FaultManager.Lambda2Overheat_Fault.ID "Fault manager configuration.  Select up to 4 actions for each fault." VALUE 0x80003302 RecordLayout_4 0 CompuMethod_1 0 65535 /end CHARACTERISTIC
/begin CHARACTERISTIC FaultManager.Lambda2Overheat_Fault.Test "Fault manager configuration.  Select up to 4 actions for each fault." VALUE 0x80003304 RecordLayout_4 0 CompuMethod_114 0 65535 /end CHARACTERISTIC
/begin CHARACTERISTIC FaultManager.Lambda2Overheat_Fault.Faulty_Samples__X_ "Fault manager configuration.  Select up to 4 actions for each fault." VALUE 0x80003306 RecordLayout_4 0 CompuMethod_1 0 65535 /end CHARACTERISTIC
/begin CHARACTERISTIC FaultManager.Lambda2Overheat_Fault.Total_Samples__Y_ "Fault manager configuration.  Select up to 4 actions for each fault." VALUE 0x80003308 RecordLayout_4 0 CompuMethod_1 0 65535 /end CHARACTERISTIC
/begin CHARACTERISTIC FaultManager.Lambda2Overheat_Fault.Action_1 "Fault manager configuration.  Select up to 4 actions for each fault." VALUE 0x8000330A RecordLayout_4 0 CompuMethod_115 0 65535 /end CHARACTERISTIC
/begin CHARACTERISTIC FaultManager.Lambda2Overheat_Fault.Action_1_Condition "Fault manager configuration.  Select up to 4 actions for each fault." VALUE 0x8000330C RecordLayout_4 0 CompuMethod_116 0 65535 /end CHARACTERISTIC
/begin CHARACTERISTIC FaultManager.Lambda2Overheat_Fault.Action_2 "Fault manager configuration.  Select up to 4 actions for each fault." VALUE 0x8000330E RecordLayout_4 0 CompuMethod_115 0 65535 /end CHARACTERISTIC
/begin CHARACTERISTIC FaultManager.Lambda2Overheat_Fault.Action_2_Condition "Fault manager configuration.  Select up to 4 actions for each fault." VALUE 0x80003310 RecordLayout_4 0 CompuMethod_116 0 65535 /end CHARACTERISTIC
/begin CHARACTERISTIC FaultManager.Lambda2Overheat_Fault.Action_3 "Fault manager configuration.  Select up to 4 actions for each fault." VALUE 0x80003312 RecordLayout_4 0 CompuMethod_115 0 65535 /end CHARACTERISTIC
/begin CHARACTERISTIC FaultManager.Lambda2Overheat_Fault.Action_3_Condition "Fault manager configuration.  Select up to 4 actions for each fault." VALUE 0x80003314 RecordLayout_4 0 CompuMethod_116 0 65535 /end CHARACTERISTIC
/begin CHARACTERISTIC FaultManager.Lambda2Overheat_Fault.Action_4 "Fault manager configuration.  Select up to 4 actions for each fault." VALUE 0x80003316 RecordLayout_4 0 CompuMethod_115 0 65535 /end CHARACTERISTIC
/begin CHARACTERISTIC FaultManager.Lambda2Overheat_Fault.Action_4_Condition "Fault manager configuration.  Select up to 4 actions for each fault." VALUE 0x80003318 RecordLayout_4 0 CompuMethod_116 0 65535 /end CHARACTERISTIC
/begin CHARACTERISTIC FaultManager.Lambda2StuckInReset_Fault.Mode "Fault manager configuration.  Select up to 4 actions for each fault." VALUE 0x8000331A RecordLayout_4 0 CompuMethod_113 0 65535 /end CHARACTERISTIC
/begin CHARACTERISTIC FaultManager.Lambda2StuckInReset_Fault.ID "Fault manager configuration.  Select up to 4 actions for each fault." VALUE 0x8000331C RecordLayout_4 0 CompuMethod_1 0 65535 /end CHARACTERISTIC
/begin CHARACTERISTIC FaultManager.Lambda2StuckInReset_Fault.Test "Fault manager configuration.  Select up to 4 actions for each fault." VALUE 0x8000331E RecordLayout_4 0 CompuMethod_114 0 65535 /end CHARACTERISTIC
/begin CHARACTERISTIC FaultManager.Lambda2StuckInReset_Fault.Faulty_Samples__X_ "Fault manager configuration.  Select up to 4 actions for each fault." VALUE 0x80003320 RecordLayout_4 0 CompuMethod_1 0 65535 /end CHARACTERISTIC
/begin CHARACTERISTIC FaultManager.Lambda2StuckInReset_Fault.Total_Samples__Y_ "Fault manager configuration.  Select up to 4 actions for each fault." VALUE 0x80003322 RecordLayout_4 0 CompuMethod_1 0 65535 /end CHARACTERISTIC
/begin CHARACTERISTIC FaultManager.Lambda2StuckInReset_Fault.Action_1 "Fault manager configuration.  Select up to 4 actions for each fault." VALUE 0x80003324 RecordLayout_4 0 CompuMethod_115 0 65535 /end CHARACTERISTIC
/begin CHARACTERISTIC FaultManager.Lambda2StuckInReset_Fault.Action_1_Condition "Fault manager configuration.  Select up to 4 actions for each fault." VALUE 0x80003326 RecordLayout_4 0 CompuMethod_116 0 65535 /end CHARACTERISTIC
/begin CHARACTERISTIC FaultManager.Lambda2StuckInReset_Fault.Action_2 "Fault manager configuration.  Select up to 4 actions for each fault." VALUE 0x80003328 RecordLayout_4 0 CompuMethod_115 0 65535 /end CHARACTERISTIC
/begin CHARACTERISTIC FaultManager.Lambda2StuckInReset_Fault.Action_2_Condition "Fault manager configuration.  Select up to 4 actions for each fault." VALUE 0x8000332A RecordLayout_4 0 CompuMethod_116 0 65535 /end CHARACTERISTIC
/begin CHARACTERISTIC FaultManager.Lambda2StuckInReset_Fault.Action_3 "Fault manager configuration.  Select up to 4 actions for each fault." VALUE 0x8000332C RecordLayout_4 0 CompuMethod_115 0 65535 /end CHARACTERISTIC
/begin CHARACTERISTIC FaultManager.Lambda2StuckInReset_Fault.Action_3_Condition "Fault manager configuration.  Select up to 4 actions for each fault." VALUE 0x8000332E RecordLayout_4 0 CompuMethod_116 0 65535 /end CHARACTERISTIC
/begin CHARACTERISTIC FaultManager.Lambda2StuckInReset_Fault.Action_4 "Fault manager configuration.  Select up to 4 actions for each fault." VALUE 0x80003330 RecordLayout_4 0 CompuMethod_115 0 65535 /end CHARACTERISTIC
/begin CHARACTERISTIC FaultManager.Lambda2StuckInReset_Fault.Action_4_Condition "Fault manager configuration.  Select up to 4 actions for each fault." VALUE 0x80003332 RecordLayout_4 0 CompuMethod_116 0 65535 /end CHARACTERISTIC
/begin CHARACTERISTIC FaultManager.Lambda2StuckInWarmup_Fault.Mode "Fault manager configuration.  Select up to 4 actions for each fault." VALUE 0x80003334 RecordLayout_4 0 CompuMethod_113 0 65535 /end CHARACTERISTIC
/begin CHARACTERISTIC FaultManager.Lambda2StuckInWarmup_Fault.ID "Fault manager configuration.  Select up to 4 actions for each fault." VALUE 0x80003336 RecordLayout_4 0 CompuMethod_1 0 65535 /end CHARACTERISTIC
/begin CHARACTERISTIC FaultManager.Lambda2StuckInWarmup_Fault.Test "Fault manager configuration.  Select up to 4 actions for each fault." VALUE 0x80003338 RecordLayout_4 0 CompuMethod_114 0 65535 /end CHARACTERISTIC
/begin CHARACTERISTIC FaultManager.Lambda2StuckInWarmup_Fault.Faulty_Samples__X_ "Fault manager configuration.  Select up to 4 actions for each fault." VALUE 0x8000333A RecordLayout_4 0 CompuMethod_1 0 65535 /end CHARACTERISTIC
/begin CHARACTERISTIC FaultManager.Lambda2StuckInWarmup_Fault.Total_Samples__Y_ "Fault manager configuration.  Select up to 4 actions for each fault." VALUE 0x8000333C RecordLayout_4 0 CompuMethod_1 0 65535 /end CHARACTERISTIC
/begin CHARACTERISTIC FaultManager.Lambda2StuckInWarmup_Fault.Action_1 "Fault manager configuration.  Select up to 4 actions for each fault." VALUE 0x8000333E RecordLayout_4 0 CompuMethod_115 0 65535 /end CHARACTERISTIC
/begin CHARACTERISTIC FaultManager.Lambda2StuckInWarmup_Fault.Action_1_Condition "Fault manager configuration.  Select up to 4 actions for each fault." VALUE 0x80003340 RecordLayout_4 0 CompuMethod_116 0 65535 /end CHARACTERISTIC
/begin CHARACTERISTIC FaultManager.Lambda2StuckInWarmup_Fault.Action_2 "Fault manager configuration.  Select up to 4 actions for each fault." VALUE 0x80003342 RecordLayout_4 0 CompuMethod_115 0 65535 /end CHARACTERISTIC
/begin CHARACTERISTIC FaultManager.Lambda2StuckInWarmup_Fault.Action_2_Condition "Fault manager configuration.  Select up to 4 actions for each fault." VALUE 0x80003344 RecordLayout_4 0 CompuMethod_116 0 65535 /end CHARACTERISTIC
/begin CHARACTERISTIC FaultManager.Lambda2StuckInWarmup_Fault.Action_3 "Fault manager configuration.  Select up to 4 actions for each fault." VALUE 0x80003346 RecordLayout_4 0 CompuMethod_115 0 65535 /end CHARACTERISTIC
/begin CHARACTERISTIC FaultManager.Lambda2StuckInWarmup_Fault.Action_3_Condition "Fault manager configuration.  Select up to 4 actions for each fault." VALUE 0x80003348 RecordLayout_4 0 CompuMethod_116 0 65535 /end CHARACTERISTIC
/begin CHARACTERISTIC FaultManager.Lambda2StuckInWarmup_Fault.Action_4 "Fault manager configuration.  Select up to 4 actions for each fault." VALUE 0x8000334A RecordLayout_4 0 CompuMethod_115 0 65535 /end CHARACTERISTIC
/begin CHARACTERISTIC FaultManager.Lambda2StuckInWarmup_Fault.Action_4_Condition "Fault manager configuration.  Select up to 4 actions for each fault." VALUE 0x8000334C RecordLayout_4 0 CompuMethod_116 0 65535 /end CHARACTERISTIC
/begin CHARACTERISTIC FaultManager.Lambda2VoltHigh_Fault.Mode "Fault manager configuration.  Select up to 4 actions for each fault." VALUE 0x8000334E RecordLayout_4 0 CompuMethod_113 0 65535 /end CHARACTERISTIC
/begin CHARACTERISTIC FaultManager.Lambda2VoltHigh_Fault.ID "Fault manager configuration.  Select up to 4 actions for each fault." VALUE 0x80003350 RecordLayout_4 0 CompuMethod_1 0 65535 /end CHARACTERISTIC
/begin RECORD_LAYOUT RecordLayout_4 FNC_VALUES 1 UWORD ROW_DIR DIRECT /end RECORD_LAYOUT
/*~~~~~~~~~ 6.3.31 COMPU_METHODs ~~~~~~~~~*/
/begin COMPU_METHOD CompuMethod_1 "" RAT_FUNC "%3.0" "" COEFFS 0 1 0 0 0 1 /end COMPU_METHOD
/begin COMPU_METHOD CompuMethod_113 "" TAB_VERB "%3.0" "" COMPU_TAB_REF CompuVtab_33 /end COMPU_METHOD
/begin COMPU_METHOD CompuMethod_114 "" TAB_VERB "%3.0" "" COMPU_TAB_REF CompuVtab_34 /end COMPU_METHOD
/begin COMPU_METHOD CompuMethod_115 "" TAB_VERB "%3.0" "" COMPU_TAB_REF CompuVtab_35 /end COMPU_METHOD
/begin COMPU_METHOD CompuMethod_116 "" TAB_VERB "%3.0" "" COMPU_TAB_REF CompuVtab_36 /end COMPU_METHOD
/begin COMPU_VTAB CompuVtab_33 "" TAB_VERB 6 0 "Disabled" 1 "Enabled" 2 "Sticky" 3 "Enabled - Persistent" 4 "Sticky - Persistent" 5 "Save Occurred" /end COMPU_VTAB
/begin COMPU_VTAB CompuVtab_34 "" TAB_VERB 2 0 "-" 1 "Test" /end COMPU_VTAB
/begin COMPU_VTAB CompuVtab_35 "" TAB_VERB 16 0 "CutThrottle" 1 "DFCODisable" 2 "DelayedEngineShutdown" 3 "DisableAC" 4 "DisableFanRun" 5 "DisableFanStall" 6 "DisableO2Ctrl" 7 "DisableVEAdapt" 8 "DisableWastegate" 9 "EngineProtectLED" 10 "EngineShutdown" 11 "HardRevLimit" 12 "MIL_LED" 13 "MediumRevLimit" 14 "SoftRevLimit" 15 "(None)" /end COMPU_VTAB
/begin COMPU_VTAB CompuVtab_36 "" TAB_VERB 8 0 "(None)" 1 "Suspected" 2 "Active" 3 "Suspected or Active" 4 "Occurred" 5 "Suspected or Occurred" 6 "Active or Occurred" 7 "Suspected or Active or Occurred" /end COMPU_VTAB
/begin FUNCTION BaseEngineController_LS_128 ""
 /begin DEF_CHARACTERISTIC FaultManager.EST4_Open.Action_2_Condition FaultManager.EST4_Open.Action_3 FaultManager.EST4_Open.Action_3_Condition FaultManager.EST4_Open.Action_4 FaultManager.EST4_Open.Action_4_Condition FaultManager.EST4_Short.Mode FaultManager.EST4_Short.ID FaultManager.EST4_Short.Test FaultManager.EST4_Short.Faulty_Samples__X_ FaultManager.EST4_Short.Total_Samples__Y_ FaultManager.EST4_Short.Action_1 FaultManager.EST4_Short.Action_1_Condition FaultManager.EST4_Short.Action_2 FaultManager.EST4_Short.Action_2_Condition FaultManager.EST4_Short.Action_3 FaultManager.EST4_Short.Action_3_Condition FaultManager.EST4_Short.Action_4 FaultManager.EST4_Short.Action_4_Condition FaultManager.EST5_Open.Mode FaultManager.EST5_Open.ID FaultManager.EST5_Open.Test FaultManager.EST5_Open.Faulty_Samples__X_ FaultManager.EST5_Open.Total_Samples__Y_ FaultManager.EST5_Open.Action_1 FaultManager.EST5_Open.Action_1_Condition FaultManager.EST5_Open.Action_2 FaultManager.EST5_Open.Action_2_Condition FaultManager.EST5_Open.Action_3 FaultManager.EST5_Open.Action_3_Condition FaultManager.EST5_Open.Action_4 FaultManager.EST5_Open.Action_4_Condition FaultManager.EST5_Short.Mode FaultManager.EST5_Short.ID FaultManager.EST5_Short.Test FaultManager.EST5_Short.Faulty_Samples__X_ FaultManager.EST5_Short.Total_Samples__Y_ FaultManager.EST5_Short.Action_1 FaultManager.EST5_Short.Action_1_Condition FaultManager.EST5_Short.Action_2 FaultManager.EST5_Short.Action_2_Condition FaultManager.EST5_Short.Action_3 FaultManager.EST5_Short.Action_3_Condition FaultManager.EST5_Short.Action_4 FaultManager.EST5_Short.Action_4_Condition FaultManager.EST6_Open.Mode FaultManager.EST6_Open.ID FaultManager.EST6_Open.Test FaultManager.EST6_Open.Faulty_Samples__X_ FaultManager.EST6_Open.Total_Samples__Y_ FaultManager.EST6_Open.Action_1 FaultManager.EST6_Open.Action_1_Condition FaultManager.EST6_Open.Action_2 FaultManager.EST6_Open.Action_2_Condition FaultManager.EST6_Open.Action_3 FaultManager.EST6_Open.Action_3_Condition FaultManager.EST6_Open.Action_4 FaultManager.EST6_Open.Action_4_Condition FaultManager.EST6_Short.Mode FaultManager.EST6_Short.ID FaultManager.EST6_Short.Test FaultManager.EST6_Short.Faulty_Samples__X_ FaultManager.EST6_Short.Total_Samples__Y_ FaultManager.EST6_Short.Action_1 FaultManager.EST6_Short.Action_1_Condition FaultManager.EST6_Short.Action_2 FaultManager.EST6_Short.Action_2_Condition FaultManager.EST6_Short.Action_3 FaultManager.EST6_Short.Action_3_Condition FaultManager.EST6_Short.Action_4 FaultManager.EST6_Short.Action_4_Condition FaultManager.EST7_Open.Mode FaultManager.EST7_Open.ID FaultManager.EST7_Open.Test FaultManager.EST7_Open.Faulty_Samples__X_ FaultManager.EST7_Open.Total_Samples__Y_ FaultManager.EST7_Open.Action_1 FaultManager.EST7_Open.Action_1_Condition FaultManager.EST7_Open.Action_2 FaultManager.EST7_Open.Action_2_Condition FaultManager.EST7_Open.Action_3 FaultManager.EST7_Open.Action_3_Condition FaultManager.EST7_Open.Action_4 FaultManager.EST7_Open.Action_4_Condition FaultManager.EST7_Short.Mode FaultManager.EST7_Short.ID FaultManager.EST7_Short.Test FaultManager.EST7_Short.Faulty_Samples__X_ FaultManager.EST7_Short.Total_Samples__Y_ FaultManager.EST7_Short.Action_1 FaultManager.EST7_Short.Action_1_Condition FaultManager.EST7_Short.Action_2 FaultManager.EST7_Short.Action_2_Condition FaultManager.EST7_Short.Action_3 FaultManager.EST7_Short.Action_3_Condition FaultManager.EST7_Short.Action_4 FaultManager.EST7_Short.Action_4_Condition FaultManager.EST8_Open.Mode FaultManager.EST8_Open.ID FaultManager.EST8_Open.Test FaultManager.EST8_Open.Faulty_Samples__X_ FaultManager.EST8_Open.Total_Samples__Y_ FaultManager.EST8_Open.Action_1 FaultManager.EST8_Open.Action_1_Condition FaultManager.EST8_Open.Action_2 FaultManager.EST8_Open.Action_2_Condition FaultManager.EST8_Open.Action_3 FaultManager.EST8_Open.Action_3_Condition FaultManager.EST8_Open.Action_4 FaultManager.EST8_Open.Action_4_Condition FaultManager.EST8_Short.Mode FaultManager.EST8_Short.ID FaultManager.EST8_Short.Test FaultManager.EST8_Short.Faulty_Samples__X_ FaultManager.EST8_Short.Total_Samples__Y_ FaultManager.EST8_Short.Action_1 FaultManager.EST8_Short.Action_1_Condition FaultManager.EST8_Short.Action_2 FaultManager.EST8_Short.Action_2_Condition FaultManager.EST8_Short.Action_3 FaultManager.EST8_Short.Action_3_Condition FaultManager.EST8_Short.Action_4 FaultManager.EST8_Short.Action_4_Condition FaultManager.ETCSpringTest.Mode FaultManager.ETCSpringTest.ID FaultManager.ETCSpringTest.Test FaultManager.ETCSpringTest.Faulty_Samples__X_ FaultManager.ETCSpringTest.Total_Samples__Y_ FaultManager.ETCSpringTest.Action_1 FaultManager.ETCSpringTest.Action_1_Condition FaultManager.ETCSpringTest.Action_2 FaultManager.ETCSpringTest.Action_2_Condition FaultManager.ETCSpringTest.Action_3 FaultManager.ETCSpringTest.Action_3_Condition FaultManager.ETCSpringTest.Action_4 FaultManager.ETCSpringTest.Action_4_Condition FaultManager.ETC_Open_Fault.Mode FaultManager.ETC_Open_Fault.ID FaultManager.ETC_Open_Fault.Test FaultManager.ETC_Open_Fault.Faulty_Samples__X_ FaultManager.ETC_Open_Fault.Total_Samples__Y_ FaultManager.ETC_Open_Fault.Action_1 FaultManager.ETC_Open_Fault.Action_1_Condition FaultManager.ETC_Open_Fault.Action_2 FaultManager.ETC_Open_Fault.Action_2_Condition FaultManager.ETC_Open_Fault.Action_3 FaultManager.ETC_Open_Fault.Action_3_Condition FaultManager.ETC_Open_Fault.Action_4 FaultManager.ETC_Open_Fault.Action_4_Condition FaultManager.ETC_Sticking.Mode FaultManager.ETC_Sticking.ID FaultManager.ETC_Sticking.Test FaultManager.ETC_Sticking.Faulty_Samples__X_ FaultManager.ETC_Sticking.Total_Samples__Y_ FaultManager.ETC_Sticking.Action_1 FaultManager.ETC_Sticking.Action_1_Condition FaultManager.ETC_Sticking.Action_2 FaultManager.ETC_Sticking.Action_2_Condition FaultManager.ETC_Sticking.Action_3 FaultManager.ETC_Sticking.Action_3_Condition FaultManager.ETC_Sticking.Action_4 FaultManager.ETC_Sticking.Action_4_Condition FaultManager.EVAPRangeHigh.Mode FaultManager.EVAPRangeHigh.ID FaultManager.EVAPRangeHigh.Test FaultManager.EVAPRangeHigh.Faulty_Samples__X_ FaultManager.EVAPRangeHigh.Total_Samples__Y_ FaultManager.EVAPRangeHigh.Action_1 FaultManager.EVAPRangeHigh.Action_1_Condition FaultManager.EVAPRangeHigh.Action_2 FaultManager.EVAPRangeHigh.Action_2_Condition FaultManager.EVAPRangeHigh.Action_3 FaultManager.EVAPRangeHigh.Action_3_Condition FaultManager.EVAPRangeHigh.Action_4 FaultManager.EVAPRangeHigh.Action_4_Condition FaultManager.EVAPRangeLow.Mode FaultManager.EVAPRangeLow.ID FaultManager.EVAPRangeLow.Test FaultManager.EVAPRangeLow.Faulty_Samples__X_ FaultManager.EVAPRangeLow.Total_Samples__Y_ FaultManager.EVAPRangeLow.Action_1 FaultManager.EVAPRangeLow.Action_1_Condition FaultManager.EVAPRangeLow.Action_2 FaultManager.EVAPRangeLow.Action_2_Condition FaultManager.EVAPRangeLow.Action_3 FaultManager.EVAPRangeLow.Action_3_Condition FaultManager.EVAPRangeLow.Action_4 FaultManager.EVAPRangeLow.Action_4_Condition FaultManager.FuelAdaptRangeHi_BankA.Mode FaultManager.FuelAdaptRangeHi_BankA.ID FaultManager.FuelAdaptRangeHi_BankA.Test FaultManager.FuelAdaptRangeHi_BankA.Faulty_Samples__X_ FaultManager.FuelAdaptRangeHi_BankA.Total_Samples__Y_ FaultManager.FuelAdaptRangeHi_BankA.Action_1 FaultManager.FuelAdaptRangeHi_BankA.Action_1_Condition FaultManager.FuelAdaptRangeHi_BankA.Action_2 FaultManager.FuelAdaptRangeHi_BankA.Action_2_Condition FaultManager.FuelAdaptRangeHi_BankA.Action_3 FaultManager.FuelAdaptRangeHi_BankA.Action_3_Condition FaultManager.FuelAdaptRangeHi_BankA.Action_4 FaultManager.FuelAdaptRangeHi_BankA.Action_4_Condition FaultManager.FuelAdaptRangeHi_BankB.Mode FaultManager.FuelAdaptRangeHi_BankB.ID FaultManager.FuelAdaptRangeHi_BankB.Test FaultManager.FuelAdaptRangeHi_BankB.Faulty_Samples__X_ FaultManager.FuelAdaptRangeHi_BankB.Total_Samples__Y_ FaultManager.FuelAdaptRangeHi_BankB.Action_1 FaultManager.FuelAdaptRangeHi_BankB.Action_1_Condition FaultManager.FuelAdaptRangeHi_BankB.Action_2 FaultManager.FuelAdaptRangeHi_BankB.Action_2_Condition FaultManager.FuelAdaptRangeHi_BankB.Action_3 FaultManager.FuelAdaptRangeHi_BankB.Action_3_Condition FaultManager.FuelAdaptRangeHi_BankB.Action_4 FaultManager.FuelAdaptRangeHi_BankB.Action_4_Condition FaultManager.FuelAdaptRangeLow_BankA.Mode FaultManager.FuelAdaptRangeLow_BankA.ID FaultManager.FuelAdaptRangeLow_BankA.Test FaultManager.FuelAdaptRangeLow_BankA.Faulty_Samples__X_ FaultManager.FuelAdaptRangeLow_BankA.Total_Samples__Y_ FaultManager.FuelAdaptRangeLow_BankA.Action_1 FaultManager.FuelAdaptRangeLow_BankA.Action_1_Condition FaultManager.FuelAdaptRangeLow_BankA.Action_2 FaultManager.FuelAdaptRangeLow_BankA.Action_2_Condition FaultManager.FuelAdaptRangeLow_BankA.Action_3 FaultManager.FuelAdaptRangeLow_BankA.Action_3_Condition FaultManager.FuelAdaptRangeLow_BankA.Action_4 FaultManager.FuelAdaptRangeLow_BankA.Action_4_Condition FaultManager.FuelAdaptRangeLow_BankB.Mode FaultManager.FuelAdaptRangeLow_BankB.ID FaultManager.FuelAdaptRangeLow_BankB.Test FaultManager.FuelAdaptRangeLow_BankB.Faulty_Samples__X_ FaultManager.FuelAdaptRangeLow_BankB.Total_Samples__Y_ FaultManager.FuelAdaptRangeLow_BankB.Action_1 FaultManager.FuelAdaptRangeLow_BankB.Action_1_Condition FaultManager.FuelAdaptRangeLow_BankB.Action_2 FaultManager.FuelAdaptRangeLow_BankB.Action_2_Condition FaultManager.FuelAdaptRangeLow_BankB.Action_3 FaultManager.FuelAdaptRangeLow_BankB.Action_3_Condition FaultManager.FuelAdaptRangeLow_BankB.Action_4 FaultManager.FuelAdaptRangeLow_BankB.Action_4_Condition FaultManager.FuelPresHigh_Fault.Mode FaultManager.FuelPresHigh_Fault.ID FaultManager.FuelPresHigh_Fault.Test FaultManager.FuelPresHigh_Fault.Faulty_Samples__X_ FaultManager.FuelPresHigh_Fault.Total_Samples__Y_ FaultManager.FuelPresHigh_Fault.Action_1 FaultManager.FuelPresHigh_Fault.Action_1_Condition FaultManager.FuelPresHigh_Fault.Action_2 FaultManager.FuelPresHigh_Fault.Action_2_Condition FaultManager.FuelPresHigh_Fault.Action_3 FaultManager.FuelPresHigh_Fault.Action_3_Condition FaultManager.FuelPresHigh_Fault.Action_4 FaultManager.FuelPresHigh_Fault.Action_4_Condition FaultManager.FuelPresLow_Fault.Mode FaultManager.FuelPresLow_Fault.ID FaultManager.FuelPresLow_Fault.Test FaultManager.FuelPresLow_Fault.Faulty_Samples__X_ FaultManager.FuelPresLow_Fault.Total_Samples__Y_ FaultManager.FuelPresLow_Fault.Action_1 FaultManager.FuelPresLow_Fault.Action_1_Condition FaultManager.FuelPresLow_Fault.Action_2 FaultManager.FuelPresLow_Fault.Action_2_Condition FaultManager.FuelPresLow_Fault.Action_3 FaultManager.FuelPresLow_Fault.Action_3_Condition FaultManager.FuelPresLow_Fault.Action_4 FaultManager.FuelPresLow_Fault.Action_4_Condition FaultManager.FuelPresRangeHigh.Mode FaultManager.FuelPresRangeHigh.ID FaultManager.FuelPresRangeHigh.Test FaultManager.FuelPresRangeHigh.Faulty_Samples__X_ FaultManager.FuelPresRangeHigh.Total_Samples__Y_ FaultManager.FuelPresRangeHigh.Action_1 FaultManager.FuelPresRangeHigh.Action_1_Condition FaultManager.FuelPresRangeHigh.Action_2 FaultManager.FuelPresRangeHigh.Action_2_Condition FaultManager.FuelPresRangeHigh.Action_3 FaultManager.FuelPresRangeHigh.Action_3_Condition FaultManager.FuelPresRangeHigh.Action_4 FaultManager.FuelPresRangeHigh.Action_4_Condition FaultManager.FuelPresRangeLow.Mode FaultManager.FuelPresRangeLow.ID FaultManager.FuelPresRangeLow.Test FaultManager.FuelPresRangeLow.Faulty_Samples__X_ FaultManager.FuelPresRangeLow.Total_Samples__Y_ FaultManager.FuelPresRangeLow.Action_1 FaultManager.FuelPresRangeLow.Action_1_Condition FaultManager.FuelPresRangeLow.Action_2 FaultManager.FuelPresRangeLow.Action_2_Condition FaultManager.FuelPresRangeLow.Action_3 FaultManager.FuelPresRangeLow.Action_3_Condition FaultManager.FuelPresRangeLow.Action_4 FaultManager.FuelPresRangeLow.Action_4_Condition FaultManager.FuelSensRangeHigh.Mode FaultManager.FuelSensRangeHigh.ID FaultManager.FuelSensRangeHigh.Test FaultManager.FuelSensRangeHigh.Faulty_Samples__X_ FaultManager.FuelSensRangeHigh.Total_Samples__Y_ FaultManager.FuelSensRangeHigh.Action_1 FaultManager.FuelSensRangeHigh.Action_1_Condition FaultManager.FuelSensRangeHigh.Action_2 FaultManager.FuelSensRangeHigh.Action_2_Condition FaultManager.FuelSensRangeHigh.Action_3 FaultManager.FuelSensRangeHigh.Action_3_Condition FaultManager.FuelSensRangeHigh.Action_4 FaultManager.FuelSensRangeHigh.Action_4_Condition FaultManager.FuelSensRangeLow.Mode FaultManager.FuelSensRangeLow.ID FaultManager.FuelSensRangeLow.Test FaultManager.FuelSensRangeLow.Faulty_Samples__X_ FaultManager.FuelSensRangeLow.Total_Samples__Y_ FaultManager.FuelSensRangeLow.Action_1 FaultManager.FuelSensRangeLow.Action_1_Condition FaultManager.FuelSensRangeLow.Action_2 FaultManager.FuelSensRangeLow.Action_2_Condition FaultManager.FuelSensRangeLow.Action_3 FaultManager.FuelSensRangeLow.Action_3_Condition FaultManager.FuelSensRangeLow.Action_4 FaultManager.FuelSensRangeLow.Action_4_Condition FaultManager.Fuel_LvlRangeHigh.Mode FaultManager.Fuel_LvlRangeHigh.ID FaultManager.Fuel_LvlRangeHigh.Test FaultManager.Fuel_LvlRangeHigh.Faulty_Samples__X_ FaultManager.Fuel_LvlRangeHigh.Total_Samples__Y_ FaultManager.Fuel_LvlRangeHigh.Action_1 FaultManager.Fuel_LvlRangeHigh.Action_1_Condition FaultManager.Fuel_LvlRangeHigh.Action_2 FaultManager.Fuel_LvlRangeHigh.Action_2_Condition FaultManager.Fuel_LvlRangeHigh.Action_3 FaultManager.Fuel_LvlRangeHigh.Action_3_Condition FaultManager.Fuel_LvlRangeHigh.Action_4 FaultManager.Fuel_LvlRangeHigh.Action_4_Condition FaultManager.Fuel_LvlRangeLow.Mode FaultManager.Fuel_LvlRangeLow.ID FaultManager.Fuel_LvlRangeLow.Test FaultManager.Fuel_LvlRangeLow.Faulty_Samples__X_ FaultManager.Fuel_LvlRangeLow.Total_Samples__Y_ FaultManager.Fuel_LvlRangeLow.Action_1 FaultManager.Fuel_LvlRangeLow.Action_1_Condition FaultManager.Fuel_LvlRangeLow.Action_2 FaultManager.Fuel_LvlRangeLow.Action_2_Condition FaultManager.Fuel_LvlRangeLow.Action_3 FaultManager.Fuel_LvlRangeLow.Action_3_Condition FaultManager.Fuel_LvlRangeLow.Action_4 FaultManager.Fuel_LvlRangeLow.Action_4_Condition FaultManager.GPS_DateTime_Timeout.Mode FaultManager.GPS_DateTime_Timeout.ID FaultManager.GPS_DateTime_Timeout.Test FaultManager.GPS_DateTime_Timeout.Faulty_Samples__X_ FaultManager.GPS_DateTime_Timeout.Total_Samples__Y_ FaultManager.GPS_DateTime_Timeout.Action_1 FaultManager.GPS_DateTime_Timeout.Action_1_Condition FaultManager.GPS_DateTime_Timeout.Action_2 FaultManager.GPS_DateTime_Timeout.Action_2_Condition FaultManager.GPS_DateTime_Timeout.Action_3 FaultManager.GPS_DateTime_Timeout.Action_3_Condition FaultManager.GPS_DateTime_Timeout.Action_4 FaultManager.GPS_DateTime_Timeout.Action_4_Condition FaultManager.GPS_LatLong_Timeout.Mode FaultManager.GPS_LatLong_Timeout.ID FaultManager.GPS_LatLong_Timeout.Test FaultManager.GPS_LatLong_Timeout.Faulty_Samples__X_ FaultManager.GPS_LatLong_Timeout.Total_Samples__Y_ FaultManager.GPS_LatLong_Timeout.Action_1 FaultManager.GPS_LatLong_Timeout.Action_1_Condition FaultManager.GPS_LatLong_Timeout.Action_2 FaultManager.GPS_LatLong_Timeout.Action_2_Condition FaultManager.GPS_LatLong_Timeout.Action_3 FaultManager.GPS_LatLong_Timeout.Action_3_Condition FaultManager.GPS_LatLong_Timeout.Action_4 FaultManager.GPS_LatLong_Timeout.Action_4_Condition FaultManager.GPS_SpeedDir_Timeout.Mode FaultManager.GPS_SpeedDir_Timeout.ID FaultManager.GPS_SpeedDir_Timeout.Test FaultManager.GPS_SpeedDir_Timeout.Faulty_Samples__X_ FaultManager.GPS_SpeedDir_Timeout.Total_Samples__Y_ FaultManager.GPS_SpeedDir_Timeout.Action_1 FaultManager.GPS_SpeedDir_Timeout.Action_1_Condition FaultManager.GPS_SpeedDir_Timeout.Action_2 FaultManager.GPS_SpeedDir_Timeout.Action_2_Condition FaultManager.GPS_SpeedDir_Timeout.Action_3 FaultManager.GPS_SpeedDir_Timeout.Action_3_Condition FaultManager.GPS_SpeedDir_Timeout.Action_4 FaultManager.GPS_SpeedDir_Timeout.Action_4_Condition FaultManager.HardOverBoost_Fault.Mode FaultManager.HardOverBoost_Fault.ID FaultManager.HardOverBoost_Fault.Test FaultManager.HardOverBoost_Fault.Faulty_Samples__X_ FaultManager.HardOverBoost_Fault.Total_Samples__Y_ FaultManager.HardOverBoost_Fault.Action_1 FaultManager.HardOverBoost_Fault.Action_1_Condition FaultManager.HardOverBoost_Fault.Action_2 FaultManager.HardOverBoost_Fault.Action_2_Condition FaultManager.HardOverBoost_Fault.Action_3 FaultManager.HardOverBoost_Fault.Action_3_Condition FaultManager.HardOverBoost_Fault.Action_4 FaultManager.HardOverBoost_Fault.Action_4_Condition FaultManager.HardOverspeed.Mode FaultManager.HardOverspeed.ID FaultManager.HardOverspeed.Test FaultManager.HardOverspeed.Faulty_Samples__X_ FaultManager.HardOverspeed.Total_Samples__Y_ FaultManager.HardOverspeed.Action_1 FaultManager.HardOverspeed.Action_1_Condition FaultManager.HardOverspeed.Action_2 FaultManager.HardOverspeed.Action_2_Condition FaultManager.HardOverspeed.Action_3 FaultManager.HardOverspeed.Action_3_Condition FaultManager.HardOverspeed.Action_4 FaultManager.HardOverspeed.Action_4_Condition FaultManager.IATRangeHigh.Mode FaultManager.IATRangeHigh.ID FaultManager.IATRangeHigh.Test FaultManager.IATRangeHigh.Faulty_Samples__X_ FaultManager.IATRangeHigh.Total_Samples__Y_ FaultManager.IATRangeHigh.Action_1 FaultManager.IATRangeHigh.Action_1_Condition FaultManager.IATRangeHigh.Action_2 FaultManager.IATRangeHigh.Action_2_Condition FaultManager.IATRangeHigh.Action_3 FaultManager.IATRangeHigh.Action_3_Condition FaultManager.IATRangeHigh.Action_4 FaultManager.IATRangeHigh.Action_4_Condition FaultManager.IATRangeLow.Mode FaultManager.IATRangeLow.ID FaultManager.IATRangeLow.Test FaultManager.IATRangeLow.Faulty_Samples__X_ FaultManager.IATRangeLow.Total_Samples__Y_ FaultManager.IATRangeLow.Action_1 FaultManager.IATRangeLow.Action_1_Condition FaultManager.IATRangeLow.Action_2 FaultManager.IATRangeLow.Action_2_Condition FaultManager.IATRangeLow.Action_3 FaultManager.IATRangeLow.Action_3_Condition FaultManager.IATRangeLow.Action_4 FaultManager.IATRangeLow.Action_4_Condition FaultManager.Inj1Open.Mode FaultManager.Inj1Open.ID FaultManager.Inj1Open.Test FaultManager.Inj1Open.Faulty_Samples__X_ FaultManager.Inj1Open.Total_Samples__Y_ FaultManager.Inj1Open.Action_1 FaultManager.Inj1Open.Action_1_Condition FaultManager.Inj1Open.Action_2 FaultManager.Inj1Open.Action_2_Condition FaultManager.Inj1Open.Action_3 FaultManager.Inj1Open.Action_3_Condition FaultManager.Inj1Open.Action_4 FaultManager.Inj1Open.Action_4_Condition FaultManager.Inj2Open.Mode FaultManager.Inj2Open.ID FaultManager.Inj2Open.Test FaultManager.Inj2Open.Faulty_Samples__X_ FaultManager.Inj2Open.Total_Samples__Y_ FaultManager.Inj2Open.Action_1 FaultManager.Inj2Open.Action_1_Condition FaultManager.Inj2Open.Action_2 FaultManager.Inj2Open.Action_2_Condition FaultManager.Inj2Open.Action_3 FaultManager.Inj2Open.Action_3_Condition FaultManager.Inj2Open.Action_4 FaultManager.Inj2Open.Action_4_Condition FaultManager.Inj3Open.Mode FaultManager.Inj3Open.ID FaultManager.Inj3Open.Test FaultManager.Inj3Open.Faulty_Samples__X_ FaultManager.Inj3Open.Total_Samples__Y_ FaultManager.Inj3Open.Action_1 FaultManager.Inj3Open.Action_1_Condition FaultManager.Inj3Open.Action_2 FaultManager.Inj3Open.Action_2_Condition FaultManager.Inj3Open.Action_3 FaultManager.Inj3Open.Action_3_Condition FaultManager.Inj3Open.Action_4 FaultManager.Inj3Open.Action_4_Condition FaultManager.Inj4Open.Mode FaultManager.Inj4Open.ID FaultManager.Inj4Open.Test FaultManager.Inj4Open.Faulty_Samples__X_ FaultManager.Inj4Open.Total_Samples__Y_ FaultManager.Inj4Open.Action_1 FaultManager.Inj4Open.Action_1_Condition FaultManager.Inj4Open.Action_2 FaultManager.Inj4Open.Action_2_Condition FaultManager.Inj4Open.Action_3 FaultManager.Inj4Open.Action_3_Condition FaultManager.Inj4Open.Action_4 FaultManager.Inj4Open.Action_4_Condition FaultManager.Inj5Open.Mode FaultManager.Inj5Open.ID FaultManager.Inj5Open.Test FaultManager.Inj5Open.Faulty_Samples__X_ FaultManager.Inj5Open.Total_Samples__Y_ FaultManager.Inj5Open.Action_1 FaultManager.Inj5Open.Action_1_Condition FaultManager.Inj5Open.Action_2 FaultManager.Inj5Open.Action_2_Condition FaultManager.Inj5Open.Action_3 FaultManager.Inj5Open.Action_3_Condition FaultManager.Inj5Open.Action_4 FaultManager.Inj5Open.Action_4_Condition FaultManager.Inj6Open.Mode FaultManager.Inj6Open.ID FaultManager.Inj6Open.Test FaultManager.Inj6Open.Faulty_Samples__X_ FaultManager.Inj6Open.Total_Samples__Y_ FaultManager.Inj6Open.Action_1 FaultManager.Inj6Open.Action_1_Condition FaultManager.Inj6Open.Action_2 FaultManager.Inj6Open.Action_2_Condition FaultManager.Inj6Open.Action_3 FaultManager.Inj6Open.Action_3_Condition FaultManager.Inj6Open.Action_4 FaultManager.Inj6Open.Action_4_Condition FaultManager.Inj7Open.Mode FaultManager.Inj7Open.ID FaultManager.Inj7Open.Test FaultManager.Inj7Open.Faulty_Samples__X_ FaultManager.Inj7Open.Total_Samples__Y_ FaultManager.Inj7Open.Action_1 FaultManager.Inj7Open.Action_1_Condition FaultManager.Inj7Open.Action_2 FaultManager.Inj7Open.Action_2_Condition FaultManager.Inj7Open.Action_3 FaultManager.Inj7Open.Action_3_Condition FaultManager.Inj7Open.Action_4 FaultManager.Inj7Open.Action_4_Condition FaultManager.Inj8Open.Mode FaultManager.Inj8Open.ID FaultManager.Inj8Open.Test FaultManager.Inj8Open.Faulty_Samples__X_ FaultManager.Inj8Open.Total_Samples__Y_ FaultManager.Inj8Open.Action_1 FaultManager.Inj8Open.Action_1_Condition FaultManager.Inj8Open.Action_2 FaultManager.Inj8Open.Action_2_Condition FaultManager.Inj8Open.Action_3 FaultManager.Inj8Open.Action_3_Condition FaultManager.Inj8Open.Action_4 FaultManager.Inj8Open.Action_4_Condition FaultManager.Lambda1Error_Fault.Mode FaultManager.Lambda1Error_Fault.ID FaultManager.Lambda1Error_Fault.Test FaultManager.Lambda1Error_Fault.Faulty_Samples__X_ FaultManager.Lambda1Error_Fault.Total_Samples__Y_ FaultManager.Lambda1Error_Fault.Action_1 FaultManager.Lambda1Error_Fault.Action_1_Condition FaultManager.Lambda1Error_Fault.Action_2 FaultManager.Lambda1Error_Fault.Action_2_Condition FaultManager.Lambda1Error_Fault.Action_3 FaultManager.Lambda1Error_Fault.Action_3_Condition FaultManager.Lambda1Error_Fault.Action_4 FaultManager.Lambda1Error_Fault.Action_4_Condition FaultManager.Lambda1Fault_Fault.Mode FaultManager.Lambda1Fault_Fault.ID FaultManager.Lambda1Fault_Fault.Test FaultManager.Lambda1Fault_Fault.Faulty_Samples__X_ FaultManager.Lambda1Fault_Fault.Total_Samples__Y_ FaultManager.Lambda1Fault_Fault.Action_1 FaultManager.Lambda1Fault_Fault.Action_1_Condition FaultManager.Lambda1Fault_Fault.Action_2 FaultManager.Lambda1Fault_Fault.Action_2_Condition FaultManager.Lambda1Fault_Fault.Action_3 FaultManager.Lambda1Fault_Fault.Action_3_Condition FaultManager.Lambda1Fault_Fault.Action_4 FaultManager.Lambda1Fault_Fault.Action_4_Condition FaultManager.Lambda1HtrOpen_Fault.Mode FaultManager.Lambda1HtrOpen_Fault.ID FaultManager.Lambda1HtrOpen_Fault.Test FaultManager.Lambda1HtrOpen_Fault.Faulty_Samples__X_ FaultManager.Lambda1HtrOpen_Fault.Total_Samples__Y_ FaultManager.Lambda1HtrOpen_Fault.Action_1 FaultManager.Lambda1HtrOpen_Fault.Action_1_Condition FaultManager.Lambda1HtrOpen_Fault.Action_2 FaultManager.Lambda1HtrOpen_Fault.Action_2_Condition FaultManager.Lambda1HtrOpen_Fault.Action_3 FaultManager.Lambda1HtrOpen_Fault.Action_3_Condition FaultManager.Lambda1HtrOpen_Fault.Action_4 FaultManager.Lambda1HtrOpen_Fault.Action_4_Condition FaultManager.Lambda1HtrShort_Fault.Mode FaultManager.Lambda1HtrShort_Fault.ID FaultManager.Lambda1HtrShort_Fault.Test FaultManager.Lambda1HtrShort_Fault.Faulty_Samples__X_ FaultManager.Lambda1HtrShort_Fault.Total_Samples__Y_ FaultManager.Lambda1HtrShort_Fault.Action_1 FaultManager.Lambda1HtrShort_Fault.Action_1_Condition FaultManager.Lambda1HtrShort_Fault.Action_2 FaultManager.Lambda1HtrShort_Fault.Action_2_Condition FaultManager.Lambda1HtrShort_Fault.Action_3 FaultManager.Lambda1HtrShort_Fault.Action_3_Condition FaultManager.Lambda1HtrShort_Fault.Action_4 FaultManager.Lambda1HtrShort_Fault.Action_4_Condition FaultManager.Lambda1Overcool_Fault.Mode FaultManager.Lambda1Overcool_Fault.ID FaultManager.Lambda1Overcool_Fault.Test FaultManager.Lambda1Overcool_Fault.Faulty_Samples__X_ FaultManager.Lambda1Overcool_Fault.Total_Samples__Y_ FaultManager.Lambda1Overcool_Fault.Action_1 FaultManager.Lambda1Overcool_Fault.Action_1_Condition FaultManager.Lambda1Overcool_Fault.Action_2 FaultManager.Lambda1Overcool_Fault.Action_2_Condition FaultManager.Lambda1Overcool_Fault.Action_3 FaultManager.Lambda1Overcool_Fault.Action_3_Condition FaultManager.Lambda1Overcool_Fault.Action_4 FaultManager.Lambda1Overcool_Fault.Action_4_Condition FaultManager.Lambda1Overheat_Fault.Mode FaultManager.Lambda1Overheat_Fault.ID FaultManager.Lambda1Overheat_Fault.Test FaultManager.Lambda1Overheat_Fault.Faulty_Samples__X_ FaultManager.Lambda1Overheat_Fault.Total_Samples__Y_ FaultManager.Lambda1Overheat_Fault.Action_1 FaultManager.Lambda1Overheat_Fault.Action_1_Condition FaultManager.Lambda1Overheat_Fault.Action_2 FaultManager.Lambda1Overheat_Fault.Action_2_Condition FaultManager.Lambda1Overheat_Fault.Action_3 FaultManager.Lambda1Overheat_Fault.Action_3_Condition FaultManager.Lambda1Overheat_Fault.Action_4 FaultManager.Lambda1Overheat_Fault.Action_4_Condition FaultManager.Lambda1StuckInReset_Fault.Mode FaultManager.Lambda1StuckInReset_Fault.ID FaultManager.Lambda1StuckInReset_Fault.Test FaultManager.Lambda1StuckInReset_Fault.Faulty_Samples__X_ FaultManager.Lambda1StuckInReset_Fault.Total_Samples__Y_ FaultManager.Lambda1StuckInReset_Fault.Action_1 FaultManager.Lambda1StuckInReset_Fault.Action_1_Condition FaultManager.Lambda1StuckInReset_Fault.Action_2 FaultManager.Lambda1StuckInReset_Fault.Action_2_Condition FaultManager.Lambda1StuckInReset_Fault.Action_3 FaultManager.Lambda1StuckInReset_Fault.Action_3_Condition FaultManager.Lambda1StuckInReset_Fault.Action_4 FaultManager.Lambda1StuckInReset_Fault.Action_4_Condition FaultManager.Lambda1StuckInWarmup_Fault.Mode FaultManager.Lambda1StuckInWarmup_Fault.ID FaultManager.Lambda1StuckInWarmup_Fault.Test FaultManager.Lambda1StuckInWarmup_Fault.Faulty_Samples__X_ FaultManager.Lambda1StuckInWarmup_Fault.Total_Samples__Y_ FaultManager.Lambda1StuckInWarmup_Fault.Action_1 FaultManager.Lambda1StuckInWarmup_Fault.Action_1_Condition FaultManager.Lambda1StuckInWarmup_Fault.Action_2 FaultManager.Lambda1StuckInWarmup_Fault.Action_2_Condition FaultManager.Lambda1StuckInWarmup_Fault.Action_3 FaultManager.Lambda1StuckInWarmup_Fault.Action_3_Condition FaultManager.Lambda1StuckInWarmup_Fault.Action_4 FaultManager.Lambda1StuckInWarmup_Fault.Action_4_Condition FaultManager.Lambda1VoltHigh_Fault.Mode FaultManager.Lambda1VoltHigh_Fault.ID FaultManager.Lambda1VoltHigh_Fault.Test FaultManager.Lambda1VoltHigh_Fault.Faulty_Samples__X_ FaultManager.Lambda1VoltHigh_Fault.Total_Samples__Y_ FaultManager.Lambda1VoltHigh_Fault.Action_1 FaultManager.Lambda1VoltHigh_Fault.Action_1_Condition FaultManager.Lambda1VoltHigh_Fault.Action_2 FaultManager.Lambda1VoltHigh_Fault.Action_2_Condition FaultManager.Lambda1VoltHigh_Fault.Action_3 FaultManager.Lambda1VoltHigh_Fault.Action_3_Condition FaultManager.Lambda1VoltHigh_Fault.Action_4 FaultManager.Lambda1VoltHigh_Fault.Action_4_Condition FaultManager.Lambda1VoltLow_Fault.Mode FaultManager.Lambda1VoltLow_Fault.ID FaultManager.Lambda1VoltLow_Fault.Test FaultManager.Lambda1VoltLow_Fault.Faulty_Samples__X_ FaultManager.Lambda1VoltLow_Fault.Total_Samples__Y_ FaultManager.Lambda1VoltLow_Fault.Action_1 FaultManager.Lambda1VoltLow_Fault.Action_1_Condition FaultManager.Lambda1VoltLow_Fault.Action_2 FaultManager.Lambda1VoltLow_Fault.Action_2_Condition FaultManager.Lambda1VoltLow_Fault.Action_3 FaultManager.Lambda1VoltLow_Fault.Action_3_Condition FaultManager.Lambda1VoltLow_Fault.Action_4 FaultManager.Lambda1VoltLow_Fault.Action_4_Condition FaultManager.Lambda2Error_Fault.Mode FaultManager.Lambda2Error_Fault.ID FaultManager.Lambda2Error_Fault.Test FaultManager.Lambda2Error_Fault.Faulty_Samples__X_ FaultManager.Lambda2Error_Fault.Total_Samples__Y_ FaultManager.Lambda2Error_Fault.Action_1 FaultManager.Lambda2Error_Fault.Action_1_Condition FaultManager.Lambda2Error_Fault.Action_2 FaultManager.Lambda2Error_Fault.Action_2_Condition FaultManager.Lambda2Error_Fault.Action_3 FaultManager.Lambda2Error_Fault.Action_3_Condition FaultManager.Lambda2Error_Fault.Action_4 FaultManager.Lambda2Error_Fault.Action_4_Condition FaultManager.Lambda2Fault_Fault.Mode FaultManager.Lambda2Fault_Fault.ID FaultManager.Lambda2Fault_Fault.Test FaultManager.Lambda2Fault_Fault.Faulty_Samples__X_ FaultManager.Lambda2Fault_Fault.Total_Samples__Y_ FaultManager.Lambda2Fault_Fault.Action_1 FaultManager.Lambda2Fault_Fault.Action_1_Condition FaultManager.Lambda2Fault_Fault.Action_2 FaultManager.Lambda2Fault_Fault.Action_2_Condition FaultManager.Lambda2Fault_Fault.Action_3 FaultManager.Lambda2Fault_Fault.Action_3_Condition FaultManager.Lambda2Fault_Fault.Action_4 FaultManager.Lambda2Fault_Fault.Action_4_Condition FaultManager.Lambda2HtrOpen_Fault.Mode FaultManager.Lambda2HtrOpen_Fault.ID FaultManager.Lambda2HtrOpen_Fault.Test FaultManager.Lambda2HtrOpen_Fault.Faulty_Samples__X_ FaultManager.Lambda2HtrOpen_Fault.Total_Samples__Y_ FaultManager.Lambda2HtrOpen_Fault.Action_1 FaultManager.Lambda2HtrOpen_Fault.Action_1_Condition FaultManager.Lambda2HtrOpen_Fault.Action_2 FaultManager.Lambda2HtrOpen_Fault.Action_2_Condition FaultManager.Lambda2HtrOpen_Fault.Action_3 FaultManager.Lambda2HtrOpen_Fault.Action_3_Condition FaultManager.Lambda2HtrOpen_Fault.Action_4 FaultManager.Lambda2HtrOpen_Fault.Action_4_Condition FaultManager.Lambda2HtrShort_Fault.Mode FaultManager.Lambda2HtrShort_Fault.ID FaultManager.Lambda2HtrShort_Fault.Test FaultManager.Lambda2HtrShort_Fault.Faulty_Samples__X_ FaultManager.Lambda2HtrShort_Fault.Total_Samples__Y_ FaultManager.Lambda2HtrShort_Fault.Action_1 FaultManager.Lambda2HtrShort_Fault.Action_1_Condition FaultManager.Lambda2HtrShort_Fault.Action_2 FaultManager.Lambda2HtrShort_Fault.Action_2_Condition FaultManager.Lambda2HtrShort_Fault.Action_3 FaultManager.Lambda2HtrShort_Fault.Action_3_Condition FaultManager.Lambda2HtrShort_Fault.Action_4 FaultManager.Lambda2HtrShort_Fault.Action_4_Condition FaultManager.Lambda2Overcool_Fault.Mode FaultManager.Lambda2Overcool_Fault.ID FaultManager.Lambda2Overcool_Fault.Test FaultManager.Lambda2Overcool_Fault.Faulty_Samples__X_ FaultManager.Lambda2Overcool_Fault.Total_Samples__Y_ FaultManager.Lambda2Overcool_Fault.Action_1 FaultManager.Lambda2Overcool_Fault.Action_1_Condition FaultManager.Lambda2Overcool_Fault.Action_2 FaultManager.Lambda2Overcool_Fault.Action_2_Condition FaultManager.Lambda2Overcool_Fault.Action_3 FaultManager.Lambda2Overcool_Fault.Action_3_Condition FaultManager.Lambda2Overcool_Fault.Action_4 FaultManager.Lambda2Overcool_Fault.Action_4_Condition FaultManager.Lambda2Overheat_Fault.Mode FaultManager.Lambda2Overheat_Fault.ID FaultManager.Lambda2Overheat_Fault.Test FaultManager.Lambda2Overheat_Fault.Faulty_Samples__X_ FaultManager.Lambda2Overheat_Fault.Total_Samples__Y_ FaultManager.Lambda2Overheat_Fault.Action_1 FaultManager.Lambda2Overheat_Fault.Action_1_Condition FaultManager.Lambda2Overheat_Fault.Action_2 FaultManager.Lambda2Overheat_Fault.Action_2_Condition FaultManager.Lambda2Overheat_Fault.Action_3 FaultManager.Lambda2Overheat_Fault.Action_3_Condition FaultManager.Lambda2Overheat_Fault.Action_4 FaultManager.Lambda2Overheat_Fault.Action_4_Condition FaultManager.Lambda2StuckInReset_Fault.Mode FaultManager.Lambda2StuckInReset_Fault.ID FaultManager.Lambda2StuckInReset_Fault.Test FaultManager.Lambda2StuckInReset_Fault.Faulty_Samples__X_ FaultManager.Lambda2StuckInReset_Fault.Total_Samples__Y_ FaultManager.Lambda2StuckInReset_Fault.Action_1 FaultManager.Lambda2StuckInReset_Fault.Action_1_Condition FaultManager.Lambda2StuckInReset_Fault.Action_2 FaultManager.Lambda2StuckInReset_Fault.Action_2_Condition FaultManager.Lambda2StuckInReset_Fault.Action_3 FaultManager.Lambda2StuckInReset_Fault.Action_3_Condition FaultManager.Lambda2StuckInReset_Fault.Action_4 FaultManager.Lambda2StuckInReset_Fault.Action_4_Condition FaultManager.Lambda2StuckInWarmup_Fault.Mode FaultManager.Lambda2StuckInWarmup_Fault.ID FaultManager.Lambda2StuckInWarmup_Fault.Test FaultManager.Lambda2StuckInWarmup_Fault.Faulty_Samples__X_ FaultManager.Lambda2StuckInWarmup_Fault.Total_Samples__Y_ FaultManager.Lambda2StuckInWarmup_Fault.Action_1 FaultManager.Lambda2StuckInWarmup_Fault.Action_1_Condition FaultManager.Lambda2StuckInWarmup_Fault.Action_2 FaultManager.Lambda2StuckInWarmup_Fault.Action_2_Condition FaultManager.Lambda2StuckInWarmup_Fault.Action_3 FaultManager.Lambda2StuckInWarmup_Fault.Action_3_Condition FaultManager.Lambda2StuckInWarmup_Fault.Action_4 FaultManager.Lambda2StuckInWarmup_Fault.Action_4_Condition FaultManager.Lambda2VoltHigh_Fault.Mode FaultManager.Lambda2VoltHigh_Fault.ID /end DEF_CHARACTERISTIC
/end FUNCTION
/end MODULE
/end PROJECT
